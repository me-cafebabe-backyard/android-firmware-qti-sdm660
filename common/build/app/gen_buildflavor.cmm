ENTRY &ARG0

GLOBAL &HLOS_TYPE
GLOBAL &TZ_BUILDID
GLOBAL &T32_VER
GLOBAL &CHIPID
GLOBAL &MODEM_BUILDID
GLOBAL &T32_VER_PATH_QIPL
GLOBAL &T32_VER_PATH_SD
GLOBAL &BDWLAN07_BINARY
GLOBAL &MPSS_ELF
GLOBAL &BDWLAN0a_BINARY
GLOBAL &CPE_ELF
GLOBAL &KEYMASTER_BINARY
GLOBAL &BDWLAN34_BINARY
GLOBAL &BDWLAN36_BINARY
GLOBAL &STORESEC_BINARY
GLOBAL &BDWLAN33_BINARY
GLOBAL &APPS_ELF
GLOBAL &GFX_ELF
GLOBAL &MPSS_BINARY
GLOBAL &CMNLIB64_BINARY
GLOBAL &APPSBOOT_BINARY
GLOBAL &MBA_ELF
GLOBAL &BDWLAN108_BINARY
GLOBAL &MBA_BINARY
GLOBAL &ADSP_SENSOR_ELF
GLOBAL &CMNLIB_BINARY
GLOBAL &BDWLAN107_BINARY
GLOBAL &BDWLAN37_BINARY
GLOBAL &QSEE_ELF
GLOBAL &BDWLAN109_BINARY
GLOBAL &BDWLAN102_BINARY
GLOBAL &RPM_ELF
GLOBAL &HYP_BINARY
GLOBAL &CPE_BINARY
GLOBAL &MPSS_QDB_BINARY
GLOBAL &APPS_BINARY
GLOBAL &VENUS_ELF
GLOBAL &BDWLAN104_BINARY
GLOBAL &BDWLAN105_BINARY
GLOBAL &BDWLAN_BINARY
GLOBAL &BDWLAN0e_BINARY
GLOBAL &BDWLAN0b_BINARY
GLOBAL &BDWLAN09_BINARY
GLOBAL &MON_ELF
GLOBAL &BDWLAN31_BINARY
GLOBAL &BDWLAN30_BINARY
GLOBAL &DataMsc_BINARY
GLOBAL &BDWLAN14_BINARY
GLOBAL &TZ_BINARY
GLOBAL &BDWLAN32_BINARY
GLOBAL &BDWLAN04_BINARY
GLOBAL &BOOT_ELF
GLOBAL &RPM_BINARY
GLOBAL &TZDEVCFG_BINARY
GLOBAL &CDSP_BINARY
GLOBAL &BDWLAN35_BINARY
GLOBAL &PMIC_BINARY
GLOBAL &BDWLAN0d_BINARY
GLOBAL &ADSP_PD2_ELF
GLOBAL &VENUS_BINARY
GLOBAL &BDWLAN0f_BINARY
GLOBAL &ADSP_BINARY
GLOBAL &HYP_ELF
GLOBAL &BDWLAN106_BINARY
GLOBAL &ADSP_ELF
GLOBAL &CDSP_ELF
GLOBAL &BOOT_BINARY

IF ("&ARG0"=="asic")
(
	&PRODUCT_FLAVOR="asic"
	&HLOS_TYPE="LA"
	&TZ_BUILDID="KAJAANAA"
	&T32_VER="LT161216"
	&CHIPID="sdm660"
	&MODEM_BUILDID="sdm660.gen.prod"
	&T32_VER_PATH_QIPL="\\king\starlord_bringup\SDM660_Softwares_and_Drivers\SDM660_Bringup\T32_software\LT161216"
	&T32_VER_PATH_SD="\\qctdfsrt\prj\dsp\qdsptools\qdsp6_sw_release\TRACE32\Run\LT161216"
	&BDWLAN07_BINARY="wlan_proc/wlan/halphy_tools/host/bdfUtil/qca61x0/bdf/bdwlan.b07"
	&MPSS_ELF="modem_proc/build/ms/M660sdm660.gen.prodQ00007.elf"
	&MPSS_ELF="modem_proc/build/ms/M660sdm660.gen.prodQ00007_ELF_LOADER_reloc.elf"
	&MPSS_ELF="modem_proc/build/ms/M660sdm660.gen.prodQ00007_MCFG_HW.elf"
	&MPSS_ELF="modem_proc/build/ms/M660sdm660.gen.prodQ00007_DEVCFG.elf"
	&MPSS_ELF="modem_proc/build/ms/M660sdm660.gen.prodQ00007_ELF_LOADER.elf"
	&MPSS_ELF="modem_proc/build/ms/M660sdm660.gen.prodQ00007_MCFG_SW.elf"
	&MPSS_ELF="modem_proc/build/ms/M660sdm660.gen.prodQ00007_reloc.elf"
	&MPSS_ELF="modem_proc/build/ms/M660sdm660.gen.prodQ00007_NODEVCFG.elf"
	&BDWLAN0a_BINARY="wlan_proc/wlan/halphy_tools/host/bdfUtil/qca61x0/bdf/bdwlan.b0a"
	&CPE_ELF="cpe_proc/build/bsp/cpe_link/build/AAAAAAAA/CPE_PROC_IMG_AAAAAAAAQ.elf"
	&CPE_ELF="wdsp_proc/build/bsp/cpe_link/build/AAAAAAAA/CPE_PROC_IMG_AAAAAAAAQ.elf"
	&KEYMASTER_BINARY="trustzone_images/build/ms/bin/KAJAANAA/km4.mbn"
	&BDWLAN34_BINARY="wlan_proc/wlan/halphy_tools/host/bdfUtil/qca61x0/bdf/bdwlan.b34"
	&BDWLAN36_BINARY="wlan_proc/wlan/halphy_tools/host/bdfUtil/qca61x0/bdf/bdwlan.b36"
	&STORESEC_BINARY="trustzone_images/build/ms/bin/KAJAANAA/storsec.mbn"
	&BDWLAN33_BINARY="wlan_proc/wlan/halphy_tools/host/bdfUtil/qca61x0/bdf/bdwlan.b33"
	&APPS_ELF="out/target/product/sdm660_64/obj/KERNEL_OBJ/vmlinux"
	&GFX_ELF="out/target/product/sdm660_64/vendor/firmware/a512_zap.elf"
	&MPSS_BINARY="modem_proc/build/ms/bin/sdm660.gen.prod/qdsp6sw.mbn"
	&CMNLIB64_BINARY="trustzone_images/build/ms/bin/KAJAANAA/cmnlib64.mbn"
	&APPSBOOT_BINARY="out/target/product/sdm660_64/abl.elf"
	&MBA_ELF="modem_proc/core/bsp/mba_img/build/sdm660.gen.prod/MBA_CORE_IMG_sdm660.gen.prodQ.elf"
	&BDWLAN108_BINARY="wlan_proc/wlan/halphy_tools/host/bdfUtil/qca61x0/bdf/bdwlan.108"
	&MBA_BINARY="modem_proc/build/ms/bin/sdm660.gen.prod/mba.mbn"
	&ADSP_SENSOR_ELF="adsp_proc/build/ms/SENSOR_660.adsp.prodQ.elf"
	&CMNLIB_BINARY="trustzone_images/build/ms/bin/KAJAANAA/cmnlib.mbn"
	&BDWLAN107_BINARY="wlan_proc/wlan/halphy_tools/host/bdfUtil/qca61x0/bdf/bdwlan.107"
	&BDWLAN37_BINARY="wlan_proc/wlan/halphy_tools/host/bdfUtil/qca61x0/bdf/bdwlan.b37"
	&QSEE_ELF="trustzone_images/core/bsp/qsee/build/KAJAANAA/qsee.elf"
	&BDWLAN109_BINARY="wlan_proc/wlan/halphy_tools/host/bdfUtil/qca61x0/bdf/bdwlan.109"
	&BDWLAN102_BINARY="wlan_proc/wlan/halphy_tools/host/bdfUtil/qca61x0/bdf/bdwlan.102"
	&RPM_ELF="rpm_proc/core/bsp/rpm/build/RPM_AAAAANAZR.elf"
	&HYP_BINARY="trustzone_images/build/ms/bin/KAJAANAA/hyp.mbn"
	&CPE_BINARY="cpe_proc/build/ms/bin/AAAAAAAAQ/cpe_9335.mbn"
	&MPSS_QDB_BINARY="modem_proc/build/ms/bin/sdm660.gen.prod/qdsp6m.qdb"
	&APPS_BINARY="out/target/product/sdm660_64/boot.img"
	&APPS_BINARY="out/target/product/sdm660_64/super.img"
	&VENUS_ELF="venus_proc/build/bsp/asic/build/PROD/venus.elf"
	&BDWLAN104_BINARY="wlan_proc/wlan/halphy_tools/host/bdfUtil/qca61x0/bdf/bdwlan.104"
	&BDWLAN105_BINARY="wlan_proc/wlan/halphy_tools/host/bdfUtil/qca61x0/bdf/bdwlan.105"
	&BDWLAN_BINARY="wlan_proc/wlan/halphy_tools/host/bdfUtil/qca61x0/bdf/bdwlan.bin"
	&BDWLAN0e_BINARY="wlan_proc/wlan/halphy_tools/host/bdfUtil/qca61x0/bdf/bdwlan.b0e"
	&BDWLAN0b_BINARY="wlan_proc/wlan/halphy_tools/host/bdfUtil/qca61x0/bdf/bdwlan.b0b"
	&BDWLAN09_BINARY="wlan_proc/wlan/halphy_tools/host/bdfUtil/qca61x0/bdf/bdwlan.b09"
	&MON_ELF="trustzone_images/core/bsp/monitor/build/KAJAANAA/mon.elf"
	&BDWLAN31_BINARY="wlan_proc/wlan/halphy_tools/host/bdfUtil/qca61x0/bdf/bdwlan.b31"
	&BDWLAN30_BINARY="wlan_proc/wlan/halphy_tools/host/bdfUtil/qca61x0/bdf/bdwlan.b30"
	&DataMsc_BINARY="wlan_proc/build/ms/Data.msc"
	&BDWLAN14_BINARY="wlan_proc/wlan/halphy_tools/host/bdfUtil/qca61x0/bdf/bdwlan.b14"
	&TZ_BINARY="trustzone_images/build/ms/bin/KAJAANAA/tz.mbn"
	&BDWLAN32_BINARY="wlan_proc/wlan/halphy_tools/host/bdfUtil/qca61x0/bdf/bdwlan.b32"
	&BDWLAN04_BINARY="wlan_proc/wlan/halphy_tools/host/bdfUtil/qca61x0/bdf/bdwlan.b04"
	&RPM_BINARY="rpm_proc/build/ms/bin/AAAAANAZR/rpm.mbn"
	&TZDEVCFG_BINARY="trustzone_images/build/ms/bin/KAJAANAA/devcfg.mbn"
	&CDSP_BINARY="cdsp_proc/obj/qdsp6v5_ReleaseG/660.cdsp.prod/cdsp.mbn"
	&BDWLAN35_BINARY="wlan_proc/wlan/halphy_tools/host/bdfUtil/qca61x0/bdf/bdwlan.b35"
	&PMIC_BINARY="boot_images/QcomPkg/Sdm660Pkg/Bin/660/LA/RELEASE/pmic.elf"
	&BDWLAN0d_BINARY="wlan_proc/wlan/halphy_tools/host/bdfUtil/qca61x0/bdf/bdwlan.b0d"
	&ADSP_PD2_ELF="adsp_proc/build/ms/AUDIO_660.adsp.prodQ.elf"
	&VENUS_BINARY="venus_proc/build/bsp/asic/build/PROD/mbn/reloc/socCheck/signed/venus.mbn"
	&BDWLAN0f_BINARY="wlan_proc/wlan/halphy_tools/host/bdfUtil/qca61x0/bdf/bdwlan.b0f"
	&ADSP_BINARY="adsp_proc/obj/qdsp6v5_ReleaseG/660.adsp.prod/adsp.mbn"
	&HYP_ELF="trustzone_images/core/bsp/hypervisor/build/KAJAANAA/hyp.elf"
	&BDWLAN106_BINARY="wlan_proc/wlan/halphy_tools/host/bdfUtil/qca61x0/bdf/bdwlan.106"
	&ADSP_ELF="adsp_proc/build/ms/ROOT_660.adsp.prodQ.elf"
	&CDSP_ELF="cdsp_proc/build/ms/ROOT_660.cdsp.prodQ.elf"
	&BOOT_BINARY="boot_images/QcomPkg/Sdm660Pkg/Bin/660/LA/RELEASE/xbl.elf"
)
ENDDO