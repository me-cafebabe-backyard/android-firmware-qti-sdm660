////////////////////////////////////////////////////////////////////
//                                                                //
//  File: std_rootcmm_menu_APPS-ARMV8-WP_internal.cmm     
//  Contains T32 script set-up for APPS-ARMV8-WP subsystem      
//  Autogenerated - Do not edit!                                  //
//  Created: 30-03-2020,01.16.57                                  //
//                                                                //
////////////////////////////////////////////////////////////////////

//###################Arguments passed #####################            
LOCAL &ArgumentLine                                                    
ENTRY %LINE &ArgumentLine                                              
LOCAL &UTILITY &therest                                                
ENTRY &UTILITY %LINE &therest                                          
                                                                       
                                                                       
//#####################Select Subroutine###################            
// Name of the utility we are calling                                  
// Input Argument 0 is the name of the utility                         
LOCAL &SUBROUTINE                                                      
&SUBROUTINE="&UTILITY"                                                 
IF !(("&SUBROUTINE"=="CREATEMENU")||("&SUBROUTINE"=="ADDMENUBUTTONS")||("&SUBROUTINE"=="HELP")||("&SUBROUTINE"=="help")) 
(                                                                      
    &SUBROUTINE="MAIN"                                                 
    GOSUB MAIN &ArgumentLine                                           
)                                                                      
ELSE                                                                   
(                                                                      
    // Call the required utility                                       
    GOSUB &SUBROUTINE &therest                                         
)                                                                      
                                                                       
    LOCAL &rvalue                                                      
    ENTRY %LINE &rvalue                                                
                                                                       
    //Remove error handler if it was set                               
    ON ERROR                                                           
                                                                       
    GOSUB EXIT &rvalue                                                 
                                                                       
////////////////////////////////////////                               
//                                                                     
//            MAIN                                                     
//            Main std_rootcmm_menu_APPS-ARMV8-WP_internal.cmm logic                                  
//                                                                     
/////////////////////////////////////////                              
MAIN:                                                                  
     LOCAL &arg0 &therest                                               
     ENTRY &arg0 %LINE &therest                                       
                                                                       
     ON ERROR GOSUB HELP                                                
     GOSUB &arg0 &therest                                                
     ON ERROR                                                          
     LOCAL &rvalue                                                     
     ENTRY &rvalue                                                      
     IF ("&rvalue"=="")                                             
     (                                                                  
         &rvalue="SUCCESS"                                           
     )                                                                 
     RETURN &rvalue                                                    
                                                                       
 
 
////////////////////////////////////////                               
//                                                                     
//            CREATEMENU                                                     
//            Creates dropdown menu for Qualcomm Scripts                  
//                                                                     
/////////////////////////////////////////                              
CREATEMENU:                                                            
 
		MENU.REPROGRAM
		(
			ADD 
			MENU 
			( 
				POPUP "[:CORRELATE]&Qualcomm Scripts" 
				( 
					POPUP "[:PSTEP]&general" 
					( 
						POPUP "[:PSTEP]&general" 
						( 
							MENUITEM "[:FLASH]&Attach And Break Processor " 
							( 
ATTACHMANAGER-BREAK:
								LOCAL &invocationtype
								ENTRY &invocationtype
								do std_utils EXECUTESCRIPT ERRORHANDLE &METATOOLSDIR/general/attachmanager.cmm break MSM8998 

								IF ("&invocationtype"=="BUTTONPROMPT")
								(
									RETURN
								)

							)
							MENUITEM "[:FLASH]&Load Symbols " 
							( 
SYMBOLMANAGER-LOADSYMS:
								LOCAL &invocationtype
								ENTRY &invocationtype
								do std_utils EXECUTESCRIPT ERRORHANDLE &METATOOLSDIR/general/symbolmanager.cmm APPS-ARMV8-WP all 

								IF ("&invocationtype"=="BUTTONPROMPT")
								(
									RETURN
								)

							)
							MENUITEM "[:FLASH]&Debug Menu " 
							( 
STDDEBUG:
								LOCAL &invocationtype
								ENTRY &invocationtype
								do std_utils EXECUTESCRIPT ERRORHANDLE &METATOOLSDIR/../cmm/common/std_debug.cmm 

								IF ("&invocationtype"=="BUTTONPROMPT")
								(
									RETURN
								)

							)
							MENUITEM "[:FLASH]&Load HWIO Symbols " 
							( 
MAINHWIOSCRIPT:
								LOCAL &invocationtype
								ENTRY &invocationtype
								do std_utils EXECUTESCRIPT ERRORHANDLE &METATOOLSDIR/../cmm/common/MSM8998/hwio.cmm 

								IF ("&invocationtype"=="BUTTONPROMPT")
								(
									RETURN
								)

							)
							MENUITEM "[:FLASH]&Build Options " 
							( 
STDLOADBUILD:
								LOCAL &invocationtype
								ENTRY &invocationtype
								do std_utils EXECUTESCRIPT ERRORHANDLE &METATOOLSDIR/../cmm/common/MSM8998/std_buildoptions.cmm 

								IF ("&invocationtype"=="BUTTONPROMPT")
								(
									RETURN
								)

							)
							MENUITEM "[:FLASH]&Attach to Processor " 
							( 
ATTACHMANAGER-ATTACH:
								LOCAL &invocationtype
								ENTRY &invocationtype
								do std_utils EXECUTESCRIPT ERRORHANDLE &METATOOLSDIR/general/attachmanager.cmm attach MSM8998 

								IF ("&invocationtype"=="BUTTONPROMPT")
								(
									RETURN
								)

							)
						) 
					) 
					POPUP "[:PSTEP]&hwengines" 
					( 
						POPUP "[:PSTEP]&tsens" 
						( 
							MENUITEM "[:FLASH]&TSENS Temperatures " 
							( 
TSENS_TEMPS:
								LOCAL &invocationtype
								ENTRY &invocationtype
								do std_utils EXECUTESCRIPT ERRORHANDLE &METATOOLSDIR/general/attachmanager.cmm attach MSM8998 
								do std_utils EXECUTESCRIPT ERRORHANDLE &METATOOLSDIR/hwengines/tsens/MSM8998/tsens_read.cmm 

								IF ("&invocationtype"=="BUTTONPROMPT")
								(
									RETURN
								)

							)
						) 
						POPUP "[:PSTEP]&epm" 
						( 
							MENUITEM "[:ACONFIG]&ALPACA GUI " 
							( 
ALPACA_GUI:
								LOCAL &invocationtype
								ENTRY &invocationtype
								do std_utils EXECUTESCRIPT ERRORHANDLE &METATOOLSDIR/hwengines/epm/alpaca.exe 

								IF ("&invocationtype"=="BUTTONPROMPT")
								(
									RETURN
								)

							)
						) 
					) 
					POPUP "[:PSTEP]&qdss" 
					( 
						POPUP "[:PSTEP]&qdss" 
						( 
							MENUITEM "[:FLASH]&MPSS to SNOC probe " 
							( 
MPSS_TO_SNOC_PROBE:
								LOCAL &invocationtype
								ENTRY &invocationtype
								do std_utils EXECUTESCRIPT ERRORHANDLE &METATOOLSDIR/general/attachmanager.cmm attach MSM8998 
								do std_utils EXECUTESCRIPT ERRORHANDLE &METATOOLSDIR/qdss/MSM8998/funnel_config.cmm 
								do std_utils EXECUTESCRIPT ERRORHANDLE &METATOOLSDIR/qdss/MSM8998/mpss_to_rpm_cnoc_probe.cmm 
								do std_utils EXECUTESCRIPT ERRORHANDLE &METATOOLSDIR/general/postscriptprompt.cmm MPSS to SNOC probe
								do std_utils EXECUTESCRIPT ERRORHANDLE &METATOOLSDIR/qdss/MSM8998/dump_etb.cmm 

								IF ("&invocationtype"=="BUTTONPROMPT")
								(
									RETURN
								)

							)
							MENUITEM "[:FLASH]&GladiatorTrace " 
							( 
GLADIATORTRACE:
								LOCAL &invocationtype
								ENTRY &invocationtype
								do std_utils EXECUTESCRIPT ERRORHANDLE &METATOOLSDIR/general/attachmanager.cmm attach MSM8998 
								do std_utils EXECUTESCRIPT ERRORHANDLE &METATOOLSDIR/qdss/gladiatortrace/MSM8998/Gladiator_Debug_Suite.cmm 

								IF ("&invocationtype"=="BUTTONPROMPT")
								(
									RETURN
								)

							)
							MENUITEM "[:FLASH]&Dump ETB " 
							( 
DUMP_ETB:
								LOCAL &invocationtype
								ENTRY &invocationtype
								do std_utils EXECUTESCRIPT ERRORHANDLE &METATOOLSDIR/general/attachmanager.cmm attach MSM8998 
								do std_utils EXECUTESCRIPT ERRORHANDLE &METATOOLSDIR/qdss/MSM8998/dump_etb.cmm &TEMP/etb_dump.bin 

								IF ("&invocationtype"=="BUTTONPROMPT")
								(
									RETURN
								)

							)
						) 
					) 
					POPUP "[:PSTEP]&sve" 
					( 
						POPUP "[:PSTEP]&pimemtrace" 
						( 
							MENUITEM "[:FLASH]&PIMEM Trace BC - APB " 
							( 
PIMEM_TRACE_BC_-_APB:
								LOCAL &invocationtype
								ENTRY &invocationtype
								do std_utils EXECUTESCRIPT ERRORHANDLE &METATOOLSDIR/general/attachmanager.cmm attach MSM8998 
								do std_utils EXECUTESCRIPT ERRORHANDLE &METATOOLSDIR/sve/pimem_TPDM/MSM8998/trace_tpdm_wrapper.cmm 
								LOCAL &traceID
								ENTRY &traceID
								do std_utils EXECUTESCRIPT ERRORHANDLE &METATOOLSDIR/sve/pimem_TPDM/MSM8998/trace_tpdmBC_pimem.cmm &traceID APB 
								do std_utils EXECUTESCRIPT ERRORHANDLE &METATOOLSDIR/general/postscriptprompt.cmm PIMEM Trace BC - APB
								do std_utils EXECUTESCRIPT ERRORHANDLE &METATOOLSDIR/qdss/MSM8998/dump_etb.cmm &TEMP/Pimem_BC_APB_ETB_Dump.bin 

								IF ("&invocationtype"=="BUTTONPROMPT")
								(
									RETURN
								)

							)
							MENUITEM "[:FLASH]&PIMEM Trace CMB " 
							( 
PIMEM_TRACE_CMB:
								LOCAL &invocationtype
								ENTRY &invocationtype
								do std_utils EXECUTESCRIPT ERRORHANDLE &METATOOLSDIR/general/attachmanager.cmm attach MSM8998 
								do std_utils EXECUTESCRIPT ERRORHANDLE &METATOOLSDIR/sve/pimem_TPDM/MSM8998/trace_tpdm_wrapper.cmm 
								LOCAL &traceID
								ENTRY &traceID
								do std_utils EXECUTESCRIPT ERRORHANDLE &METATOOLSDIR/sve/pimem_TPDM/MSM8998/trace_tpdmCMB_pimem.cmm &traceID 0xF0F 
								do std_utils EXECUTESCRIPT ERRORHANDLE &METATOOLSDIR/general/postscriptprompt.cmm PIMEM Trace CMB
								do std_utils EXECUTESCRIPT ERRORHANDLE &METATOOLSDIR/qdss/MSM8998/dump_etb.cmm Pimem_CMB_ETB_Dump.bin 

								IF ("&invocationtype"=="BUTTONPROMPT")
								(
									RETURN
								)

							)
							MENUITEM "[:FLASH]&PIMEM Trace BC - ATB " 
							( 
PIMEM_TRACE_BC_-_ATB:
								LOCAL &invocationtype
								ENTRY &invocationtype
								do std_utils EXECUTESCRIPT ERRORHANDLE &METATOOLSDIR/general/attachmanager.cmm attach MSM8998 
								do std_utils EXECUTESCRIPT ERRORHANDLE &METATOOLSDIR/sve/pimem_TPDM/MSM8998/trace_tpdm_wrapper.cmm 
								LOCAL &traceID
								ENTRY &traceID
								do std_utils EXECUTESCRIPT ERRORHANDLE &METATOOLSDIR/sve/pimem_TPDM/MSM8998/trace_tpdmBC_pimem.cmm &traceID ATB 
								do std_utils EXECUTESCRIPT ERRORHANDLE &METATOOLSDIR/general/postscriptprompt.cmm PIMEM Trace BC - ATB
								do std_utils EXECUTESCRIPT ERRORHANDLE &METATOOLSDIR/qdss/MSM8998/dump_etb.cmm &TEMP/Pimem_BC_ATB_ETB_Dump.bin 

								IF ("&invocationtype"=="BUTTONPROMPT")
								(
									RETURN
								)

							)
						) 
						POPUP "[:PSTEP]&DragonLink" 
						( 
							MENUITEM "[:FLASH]&Dragonlink OLC " 
							( 
DRAGONLINK_OLC:
								LOCAL &invocationtype
								ENTRY &invocationtype
								do std_utils EXECUTESCRIPT ERRORHANDLE &METATOOLSDIR/general/attachmanager.cmm attach MSM8998 
								do std_utils EXECUTESCRIPT ERRORHANDLE &METATOOLSDIR/sve/dragonlink/MSM8998/cpuss_dragonlink_olc.cmm 
								do std_utils EXECUTESCRIPT ERRORHANDLE &METATOOLSDIR/general/postscriptprompt.cmm Dragonlink OLC
								do std_utils EXECUTESCRIPT ERRORHANDLE &METATOOLSDIR/sve/pimem_TPDM/MSM8998/trace_tpdm_wrapper.cmm 
								LOCAL &traceID
								ENTRY &traceID
								do std_utils EXECUTESCRIPT ERRORHANDLE &METATOOLSDIR/sve/dragonlink/etb_to_bin.py &traceID &TEMP/etb_dump.bin 
								do std_utils EXECUTESCRIPT ERRORHANDLE &METATOOLSDIR/../cmm/common/std_utils.cmm DELAYSECONDS 15 
								do std_utils EXECUTESCRIPT ERRORHANDLE &METATOOLSDIR/sve/dragonlink/parse_cpuss_dsb.py &TEMP/parsed_etbdump.bin 

								IF ("&invocationtype"=="BUTTONPROMPT")
								(
									RETURN
								)

							)
							MENUITEM "[:FLASH]&Dragonlink " 
							( 
DRAGONLINK_COPY_AND_PEDIT_UTILITY:
								LOCAL &invocationtype
								ENTRY &invocationtype
								do std_utils EXECUTESCRIPT ERRORHANDLE &METATOOLSDIR/general/attachmanager.cmm attach MSM8998 
								do std_utils EXECUTESCRIPT ERRORHANDLE &METATOOLSDIR/../cmm/common/std_utils.cmm FILECOPIER &METATOOLSDIR/sve/dragonlink/MSM8998/cpuss_dragonlink.cmm &TEMP/cpuss_dragonlink_local.cmm 
								do std_utils EXECUTESCRIPT ERRORHANDLE &METATOOLSDIR/general/generaldialog.cmm DIALOGMESSAGE A copy of dragonlink.cmm has been copied to &TEMP/cpuss_dragonlink_local.cmm. Open that file, modify it per instructions, and then press continue 
								do std_utils EXECUTESCRIPT ERRORHANDLE &TEMP/cpuss_dragonlink_local.cmm 
								do std_utils EXECUTESCRIPT ERRORHANDLE &METATOOLSDIR/general/postscriptprompt.cmm 
								do std_utils EXECUTESCRIPT ERRORHANDLE &TEMP/etb_dump.bin/dump_etb.cmm &TEMP/etbdump.bin 
								do std_utils EXECUTESCRIPT ERRORHANDLE &METATOOLSDIR/sve/pimem_TPDM/MSM8998/trace_tpdm_wrapper.cmm 
								LOCAL &traceID
								ENTRY &traceID
								do std_utils EXECUTESCRIPT ERRORHANDLE &METATOOLSDIR/sve/dragonlink/etb_to_bin.py &traceID &TEMP/etb_dump.bin 
								do std_utils EXECUTESCRIPT ERRORHANDLE &METATOOLSDIR/../cmm/common/std_utils.cmm DELAYSECONDS 15 
								do std_utils EXECUTESCRIPT ERRORHANDLE &METATOOLSDIR/sve/dragonlink/parse_cpuss_dsb.py &TEMP/parsed_etbdump.bin 

								IF ("&invocationtype"=="BUTTONPROMPT")
								(
									RETURN
								)

							)
						) 
					) 
					POPUP "[:PSTEP]&systemdrivers" 
					( 
						POPUP "[:PSTEP]&vcs" 
						( 
							MENUITEM "[:FLASH]&VCS " 
							( 
VCS:
								LOCAL &invocationtype
								ENTRY &invocationtype
								do std_utils EXECUTESCRIPT ERRORHANDLE &METATOOLSDIR/systemdrivers/vcs/vcs.cmm 

								IF ("&invocationtype"=="BUTTONPROMPT")
								(
									RETURN
								)

							)
						) 
						POPUP "[:PSTEP]&clock" 
						( 
							MENUITEM "[:FLASH]&Clock Driver " 
							( 
CLOCKDRIVER_8998:
								LOCAL &invocationtype
								ENTRY &invocationtype
								do std_utils EXECUTESCRIPT ERRORHANDLE &METATOOLSDIR/systemdrivers/clock/ClockDriver.cmm 

								IF ("&invocationtype"=="BUTTONPROMPT")
								(
									RETURN
								)

							)
							MENUITEM "[:FLASH]&testclock " 
							( 
TESTCLOCK_8998:
								LOCAL &invocationtype
								ENTRY &invocationtype
								do std_utils EXECUTESCRIPT ERRORHANDLE &METATOOLSDIR/systemdrivers/clock/MSM8998/testclock.cmm 

								IF ("&invocationtype"=="BUTTONPROMPT")
								(
									RETURN
								)

							)
							MENUITEM "[:FLASH]&testpll " 
							( 
TESTPLL_8998:
								LOCAL &invocationtype
								ENTRY &invocationtype
								do std_utils EXECUTESCRIPT ERRORHANDLE &METATOOLSDIR/systemdrivers/clock/MSM8998/testpll.cmm 

								IF ("&invocationtype"=="BUTTONPROMPT")
								(
									RETURN
								)

							)
						) 
						POPUP "[:PSTEP]&pmic" 
						( 
							MENUITEM "[:FLASH]&PMIC Dump " 
							( 
PMIC_DUMP:
								LOCAL &invocationtype
								ENTRY &invocationtype
								do std_utils EXECUTESCRIPT ERRORHANDLE &METATOOLSDIR/general/attachmanager.cmm attach MSM8998 
								do std_utils EXECUTESCRIPT ERRORHANDLE &METATOOLSDIR/systemdrivers/pmic/honeybadger/PMICDump.cmm 

								IF ("&invocationtype"=="BUTTONPROMPT")
								(
									RETURN
								)

							)
							MENUITEM "[:FLASH]&PMIC Registers " 
							( 
PMIC_REGISTERS:
								LOCAL &invocationtype
								ENTRY &invocationtype
								do std_utils EXECUTESCRIPT ERRORHANDLE &METATOOLSDIR/general/attachmanager.cmm attach MSM8998 
								do std_utils EXECUTESCRIPT ERRORHANDLE &METATOOLSDIR/systemdrivers/pmic/honeybadger/PMICRegisters.cmm  

								IF ("&invocationtype"=="BUTTONPROMPT")
								(
									RETURN
								)

							)
							MENUITEM "[:FLASH]&PMIC Dashboard " 
							( 
PMIC_DASHBOARD:
								LOCAL &invocationtype
								ENTRY &invocationtype
								do std_utils EXECUTESCRIPT ERRORHANDLE &METATOOLSDIR/general/attachmanager.cmm attach MSM8998 
								do std_utils EXECUTESCRIPT ERRORHANDLE &METATOOLSDIR/systemdrivers/pmic/honeybadger/PMICDashBoard.cmm 

								IF ("&invocationtype"=="BUTTONPROMPT")
								(
									RETURN
								)

							)
							MENUITEM "[:FLASH]&PMIC Warm Reset " 
							( 
PMIC_WARM_RESET:
								LOCAL &invocationtype
								ENTRY &invocationtype
								do std_utils EXECUTESCRIPT ERRORHANDLE &METATOOLSDIR/general/attachmanager.cmm attach MSM8998 
								do std_utils EXECUTESCRIPT ERRORHANDLE &METATOOLSDIR/systemdrivers/pmic/PMICReset.cmm WARMRESET 

								IF ("&invocationtype"=="BUTTONPROMPT")
								(
									RETURN
								)

							)
							MENUITEM "[:FLASH]&PMIC Peek " 
							( 
PMIC_PEEK:
								LOCAL &invocationtype
								ENTRY &invocationtype
								do std_utils EXECUTESCRIPT ERRORHANDLE &METATOOLSDIR/general/attachmanager.cmm attach MSM8998 
								do std_utils EXECUTESCRIPT ERRORHANDLE &METATOOLSDIR/systemdrivers/pmic/honeybadger/PMICPeek.cmm 

								IF ("&invocationtype"=="BUTTONPROMPT")
								(
									RETURN
								)

							)
							MENUITEM "[:FLASH]&PBUS Logger " 
							( 
PBUS_LOGGER:
								LOCAL &invocationtype
								ENTRY &invocationtype
								do std_utils EXECUTESCRIPT ERRORHANDLE &METATOOLSDIR/general/attachmanager.cmm attach MSM8998 
								do std_utils EXECUTESCRIPT ERRORHANDLE &METATOOLSDIR/systemdrivers/pmic/honeybadger/PBUSLogger.cmm 

								IF ("&invocationtype"=="BUTTONPROMPT")
								(
									RETURN
								)

							)
							MENUITEM "[:FLASH]&PMIC Hard Reset " 
							( 
PMIC_HARD_RESET:
								LOCAL &invocationtype
								ENTRY &invocationtype
								do std_utils EXECUTESCRIPT ERRORHANDLE &METATOOLSDIR/general/attachmanager.cmm attach MSM8998 
								do std_utils EXECUTESCRIPT ERRORHANDLE &METATOOLSDIR/systemdrivers/pmic/PMICReset.cmm HARDRESET 

								IF ("&invocationtype"=="BUTTONPROMPT")
								(
									RETURN
								)

							)
						) 
						POPUP "[:PSTEP]&hwio" 
						( 
							MENUITEM "[:FLASH]&View HWIO Registers " 
							( 
VIEW_HWIO_REGISTERS:
								LOCAL &invocationtype
								ENTRY &invocationtype
								do std_utils EXECUTESCRIPT ERRORHANDLE &METATOOLSDIR/systemdrivers/hwio/HWIORegisters.cmm MSM8998 

								IF ("&invocationtype"=="BUTTONPROMPT")
								(
									RETURN
								)

							)
						) 
					) 
					POPUP "[:PSTEP]&tz" 
					( 
						POPUP "[:PSTEP]&tz" 
						( 
							MENUITEM "[:FLASH]&Load TZ elfs " 
							( 
LOAD_TZ_ELFS:
								LOCAL &invocationtype
								ENTRY &invocationtype
								do std_utils EXECUTESCRIPT ERRORHANDLE &METATOOLSDIR/tz/load_qsee_elf.cmm &TZ_BUILDROOT &TZ_BUILDID 

								IF ("&invocationtype"=="BUTTONPROMPT")
								(
									RETURN
								)

							)
							MENUITEM "[:FLASH]&SMMU Fault parser " 
							( 
SMMU_FAULT_PARSER:
								LOCAL &invocationtype
								ENTRY &invocationtype
								do std_utils EXECUTESCRIPT ERRORHANDLE &METATOOLSDIR/general/attachmanager.cmm attach MSM8998 
								do std_utils EXECUTESCRIPT ERRORHANDLE &METATOOLSDIR/tz/smmu/MSM8998/smmu_debug_fault.cmm 

								IF ("&invocationtype"=="BUTTONPROMPT")
								(
									RETURN
								)

							)
							MENUITEM "[:FLASH]&Print TZ Log " 
							( 
PRINT_TZ_LOG:
								LOCAL &invocationtype
								ENTRY &invocationtype
								do std_utils EXECUTESCRIPT ERRORHANDLE &METATOOLSDIR/tz/tzlogs/print_tz_log.cmm &TZ_BUILDROOT MSM8998 

								IF ("&invocationtype"=="BUTTONPROMPT")
								(
									RETURN
								)

							)
							MENUITEM "[:FLASH]&Stage 2 pagetable walker " 
							( 
STAGE_2_PAGETABLE_WALKER:
								LOCAL &invocationtype
								ENTRY &invocationtype
								do std_utils EXECUTESCRIPT ERRORHANDLE &METATOOLSDIR/general/attachmanager.cmm attach MSM8998 
								do std_utils EXECUTESCRIPT ERRORHANDLE &METATOOLSDIR/tz/smmu/MSM8998/dump_pt.cmm 

								IF ("&invocationtype"=="BUTTONPROMPT")
								(
									RETURN
								)

							)
						) 
					) 
				) 
			) 
		) 
	
	RETURN SUCCESS


 
 
////////////////////////////////////////                               
//                                                                     
//            ADDMENUBUTTONS                                                     
//            Creates dropdown menu for Qualcomm Scripts                  
//                                                                     
/////////////////////////////////////////                              
ADDMENUBUTTONS:                                                            
	 
		 
			MENU.ADDTOOL "testclock" "_,X,:time" "DO std_utils EXECUTESCRIPT ERRORHANDLE &METATOOLSDIR/MSM8998/std_rootcmm_menu_APPS-ARMV8-WP_internal.cmm TESTCLOCK_8998 BUTTONPROMPT"

			MENU.ADDTOOL "View HWIO Registers" "_,X,:chip" "DO std_utils EXECUTESCRIPT ERRORHANDLE &METATOOLSDIR/MSM8998/std_rootcmm_menu_APPS-ARMV8-WP_internal.cmm VIEW_HWIO_REGISTERS BUTTONPROMPT"

			
			RETURN                                                            
 



 
 
////////////////////////////////////////                               
//                                                                     
//            HELP                                                     
//            Displays available tools for Qualcomm Scripts                  
//                                                                     
/////////////////////////////////////////                              
HELP:                                                            
 
		 
		AREA.CREATE QualcommScripts 139. 56.                        
		AREA.SELECT QualcommScripts                                             
		WINPOS 60% 29. 139. 56.                               
		AREA.VIEW QualcommScripts                                               
		                                                                 
		//HEADER "Qualcomm Scripts Help window"                         
		                                                                 
		                                                                 
		PRINT " ///////////////////////////////////////////////////////////////////"
		PRINT " /////////////////// Qualcomm Scripts Help //////////////////////////"
		PRINT " ///////////////////////////////////////////////////////////////////"
		PRINT " //" 
		PRINT " // The following are the available tools. " 
		PRINT " // Use the dropdown menu labeled Qualcomm Scripts " 
		PRINT " // To navigate to your desired script " 
		PRINT " //" 
		PRINT " ///////////////////////////////////////////////////////////////////"
		PRINT " //" 
		PRINT " //  ALPACA GUI                        : ALPACA GUI" 
		PRINT " //  AttachManager-Attach              : Attach to a runningMSM8998 APPS-ARMV8-WP" 
		PRINT " //  AttachManager-Break               : Attach and break on a MSM8998 APPS-ARMV8-WP" 
		PRINT " //  DragonLink OLC                    : Dragonlink OLC - Configure the CPUSS DragonLink TPDM/TPDA complex to collect hardware events" 
		PRINT " //  DragonLink copy and pedit utility : Dragonlink - Configure the CPUSS DragonLink TPDM/TPDA complex to collect hardware events" 
		PRINT " //  DragonLink get ATID               : None" 
		PRINT " //  DragonLink-actualscript           : None" 
		PRINT " //  DragonLink-etbdump                : None" 
		PRINT " //  DragonLink-modify-message         : None" 
		PRINT " //  Dump ETB                          : Dump ETB" 
		PRINT " //  GladiatorTrace                    : Gladiator Cache Coherency Unit Trace Setup" 
		PRINT " //  Load TZ elfs                      : Load TZ elfs" 
		PRINT " //  MPSS to SNOC probe                : Trace packets originating from MPSS across SNOC" 
		PRINT " //  MainHWIOScript                    : Load HWIO Symbols" 
		PRINT " //  PBUS Logger                       : Logs and displays the SPMI/PBS transactions" 
		PRINT " //  PIMEM Trace BC - APB              : Trace PIMEM TPDM - APB mode" 
		PRINT " //  PIMEM Trace BC - APB - postscript : None" 
		PRINT " //  PIMEM Trace BC - ATB              : Trace PIMEM TPDM - ATB mode" 
		PRINT " //  PIMEM Trace BC - ATB - postscript : None" 
		PRINT " //  PIMEM Trace CMB                   : Trace PIMEM CMB" 
		PRINT " //  PIMEM Trace CMB - postscript      : None" 
		PRINT " //  PMIC Dashboard                    : Displays PMIC power rails, clocks and GPIOs status" 
		PRINT " //  PMIC Dump                         : Collects PMIC register dump" 
		PRINT " //  PMIC HARD RESET                   : Does a PMIC Hard Reset" 
		PRINT " //  PMIC Peek                         : Peek/poke PMIC registers" 
		PRINT " //  PMIC Registers                    : PMIC Registers" 
		PRINT " //  PMIC WARM RESET                   : Does a PMIC Warm Reset" 
		PRINT " //  PostScriptPrompt                  : None" 
		PRINT " //  Print TZ Log                      : Print TZ Logs" 
		PRINT " //  SMMU Fault parser                 : SMMU Fault parser - Parse SMMU fault" 
		PRINT " //  Stage 2 Pagetable Walker          : Stage 2 pagetable walker for SMMU" 
		PRINT " //  SymbolManager-Loadsyms            : Load symbols for APPS-ARMV8-WP" 
		PRINT " //  TSENS Temps                       : TSENS Temperatures" 
		PRINT " //  VCS                               : VCS Configuration" 
		PRINT " //  View HWIO Registers               : View HWIO Registers - Register Tree view (per file)" 
		PRINT " //  clockdriver_8998                  : Main Clock Script" 
		PRINT " //  dragonlink delay 15 seconds       : None" 
		PRINT " //  dragonlink etb to bin             : None" 
		PRINT " //  dragonlink parser                 : None" 
		PRINT " //  openallfunnels                    : Trace packets originating from MPSS across SNOC" 
		PRINT " //  stddebug                          : Main debug menu for debugging various subsystems" 
		PRINT " //  stdloadbuild                      : Main build loading routine for cleaning and loading a build onto device" 
		PRINT " //  testclock_8998                    : testclock - query clock frequencies and on/off state" 
		PRINT " //  testpll_8998                      : testpll - query pll status" 
		PRINT " //" 
		PRINT " ///////////////////////////////////////////////////////////////////"


		RETURN                                                            
 



//In case a return was missed from above                                    
    RETURN                                                                  
                                                                            
EXIT:                                                                       
    LOCAL &rvalue                                                           
    ENTRY %LINE &rvalue                                                     
                                                                            
    //Clear any persistent variables needed                                 
    do std_cti_&CHIPSET CLEARSENTINELS                                      
                                                                            
    ENDDO &rvalue                                                           
                                                                            
                                                                            
//Should never get here.                                                    
FATALEXIT:                                                                  
    LOCAL &rvalue                                                           
    ENTRY %LINE &rvalue                                                     
    IF STRING.SCAN("&FAILUREKEYWORD","FAILUREKEYWORD",0)==-1                
    (                                                                       
        GOSUB EXIT &FAILUREKEYWORD - &rvalue                                
    )                                                                       
    ELSE                                                                    
    (                                                                       
        GOSUB EXIT &rvalue                                                  
    )                                                                       
                                                                            
//Should never get here                                                     
    END                                                                     
