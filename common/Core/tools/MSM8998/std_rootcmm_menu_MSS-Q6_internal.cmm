////////////////////////////////////////////////////////////////////
//                                                                //
//  File: std_rootcmm_menu_MSS-Q6_internal.cmm     
//  Contains T32 script set-up for MSS-Q6 subsystem      
//  Autogenerated - Do not edit!                                  //
//  Created: 30-03-2020,01.16.57                                  //
//                                                                //
////////////////////////////////////////////////////////////////////

//###################Arguments passed #####################            
LOCAL &ArgumentLine                                                    
ENTRY %LINE &ArgumentLine                                              
LOCAL &UTILITY &therest                                                
ENTRY &UTILITY %LINE &therest                                          
                                                                       
                                                                       
//#####################Select Subroutine###################            
// Name of the utility we are calling                                  
// Input Argument 0 is the name of the utility                         
LOCAL &SUBROUTINE                                                      
&SUBROUTINE="&UTILITY"                                                 
IF !(("&SUBROUTINE"=="CREATEMENU")||("&SUBROUTINE"=="ADDMENUBUTTONS")||("&SUBROUTINE"=="HELP")||("&SUBROUTINE"=="help")) 
(                                                                      
    &SUBROUTINE="MAIN"                                                 
    GOSUB MAIN &ArgumentLine                                           
)                                                                      
ELSE                                                                   
(                                                                      
    // Call the required utility                                       
    GOSUB &SUBROUTINE &therest                                         
)                                                                      
                                                                       
    LOCAL &rvalue                                                      
    ENTRY %LINE &rvalue                                                
                                                                       
    //Remove error handler if it was set                               
    ON ERROR                                                           
                                                                       
    GOSUB EXIT &rvalue                                                 
                                                                       
////////////////////////////////////////                               
//                                                                     
//            MAIN                                                     
//            Main std_rootcmm_menu_MSS-Q6_internal.cmm logic                                  
//                                                                     
/////////////////////////////////////////                              
MAIN:                                                                  
     LOCAL &arg0 &therest                                               
     ENTRY &arg0 %LINE &therest                                       
                                                                       
     ON ERROR GOSUB HELP                                                
     GOSUB &arg0 &therest                                                
     ON ERROR                                                          
     LOCAL &rvalue                                                     
     ENTRY &rvalue                                                      
     IF ("&rvalue"=="")                                             
     (                                                                  
         &rvalue="SUCCESS"                                           
     )                                                                 
     RETURN &rvalue                                                    
                                                                       
 
 
////////////////////////////////////////                               
//                                                                     
//            CREATEMENU                                                     
//            Creates dropdown menu for Qualcomm Scripts                  
//                                                                     
/////////////////////////////////////////                              
CREATEMENU:                                                            
 
		MENU.REPROGRAM
		(
			ADD 
			MENU 
			( 
				POPUP "[:CORRELATE]&Qualcomm Scripts" 
				( 
					POPUP "[:PSTEP]&general" 
					( 
						POPUP "[:PSTEP]&general" 
						( 
							MENUITEM "[:FLASH]&Attach And Break Processor " 
							( 
ATTACHMANAGER-BREAK:
								LOCAL &invocationtype
								ENTRY &invocationtype
								do std_utils EXECUTESCRIPT ERRORHANDLE &METATOOLSDIR/general/attachmanager.cmm break MSM8998 

								IF ("&invocationtype"=="BUTTONPROMPT")
								(
									RETURN
								)

							)
							MENUITEM "[:FLASH]&Load Symbols " 
							( 
SYMBOLMANAGER-LOADSYMS:
								LOCAL &invocationtype
								ENTRY &invocationtype
								do std_utils EXECUTESCRIPT ERRORHANDLE &METATOOLSDIR/general/symbolmanager.cmm MSS-Q6 all 

								IF ("&invocationtype"=="BUTTONPROMPT")
								(
									RETURN
								)

							)
							MENUITEM "[:FLASH]&Load HWIO Symbols " 
							( 
MAINHWIOSCRIPT:
								LOCAL &invocationtype
								ENTRY &invocationtype
								do std_utils EXECUTESCRIPT ERRORHANDLE &METATOOLSDIR/../cmm/common/MSM8998/hwio.cmm 

								IF ("&invocationtype"=="BUTTONPROMPT")
								(
									RETURN
								)

							)
							MENUITEM "[:FLASH]&Attach to Processor " 
							( 
ATTACHMANAGER-ATTACH:
								LOCAL &invocationtype
								ENTRY &invocationtype
								do std_utils EXECUTESCRIPT ERRORHANDLE &METATOOLSDIR/general/attachmanager.cmm attach MSM8998 

								IF ("&invocationtype"=="BUTTONPROMPT")
								(
									RETURN
								)

							)
						) 
					) 
					POPUP "[:PSTEP]&hwengines" 
					( 
						POPUP "[:PSTEP]&tsens" 
						( 
							MENUITEM "[:FLASH]&TSENS Temperatures " 
							( 
TSENS_TEMPS:
								LOCAL &invocationtype
								ENTRY &invocationtype
								do std_utils EXECUTESCRIPT ERRORHANDLE &METATOOLSDIR/general/attachmanager.cmm attach MSM8998 
								do std_utils EXECUTESCRIPT ERRORHANDLE &METATOOLSDIR/hwengines/tsens/MSM8998/tsens_read.cmm 

								IF ("&invocationtype"=="BUTTONPROMPT")
								(
									RETURN
								)

							)
						) 
						POPUP "[:PSTEP]&epm" 
						( 
							MENUITEM "[:ACONFIG]&ALPACA GUI " 
							( 
ALPACA_GUI:
								LOCAL &invocationtype
								ENTRY &invocationtype
								do std_utils EXECUTESCRIPT ERRORHANDLE &METATOOLSDIR/hwengines/epm/alpaca.exe 

								IF ("&invocationtype"=="BUTTONPROMPT")
								(
									RETURN
								)

							)
						) 
					) 
					POPUP "[:PSTEP]&qdss" 
					( 
						POPUP "[:PSTEP]&qdss" 
						( 
							MENUITEM "[:FLASH]&Dump ETB " 
							( 
DUMP_ETB:
								LOCAL &invocationtype
								ENTRY &invocationtype
								do std_utils EXECUTESCRIPT ERRORHANDLE &METATOOLSDIR/general/attachmanager.cmm attach MSM8998 
								do std_utils EXECUTESCRIPT ERRORHANDLE &METATOOLSDIR/qdss/MSM8998/dump_etb.cmm &TEMP/etb_dump.bin 

								IF ("&invocationtype"=="BUTTONPROMPT")
								(
									RETURN
								)

							)
						) 
					) 
					POPUP "[:PSTEP]&sve" 
					( 
						POPUP "[:PSTEP]&DragonLink" 
						( 
						) 
					) 
					POPUP "[:PSTEP]&systemdrivers" 
					( 
						POPUP "[:PSTEP]&icb" 
						( 
							MENUITEM "[:FLASH]&Dump Bus Bandwidth Requests " 
							( 
DUMP_BUS_BANDWIDTH_REQUESTS:
								LOCAL &invocationtype
								ENTRY &invocationtype
								do std_utils EXECUTESCRIPT ERRORHANDLE &METATOOLSDIR/general/attachmanager.cmm break MSM8998 
								do std_utils EXECUTESCRIPT ERRORHANDLE &METATOOLSDIR/systemdrivers/icb/ICBDump.cmm 

								IF ("&invocationtype"=="BUTTONPROMPT")
								(
									RETURN
								)

							)
						) 
						POPUP "[:PSTEP]&vcs" 
						( 
							MENUITEM "[:FLASH]&VCS " 
							( 
VCS:
								LOCAL &invocationtype
								ENTRY &invocationtype
								do std_utils EXECUTESCRIPT ERRORHANDLE &METATOOLSDIR/systemdrivers/vcs/vcs.cmm 

								IF ("&invocationtype"=="BUTTONPROMPT")
								(
									RETURN
								)

							)
						) 
						POPUP "[:PSTEP]&clock" 
						( 
							MENUITEM "[:FLASH]&testpll " 
							( 
TESTPLL_8998_MPSS:
								LOCAL &invocationtype
								ENTRY &invocationtype
								do std_utils EXECUTESCRIPT ERRORHANDLE &METATOOLSDIR/systemdrivers/clock/MSM8998/testpll_mpss.cmm 

								IF ("&invocationtype"=="BUTTONPROMPT")
								(
									RETURN
								)

							)
							MENUITEM "[:FLASH]&Clock Driver " 
							( 
CLOCKDRIVER_8998:
								LOCAL &invocationtype
								ENTRY &invocationtype
								do std_utils EXECUTESCRIPT ERRORHANDLE &METATOOLSDIR/systemdrivers/clock/ClockDriver.cmm 

								IF ("&invocationtype"=="BUTTONPROMPT")
								(
									RETURN
								)

							)
							MENUITEM "[:FLASH]&testclock " 
							( 
TESTCLOCK_8998_MPSS:
								LOCAL &invocationtype
								ENTRY &invocationtype
								do std_utils EXECUTESCRIPT ERRORHANDLE &METATOOLSDIR/systemdrivers/clock/MSM8998/testclock_mpss.cmm 

								IF ("&invocationtype"=="BUTTONPROMPT")
								(
									RETURN
								)

							)
						) 
						POPUP "[:PSTEP]&pmic" 
						( 
							MENUITEM "[:FLASH]&PMIC Dump " 
							( 
PMIC_DUMP:
								LOCAL &invocationtype
								ENTRY &invocationtype
								do std_utils EXECUTESCRIPT ERRORHANDLE &METATOOLSDIR/general/attachmanager.cmm attach MSM8998 
								do std_utils EXECUTESCRIPT ERRORHANDLE &METATOOLSDIR/systemdrivers/pmic/honeybadger/PMICDump.cmm 

								IF ("&invocationtype"=="BUTTONPROMPT")
								(
									RETURN
								)

							)
							MENUITEM "[:FLASH]&PMIC Registers " 
							( 
PMIC_REGISTERS:
								LOCAL &invocationtype
								ENTRY &invocationtype
								do std_utils EXECUTESCRIPT ERRORHANDLE &METATOOLSDIR/general/attachmanager.cmm attach MSM8998 
								do std_utils EXECUTESCRIPT ERRORHANDLE &METATOOLSDIR/systemdrivers/pmic/honeybadger/PMICRegisters.cmm  

								IF ("&invocationtype"=="BUTTONPROMPT")
								(
									RETURN
								)

							)
							MENUITEM "[:FLASH]&PMIC Dashboard " 
							( 
PMIC_DASHBOARD:
								LOCAL &invocationtype
								ENTRY &invocationtype
								do std_utils EXECUTESCRIPT ERRORHANDLE &METATOOLSDIR/general/attachmanager.cmm attach MSM8998 
								do std_utils EXECUTESCRIPT ERRORHANDLE &METATOOLSDIR/systemdrivers/pmic/honeybadger/PMICDashBoard.cmm 

								IF ("&invocationtype"=="BUTTONPROMPT")
								(
									RETURN
								)

							)
							MENUITEM "[:FLASH]&PMIC Warm Reset " 
							( 
PMIC_WARM_RESET:
								LOCAL &invocationtype
								ENTRY &invocationtype
								do std_utils EXECUTESCRIPT ERRORHANDLE &METATOOLSDIR/general/attachmanager.cmm attach MSM8998 
								do std_utils EXECUTESCRIPT ERRORHANDLE &METATOOLSDIR/systemdrivers/pmic/PMICReset.cmm WARMRESET 

								IF ("&invocationtype"=="BUTTONPROMPT")
								(
									RETURN
								)

							)
							MENUITEM "[:FLASH]&PMIC Peek " 
							( 
PMIC_PEEK:
								LOCAL &invocationtype
								ENTRY &invocationtype
								do std_utils EXECUTESCRIPT ERRORHANDLE &METATOOLSDIR/general/attachmanager.cmm attach MSM8998 
								do std_utils EXECUTESCRIPT ERRORHANDLE &METATOOLSDIR/systemdrivers/pmic/honeybadger/PMICPeek.cmm 

								IF ("&invocationtype"=="BUTTONPROMPT")
								(
									RETURN
								)

							)
							MENUITEM "[:FLASH]&PBUS Logger " 
							( 
PBUS_LOGGER:
								LOCAL &invocationtype
								ENTRY &invocationtype
								do std_utils EXECUTESCRIPT ERRORHANDLE &METATOOLSDIR/general/attachmanager.cmm attach MSM8998 
								do std_utils EXECUTESCRIPT ERRORHANDLE &METATOOLSDIR/systemdrivers/pmic/honeybadger/PBUSLogger.cmm 

								IF ("&invocationtype"=="BUTTONPROMPT")
								(
									RETURN
								)

							)
							MENUITEM "[:FLASH]&PMIC Hard Reset " 
							( 
PMIC_HARD_RESET:
								LOCAL &invocationtype
								ENTRY &invocationtype
								do std_utils EXECUTESCRIPT ERRORHANDLE &METATOOLSDIR/general/attachmanager.cmm attach MSM8998 
								do std_utils EXECUTESCRIPT ERRORHANDLE &METATOOLSDIR/systemdrivers/pmic/PMICReset.cmm HARDRESET 

								IF ("&invocationtype"=="BUTTONPROMPT")
								(
									RETURN
								)

							)
						) 
						POPUP "[:PSTEP]&hwio" 
						( 
							MENUITEM "[:FLASH]&View HWIO Registers " 
							( 
VIEW_HWIO_REGISTERS:
								LOCAL &invocationtype
								ENTRY &invocationtype
								do std_utils EXECUTESCRIPT ERRORHANDLE &METATOOLSDIR/systemdrivers/hwio/HWIORegisters.cmm MSM8998 

								IF ("&invocationtype"=="BUTTONPROMPT")
								(
									RETURN
								)

							)
						) 
					) 
					POPUP "[:PSTEP]&wlan" 
					( 
						POPUP "[:PSTEP]&wlan" 
						( 
							MENUITEM "[:FLASH]&Debug WLAN Low Power Mode " 
							( 
DEBUG_WLAN_LOW_POWER_MODE:
								LOCAL &invocationtype
								ENTRY &invocationtype
								do std_utils EXECUTESCRIPT ERRORHANDLE &METATOOLSDIR/general/attachmanager.cmm attach MSM8998 
								do std_utils EXECUTESCRIPT ERRORHANDLE &METATOOLSDIR/../cmm/common/MSM8998/hwio.cmm 
								do std_utils EXECUTESCRIPT ERRORHANDLE &METATOOLSDIR/wlan/sr_force_wakeup.cmm 

								IF ("&invocationtype"=="BUTTONPROMPT")
								(
									RETURN
								)

							)
						) 
					) 
				) 
			) 
		) 
	
	RETURN SUCCESS


 
 
////////////////////////////////////////                               
//                                                                     
//            ADDMENUBUTTONS                                                     
//            Creates dropdown menu for Qualcomm Scripts                  
//                                                                     
/////////////////////////////////////////                              
ADDMENUBUTTONS:                                                            
	 
		 
			MENU.ADDTOOL "testclock" "_,X,:time" "DO std_utils EXECUTESCRIPT ERRORHANDLE &METATOOLSDIR/MSM8998/std_rootcmm_menu_MSS-Q6_internal.cmm TESTCLOCK_8998_MPSS BUTTONPROMPT"

			MENU.ADDTOOL "View HWIO Registers" "_,X,:chip" "DO std_utils EXECUTESCRIPT ERRORHANDLE &METATOOLSDIR/MSM8998/std_rootcmm_menu_MSS-Q6_internal.cmm VIEW_HWIO_REGISTERS BUTTONPROMPT"

			
			RETURN                                                            
 



 
 
////////////////////////////////////////                               
//                                                                     
//            HELP                                                     
//            Displays available tools for Qualcomm Scripts                  
//                                                                     
/////////////////////////////////////////                              
HELP:                                                            
 
		 
		AREA.CREATE QualcommScripts 93. 35.                        
		AREA.SELECT QualcommScripts                                             
		WINPOS 60% 29. 93. 35.                               
		AREA.VIEW QualcommScripts                                               
		                                                                 
		//HEADER "Qualcomm Scripts Help window"                         
		                                                                 
		                                                                 
		PRINT " ///////////////////////////////////////////////////////////////////"
		PRINT " /////////////////// Qualcomm Scripts Help //////////////////////////"
		PRINT " ///////////////////////////////////////////////////////////////////"
		PRINT " //" 
		PRINT " // The following are the available tools. " 
		PRINT " // Use the dropdown menu labeled Qualcomm Scripts " 
		PRINT " // To navigate to your desired script " 
		PRINT " //" 
		PRINT " ///////////////////////////////////////////////////////////////////"
		PRINT " //" 
		PRINT " //  ALPACA GUI                  : ALPACA GUI" 
		PRINT " //  AttachManager-Attach        : Attach to a runningMSM8998 MSS-Q6" 
		PRINT " //  AttachManager-Break         : Attach and break on a MSM8998 MSS-Q6" 
		PRINT " //  Debug WLAN Low Power Mode   : Debug WLAN Low Power Mode" 
		PRINT " //  Dump Bus Bandwidth Requests : Dump Bus Bandwidth Requests" 
		PRINT " //  Dump ETB                    : Dump ETB" 
		PRINT " //  MainHWIOScript              : Load HWIO Symbols" 
		PRINT " //  PBUS Logger                 : Logs and displays the SPMI/PBS transactions" 
		PRINT " //  PMIC Dashboard              : Displays PMIC power rails, clocks and GPIOs status" 
		PRINT " //  PMIC Dump                   : Collects PMIC register dump" 
		PRINT " //  PMIC HARD RESET             : Does a PMIC Hard Reset" 
		PRINT " //  PMIC Peek                   : Peek/poke PMIC registers" 
		PRINT " //  PMIC Registers              : PMIC Registers" 
		PRINT " //  PMIC WARM RESET             : Does a PMIC Warm Reset" 
		PRINT " //  PostScriptPrompt            : None" 
		PRINT " //  SymbolManager-Loadsyms      : Load symbols for MSS-Q6" 
		PRINT " //  TSENS Temps                 : TSENS Temperatures" 
		PRINT " //  VCS                         : VCS Configuration" 
		PRINT " //  View HWIO Registers         : View HWIO Registers - Register Tree view (per file)" 
		PRINT " //  clockdriver_8998            : Main Clock Script" 
		PRINT " //  dragonlink delay 15 seconds : None" 
		PRINT " //  testclock_8998_mpss         : testclock - query clock frequencies and on/off state" 
		PRINT " //  testpll_8998_mpss           : testpll - query pll status" 
		PRINT " //" 
		PRINT " ///////////////////////////////////////////////////////////////////"


		RETURN                                                            
 



//In case a return was missed from above                                    
    RETURN                                                                  
                                                                            
EXIT:                                                                       
    LOCAL &rvalue                                                           
    ENTRY %LINE &rvalue                                                     
                                                                            
    //Clear any persistent variables needed                                 
    do std_cti_&CHIPSET CLEARSENTINELS                                      
                                                                            
    ENDDO &rvalue                                                           
                                                                            
                                                                            
//Should never get here.                                                    
FATALEXIT:                                                                  
    LOCAL &rvalue                                                           
    ENTRY %LINE &rvalue                                                     
    IF STRING.SCAN("&FAILUREKEYWORD","FAILUREKEYWORD",0)==-1                
    (                                                                       
        GOSUB EXIT &FAILUREKEYWORD - &rvalue                                
    )                                                                       
    ELSE                                                                    
    (                                                                       
        GOSUB EXIT &rvalue                                                  
    )                                                                       
                                                                            
//Should never get here                                                     
    END                                                                     
