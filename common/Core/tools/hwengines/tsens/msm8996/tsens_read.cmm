;============================================================================
;  Name:
;    tsens_read.cmm
;
;  Description:
;    Prints the TSENS temperatures.
;
;
;  Copyright (c) 2016 Qualcomm Technologies, Inc.
;  All Rights Reserved.
;  Qualcomm Technologies Confidential and Proprietary.
;============================================================================
;============================================================================
;
;                        EDIT HISTORY FOR MODULE
;
; $Header: //components/rel/core.glue/1.2.1/tools/tools/hwengines/tsens/msm8996/tsens_read.cmm#1 $
; $DateTime: 2016/11/23 22:06:41 $ $Author: pwbldsvc $
;
; when        who  what, where, why
; ----------  ---  -----------------------------------------------------------
; 2016-04-02  jjo  Initial revision.

;============================================================================

;============================================================================
; Variables
;============================================================================
LOCAL &baseAddr
&num_sensors=21.
Var.NEWGLOBAL int[&num_sensors] \controller_idx
Var.NEWGLOBAL int[&num_sensors] \channel_idx

Var.Set \controller_idx[0..&num_sensors-1]=(0,0,0,0,0,0,0,0,0,0,0,0,0,1,1,1,1,1,1,1,1)
Var.Set \channel_idx[0..&num_sensors-1]=(0,1,2,3,4,5,6,7,8,9,10,11,12,1,6,7,0,2,3,4,5)

;============================================================================
; Create a new window
;============================================================================
AREA.Create TSENS 120. 1000.
AREA.Select TSENS
WINPOS 0. 0. 50% 100%
AREA.View TSENS

;============================================================================
; Read the temperatures
;============================================================================
&sensor=0
while (&sensor<&num_sensors)
(
   &channel=VAR.VALUE(\channel_idx[&sensor])
   &controller=VAR.VALUE(\controller_idx[&sensor])

   ; print "Controller = &controller Channel = &channel"

   if (&controller==0x0)
   (
      &baseAddr=0x4A9000
   )
   else if (&controller==0x1)
   (
      &baseAddr=0x4AD000
   )

   &value=data.long(ezaxi:(&baseAddr+0xa0+4*&channel))
   &value=&value&0xfff
   if ((&value&0x800)==0x800)
   (
      ; Sign extend
      &value=&value|(~0xfff)
   )
   print "Sensor &sensor (controller &controller channel &channel) reports temperature (deci deg C): " %DECIMAL &value

   &sensor=&sensor+1
)

ENDDO

