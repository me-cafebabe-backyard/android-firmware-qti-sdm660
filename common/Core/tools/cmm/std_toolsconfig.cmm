//============================================================================
//  Name:                                                                     
//    std_toolsconfig.cmm 
//
//  Description:                                                              
//    Configures the path of the tools / scripts for a particular debug session
//                                                                            
// Copyright (c) 2012 - 2014 by Qualcomm Technologies, Incorporated.  All Rights Reserved.        
//
//
//
//
//                      EDIT HISTORY FOR FILE
//  This section contains comments describing changes made to the module.
//  Notice that changes are listed in reverse chronological order.
//
// when       who           what, where, why
// --------   ---           ---------------------------------------------------------
// 03/03/2016 JBILLING      Changes to be called without t32start environment
// 08/13/2015 RSSRIDHA      Added support for MDMs
// 12/10/2012 AJCheriyan    Added support for multiple chipsets     
// 07/10/2012 AJCheriyan    Created for B-family. 

// Supports 2 arguments
// ARG0 - Name of the Chipset for which path has to be setup
// ARG1 - Name of the Subsys for which path has to be setup
ENTRY &ARG0 &ARG1

IF STRING.SCAN("&TOOLSCONFIG_RAN","TOOLSCONFIG_RAN",0)==-1
(
    //If it's true it already ran
    IF "&TOOLSCONFIG_RAN"=="TRUE"
    (
        ENDDO
    )
)
GLOBAL &TOOLSCONFIG_RAN
&TOOLSCONFIG_RAN="TRUE"



// Create a global variable for every "subsystem" script folder
// Top level meta scripts
GLOBAL &METASCRIPTSDIR
// Common Scripts
GLOBAL &METATOOLSDIR
GLOBAL &COMMON_METASCRIPTSDIR
// Generated Scripts
GLOBAL &GEN_METASCRIPTSDIR
// Sub-system level scripts
GLOBAL &MPSS_METASCRIPTSDIR
GLOBAL &RPM_METASCRIPTSDIR
GLOBAL &APPS_METASCRIPTSDIR
GLOBAL &ADSP_METASCRIPTSDIR
GLOBAL &CDSP_METASCRIPTSDIR
GLOBAL &WCNSS_METASCRIPTSDIR
GLOBAL &IPA_METASCRIPTSDIR
GLOBAL &VSS_METASCRIPTSDIR
GLOBAL &IPA_METASCRIPTSDIR
GLOBAL &PARTITION_METASCRIPTSDIR
GLOBAL &COMMON_CHIPSET_METASCRIPTSDIR
GLOBAL &DEBUGLEVEL
GLOBAL &APPS_METASCRIPTSDIR_HLOS
&DEBUGLEVEL="NORMAL"

&METASCRIPTSDIR=OS.PPD()
&GEN_METASCRIPTSDIR="&METASCRIPTSDIR/gen"
&METATOOLSDIR="&METASCRIPTSDIR/../tools"
&MPSS_METASCRIPTSDIR="&METASCRIPTSDIR/mpss/&ARG0"
&COMMON_METASCRIPTSDIR="&METASCRIPTSDIR/common"
&COMMON_CHIPSET_METASCRIPTSDIR="&METASCRIPTSDIR/common/&ARG0"
&APPS_METASCRIPTSDIR="&METASCRIPTSDIR/apps/&ARG0"
&APPS_METASCRIPTSDIR_HLOS="&METASCRIPTSDIR/apps/&ARG0/&HLOS"

&RPM_METASCRIPTSDIR="&METASCRIPTSDIR/rpm/&ARG0"
&ADSP_METASCRIPTSDIR="&METASCRIPTSDIR/adsp/&ARG0"
&CDSP_METASCRIPTSDIR="&METASCRIPTSDIR/cdsp/&ARG0"
&SLPI_METASCRIPTSDIR="&METASCRIPTSDIR/slpi/&ARG0"
&WCNSS_METASCRIPTSDIR="&METASCRIPTSDIR/wcnss/&ARG0"
&VSS_METASCRIPTSDIR="&METASCRIPTSDIR/vss/&ARG0"
&IPA_METASCRIPTSDIR="&METASCRIPTSDIR/ipa/&ARG0"
&SP_METASCRIPTSDIR="&METASCRIPTSDIR/sp"
&PARTITION_METASCRIPTSDIR="&METASCRIPTSDIR\..\..\..\build"

// Set the path up to include the top level, SS specific scripts and apps specific script
IF STR.UPR("&ARG1")=="NULL"
(
    LOCAL &executable
    //Gives us the name of the executable running. Can determine if ARM or Q6
    &executable=OS.PEF()
    IF (STRING.SCAN(STR.LWR("&executable"),"t32marm",0)!=-1)
    (
        &ARG1="APPS"
    )
    ELSE IF (STRING.SCAN(STR.LWR("&executable"),"t32mqdsp",0)!=-1)
    (
        &ARG1="MPSS"
    )
)

PATH &METASCRIPTSDIR &COMMON_METASCRIPTSDIR &COMMON_CHIPSET_METASCRIPTSDIR &GEN_METASCRIPTSDIR &METASCRIPTSDIR/&ARG1/&ARG0 &APPS_METASCRIPTSDIR &APPS_METASCRIPTSDIR/&HLOS &METASCRIPTSDIR/apps &METASCRIPTSDIR/&ARG1 &METASCRIPTSDIR/adsp &METASCRIPTSDIR/slpi &METASCRIPTSDIR/mpss &METASCRIPTSDIR/apps &METASCRIPTSDIR/ipa &METASCRIPTSDIR/wlan &METASCRIPTSDIR/rpm &PARTITION_METASCRIPTSDIR &METASCRIPTSDIR/&apps/&ARG0/&HLOS &IPA_METASCRIPTSDIR &SP_METASCRIPTSDIR &METASCRIPTSDIR/cdsp


// Set boot processor to have full system knowledge 
LOCAL &arg1
&arg1=STR.LWR("&ARG1")

IF (("&arg1"=="apps")||("&arg1"=="rpm")||("&T32PROP"=="sim"))
(
    PATH + &MPSS_METASCRIPTSDIR &ADSP_METASCRIPTSDIR &SLPI_METASCRIPTSDIR &WCNSS_METASCRIPTSDIR &VSS_METASCRIPTSDIR &RPM_METASCRIPTSDIR &CDSP_METASCRIPTSDIR
)

//For future live debug configuration
IF (("&arg1"=="mpss")&&("&T32PROP"!="sim"))
(
    PATH + &MPSS_METASCRIPTSDIR &ADSP_METASCRIPTSDIR &SLPI_METASCRIPTSDIR &WCNSS_METASCRIPTSDIR &METASCRIPTSDIR/ADSP &METASCRIPTSDIR/SLPI &METASCRIPTSDIR/WCNSS &METASCRIPTSDIR/SP &CDSP_METASCRIPTSDIR
)

ENDDO
