//============================================================================
//  Name:                                                                     
//    std_intercom_init.cmm
//
//  Description:                                                              
//    It initializes the intercom ports for all the subsystems. It will ping
//    a particular sub-system to check if it is "alive" depending on the arguments
//    passes
//                                                                            
// Copyright (c) 2012 - 2014 by Qualcomm Technologies, Incorporated.  All Rights Reserved.        
//
//
//
//
//                      EDIT HISTORY FOR FILE
//  This section contains comments describing changes made to the module.
//  Notice that changes are listed in reverse chronological order.
//
// when       who             what, where, why
// --------   ---             ---------------------------------------------------------
// 03/10/2016 JBILLING      Configure for 8998
// 12/14/2015 JBILLING      Add Fusion intercoms
// 05/13/2015 JBILLING      Added HOSTNAME variable
// 02/05/2015 JBILLING      Updated for Istari, changed API ports per CPU team's request
// 08/19/2014 JBILLING      Added checks for apps cluster sessions
// 05/02/2014 AJCheriyan    Added a return value for a single CHECKSESSION request
// 07/19/2012 AJCheriyan    Fixed localhost issue and renamed intercom ports 
// 07/10/2012 AJCheriyan    Created for B-family
//
//

// We support two values for the first argument with arguments = no.of sub-systems + 1  
// IARG0 - NEWSESSION or CHECKSESSION. If NEWSESSION, we just initialize the intercom ports and return
//           If CHECKSESSION is chosen, sessions indicated by ARG1 - ARGn are checked and global
//           variables are updated
// IARG1 - No. of sessions to check. Used only if ARG0 is CHECKSESSION
// IARGn - n > 1 - SESSION names to check for. Currently supports the following
//           RPM, APPS0, APPS1, APPS2, APPS3, MPSS, ADSP, WLAN

ENTRY &IARG0 &IARG1 &IARG2 &IARG3 &IARG4 &IARG5 &IARG6 &IARG7 &IARG8 &IARG9 &IARG10

// Globals: Global Variables
// Global variables / intercom handles for every subsystem
GLOBAL &RPM_ALIVE &RPM_PORT 
GLOBAL &APPS0_ALIVE &APPS0_PORT 
GLOBAL &APPS1_ALIVE &APPS1_PORT 
GLOBAL &APPS2_ALIVE &APPS2_PORT 
GLOBAL &APPS3_ALIVE &APPS3_PORT
GLOBAL &APPS4_ALIVE &APPS4_PORT
GLOBAL &APPS5_ALIVE &APPS5_PORT
GLOBAL &APPS6_ALIVE &APPS6_PORT
GLOBAL &APPS7_ALIVE &APPS7_PORT
GLOBAL &APPSC0_ALIVE &APPSC0_PORT
GLOBAL &APPSC1_ALIVE &APPSC1_PORT
GLOBAL &MPSS_ALIVE &MPSS_PORT
GLOBAL &ADSP_ALIVE &ADSP_PORT
GLOBAL &CDSP_ALIVE &CDSP_PORT
GLOBAL &SLPI_ALIVE &SLPI_PORT
GLOBAL &WLAN_ALIVE &WLAN_PORT
GLOBAL &VSS_ALIVE &VSS_PORT
GLOBAL &IPA_ALIVE &IPA_PORT
GLOBAL &VPU_ALIVE &VPU_PORT
GLOBAL &SP_ALIVE &SP_PORT
GLOBAL &MDM_APPS0_PORT &MDM_RPM_PORT &MDM_MPSS_PORT &MDM_IPA_PORT

// Handle for this processor
GLOBAL &LOCALHOST &LOCALNAME

// Any locals for this script
LOCAL &RVAL


MAIN:

   &RVAL=0
   // Setup intercom ports only if NEWSESSION    
   IF ("&IARG0"=="NEWSESSION")
   (

    // Intercom port number of the currrent session
       &LOCALHOST=INTERCOM.PORT()

    // Intercom ports for any clusters should be equal to the core 0 of that cluster
    &RPM_PORT="15400."
    &APPS0_PORT="15370."
    &APPS1_PORT="15371."
    &APPS2_PORT="15372."
    &APPS3_PORT="15373."

    &APPS4_PORT="15374."
    &APPS5_PORT="15375."
    &APPS6_PORT="15376."
    &APPS7_PORT="15377."
    
    &APPSC0_PORT="15378."
    &APPSC1_PORT="15379."
    
    &MPSS_PORT="15401."
    &ADSP_PORT="15402."
    &SLPI_PORT="15403."
    
    &VSS_PORT="15404."
    &IPA_PORT="15405."
    &SP_PORT="15406."
	&CDSP_PORT="15410."
    
    //For fusion setup

    &MDM_APPS0_PORT="15407."
    &MDM_RPM_PORT="15406."
    &MDM_MPSS_PORT="15408."
    &MDM_IPA_PORT="15409."

    IF ("&FUSION_PLATFORM"=="TRUE")
    (
        &MPSS_PORT="&MDM_MPSS_PORT"
    )
    
    //Populate localname
    IF (&LOCALHOST==&RPM_PORT)
    (
        &LOCALNAME="RPM"
    )
    ELSE IF (&LOCALHOST==&APPS0_PORT)
    (
        &LOCALNAME="APPS0"
    )
    ELSE IF (&LOCALHOST==&APPS1_PORT)
    (
        &LOCALNAME="APPS1"
    )
    ELSE IF (&LOCALHOST==&APPS2_PORT)
    (
        &LOCALNAME="APPS2"
    )
    ELSE IF (&LOCALHOST==&APPS3_PORT)
    (
        &LOCALNAME="APPS3"
    )
    
    
    ELSE IF (&LOCALHOST==&APPS4_PORT)
    (
        &LOCALNAME="APPS4"
    )
    ELSE IF (&LOCALHOST==&APPS5_PORT)
    (
        &LOCALNAME="APPS5"
    )
    ELSE IF (&LOCALHOST==&APPS6_PORT)
    (
        &LOCALNAME="APPS6"
    )
    ELSE IF (&LOCALHOST==&APPS7_PORT)
    (
        &LOCALNAME="APPS7"
    )
    
    
    ELSE IF (&LOCALHOST==&APPSC0_PORT)
    (
        &LOCALNAME="APPSC0"
    )
    ELSE IF (&LOCALHOST==&APPSC1_PORT)
    (
        &LOCALNAME="APPSC1"
    )
    ELSE IF (&LOCALHOST==&MPSS_PORT)
    (
        &LOCALNAME="MPSS"
    )
    ELSE IF (&LOCALHOST==&ADSP_PORT)
    (
        &LOCALNAME="ADSP"
    )
	ELSE IF (&LOCALHOST==&CDSP_PORT)
    (
        &LOCALNAME="CDSP"
    )
    ELSE IF (&LOCALHOST==&SLPI_PORT)
    (
        &LOCALNAME="SLPI"
    )
    
    ELSE IF (&LOCALHOST==&IPA_PORT)
    (
        &LOCALNAME="IPA"
    )
    ELSE IF (&LOCALHOST==&VSS_PORT)
    (
        &LOCALNAME="VSS"
    )
    ELSE IF (&LOCALHOST==&SP_PORT)
    (
        &LOCALNAME="SP"
    )
    &RVAL=1
  )

  // We want to check if a particular session is 
  // active. So ping and find out 
  IF ("&IARG0"=="CHECKSESSION")
  (
    GOSUB CHECKSESSIONARG &IARG2
    GOSUB CHECKSESSIONARG &IARG3
    GOSUB CHECKSESSIONARG &IARG4
    GOSUB CHECKSESSIONARG &IARG5
    GOSUB CHECKSESSIONARG &IARG6
    GOSUB CHECKSESSIONARG &IARG7
    GOSUB CHECKSESSIONARG &IARG8
    GOSUB CHECKSESSIONARG &IARG9
    GOSUB CHECKSESSIONARG &IARG10
  )

  GOTO EXIT


 // Function to check if the session is valid or not
 // If invalid, it will exit the script. The assumption
 // is that the first argument which is "NULL" will be 
 // followed by more NULL arguments and hence, can exit. 
 // The arguments must be checked in serial order for this 
 // to be true.
CHECKSESSIONARG:
    ENTRY &SESSION


    IF ("&SESSION"=="")
    (
        GOTO EXIT
    )

    IF ("&SESSION"=="RPM")
    (
        IF INTERCOM.PING(&RPM_PORT)
        (
            &RPM_ALIVE=1.
            &RVAL=1.
            PRINT "RPM Session Active."
        )
        ELSE
        (
            &RPM_ALIVE=0.
        )
        
    )

    IF ("&SESSION"=="APPS0")
    (
        IF INTERCOM.PING(&APPS0_PORT)
        (
            &APPS0_ALIVE=1.
            &RVAL=1.
            PRINT "Apps Session 0 Active."
        )
        ELSE
        (
            &APPS0_ALIVE=0.
        )
        
    )

    IF ("&SESSION"=="APPS1")
    (
        IF INTERCOM.PING(&APPS1_PORT)
        (
            &APPS1_ALIVE=1.
            &RVAL=1.
            PRINT "Apps Session 1 Active."
        )
        ELSE
        (
            &APPS0_ALIVE=0.
        )
        
    )

    IF ("&SESSION"=="APPS2")
    (
        IF INTERCOM.PING(&APPS2_PORT)
        (
            &APPS2_ALIVE=1.
            &RVAL=1.
            PRINT "Apps Session 2 Active."
        )
        ELSE
        (
            &APPS2_ALIVE=0.
        )
        
    )

    IF ("&SESSION"=="APPS3")
    (
        IF INTERCOM.PING(&APPS3_PORT)
        (
            &APPS3_ALIVE=1.
            &RVAL=1.
            PRINT "Apps Session 3 Active."
        )
        ELSE
        (
            &APPS3_ALIVE=0.
        )
        
    )

    IF ("&SESSION"=="APPS4")
    (
        IF INTERCOM.PING(&APPS4_PORT)
        (
            &APPS4_ALIVE=1.
            &RVAL=1.
            PRINT "Apps Session 4 Active."
        )
        ELSE
        (
            &APPS4_ALIVE=0.
        )
        
    )
    IF ("&SESSION"=="APPS5")
    (
        IF INTERCOM.PING(&APPS5_PORT)
        (
            &APPS5_ALIVE=1.
            &RVAL=1.
            PRINT "Apps Session 5 Active."
        )
        ELSE
        (
            &APPS5_ALIVE=0.
        )
        
    )
    IF ("&SESSION"=="APPS6")
    (
        IF INTERCOM.PING(&APPS6_PORT)
        (
            &APPS6_ALIVE=1.
            &RVAL=1.
            PRINT "Apps Session 6 Active."
        )
        ELSE
        (
            &APPS6_ALIVE=0.
        )
        
    )
    IF ("&SESSION"=="APPS7")
    (
        IF INTERCOM.PING(&APPS7_PORT)
        (
            &APPS7_ALIVE=1.
            &RVAL=1.
            PRINT "Apps Session 7 Active."
        )
        ELSE
        (
            &APPS7_ALIVE=0.
        )
        
    )
    IF ("&SESSION"=="APPSC0")
    (
        IF INTERCOM.PING(&APPSC0_PORT)
        (
            &APPSC0_ALIVE=1.
            &RVAL=1.
            PRINT "Apps Session Cluster0 Active."
        )
        ELSE
        (
            &APPSC0_ALIVE=0.
        )
        
    )

    IF ("&SESSION"=="APPSC1")
    (
        IF INTERCOM.PING(&APPSC1_PORT)
        (
            &APPSC1_ALIVE=1.
            &RVAL=1.
            PRINT "Apps Session Cluster1 Active."
        )
        ELSE
        (
            &APPSC1_ALIVE=0.
        )
        
    )

    
    IF ("&SESSION"=="MPSS")
    (
        IF INTERCOM.PING(&MPSS_PORT)
        (
            &MPSS_ALIVE=1.
            &RVAL=1.
            PRINT "MPSS Session Active."
        )
        ELSE
        (
            &MPSS_ALIVE=0.
        )
        
    )

    IF ("&SESSION"=="ADSP")
    (
        IF INTERCOM.PING(&ADSP_PORT)
        (
            &ADSP_ALIVE=1.
            &RVAL=1.
            PRINT "ADSP Session Active."
        )
        ELSE
        (
            &ADSP_ALIVE=0.
        )
        
    )
	
	IF ("&SESSION"=="CDSP")
    (
        IF INTERCOM.PING(&CDSP_PORT)
        (
            &CDSP_ALIVE=1.
            &RVAL=1.
            PRINT "CDSP Session Active."
        )
        ELSE
        (
            &CDSP_ALIVE=0.
        )
        
    )

    IF ("&SESSION"=="SLPI")
    (
        IF INTERCOM.PING(&SLPI_PORT)
        (
            &SLPI_ALIVE=1.
            &RVAL=1.
            PRINT "SLPI Session Active."
        )
        ELSE
        (
            &SLPI_ALIVE=0.
        )
        
    )
    IF ("&SESSION"=="VSS")
    (
        IF INTERCOM.PING(&VSS_PORT)
        (
            &VSS_ALIVE=1.
            &RVAL=1.
            PRINT "VSS Session Active."
        )
        ELSE
        (
            &VSS_ALIVE=0.
        )
        
    )

    IF ("&SESSION"=="IPA")
    (
        IF INTERCOM.PING(&IPA_PORT)
        (
            &IPA_ALIVE=1.
            &RVAL=1.
            PRINT "IPA Session Active."
        )
        ELSE
        (
            &IPA_ALIVE=0.
        )
        
    )
    IF ("&SESSION"=="SP")
    (
        IF INTERCOM.PING(&SP_PORT)
        (
            &SP_ALIVE=1.
            &RVAL=1.
            PRINT "SP Session Active."
        )
        ELSE
        (
            &SP_ALIVE=0.
        )
        
    )

    ENDDO &RVAL


EXIT:
    ENDDO &RVAL
