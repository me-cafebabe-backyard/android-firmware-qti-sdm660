;============================================================================
;
;           SDM660 SPMI Clock Enable CLOCK SCRIPT
;
; GENERAL DESCRIPTION
;   This script can be used to Ebable SPMI Clocks
;   Owner: Pradeep Mohanannair
;      Copyright (c) 2016 by Qualcomm Technologies, Inc.  All Rights Reserved.
;============================================================================

&HWIO_GCC_SPMI_BCR_ADDR=0x13f000; 
&HWIO_GCC_SPMI_CNOC_AHB_CBCR_ADDR=0x13f008;
&HWIO_GCC_SPMI_SER_CBCR_ADDR=0x13f004; 
&HWIO_GCC_SPMI_SER_CFG_RCGR_ADDR=0x13f014; 
&HWIO_GCC_SPMI_SER_CMD_RCGR_ADDR=0x13f010; 
&HWIO_GCC_SPMI_AHB_CBCR_ADDR=0x13f00c; 
&HWIO_GCC_SPMI_AHB_CFG_RCGR_ADDR=0x13f02c; 
&HWIO_GCC_SPMI_AHB_CMD_RCGR_ADDR=0x13f028; 


&reg=0x0

;data.set a:&HWIO_GCC_SPMI_CNOC_AHB_CBCR_ADDR %LONG 0x8001
data.set a:0x152004 %long 0xFFFFFFFF ; Enable all votable clocks in GCC_APCS_CLOCK_BRANCH_ENA_VOTE


data.set a:&HWIO_GCC_SPMI_SER_CFG_RCGR_ADDR %LONG 0x0
data.set a:&HWIO_GCC_SPMI_SER_CMD_RCGR_ADDR %LONG 0x3
data.set a:&HWIO_GCC_SPMI_SER_CBCR_ADDR %LONG 0x1

data.set a:&HWIO_GCC_SPMI_AHB_CFG_RCGR_ADDR %LONG 0x0
data.set a:&HWIO_GCC_SPMI_AHB_CMD_RCGR_ADDR %LONG 0x3
data.set a:&HWIO_GCC_SPMI_AHB_CBCR_ADDR %LONG 0x1

print "SPMC clock enabled!!!"

enddo
