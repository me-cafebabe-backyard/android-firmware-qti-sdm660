Local &baseOffset

if state.processor()=="CortexM3"
(
    &baseOffset=0x60000000
)

y.create.l HWIO_SPMI_GENI_CLK_CTRL_ADDR A:(&baseOffset+0x400a000)
y.create.l HWIO_SPMI_GENI_HW_VERSION_ADDR A:(&baseOffset+0x400a004)
y.create.l HWIO_SPMI_GENI_FW_REVISION_ADDR A:(&baseOffset+0x400a008)
y.create.l HWIO_SPMI_GENI_S_FW_REVISION_ADDR A:(&baseOffset+0x400a00c)
y.create.l HWIO_SPMI_GENI_FORCE_DEFAULT_REG_ADDR A:(&baseOffset+0x400a010)
y.create.l HWIO_SPMI_GENI_OUTPUT_CTRL_ADDR A:(&baseOffset+0x400a014)
y.create.l HWIO_SPMI_GENI_CGC_CTRL_ADDR A:(&baseOffset+0x400a018)
y.create.l HWIO_SPMI_GENI_CHAR_CFG_ADDR A:(&baseOffset+0x400a01c)
y.create.l HWIO_SPMI_GENI_CHAR_DATA_0_ADDR A:(&baseOffset+0x400a020)
y.create.l HWIO_SPMI_GENI_CHAR_DATA_1_ADDR A:(&baseOffset+0x400a024)
y.create.l HWIO_SPMI_GENI_CTRL_ADDR A:(&baseOffset+0x400a028)
y.create.l HWIO_SPMI_GENI_STATUS_ADDR A:(&baseOffset+0x400a02c)
y.create.l HWIO_SPMI_GENI_TEST_BUS_CTRL_ADDR A:(&baseOffset+0x400a030)
y.create.l HWIO_SPMI_GENI_SER_CLK_CFG_ADDR A:(&baseOffset+0x400a034)
y.create.l HWIO_SPMI_GENI_TX_WATERMARK_REG_ADDR A:(&baseOffset+0x400a038)
y.create.l HWIO_SPMI_GENI_RX_WATERMARK_REG_ADDR A:(&baseOffset+0x400a03c)
y.create.l HWIO_SPMI_GENI_STOP_REG_ADDR A:(&baseOffset+0x400a040)
y.create.l HWIO_SPMI_GENI_SW_COMP_REG_ADDR A:(&baseOffset+0x400a044)
y.create.l HWIO_SPMI_GENI_PROG_ROM_CTRL_REG_ADDR A:(&baseOffset+0x400a048)
y.create.l HWIO_SPMI_GENI_CFG_REG0_ADDR A:(&baseOffset+0x400a100)
y.create.l HWIO_SPMI_GENI_CFG_REG1_ADDR A:(&baseOffset+0x400a104)
y.create.l HWIO_SPMI_GENI_CFG_REG2_ADDR A:(&baseOffset+0x400a108)
y.create.l HWIO_SPMI_GENI_CFG_REG3_ADDR A:(&baseOffset+0x400a10c)
y.create.l HWIO_SPMI_GENI_CFG_REG4_ADDR A:(&baseOffset+0x400a110)
y.create.l HWIO_SPMI_GENI_CFG_REG5_ADDR A:(&baseOffset+0x400a114)
y.create.l HWIO_SPMI_GENI_CFG_REG6_ADDR A:(&baseOffset+0x400a118)
y.create.l HWIO_SPMI_GENI_CFG_REG7_ADDR A:(&baseOffset+0x400a11c)
y.create.l HWIO_SPMI_GENI_CFG_REG8_ADDR A:(&baseOffset+0x400a120)
y.create.l HWIO_SPMI_GENI_CFG_REG9_ADDR A:(&baseOffset+0x400a124)
y.create.l HWIO_SPMI_GENI_CFG_REG10_ADDR A:(&baseOffset+0x400a128)
y.create.l HWIO_SPMI_GENI_CFG_REG11_ADDR A:(&baseOffset+0x400a12c)
y.create.l HWIO_SPMI_GENI_CFG_REG12_ADDR A:(&baseOffset+0x400a130)
y.create.l HWIO_SPMI_GENI_CFG_REG13_ADDR A:(&baseOffset+0x400a134)
y.create.l HWIO_SPMI_GENI_CFG_REG14_ADDR A:(&baseOffset+0x400a138)
y.create.l HWIO_SPMI_GENI_CFG_REG15_ADDR A:(&baseOffset+0x400a13c)
y.create.l HWIO_SPMI_GENI_CFG_REG16_ADDR A:(&baseOffset+0x400a140)
y.create.l HWIO_SPMI_GENI_CFG_REG17_ADDR A:(&baseOffset+0x400a144)
y.create.l HWIO_SPMI_GENI_CFG_REG18_ADDR A:(&baseOffset+0x400a148)
y.create.l HWIO_SPMI_GENI_CFG_REG19_ADDR A:(&baseOffset+0x400a14c)
y.create.l HWIO_SPMI_GENI_CFG_REG20_ADDR A:(&baseOffset+0x400a150)
y.create.l HWIO_SPMI_GENI_CFG_REG21_ADDR A:(&baseOffset+0x400a154)
y.create.l HWIO_SPMI_GENI_CFG_REG22_ADDR A:(&baseOffset+0x400a158)
y.create.l HWIO_SPMI_GENI_CFG_REG23_ADDR A:(&baseOffset+0x400a15c)
y.create.l HWIO_SPMI_GENI_CFG_REG24_ADDR A:(&baseOffset+0x400a160)
y.create.l HWIO_SPMI_GENI_CFG_REG25_ADDR A:(&baseOffset+0x400a164)
y.create.l HWIO_SPMI_GENI_CFG_REG26_ADDR A:(&baseOffset+0x400a168)
y.create.l HWIO_SPMI_GENI_CFG_REG27_ADDR A:(&baseOffset+0x400a16c)
y.create.l HWIO_SPMI_GENI_CFG_REG28_ADDR A:(&baseOffset+0x400a170)
y.create.l HWIO_SPMI_GENI_CFG_REG29_ADDR A:(&baseOffset+0x400a174)
y.create.l HWIO_SPMI_GENI_CFG_REG30_ADDR A:(&baseOffset+0x400a178)
y.create.l HWIO_SPMI_GENI_CFG_RAM0_ADDR A:(&baseOffset+0x400a200)
y.create.l HWIO_SPMI_GENI_CFG_RAM1_ADDR A:(&baseOffset+0x400a204)
y.create.l HWIO_SPMI_GENI_CFG_RAM2_ADDR A:(&baseOffset+0x400a208)
y.create.l HWIO_SPMI_GENI_CFG_RAM3_ADDR A:(&baseOffset+0x400a20c)
y.create.l HWIO_SPMI_GENI_CFG_RAM4_ADDR A:(&baseOffset+0x400a210)
y.create.l HWIO_SPMI_GENI_CFG_RAM5_ADDR A:(&baseOffset+0x400a214)
y.create.l HWIO_SPMI_GENI_CFG_RAM6_ADDR A:(&baseOffset+0x400a218)
y.create.l HWIO_SPMI_GENI_CFG_RAM7_ADDR A:(&baseOffset+0x400a21c)
y.create.l HWIO_SPMI_GENI_CFG_RAM8_ADDR A:(&baseOffset+0x400a220)
y.create.l HWIO_SPMI_GENI_CFG_RAM9_ADDR A:(&baseOffset+0x400a224)
y.create.l HWIO_SPMI_PERIPH0_2OWNER_TABLE_REG_ADDR A:(&baseOffset+0x400a700)
y.create.l HWIO_SPMI_PERIPH1_2OWNER_TABLE_REG_ADDR A:(&baseOffset+0x400a704)
y.create.l HWIO_SPMI_PERIPH2_2OWNER_TABLE_REG_ADDR A:(&baseOffset+0x400a708)
y.create.l HWIO_SPMI_PERIPH3_2OWNER_TABLE_REG_ADDR A:(&baseOffset+0x400a70c)
y.create.l HWIO_SPMI_PERIPH4_2OWNER_TABLE_REG_ADDR A:(&baseOffset+0x400a710)
y.create.l HWIO_SPMI_PERIPH5_2OWNER_TABLE_REG_ADDR A:(&baseOffset+0x400a714)
y.create.l HWIO_SPMI_PERIPH6_2OWNER_TABLE_REG_ADDR A:(&baseOffset+0x400a718)
y.create.l HWIO_SPMI_PERIPH7_2OWNER_TABLE_REG_ADDR A:(&baseOffset+0x400a71c)
y.create.l HWIO_SPMI_PERIPH8_2OWNER_TABLE_REG_ADDR A:(&baseOffset+0x400a720)
y.create.l HWIO_SPMI_PERIPH9_2OWNER_TABLE_REG_ADDR A:(&baseOffset+0x400a724)
y.create.l HWIO_SPMI_MAPPING_TABLE_REG0_ADDR A:(&baseOffset+0x400ab00)
y.create.l HWIO_SPMI_MAPPING_TABLE_REG1_ADDR A:(&baseOffset+0x400ab04)
y.create.l HWIO_SPMI_MAPPING_TABLE_REG2_ADDR A:(&baseOffset+0x400ab08)
y.create.l HWIO_SPMI_MAPPING_TABLE_REG3_ADDR A:(&baseOffset+0x400ab0c)
y.create.l HWIO_SPMI_MAPPING_TABLE_REG4_ADDR A:(&baseOffset+0x400ab10)
y.create.l HWIO_SPMI_MAPPING_TABLE_REG5_ADDR A:(&baseOffset+0x400ab14)
y.create.l HWIO_SPMI_MAPPING_TABLE_REG6_ADDR A:(&baseOffset+0x400ab18)
y.create.l HWIO_SPMI_MAPPING_TABLE_REG7_ADDR A:(&baseOffset+0x400ab1c)
y.create.l HWIO_SPMI_MAPPING_TABLE_REG8_ADDR A:(&baseOffset+0x400ab20)
y.create.l HWIO_SPMI_MAPPING_TABLE_REG9_ADDR A:(&baseOffset+0x400ab24)
y.create.l HWIO_SPMI_MID_REG_ADDR A:(&baseOffset+0x400af00)
y.create.l HWIO_SPMI_CFG_REG_ADDR A:(&baseOffset+0x400af04)
y.create.l HWIO_SPMI_SEC_DISABLE_REG_ADDR A:(&baseOffset+0x400af08)
y.create.l HWIO_SPMI_HW_VERSION_ADDR A:(&baseOffset+0x400af0c)
y.create.l HWIO_SPMI_CGC_CTRL_ADDR A:(&baseOffset+0x400af10)
y.create.l HWIO_SPMI_MWB_ENABLE_REG_ADDR A:(&baseOffset+0x400af14)
y.create.l HWIO_SPMI_CHAR_CFG_ADDR A:(&baseOffset+0x400af40)
y.create.l HWIO_SPMI_CHAR_DATA_0_ADDR A:(&baseOffset+0x400af44)
y.create.l HWIO_SPMI_CHAR_DATA_1_ADDR A:(&baseOffset+0x400af48)
y.create.l HWIO_SPMI_CMPR_EN_REG_ADDR A:(&baseOffset+0x400af54)
y.create.l HWIO_SPMI_PROTOCOL_IRQ_STATUS_ADDR A:(&baseOffset+0x400b000)
y.create.l HWIO_SPMI_PROTOCOL_IRQ_ENABLE_ADDR A:(&baseOffset+0x400b004)
y.create.l HWIO_SPMI_PROTOCOL_IRQ_CLEAR_ADDR A:(&baseOffset+0x400b008)
y.create.l HWIO_SPMI_PROTOCOL_IRQ_EN_SET_ADDR A:(&baseOffset+0x400b00c)
y.create.l HWIO_SPMI_PROTOCOL_IRQ_EN_CLEAR_ADDR A:(&baseOffset+0x400b010)
y.create.l HWIO_SPMI_TEST_BUS_CTRL_ADDR A:(&baseOffset+0x400c000)
y.create.l HWIO_SPMI_HW_SW_EVENTS_CTRL_ADDR A:(&baseOffset+0x400c004)
y.create.l HWIO_SPMI_HW_SW_EVENTS_BITWISE_REG0_ADDR A:(&baseOffset+0x400c008)
y.create.l HWIO_SPMI_HW_SW_EVENTS_BITWISE_REG1_ADDR A:(&baseOffset+0x400c00c)
y.create.l HWIO_SPMI_HW_SW_EVENTS_BITWISE_REG2_ADDR A:(&baseOffset+0x400c010)
y.create.l HWIO_SPMI_HW_SW_EVENTS_BITWISE_REG3_ADDR A:(&baseOffset+0x400c014)
y.create.l HWIO_SPMI_HW_SW_EVENTS_BITWISE_REG4_ADDR A:(&baseOffset+0x400c018)
y.create.l HWIO_SPMI_HW_SW_EVENTS_BITWISE_REG5_ADDR A:(&baseOffset+0x400c01c)
y.create.l HWIO_SPMI_HW_SW_EVENTS_BITWISE_REG6_ADDR A:(&baseOffset+0x400c020)
y.create.l HWIO_SPMI_HW_SW_EVENTS_BITWISE_REG7_ADDR A:(&baseOffset+0x400c024)
y.create.l HWIO_SPMI_PIC_OWNER0_ACC_STATUS0_ADDR A:(&baseOffset+0x5900000)
y.create.l HWIO_SPMI_PIC_OWNER1_ACC_STATUS0_ADDR A:(&baseOffset+0x5901000)
y.create.l HWIO_SPMI_PIC_OWNER2_ACC_STATUS0_ADDR A:(&baseOffset+0x5902000)
y.create.l HWIO_SPMI_PIC_OWNER3_ACC_STATUS0_ADDR A:(&baseOffset+0x5903000)
y.create.l HWIO_SPMI_PIC_OWNER0_ACC_STATUS1_ADDR A:(&baseOffset+0x5900004)
y.create.l HWIO_SPMI_PIC_OWNER1_ACC_STATUS1_ADDR A:(&baseOffset+0x5901004)
y.create.l HWIO_SPMI_PIC_OWNER2_ACC_STATUS1_ADDR A:(&baseOffset+0x5902004)
y.create.l HWIO_SPMI_PIC_OWNER3_ACC_STATUS1_ADDR A:(&baseOffset+0x5903004)
y.create.l HWIO_SPMI_PIC_OWNER0_ACC_STATUS2_ADDR A:(&baseOffset+0x5900008)
y.create.l HWIO_SPMI_PIC_OWNER1_ACC_STATUS2_ADDR A:(&baseOffset+0x5901008)
y.create.l HWIO_SPMI_PIC_OWNER2_ACC_STATUS2_ADDR A:(&baseOffset+0x5902008)
y.create.l HWIO_SPMI_PIC_OWNER3_ACC_STATUS2_ADDR A:(&baseOffset+0x5903008)
y.create.l HWIO_SPMI_PIC_OWNER0_ACC_STATUS3_ADDR A:(&baseOffset+0x590000c)
y.create.l HWIO_SPMI_PIC_OWNER1_ACC_STATUS3_ADDR A:(&baseOffset+0x590100c)
y.create.l HWIO_SPMI_PIC_OWNER2_ACC_STATUS3_ADDR A:(&baseOffset+0x590200c)
y.create.l HWIO_SPMI_PIC_OWNER3_ACC_STATUS3_ADDR A:(&baseOffset+0x590300c)
y.create.l HWIO_SPMI_PIC_ACC_ENABLE0_ADDR A:(&baseOffset+0x5800000)
y.create.l HWIO_SPMI_PIC_ACC_ENABLE1_ADDR A:(&baseOffset+0x5801000)
y.create.l HWIO_SPMI_PIC_ACC_ENABLE2_ADDR A:(&baseOffset+0x5802000)
y.create.l HWIO_SPMI_PIC_ACC_ENABLE3_ADDR A:(&baseOffset+0x5803000)
y.create.l HWIO_SPMI_PIC_ACC_ENABLE4_ADDR A:(&baseOffset+0x5804000)
y.create.l HWIO_SPMI_PIC_ACC_ENABLE5_ADDR A:(&baseOffset+0x5805000)
y.create.l HWIO_SPMI_PIC_ACC_ENABLE6_ADDR A:(&baseOffset+0x5806000)
y.create.l HWIO_SPMI_PIC_ACC_ENABLE7_ADDR A:(&baseOffset+0x5807000)
y.create.l HWIO_SPMI_PIC_ACC_ENABLE8_ADDR A:(&baseOffset+0x5808000)
y.create.l HWIO_SPMI_PIC_ACC_ENABLE9_ADDR A:(&baseOffset+0x5809000)
y.create.l HWIO_SPMI_PIC_IRQ_STATUS0_ADDR A:(&baseOffset+0x5800004)
y.create.l HWIO_SPMI_PIC_IRQ_STATUS1_ADDR A:(&baseOffset+0x5801004)
y.create.l HWIO_SPMI_PIC_IRQ_STATUS2_ADDR A:(&baseOffset+0x5802004)
y.create.l HWIO_SPMI_PIC_IRQ_STATUS3_ADDR A:(&baseOffset+0x5803004)
y.create.l HWIO_SPMI_PIC_IRQ_STATUS4_ADDR A:(&baseOffset+0x5804004)
y.create.l HWIO_SPMI_PIC_IRQ_STATUS5_ADDR A:(&baseOffset+0x5805004)
y.create.l HWIO_SPMI_PIC_IRQ_STATUS6_ADDR A:(&baseOffset+0x5806004)
y.create.l HWIO_SPMI_PIC_IRQ_STATUS7_ADDR A:(&baseOffset+0x5807004)
y.create.l HWIO_SPMI_PIC_IRQ_STATUS8_ADDR A:(&baseOffset+0x5808004)
y.create.l HWIO_SPMI_PIC_IRQ_STATUS9_ADDR A:(&baseOffset+0x5809004)
y.create.l HWIO_SPMI_PIC_IRQ_CLEAR0_ADDR A:(&baseOffset+0x5800008)
y.create.l HWIO_SPMI_PIC_IRQ_CLEAR1_ADDR A:(&baseOffset+0x5801008)
y.create.l HWIO_SPMI_PIC_IRQ_CLEAR2_ADDR A:(&baseOffset+0x5802008)
y.create.l HWIO_SPMI_PIC_IRQ_CLEAR3_ADDR A:(&baseOffset+0x5803008)
y.create.l HWIO_SPMI_PIC_IRQ_CLEAR4_ADDR A:(&baseOffset+0x5804008)
y.create.l HWIO_SPMI_PIC_IRQ_CLEAR5_ADDR A:(&baseOffset+0x5805008)
y.create.l HWIO_SPMI_PIC_IRQ_CLEAR6_ADDR A:(&baseOffset+0x5806008)
y.create.l HWIO_SPMI_PIC_IRQ_CLEAR7_ADDR A:(&baseOffset+0x5807008)
y.create.l HWIO_SPMI_PIC_IRQ_CLEAR8_ADDR A:(&baseOffset+0x5808008)
y.create.l HWIO_SPMI_PIC_IRQ_CLEAR9_ADDR A:(&baseOffset+0x5809008)
y.create.l HWIO_PMIC_ARB_XPU_SCR_ADDR A:(&baseOffset+0x400e000)
y.create.l HWIO_PMIC_ARB_XPU_SWDR_ADDR A:(&baseOffset+0x400e004)
y.create.l HWIO_PMIC_ARB_XPU_PRTN_RACR_SSHADOW_ADDR A:(&baseOffset+0x400e008)
y.create.l HWIO_PMIC_ARB_XPU_PRTN_WACR_SSHADOW_ADDR A:(&baseOffset+0x400e00c)
y.create.l HWIO_PMIC_ARB_XPU_PRTN_START_SSHADOW0_ADDR A:(&baseOffset+0x400e010)
y.create.l HWIO_PMIC_ARB_XPU_PRTN_END_SSHADOW0_ADDR A:(&baseOffset+0x400e018)
y.create.l HWIO_PMIC_ARB_XPU_SEAR0_ADDR A:(&baseOffset+0x400e040)
y.create.l HWIO_PMIC_ARB_XPU_SESR_ADDR A:(&baseOffset+0x400e048)
y.create.l HWIO_PMIC_ARB_XPU_SESRRESTORE_ADDR A:(&baseOffset+0x400e04c)
y.create.l HWIO_PMIC_ARB_XPU_SESYNR0_ADDR A:(&baseOffset+0x400e050)
y.create.l HWIO_PMIC_ARB_XPU_SESYNR1_ADDR A:(&baseOffset+0x400e054)
y.create.l HWIO_PMIC_ARB_XPU_SESYNR2_ADDR A:(&baseOffset+0x400e058)
y.create.l HWIO_PMIC_ARB_XPU_MCR_ADDR A:(&baseOffset+0x400e100)
y.create.l HWIO_PMIC_ARB_XPU_MEAR0_ADDR A:(&baseOffset+0x400e140)
y.create.l HWIO_PMIC_ARB_XPU_MESR_ADDR A:(&baseOffset+0x400e148)
y.create.l HWIO_PMIC_ARB_XPU_MESRRESTORE_ADDR A:(&baseOffset+0x400e14c)
y.create.l HWIO_PMIC_ARB_XPU_MESYNR0_ADDR A:(&baseOffset+0x400e150)
y.create.l HWIO_PMIC_ARB_XPU_MESYNR1_ADDR A:(&baseOffset+0x400e154)
y.create.l HWIO_PMIC_ARB_XPU_MESYNR2_ADDR A:(&baseOffset+0x400e158)
y.create.l HWIO_PMIC_ARB_XPU_CR_ADDR A:(&baseOffset+0x400e080)
y.create.l HWIO_PMIC_ARB_XPU_PRTN_RACR_SHADOW_ADDR A:(&baseOffset+0x400e088)
y.create.l HWIO_PMIC_ARB_XPU_PRTN_WACR_SHADOW_ADDR A:(&baseOffset+0x400e08c)
y.create.l HWIO_PMIC_ARB_XPU_PRTN_START_SHADOW0_ADDR A:(&baseOffset+0x400e090)
y.create.l HWIO_PMIC_ARB_XPU_PRTN_END_SHADOW0_ADDR A:(&baseOffset+0x400e098)
y.create.l HWIO_PMIC_ARB_XPU_RPU_ACR0_ADDR A:(&baseOffset+0x400e0a0)
y.create.l HWIO_PMIC_ARB_XPU_EAR0_ADDR A:(&baseOffset+0x400e0c0)
y.create.l HWIO_PMIC_ARB_XPU_ESR_ADDR A:(&baseOffset+0x400e0c8)
y.create.l HWIO_PMIC_ARB_XPU_ESRRESTORE_ADDR A:(&baseOffset+0x400e0cc)
y.create.l HWIO_PMIC_ARB_XPU_ESYNR0_ADDR A:(&baseOffset+0x400e0d0)
y.create.l HWIO_PMIC_ARB_XPU_ESYNR1_ADDR A:(&baseOffset+0x400e0d4)
y.create.l HWIO_PMIC_ARB_XPU_ESYNR2_ADDR A:(&baseOffset+0x400e0d8)
y.create.l HWIO_PMIC_ARB_XPU_UMR_RACR_ADDR A:(&baseOffset+0x400e0e0)
y.create.l HWIO_PMIC_ARB_XPU_UMR_WACR_ADDR A:(&baseOffset+0x400e0e4)
y.create.l HWIO_PMIC_ARB_XPU_UMR_CNTL_ADDR A:(&baseOffset+0x400e0f0)
y.create.l HWIO_PMIC_ARB_XPU_IDR0_ADDR A:(&baseOffset+0x400e074)
y.create.l HWIO_PMIC_ARB_XPU_IDR1_ADDR A:(&baseOffset+0x400e078)
y.create.l HWIO_PMIC_ARB_XPU_REV_ADDR A:(&baseOffset+0x400e07c)
y.create.l HWIO_PMIC_ARB_XPU_PRT0_RACR0_ADDR A:(&baseOffset+0x400e200)
y.create.l HWIO_PMIC_ARB_XPU_PRT1_RACR0_ADDR A:(&baseOffset+0x400e280)
y.create.l HWIO_PMIC_ARB_XPU_PRT2_RACR0_ADDR A:(&baseOffset+0x400e300)
y.create.l HWIO_PMIC_ARB_XPU_PRT3_RACR0_ADDR A:(&baseOffset+0x400e380)
y.create.l HWIO_PMIC_ARB_XPU_PRT4_RACR0_ADDR A:(&baseOffset+0x400e400)
y.create.l HWIO_PMIC_ARB_XPU_PRT5_RACR0_ADDR A:(&baseOffset+0x400e480)
y.create.l HWIO_PMIC_ARB_XPU_PRT6_RACR0_ADDR A:(&baseOffset+0x400e500)
y.create.l HWIO_PMIC_ARB_XPU_PRT7_RACR0_ADDR A:(&baseOffset+0x400e580)
y.create.l HWIO_PMIC_ARB_XPU_PRT8_RACR0_ADDR A:(&baseOffset+0x400e600)
y.create.l HWIO_PMIC_ARB_XPU_PRT9_RACR0_ADDR A:(&baseOffset+0x400e680)
y.create.l HWIO_PMIC_ARB_XPU_PRT0_WACR0_ADDR A:(&baseOffset+0x400e220)
y.create.l HWIO_PMIC_ARB_XPU_PRT1_WACR0_ADDR A:(&baseOffset+0x400e2a0)
y.create.l HWIO_PMIC_ARB_XPU_PRT2_WACR0_ADDR A:(&baseOffset+0x400e320)
y.create.l HWIO_PMIC_ARB_XPU_PRT3_WACR0_ADDR A:(&baseOffset+0x400e3a0)
y.create.l HWIO_PMIC_ARB_XPU_PRT4_WACR0_ADDR A:(&baseOffset+0x400e420)
y.create.l HWIO_PMIC_ARB_XPU_PRT5_WACR0_ADDR A:(&baseOffset+0x400e4a0)
y.create.l HWIO_PMIC_ARB_XPU_PRT6_WACR0_ADDR A:(&baseOffset+0x400e520)
y.create.l HWIO_PMIC_ARB_XPU_PRT7_WACR0_ADDR A:(&baseOffset+0x400e5a0)
y.create.l HWIO_PMIC_ARB_XPU_PRT8_WACR0_ADDR A:(&baseOffset+0x400e620)
y.create.l HWIO_PMIC_ARB_XPU_PRT9_WACR0_ADDR A:(&baseOffset+0x400e6a0)
y.create.l HWIO_PMIC_ARB_XPU_PRT0_START0_ADDR A:(&baseOffset+0x400e240)
y.create.l HWIO_PMIC_ARB_XPU_PRT1_START0_ADDR A:(&baseOffset+0x400e2c0)
y.create.l HWIO_PMIC_ARB_XPU_PRT2_START0_ADDR A:(&baseOffset+0x400e340)
y.create.l HWIO_PMIC_ARB_XPU_PRT3_START0_ADDR A:(&baseOffset+0x400e3c0)
y.create.l HWIO_PMIC_ARB_XPU_PRT4_START0_ADDR A:(&baseOffset+0x400e440)
y.create.l HWIO_PMIC_ARB_XPU_PRT5_START0_ADDR A:(&baseOffset+0x400e4c0)
y.create.l HWIO_PMIC_ARB_XPU_PRT6_START0_ADDR A:(&baseOffset+0x400e540)
y.create.l HWIO_PMIC_ARB_XPU_PRT7_START0_ADDR A:(&baseOffset+0x400e5c0)
y.create.l HWIO_PMIC_ARB_XPU_PRT8_START0_ADDR A:(&baseOffset+0x400e640)
y.create.l HWIO_PMIC_ARB_XPU_PRT9_START0_ADDR A:(&baseOffset+0x400e6c0)
y.create.l HWIO_PMIC_ARB_XPU_PRT0_END0_ADDR A:(&baseOffset+0x400e248)
y.create.l HWIO_PMIC_ARB_XPU_PRT1_END0_ADDR A:(&baseOffset+0x400e2c8)
y.create.l HWIO_PMIC_ARB_XPU_PRT2_END0_ADDR A:(&baseOffset+0x400e348)
y.create.l HWIO_PMIC_ARB_XPU_PRT3_END0_ADDR A:(&baseOffset+0x400e3c8)
y.create.l HWIO_PMIC_ARB_XPU_PRT4_END0_ADDR A:(&baseOffset+0x400e448)
y.create.l HWIO_PMIC_ARB_XPU_PRT5_END0_ADDR A:(&baseOffset+0x400e4c8)
y.create.l HWIO_PMIC_ARB_XPU_PRT6_END0_ADDR A:(&baseOffset+0x400e548)
y.create.l HWIO_PMIC_ARB_XPU_PRT7_END0_ADDR A:(&baseOffset+0x400e5c8)
y.create.l HWIO_PMIC_ARB_XPU_PRT8_END0_ADDR A:(&baseOffset+0x400e648)
y.create.l HWIO_PMIC_ARB_XPU_PRT9_END0_ADDR A:(&baseOffset+0x400e6c8)
y.create.l HWIO_PMIC_ARB_XPU_PRT0_SCR_ADDR A:(&baseOffset+0x400e250)
y.create.l HWIO_PMIC_ARB_XPU_PRT1_SCR_ADDR A:(&baseOffset+0x400e2d0)
y.create.l HWIO_PMIC_ARB_XPU_PRT2_SCR_ADDR A:(&baseOffset+0x400e350)
y.create.l HWIO_PMIC_ARB_XPU_PRT3_SCR_ADDR A:(&baseOffset+0x400e3d0)
y.create.l HWIO_PMIC_ARB_XPU_PRT4_SCR_ADDR A:(&baseOffset+0x400e450)
y.create.l HWIO_PMIC_ARB_XPU_PRT5_SCR_ADDR A:(&baseOffset+0x400e4d0)
y.create.l HWIO_PMIC_ARB_XPU_PRT6_SCR_ADDR A:(&baseOffset+0x400e550)
y.create.l HWIO_PMIC_ARB_XPU_PRT7_SCR_ADDR A:(&baseOffset+0x400e5d0)
y.create.l HWIO_PMIC_ARB_XPU_PRT8_SCR_ADDR A:(&baseOffset+0x400e650)
y.create.l HWIO_PMIC_ARB_XPU_PRT9_SCR_ADDR A:(&baseOffset+0x400e6d0)
y.create.l HWIO_PMIC_ARB_XPU_PRT0_MCR_ADDR A:(&baseOffset+0x400e254)
y.create.l HWIO_PMIC_ARB_XPU_PRT1_MCR_ADDR A:(&baseOffset+0x400e2d4)
y.create.l HWIO_PMIC_ARB_XPU_PRT2_MCR_ADDR A:(&baseOffset+0x400e354)
y.create.l HWIO_PMIC_ARB_XPU_PRT3_MCR_ADDR A:(&baseOffset+0x400e3d4)
y.create.l HWIO_PMIC_ARB_XPU_PRT4_MCR_ADDR A:(&baseOffset+0x400e454)
y.create.l HWIO_PMIC_ARB_XPU_PRT5_MCR_ADDR A:(&baseOffset+0x400e4d4)
y.create.l HWIO_PMIC_ARB_XPU_PRT6_MCR_ADDR A:(&baseOffset+0x400e554)
y.create.l HWIO_PMIC_ARB_XPU_PRT7_MCR_ADDR A:(&baseOffset+0x400e5d4)
y.create.l HWIO_PMIC_ARB_XPU_PRT8_MCR_ADDR A:(&baseOffset+0x400e654)
y.create.l HWIO_PMIC_ARB_XPU_PRT9_MCR_ADDR A:(&baseOffset+0x400e6d4)
y.create.l HWIO_PMIC_ARB_XPU_PRT0_CNTL0_ADDR A:(&baseOffset+0x400e258)
y.create.l HWIO_PMIC_ARB_XPU_PRT1_CNTL0_ADDR A:(&baseOffset+0x400e2d8)
y.create.l HWIO_PMIC_ARB_XPU_PRT2_CNTL0_ADDR A:(&baseOffset+0x400e358)
y.create.l HWIO_PMIC_ARB_XPU_PRT3_CNTL0_ADDR A:(&baseOffset+0x400e3d8)
y.create.l HWIO_PMIC_ARB_XPU_PRT4_CNTL0_ADDR A:(&baseOffset+0x400e458)
y.create.l HWIO_PMIC_ARB_XPU_PRT5_CNTL0_ADDR A:(&baseOffset+0x400e4d8)
y.create.l HWIO_PMIC_ARB_XPU_PRT6_CNTL0_ADDR A:(&baseOffset+0x400e558)
y.create.l HWIO_PMIC_ARB_XPU_PRT7_CNTL0_ADDR A:(&baseOffset+0x400e5d8)
y.create.l HWIO_PMIC_ARB_XPU_PRT8_CNTL0_ADDR A:(&baseOffset+0x400e658)
y.create.l HWIO_PMIC_ARB_XPU_PRT9_CNTL0_ADDR A:(&baseOffset+0x400e6d8)
y.create.l HWIO_PMIC_ARB_XPU_PRT0_CNTL1_ADDR A:(&baseOffset+0x400e25c)
y.create.l HWIO_PMIC_ARB_XPU_PRT1_CNTL1_ADDR A:(&baseOffset+0x400e2dc)
y.create.l HWIO_PMIC_ARB_XPU_PRT2_CNTL1_ADDR A:(&baseOffset+0x400e35c)
y.create.l HWIO_PMIC_ARB_XPU_PRT3_CNTL1_ADDR A:(&baseOffset+0x400e3dc)
y.create.l HWIO_PMIC_ARB_XPU_PRT4_CNTL1_ADDR A:(&baseOffset+0x400e45c)
y.create.l HWIO_PMIC_ARB_XPU_PRT5_CNTL1_ADDR A:(&baseOffset+0x400e4dc)
y.create.l HWIO_PMIC_ARB_XPU_PRT6_CNTL1_ADDR A:(&baseOffset+0x400e55c)
y.create.l HWIO_PMIC_ARB_XPU_PRT7_CNTL1_ADDR A:(&baseOffset+0x400e5dc)
y.create.l HWIO_PMIC_ARB_XPU_PRT8_CNTL1_ADDR A:(&baseOffset+0x400e65c)
y.create.l HWIO_PMIC_ARB_XPU_PRT9_CNTL1_ADDR A:(&baseOffset+0x400e6dc)
y.create.l HWIO_PMIC_ARB_HW_VERSION_ADDR A:(&baseOffset+0x400f000)
y.create.l HWIO_PMIC_ARB_MISC_CONFIG_ADDR A:(&baseOffset+0x400f004)
y.create.l HWIO_PMIC_ARB_PVC_INTF_CTL_ADDR A:(&baseOffset+0x400f008)
y.create.l HWIO_PMIC_ARB_PVC_INTF_STATUS_ADDR A:(&baseOffset+0x400f00c)
y.create.l HWIO_PMIC_ARB_PRIORITIES0_ADDR A:(&baseOffset+0x400f100)
y.create.l HWIO_PMIC_ARB_PRIORITIES1_ADDR A:(&baseOffset+0x400f104)
y.create.l HWIO_PMIC_ARB_PRIORITIES2_ADDR A:(&baseOffset+0x400f108)
y.create.l HWIO_PMIC_ARB_PRIORITIES3_ADDR A:(&baseOffset+0x400f10c)
y.create.l HWIO_PMIC_ARB_PRIORITIES4_ADDR A:(&baseOffset+0x400f110)
y.create.l HWIO_PMIC_ARB_PRIORITIES5_ADDR A:(&baseOffset+0x400f114)
y.create.l HWIO_PMIC_ARB_PVC_PORT0_CTL_ADDR A:(&baseOffset+0x400f200)
y.create.l HWIO_PMIC_ARB_PVC_PORT1_CTL_ADDR A:(&baseOffset+0x400f204)
y.create.l HWIO_PMIC_ARB_PVC_PORT2_CTL_ADDR A:(&baseOffset+0x400f208)
y.create.l HWIO_PMIC_ARB_PVC_PORT3_CTL_ADDR A:(&baseOffset+0x400f20c)
y.create.l HWIO_PMIC_ARB_PVC_PORT4_CTL_ADDR A:(&baseOffset+0x400f210)
y.create.l HWIO_PMIC_ARB_PVC_PORT0_STATUS_ADDR A:(&baseOffset+0x400f280)
y.create.l HWIO_PMIC_ARB_PVC_PORT1_STATUS_ADDR A:(&baseOffset+0x400f284)
y.create.l HWIO_PMIC_ARB_PVC_PORT2_STATUS_ADDR A:(&baseOffset+0x400f288)
y.create.l HWIO_PMIC_ARB_PVC_PORT3_STATUS_ADDR A:(&baseOffset+0x400f28c)
y.create.l HWIO_PMIC_ARB_PVC_PORT4_STATUS_ADDR A:(&baseOffset+0x400f290)
y.create.l HWIO_PMIC_ARB_PVC0_ADDR0_ADDR A:(&baseOffset+0x400f400)
y.create.l HWIO_PMIC_ARB_PVC1_ADDR0_ADDR A:(&baseOffset+0x400f420)
y.create.l HWIO_PMIC_ARB_PVC2_ADDR0_ADDR A:(&baseOffset+0x400f440)
y.create.l HWIO_PMIC_ARB_PVC3_ADDR0_ADDR A:(&baseOffset+0x400f460)
y.create.l HWIO_PMIC_ARB_PVC0_ADDR1_ADDR A:(&baseOffset+0x400f404)
y.create.l HWIO_PMIC_ARB_PVC1_ADDR1_ADDR A:(&baseOffset+0x400f424)
y.create.l HWIO_PMIC_ARB_PVC2_ADDR1_ADDR A:(&baseOffset+0x400f444)
y.create.l HWIO_PMIC_ARB_PVC3_ADDR1_ADDR A:(&baseOffset+0x400f464)
y.create.l HWIO_PMIC_ARB_PVC0_ADDR2_ADDR A:(&baseOffset+0x400f408)
y.create.l HWIO_PMIC_ARB_PVC1_ADDR2_ADDR A:(&baseOffset+0x400f428)
y.create.l HWIO_PMIC_ARB_PVC2_ADDR2_ADDR A:(&baseOffset+0x400f448)
y.create.l HWIO_PMIC_ARB_PVC3_ADDR2_ADDR A:(&baseOffset+0x400f468)
y.create.l HWIO_PMIC_ARB_PVC0_ADDR3_ADDR A:(&baseOffset+0x400f40c)
y.create.l HWIO_PMIC_ARB_PVC1_ADDR3_ADDR A:(&baseOffset+0x400f42c)
y.create.l HWIO_PMIC_ARB_PVC2_ADDR3_ADDR A:(&baseOffset+0x400f44c)
y.create.l HWIO_PMIC_ARB_PVC3_ADDR3_ADDR A:(&baseOffset+0x400f46c)
y.create.l HWIO_PMIC_ARB_REG_CHNL0_ADDR A:(&baseOffset+0x400f800)
y.create.l HWIO_PMIC_ARB_REG_CHNL1_ADDR A:(&baseOffset+0x400f804)
y.create.l HWIO_PMIC_ARB_REG_CHNL2_ADDR A:(&baseOffset+0x400f808)
y.create.l HWIO_PMIC_ARB_REG_CHNL3_ADDR A:(&baseOffset+0x400f80c)
y.create.l HWIO_PMIC_ARB_REG_CHNL4_ADDR A:(&baseOffset+0x400f810)
y.create.l HWIO_PMIC_ARB_REG_CHNL5_ADDR A:(&baseOffset+0x400f814)
y.create.l HWIO_PMIC_ARB_REG_CHNL6_ADDR A:(&baseOffset+0x400f818)
y.create.l HWIO_PMIC_ARB_REG_CHNL7_ADDR A:(&baseOffset+0x400f81c)
y.create.l HWIO_PMIC_ARB_REG_CHNL8_ADDR A:(&baseOffset+0x400f820)
y.create.l HWIO_PMIC_ARB_REG_CHNL9_ADDR A:(&baseOffset+0x400f824)
y.create.l HWIO_PMIC_ARB0_CHNL0_CMD_ADDR A:(&baseOffset+0x4400000)
y.create.l HWIO_PMIC_ARB1_CHNL0_CMD_ADDR A:(&baseOffset+0x4401000)
y.create.l HWIO_PMIC_ARB2_CHNL0_CMD_ADDR A:(&baseOffset+0x4402000)
y.create.l HWIO_PMIC_ARB3_CHNL0_CMD_ADDR A:(&baseOffset+0x4403000)
y.create.l HWIO_PMIC_ARB0_CHNL1_CMD_ADDR A:(&baseOffset+0x4408000)
y.create.l HWIO_PMIC_ARB1_CHNL1_CMD_ADDR A:(&baseOffset+0x4409000)
y.create.l HWIO_PMIC_ARB2_CHNL1_CMD_ADDR A:(&baseOffset+0x440a000)
y.create.l HWIO_PMIC_ARB3_CHNL1_CMD_ADDR A:(&baseOffset+0x440b000)
y.create.l HWIO_PMIC_ARB0_CHNL2_CMD_ADDR A:(&baseOffset+0x4410000)
y.create.l HWIO_PMIC_ARB1_CHNL2_CMD_ADDR A:(&baseOffset+0x4411000)
y.create.l HWIO_PMIC_ARB2_CHNL2_CMD_ADDR A:(&baseOffset+0x4412000)
y.create.l HWIO_PMIC_ARB3_CHNL2_CMD_ADDR A:(&baseOffset+0x4413000)
y.create.l HWIO_PMIC_ARB0_CHNL3_CMD_ADDR A:(&baseOffset+0x4418000)
y.create.l HWIO_PMIC_ARB1_CHNL3_CMD_ADDR A:(&baseOffset+0x4419000)
y.create.l HWIO_PMIC_ARB2_CHNL3_CMD_ADDR A:(&baseOffset+0x441a000)
y.create.l HWIO_PMIC_ARB3_CHNL3_CMD_ADDR A:(&baseOffset+0x441b000)
y.create.l HWIO_PMIC_ARB0_CHNL4_CMD_ADDR A:(&baseOffset+0x4420000)
y.create.l HWIO_PMIC_ARB1_CHNL4_CMD_ADDR A:(&baseOffset+0x4421000)
y.create.l HWIO_PMIC_ARB2_CHNL4_CMD_ADDR A:(&baseOffset+0x4422000)
y.create.l HWIO_PMIC_ARB3_CHNL4_CMD_ADDR A:(&baseOffset+0x4423000)
y.create.l HWIO_PMIC_ARB0_CHNL5_CMD_ADDR A:(&baseOffset+0x4428000)
y.create.l HWIO_PMIC_ARB1_CHNL5_CMD_ADDR A:(&baseOffset+0x4429000)
y.create.l HWIO_PMIC_ARB2_CHNL5_CMD_ADDR A:(&baseOffset+0x442a000)
y.create.l HWIO_PMIC_ARB3_CHNL5_CMD_ADDR A:(&baseOffset+0x442b000)
y.create.l HWIO_PMIC_ARB0_CHNL6_CMD_ADDR A:(&baseOffset+0x4430000)
y.create.l HWIO_PMIC_ARB1_CHNL6_CMD_ADDR A:(&baseOffset+0x4431000)
y.create.l HWIO_PMIC_ARB2_CHNL6_CMD_ADDR A:(&baseOffset+0x4432000)
y.create.l HWIO_PMIC_ARB3_CHNL6_CMD_ADDR A:(&baseOffset+0x4433000)
y.create.l HWIO_PMIC_ARB0_CHNL7_CMD_ADDR A:(&baseOffset+0x4438000)
y.create.l HWIO_PMIC_ARB1_CHNL7_CMD_ADDR A:(&baseOffset+0x4439000)
y.create.l HWIO_PMIC_ARB2_CHNL7_CMD_ADDR A:(&baseOffset+0x443a000)
y.create.l HWIO_PMIC_ARB3_CHNL7_CMD_ADDR A:(&baseOffset+0x443b000)
y.create.l HWIO_PMIC_ARB0_CHNL8_CMD_ADDR A:(&baseOffset+0x4440000)
y.create.l HWIO_PMIC_ARB1_CHNL8_CMD_ADDR A:(&baseOffset+0x4441000)
y.create.l HWIO_PMIC_ARB2_CHNL8_CMD_ADDR A:(&baseOffset+0x4442000)
y.create.l HWIO_PMIC_ARB3_CHNL8_CMD_ADDR A:(&baseOffset+0x4443000)
y.create.l HWIO_PMIC_ARB0_CHNL9_CMD_ADDR A:(&baseOffset+0x4448000)
y.create.l HWIO_PMIC_ARB1_CHNL9_CMD_ADDR A:(&baseOffset+0x4449000)
y.create.l HWIO_PMIC_ARB2_CHNL9_CMD_ADDR A:(&baseOffset+0x444a000)
y.create.l HWIO_PMIC_ARB3_CHNL9_CMD_ADDR A:(&baseOffset+0x444b000)
y.create.l HWIO_PMIC_ARB0_CHNL0_CONFIG_ADDR A:(&baseOffset+0x4400004)
y.create.l HWIO_PMIC_ARB1_CHNL0_CONFIG_ADDR A:(&baseOffset+0x4401004)
y.create.l HWIO_PMIC_ARB2_CHNL0_CONFIG_ADDR A:(&baseOffset+0x4402004)
y.create.l HWIO_PMIC_ARB3_CHNL0_CONFIG_ADDR A:(&baseOffset+0x4403004)
y.create.l HWIO_PMIC_ARB0_CHNL1_CONFIG_ADDR A:(&baseOffset+0x4408004)
y.create.l HWIO_PMIC_ARB1_CHNL1_CONFIG_ADDR A:(&baseOffset+0x4409004)
y.create.l HWIO_PMIC_ARB2_CHNL1_CONFIG_ADDR A:(&baseOffset+0x440a004)
y.create.l HWIO_PMIC_ARB3_CHNL1_CONFIG_ADDR A:(&baseOffset+0x440b004)
y.create.l HWIO_PMIC_ARB0_CHNL2_CONFIG_ADDR A:(&baseOffset+0x4410004)
y.create.l HWIO_PMIC_ARB1_CHNL2_CONFIG_ADDR A:(&baseOffset+0x4411004)
y.create.l HWIO_PMIC_ARB2_CHNL2_CONFIG_ADDR A:(&baseOffset+0x4412004)
y.create.l HWIO_PMIC_ARB3_CHNL2_CONFIG_ADDR A:(&baseOffset+0x4413004)
y.create.l HWIO_PMIC_ARB0_CHNL3_CONFIG_ADDR A:(&baseOffset+0x4418004)
y.create.l HWIO_PMIC_ARB1_CHNL3_CONFIG_ADDR A:(&baseOffset+0x4419004)
y.create.l HWIO_PMIC_ARB2_CHNL3_CONFIG_ADDR A:(&baseOffset+0x441a004)
y.create.l HWIO_PMIC_ARB3_CHNL3_CONFIG_ADDR A:(&baseOffset+0x441b004)
y.create.l HWIO_PMIC_ARB0_CHNL4_CONFIG_ADDR A:(&baseOffset+0x4420004)
y.create.l HWIO_PMIC_ARB1_CHNL4_CONFIG_ADDR A:(&baseOffset+0x4421004)
y.create.l HWIO_PMIC_ARB2_CHNL4_CONFIG_ADDR A:(&baseOffset+0x4422004)
y.create.l HWIO_PMIC_ARB3_CHNL4_CONFIG_ADDR A:(&baseOffset+0x4423004)
y.create.l HWIO_PMIC_ARB0_CHNL5_CONFIG_ADDR A:(&baseOffset+0x4428004)
y.create.l HWIO_PMIC_ARB1_CHNL5_CONFIG_ADDR A:(&baseOffset+0x4429004)
y.create.l HWIO_PMIC_ARB2_CHNL5_CONFIG_ADDR A:(&baseOffset+0x442a004)
y.create.l HWIO_PMIC_ARB3_CHNL5_CONFIG_ADDR A:(&baseOffset+0x442b004)
y.create.l HWIO_PMIC_ARB0_CHNL6_CONFIG_ADDR A:(&baseOffset+0x4430004)
y.create.l HWIO_PMIC_ARB1_CHNL6_CONFIG_ADDR A:(&baseOffset+0x4431004)
y.create.l HWIO_PMIC_ARB2_CHNL6_CONFIG_ADDR A:(&baseOffset+0x4432004)
y.create.l HWIO_PMIC_ARB3_CHNL6_CONFIG_ADDR A:(&baseOffset+0x4433004)
y.create.l HWIO_PMIC_ARB0_CHNL7_CONFIG_ADDR A:(&baseOffset+0x4438004)
y.create.l HWIO_PMIC_ARB1_CHNL7_CONFIG_ADDR A:(&baseOffset+0x4439004)
y.create.l HWIO_PMIC_ARB2_CHNL7_CONFIG_ADDR A:(&baseOffset+0x443a004)
y.create.l HWIO_PMIC_ARB3_CHNL7_CONFIG_ADDR A:(&baseOffset+0x443b004)
y.create.l HWIO_PMIC_ARB0_CHNL8_CONFIG_ADDR A:(&baseOffset+0x4440004)
y.create.l HWIO_PMIC_ARB1_CHNL8_CONFIG_ADDR A:(&baseOffset+0x4441004)
y.create.l HWIO_PMIC_ARB2_CHNL8_CONFIG_ADDR A:(&baseOffset+0x4442004)
y.create.l HWIO_PMIC_ARB3_CHNL8_CONFIG_ADDR A:(&baseOffset+0x4443004)
y.create.l HWIO_PMIC_ARB0_CHNL9_CONFIG_ADDR A:(&baseOffset+0x4448004)
y.create.l HWIO_PMIC_ARB1_CHNL9_CONFIG_ADDR A:(&baseOffset+0x4449004)
y.create.l HWIO_PMIC_ARB2_CHNL9_CONFIG_ADDR A:(&baseOffset+0x444a004)
y.create.l HWIO_PMIC_ARB3_CHNL9_CONFIG_ADDR A:(&baseOffset+0x444b004)
y.create.l HWIO_PMIC_ARB0_CHNL0_STATUS_ADDR A:(&baseOffset+0x4400008)
y.create.l HWIO_PMIC_ARB1_CHNL0_STATUS_ADDR A:(&baseOffset+0x4401008)
y.create.l HWIO_PMIC_ARB2_CHNL0_STATUS_ADDR A:(&baseOffset+0x4402008)
y.create.l HWIO_PMIC_ARB3_CHNL0_STATUS_ADDR A:(&baseOffset+0x4403008)
y.create.l HWIO_PMIC_ARB0_CHNL1_STATUS_ADDR A:(&baseOffset+0x4408008)
y.create.l HWIO_PMIC_ARB1_CHNL1_STATUS_ADDR A:(&baseOffset+0x4409008)
y.create.l HWIO_PMIC_ARB2_CHNL1_STATUS_ADDR A:(&baseOffset+0x440a008)
y.create.l HWIO_PMIC_ARB3_CHNL1_STATUS_ADDR A:(&baseOffset+0x440b008)
y.create.l HWIO_PMIC_ARB0_CHNL2_STATUS_ADDR A:(&baseOffset+0x4410008)
y.create.l HWIO_PMIC_ARB1_CHNL2_STATUS_ADDR A:(&baseOffset+0x4411008)
y.create.l HWIO_PMIC_ARB2_CHNL2_STATUS_ADDR A:(&baseOffset+0x4412008)
y.create.l HWIO_PMIC_ARB3_CHNL2_STATUS_ADDR A:(&baseOffset+0x4413008)
y.create.l HWIO_PMIC_ARB0_CHNL3_STATUS_ADDR A:(&baseOffset+0x4418008)
y.create.l HWIO_PMIC_ARB1_CHNL3_STATUS_ADDR A:(&baseOffset+0x4419008)
y.create.l HWIO_PMIC_ARB2_CHNL3_STATUS_ADDR A:(&baseOffset+0x441a008)
y.create.l HWIO_PMIC_ARB3_CHNL3_STATUS_ADDR A:(&baseOffset+0x441b008)
y.create.l HWIO_PMIC_ARB0_CHNL4_STATUS_ADDR A:(&baseOffset+0x4420008)
y.create.l HWIO_PMIC_ARB1_CHNL4_STATUS_ADDR A:(&baseOffset+0x4421008)
y.create.l HWIO_PMIC_ARB2_CHNL4_STATUS_ADDR A:(&baseOffset+0x4422008)
y.create.l HWIO_PMIC_ARB3_CHNL4_STATUS_ADDR A:(&baseOffset+0x4423008)
y.create.l HWIO_PMIC_ARB0_CHNL5_STATUS_ADDR A:(&baseOffset+0x4428008)
y.create.l HWIO_PMIC_ARB1_CHNL5_STATUS_ADDR A:(&baseOffset+0x4429008)
y.create.l HWIO_PMIC_ARB2_CHNL5_STATUS_ADDR A:(&baseOffset+0x442a008)
y.create.l HWIO_PMIC_ARB3_CHNL5_STATUS_ADDR A:(&baseOffset+0x442b008)
y.create.l HWIO_PMIC_ARB0_CHNL6_STATUS_ADDR A:(&baseOffset+0x4430008)
y.create.l HWIO_PMIC_ARB1_CHNL6_STATUS_ADDR A:(&baseOffset+0x4431008)
y.create.l HWIO_PMIC_ARB2_CHNL6_STATUS_ADDR A:(&baseOffset+0x4432008)
y.create.l HWIO_PMIC_ARB3_CHNL6_STATUS_ADDR A:(&baseOffset+0x4433008)
y.create.l HWIO_PMIC_ARB0_CHNL7_STATUS_ADDR A:(&baseOffset+0x4438008)
y.create.l HWIO_PMIC_ARB1_CHNL7_STATUS_ADDR A:(&baseOffset+0x4439008)
y.create.l HWIO_PMIC_ARB2_CHNL7_STATUS_ADDR A:(&baseOffset+0x443a008)
y.create.l HWIO_PMIC_ARB3_CHNL7_STATUS_ADDR A:(&baseOffset+0x443b008)
y.create.l HWIO_PMIC_ARB0_CHNL8_STATUS_ADDR A:(&baseOffset+0x4440008)
y.create.l HWIO_PMIC_ARB1_CHNL8_STATUS_ADDR A:(&baseOffset+0x4441008)
y.create.l HWIO_PMIC_ARB2_CHNL8_STATUS_ADDR A:(&baseOffset+0x4442008)
y.create.l HWIO_PMIC_ARB3_CHNL8_STATUS_ADDR A:(&baseOffset+0x4443008)
y.create.l HWIO_PMIC_ARB0_CHNL9_STATUS_ADDR A:(&baseOffset+0x4448008)
y.create.l HWIO_PMIC_ARB1_CHNL9_STATUS_ADDR A:(&baseOffset+0x4449008)
y.create.l HWIO_PMIC_ARB2_CHNL9_STATUS_ADDR A:(&baseOffset+0x444a008)
y.create.l HWIO_PMIC_ARB3_CHNL9_STATUS_ADDR A:(&baseOffset+0x444b008)
y.create.l HWIO_PMIC_ARB0_CHNL0_WDATA0_ADDR A:(&baseOffset+0x4400010)
y.create.l HWIO_PMIC_ARB1_CHNL0_WDATA0_ADDR A:(&baseOffset+0x4401010)
y.create.l HWIO_PMIC_ARB2_CHNL0_WDATA0_ADDR A:(&baseOffset+0x4402010)
y.create.l HWIO_PMIC_ARB3_CHNL0_WDATA0_ADDR A:(&baseOffset+0x4403010)
y.create.l HWIO_PMIC_ARB0_CHNL1_WDATA0_ADDR A:(&baseOffset+0x4408010)
y.create.l HWIO_PMIC_ARB1_CHNL1_WDATA0_ADDR A:(&baseOffset+0x4409010)
y.create.l HWIO_PMIC_ARB2_CHNL1_WDATA0_ADDR A:(&baseOffset+0x440a010)
y.create.l HWIO_PMIC_ARB3_CHNL1_WDATA0_ADDR A:(&baseOffset+0x440b010)
y.create.l HWIO_PMIC_ARB0_CHNL2_WDATA0_ADDR A:(&baseOffset+0x4410010)
y.create.l HWIO_PMIC_ARB1_CHNL2_WDATA0_ADDR A:(&baseOffset+0x4411010)
y.create.l HWIO_PMIC_ARB2_CHNL2_WDATA0_ADDR A:(&baseOffset+0x4412010)
y.create.l HWIO_PMIC_ARB3_CHNL2_WDATA0_ADDR A:(&baseOffset+0x4413010)
y.create.l HWIO_PMIC_ARB0_CHNL3_WDATA0_ADDR A:(&baseOffset+0x4418010)
y.create.l HWIO_PMIC_ARB1_CHNL3_WDATA0_ADDR A:(&baseOffset+0x4419010)
y.create.l HWIO_PMIC_ARB2_CHNL3_WDATA0_ADDR A:(&baseOffset+0x441a010)
y.create.l HWIO_PMIC_ARB3_CHNL3_WDATA0_ADDR A:(&baseOffset+0x441b010)
y.create.l HWIO_PMIC_ARB0_CHNL4_WDATA0_ADDR A:(&baseOffset+0x4420010)
y.create.l HWIO_PMIC_ARB1_CHNL4_WDATA0_ADDR A:(&baseOffset+0x4421010)
y.create.l HWIO_PMIC_ARB2_CHNL4_WDATA0_ADDR A:(&baseOffset+0x4422010)
y.create.l HWIO_PMIC_ARB3_CHNL4_WDATA0_ADDR A:(&baseOffset+0x4423010)
y.create.l HWIO_PMIC_ARB0_CHNL5_WDATA0_ADDR A:(&baseOffset+0x4428010)
y.create.l HWIO_PMIC_ARB1_CHNL5_WDATA0_ADDR A:(&baseOffset+0x4429010)
y.create.l HWIO_PMIC_ARB2_CHNL5_WDATA0_ADDR A:(&baseOffset+0x442a010)
y.create.l HWIO_PMIC_ARB3_CHNL5_WDATA0_ADDR A:(&baseOffset+0x442b010)
y.create.l HWIO_PMIC_ARB0_CHNL6_WDATA0_ADDR A:(&baseOffset+0x4430010)
y.create.l HWIO_PMIC_ARB1_CHNL6_WDATA0_ADDR A:(&baseOffset+0x4431010)
y.create.l HWIO_PMIC_ARB2_CHNL6_WDATA0_ADDR A:(&baseOffset+0x4432010)
y.create.l HWIO_PMIC_ARB3_CHNL6_WDATA0_ADDR A:(&baseOffset+0x4433010)
y.create.l HWIO_PMIC_ARB0_CHNL7_WDATA0_ADDR A:(&baseOffset+0x4438010)
y.create.l HWIO_PMIC_ARB1_CHNL7_WDATA0_ADDR A:(&baseOffset+0x4439010)
y.create.l HWIO_PMIC_ARB2_CHNL7_WDATA0_ADDR A:(&baseOffset+0x443a010)
y.create.l HWIO_PMIC_ARB3_CHNL7_WDATA0_ADDR A:(&baseOffset+0x443b010)
y.create.l HWIO_PMIC_ARB0_CHNL8_WDATA0_ADDR A:(&baseOffset+0x4440010)
y.create.l HWIO_PMIC_ARB1_CHNL8_WDATA0_ADDR A:(&baseOffset+0x4441010)
y.create.l HWIO_PMIC_ARB2_CHNL8_WDATA0_ADDR A:(&baseOffset+0x4442010)
y.create.l HWIO_PMIC_ARB3_CHNL8_WDATA0_ADDR A:(&baseOffset+0x4443010)
y.create.l HWIO_PMIC_ARB0_CHNL9_WDATA0_ADDR A:(&baseOffset+0x4448010)
y.create.l HWIO_PMIC_ARB1_CHNL9_WDATA0_ADDR A:(&baseOffset+0x4449010)
y.create.l HWIO_PMIC_ARB2_CHNL9_WDATA0_ADDR A:(&baseOffset+0x444a010)
y.create.l HWIO_PMIC_ARB3_CHNL9_WDATA0_ADDR A:(&baseOffset+0x444b010)
y.create.l HWIO_PMIC_ARB0_CHNL0_WDATA1_ADDR A:(&baseOffset+0x4400014)
y.create.l HWIO_PMIC_ARB1_CHNL0_WDATA1_ADDR A:(&baseOffset+0x4401014)
y.create.l HWIO_PMIC_ARB2_CHNL0_WDATA1_ADDR A:(&baseOffset+0x4402014)
y.create.l HWIO_PMIC_ARB3_CHNL0_WDATA1_ADDR A:(&baseOffset+0x4403014)
y.create.l HWIO_PMIC_ARB0_CHNL1_WDATA1_ADDR A:(&baseOffset+0x4408014)
y.create.l HWIO_PMIC_ARB1_CHNL1_WDATA1_ADDR A:(&baseOffset+0x4409014)
y.create.l HWIO_PMIC_ARB2_CHNL1_WDATA1_ADDR A:(&baseOffset+0x440a014)
y.create.l HWIO_PMIC_ARB3_CHNL1_WDATA1_ADDR A:(&baseOffset+0x440b014)
y.create.l HWIO_PMIC_ARB0_CHNL2_WDATA1_ADDR A:(&baseOffset+0x4410014)
y.create.l HWIO_PMIC_ARB1_CHNL2_WDATA1_ADDR A:(&baseOffset+0x4411014)
y.create.l HWIO_PMIC_ARB2_CHNL2_WDATA1_ADDR A:(&baseOffset+0x4412014)
y.create.l HWIO_PMIC_ARB3_CHNL2_WDATA1_ADDR A:(&baseOffset+0x4413014)
y.create.l HWIO_PMIC_ARB0_CHNL3_WDATA1_ADDR A:(&baseOffset+0x4418014)
y.create.l HWIO_PMIC_ARB1_CHNL3_WDATA1_ADDR A:(&baseOffset+0x4419014)
y.create.l HWIO_PMIC_ARB2_CHNL3_WDATA1_ADDR A:(&baseOffset+0x441a014)
y.create.l HWIO_PMIC_ARB3_CHNL3_WDATA1_ADDR A:(&baseOffset+0x441b014)
y.create.l HWIO_PMIC_ARB0_CHNL4_WDATA1_ADDR A:(&baseOffset+0x4420014)
y.create.l HWIO_PMIC_ARB1_CHNL4_WDATA1_ADDR A:(&baseOffset+0x4421014)
y.create.l HWIO_PMIC_ARB2_CHNL4_WDATA1_ADDR A:(&baseOffset+0x4422014)
y.create.l HWIO_PMIC_ARB3_CHNL4_WDATA1_ADDR A:(&baseOffset+0x4423014)
y.create.l HWIO_PMIC_ARB0_CHNL5_WDATA1_ADDR A:(&baseOffset+0x4428014)
y.create.l HWIO_PMIC_ARB1_CHNL5_WDATA1_ADDR A:(&baseOffset+0x4429014)
y.create.l HWIO_PMIC_ARB2_CHNL5_WDATA1_ADDR A:(&baseOffset+0x442a014)
y.create.l HWIO_PMIC_ARB3_CHNL5_WDATA1_ADDR A:(&baseOffset+0x442b014)
y.create.l HWIO_PMIC_ARB0_CHNL6_WDATA1_ADDR A:(&baseOffset+0x4430014)
y.create.l HWIO_PMIC_ARB1_CHNL6_WDATA1_ADDR A:(&baseOffset+0x4431014)
y.create.l HWIO_PMIC_ARB2_CHNL6_WDATA1_ADDR A:(&baseOffset+0x4432014)
y.create.l HWIO_PMIC_ARB3_CHNL6_WDATA1_ADDR A:(&baseOffset+0x4433014)
y.create.l HWIO_PMIC_ARB0_CHNL7_WDATA1_ADDR A:(&baseOffset+0x4438014)
y.create.l HWIO_PMIC_ARB1_CHNL7_WDATA1_ADDR A:(&baseOffset+0x4439014)
y.create.l HWIO_PMIC_ARB2_CHNL7_WDATA1_ADDR A:(&baseOffset+0x443a014)
y.create.l HWIO_PMIC_ARB3_CHNL7_WDATA1_ADDR A:(&baseOffset+0x443b014)
y.create.l HWIO_PMIC_ARB0_CHNL8_WDATA1_ADDR A:(&baseOffset+0x4440014)
y.create.l HWIO_PMIC_ARB1_CHNL8_WDATA1_ADDR A:(&baseOffset+0x4441014)
y.create.l HWIO_PMIC_ARB2_CHNL8_WDATA1_ADDR A:(&baseOffset+0x4442014)
y.create.l HWIO_PMIC_ARB3_CHNL8_WDATA1_ADDR A:(&baseOffset+0x4443014)
y.create.l HWIO_PMIC_ARB0_CHNL9_WDATA1_ADDR A:(&baseOffset+0x4448014)
y.create.l HWIO_PMIC_ARB1_CHNL9_WDATA1_ADDR A:(&baseOffset+0x4449014)
y.create.l HWIO_PMIC_ARB2_CHNL9_WDATA1_ADDR A:(&baseOffset+0x444a014)
y.create.l HWIO_PMIC_ARB3_CHNL9_WDATA1_ADDR A:(&baseOffset+0x444b014)
y.create.l HWIO_PMIC_ARB0_CHNL0_RDATA0_ADDR A:(&baseOffset+0x4400018)
y.create.l HWIO_PMIC_ARB1_CHNL0_RDATA0_ADDR A:(&baseOffset+0x4401018)
y.create.l HWIO_PMIC_ARB2_CHNL0_RDATA0_ADDR A:(&baseOffset+0x4402018)
y.create.l HWIO_PMIC_ARB3_CHNL0_RDATA0_ADDR A:(&baseOffset+0x4403018)
y.create.l HWIO_PMIC_ARB0_CHNL1_RDATA0_ADDR A:(&baseOffset+0x4408018)
y.create.l HWIO_PMIC_ARB1_CHNL1_RDATA0_ADDR A:(&baseOffset+0x4409018)
y.create.l HWIO_PMIC_ARB2_CHNL1_RDATA0_ADDR A:(&baseOffset+0x440a018)
y.create.l HWIO_PMIC_ARB3_CHNL1_RDATA0_ADDR A:(&baseOffset+0x440b018)
y.create.l HWIO_PMIC_ARB0_CHNL2_RDATA0_ADDR A:(&baseOffset+0x4410018)
y.create.l HWIO_PMIC_ARB1_CHNL2_RDATA0_ADDR A:(&baseOffset+0x4411018)
y.create.l HWIO_PMIC_ARB2_CHNL2_RDATA0_ADDR A:(&baseOffset+0x4412018)
y.create.l HWIO_PMIC_ARB3_CHNL2_RDATA0_ADDR A:(&baseOffset+0x4413018)
y.create.l HWIO_PMIC_ARB0_CHNL3_RDATA0_ADDR A:(&baseOffset+0x4418018)
y.create.l HWIO_PMIC_ARB1_CHNL3_RDATA0_ADDR A:(&baseOffset+0x4419018)
y.create.l HWIO_PMIC_ARB2_CHNL3_RDATA0_ADDR A:(&baseOffset+0x441a018)
y.create.l HWIO_PMIC_ARB3_CHNL3_RDATA0_ADDR A:(&baseOffset+0x441b018)
y.create.l HWIO_PMIC_ARB0_CHNL4_RDATA0_ADDR A:(&baseOffset+0x4420018)
y.create.l HWIO_PMIC_ARB1_CHNL4_RDATA0_ADDR A:(&baseOffset+0x4421018)
y.create.l HWIO_PMIC_ARB2_CHNL4_RDATA0_ADDR A:(&baseOffset+0x4422018)
y.create.l HWIO_PMIC_ARB3_CHNL4_RDATA0_ADDR A:(&baseOffset+0x4423018)
y.create.l HWIO_PMIC_ARB0_CHNL5_RDATA0_ADDR A:(&baseOffset+0x4428018)
y.create.l HWIO_PMIC_ARB1_CHNL5_RDATA0_ADDR A:(&baseOffset+0x4429018)
y.create.l HWIO_PMIC_ARB2_CHNL5_RDATA0_ADDR A:(&baseOffset+0x442a018)
y.create.l HWIO_PMIC_ARB3_CHNL5_RDATA0_ADDR A:(&baseOffset+0x442b018)
y.create.l HWIO_PMIC_ARB0_CHNL6_RDATA0_ADDR A:(&baseOffset+0x4430018)
y.create.l HWIO_PMIC_ARB1_CHNL6_RDATA0_ADDR A:(&baseOffset+0x4431018)
y.create.l HWIO_PMIC_ARB2_CHNL6_RDATA0_ADDR A:(&baseOffset+0x4432018)
y.create.l HWIO_PMIC_ARB3_CHNL6_RDATA0_ADDR A:(&baseOffset+0x4433018)
y.create.l HWIO_PMIC_ARB0_CHNL7_RDATA0_ADDR A:(&baseOffset+0x4438018)
y.create.l HWIO_PMIC_ARB1_CHNL7_RDATA0_ADDR A:(&baseOffset+0x4439018)
y.create.l HWIO_PMIC_ARB2_CHNL7_RDATA0_ADDR A:(&baseOffset+0x443a018)
y.create.l HWIO_PMIC_ARB3_CHNL7_RDATA0_ADDR A:(&baseOffset+0x443b018)
y.create.l HWIO_PMIC_ARB0_CHNL8_RDATA0_ADDR A:(&baseOffset+0x4440018)
y.create.l HWIO_PMIC_ARB1_CHNL8_RDATA0_ADDR A:(&baseOffset+0x4441018)
y.create.l HWIO_PMIC_ARB2_CHNL8_RDATA0_ADDR A:(&baseOffset+0x4442018)
y.create.l HWIO_PMIC_ARB3_CHNL8_RDATA0_ADDR A:(&baseOffset+0x4443018)
y.create.l HWIO_PMIC_ARB0_CHNL9_RDATA0_ADDR A:(&baseOffset+0x4448018)
y.create.l HWIO_PMIC_ARB1_CHNL9_RDATA0_ADDR A:(&baseOffset+0x4449018)
y.create.l HWIO_PMIC_ARB2_CHNL9_RDATA0_ADDR A:(&baseOffset+0x444a018)
y.create.l HWIO_PMIC_ARB3_CHNL9_RDATA0_ADDR A:(&baseOffset+0x444b018)
y.create.l HWIO_PMIC_ARB0_CHNL0_RDATA1_ADDR A:(&baseOffset+0x440001c)
y.create.l HWIO_PMIC_ARB1_CHNL0_RDATA1_ADDR A:(&baseOffset+0x440101c)
y.create.l HWIO_PMIC_ARB2_CHNL0_RDATA1_ADDR A:(&baseOffset+0x440201c)
y.create.l HWIO_PMIC_ARB3_CHNL0_RDATA1_ADDR A:(&baseOffset+0x440301c)
y.create.l HWIO_PMIC_ARB0_CHNL1_RDATA1_ADDR A:(&baseOffset+0x440801c)
y.create.l HWIO_PMIC_ARB1_CHNL1_RDATA1_ADDR A:(&baseOffset+0x440901c)
y.create.l HWIO_PMIC_ARB2_CHNL1_RDATA1_ADDR A:(&baseOffset+0x440a01c)
y.create.l HWIO_PMIC_ARB3_CHNL1_RDATA1_ADDR A:(&baseOffset+0x440b01c)
y.create.l HWIO_PMIC_ARB0_CHNL2_RDATA1_ADDR A:(&baseOffset+0x441001c)
y.create.l HWIO_PMIC_ARB1_CHNL2_RDATA1_ADDR A:(&baseOffset+0x441101c)
y.create.l HWIO_PMIC_ARB2_CHNL2_RDATA1_ADDR A:(&baseOffset+0x441201c)
y.create.l HWIO_PMIC_ARB3_CHNL2_RDATA1_ADDR A:(&baseOffset+0x441301c)
y.create.l HWIO_PMIC_ARB0_CHNL3_RDATA1_ADDR A:(&baseOffset+0x441801c)
y.create.l HWIO_PMIC_ARB1_CHNL3_RDATA1_ADDR A:(&baseOffset+0x441901c)
y.create.l HWIO_PMIC_ARB2_CHNL3_RDATA1_ADDR A:(&baseOffset+0x441a01c)
y.create.l HWIO_PMIC_ARB3_CHNL3_RDATA1_ADDR A:(&baseOffset+0x441b01c)
y.create.l HWIO_PMIC_ARB0_CHNL4_RDATA1_ADDR A:(&baseOffset+0x442001c)
y.create.l HWIO_PMIC_ARB1_CHNL4_RDATA1_ADDR A:(&baseOffset+0x442101c)
y.create.l HWIO_PMIC_ARB2_CHNL4_RDATA1_ADDR A:(&baseOffset+0x442201c)
y.create.l HWIO_PMIC_ARB3_CHNL4_RDATA1_ADDR A:(&baseOffset+0x442301c)
y.create.l HWIO_PMIC_ARB0_CHNL5_RDATA1_ADDR A:(&baseOffset+0x442801c)
y.create.l HWIO_PMIC_ARB1_CHNL5_RDATA1_ADDR A:(&baseOffset+0x442901c)
y.create.l HWIO_PMIC_ARB2_CHNL5_RDATA1_ADDR A:(&baseOffset+0x442a01c)
y.create.l HWIO_PMIC_ARB3_CHNL5_RDATA1_ADDR A:(&baseOffset+0x442b01c)
y.create.l HWIO_PMIC_ARB0_CHNL6_RDATA1_ADDR A:(&baseOffset+0x443001c)
y.create.l HWIO_PMIC_ARB1_CHNL6_RDATA1_ADDR A:(&baseOffset+0x443101c)
y.create.l HWIO_PMIC_ARB2_CHNL6_RDATA1_ADDR A:(&baseOffset+0x443201c)
y.create.l HWIO_PMIC_ARB3_CHNL6_RDATA1_ADDR A:(&baseOffset+0x443301c)
y.create.l HWIO_PMIC_ARB0_CHNL7_RDATA1_ADDR A:(&baseOffset+0x443801c)
y.create.l HWIO_PMIC_ARB1_CHNL7_RDATA1_ADDR A:(&baseOffset+0x443901c)
y.create.l HWIO_PMIC_ARB2_CHNL7_RDATA1_ADDR A:(&baseOffset+0x443a01c)
y.create.l HWIO_PMIC_ARB3_CHNL7_RDATA1_ADDR A:(&baseOffset+0x443b01c)
y.create.l HWIO_PMIC_ARB0_CHNL8_RDATA1_ADDR A:(&baseOffset+0x444001c)
y.create.l HWIO_PMIC_ARB1_CHNL8_RDATA1_ADDR A:(&baseOffset+0x444101c)
y.create.l HWIO_PMIC_ARB2_CHNL8_RDATA1_ADDR A:(&baseOffset+0x444201c)
y.create.l HWIO_PMIC_ARB3_CHNL8_RDATA1_ADDR A:(&baseOffset+0x444301c)
y.create.l HWIO_PMIC_ARB0_CHNL9_RDATA1_ADDR A:(&baseOffset+0x444801c)
y.create.l HWIO_PMIC_ARB1_CHNL9_RDATA1_ADDR A:(&baseOffset+0x444901c)
y.create.l HWIO_PMIC_ARB2_CHNL9_RDATA1_ADDR A:(&baseOffset+0x444a01c)
y.create.l HWIO_PMIC_ARB3_CHNL9_RDATA1_ADDR A:(&baseOffset+0x444b01c)
y.create.l HWIO_PMIC_ARB0_CHNL0_RDATA2_ADDR A:(&baseOffset+0x4400020)
y.create.l HWIO_PMIC_ARB1_CHNL0_RDATA2_ADDR A:(&baseOffset+0x4401020)
y.create.l HWIO_PMIC_ARB2_CHNL0_RDATA2_ADDR A:(&baseOffset+0x4402020)
y.create.l HWIO_PMIC_ARB3_CHNL0_RDATA2_ADDR A:(&baseOffset+0x4403020)
y.create.l HWIO_PMIC_ARB0_CHNL1_RDATA2_ADDR A:(&baseOffset+0x4408020)
y.create.l HWIO_PMIC_ARB1_CHNL1_RDATA2_ADDR A:(&baseOffset+0x4409020)
y.create.l HWIO_PMIC_ARB2_CHNL1_RDATA2_ADDR A:(&baseOffset+0x440a020)
y.create.l HWIO_PMIC_ARB3_CHNL1_RDATA2_ADDR A:(&baseOffset+0x440b020)
y.create.l HWIO_PMIC_ARB0_CHNL2_RDATA2_ADDR A:(&baseOffset+0x4410020)
y.create.l HWIO_PMIC_ARB1_CHNL2_RDATA2_ADDR A:(&baseOffset+0x4411020)
y.create.l HWIO_PMIC_ARB2_CHNL2_RDATA2_ADDR A:(&baseOffset+0x4412020)
y.create.l HWIO_PMIC_ARB3_CHNL2_RDATA2_ADDR A:(&baseOffset+0x4413020)
y.create.l HWIO_PMIC_ARB0_CHNL3_RDATA2_ADDR A:(&baseOffset+0x4418020)
y.create.l HWIO_PMIC_ARB1_CHNL3_RDATA2_ADDR A:(&baseOffset+0x4419020)
y.create.l HWIO_PMIC_ARB2_CHNL3_RDATA2_ADDR A:(&baseOffset+0x441a020)
y.create.l HWIO_PMIC_ARB3_CHNL3_RDATA2_ADDR A:(&baseOffset+0x441b020)
y.create.l HWIO_PMIC_ARB0_CHNL4_RDATA2_ADDR A:(&baseOffset+0x4420020)
y.create.l HWIO_PMIC_ARB1_CHNL4_RDATA2_ADDR A:(&baseOffset+0x4421020)
y.create.l HWIO_PMIC_ARB2_CHNL4_RDATA2_ADDR A:(&baseOffset+0x4422020)
y.create.l HWIO_PMIC_ARB3_CHNL4_RDATA2_ADDR A:(&baseOffset+0x4423020)
y.create.l HWIO_PMIC_ARB0_CHNL5_RDATA2_ADDR A:(&baseOffset+0x4428020)
y.create.l HWIO_PMIC_ARB1_CHNL5_RDATA2_ADDR A:(&baseOffset+0x4429020)
y.create.l HWIO_PMIC_ARB2_CHNL5_RDATA2_ADDR A:(&baseOffset+0x442a020)
y.create.l HWIO_PMIC_ARB3_CHNL5_RDATA2_ADDR A:(&baseOffset+0x442b020)
y.create.l HWIO_PMIC_ARB0_CHNL6_RDATA2_ADDR A:(&baseOffset+0x4430020)
y.create.l HWIO_PMIC_ARB1_CHNL6_RDATA2_ADDR A:(&baseOffset+0x4431020)
y.create.l HWIO_PMIC_ARB2_CHNL6_RDATA2_ADDR A:(&baseOffset+0x4432020)
y.create.l HWIO_PMIC_ARB3_CHNL6_RDATA2_ADDR A:(&baseOffset+0x4433020)
y.create.l HWIO_PMIC_ARB0_CHNL7_RDATA2_ADDR A:(&baseOffset+0x4438020)
y.create.l HWIO_PMIC_ARB1_CHNL7_RDATA2_ADDR A:(&baseOffset+0x4439020)
y.create.l HWIO_PMIC_ARB2_CHNL7_RDATA2_ADDR A:(&baseOffset+0x443a020)
y.create.l HWIO_PMIC_ARB3_CHNL7_RDATA2_ADDR A:(&baseOffset+0x443b020)
y.create.l HWIO_PMIC_ARB0_CHNL8_RDATA2_ADDR A:(&baseOffset+0x4440020)
y.create.l HWIO_PMIC_ARB1_CHNL8_RDATA2_ADDR A:(&baseOffset+0x4441020)
y.create.l HWIO_PMIC_ARB2_CHNL8_RDATA2_ADDR A:(&baseOffset+0x4442020)
y.create.l HWIO_PMIC_ARB3_CHNL8_RDATA2_ADDR A:(&baseOffset+0x4443020)
y.create.l HWIO_PMIC_ARB0_CHNL9_RDATA2_ADDR A:(&baseOffset+0x4448020)
y.create.l HWIO_PMIC_ARB1_CHNL9_RDATA2_ADDR A:(&baseOffset+0x4449020)
y.create.l HWIO_PMIC_ARB2_CHNL9_RDATA2_ADDR A:(&baseOffset+0x444a020)
y.create.l HWIO_PMIC_ARB3_CHNL9_RDATA2_ADDR A:(&baseOffset+0x444b020)
y.create.l HWIO_PMIC_ARB_OBS0_CHNL0_CMD_ADDR A:(&baseOffset+0x4c00000)
y.create.l HWIO_PMIC_ARB_OBS1_CHNL0_CMD_ADDR A:(&baseOffset+0x4c01000)
y.create.l HWIO_PMIC_ARB_OBS2_CHNL0_CMD_ADDR A:(&baseOffset+0x4c02000)
y.create.l HWIO_PMIC_ARB_OBS3_CHNL0_CMD_ADDR A:(&baseOffset+0x4c03000)
y.create.l HWIO_PMIC_ARB_OBS0_CHNL1_CMD_ADDR A:(&baseOffset+0x4c08000)
y.create.l HWIO_PMIC_ARB_OBS1_CHNL1_CMD_ADDR A:(&baseOffset+0x4c09000)
y.create.l HWIO_PMIC_ARB_OBS2_CHNL1_CMD_ADDR A:(&baseOffset+0x4c0a000)
y.create.l HWIO_PMIC_ARB_OBS3_CHNL1_CMD_ADDR A:(&baseOffset+0x4c0b000)
y.create.l HWIO_PMIC_ARB_OBS0_CHNL2_CMD_ADDR A:(&baseOffset+0x4c10000)
y.create.l HWIO_PMIC_ARB_OBS1_CHNL2_CMD_ADDR A:(&baseOffset+0x4c11000)
y.create.l HWIO_PMIC_ARB_OBS2_CHNL2_CMD_ADDR A:(&baseOffset+0x4c12000)
y.create.l HWIO_PMIC_ARB_OBS3_CHNL2_CMD_ADDR A:(&baseOffset+0x4c13000)
y.create.l HWIO_PMIC_ARB_OBS0_CHNL3_CMD_ADDR A:(&baseOffset+0x4c18000)
y.create.l HWIO_PMIC_ARB_OBS1_CHNL3_CMD_ADDR A:(&baseOffset+0x4c19000)
y.create.l HWIO_PMIC_ARB_OBS2_CHNL3_CMD_ADDR A:(&baseOffset+0x4c1a000)
y.create.l HWIO_PMIC_ARB_OBS3_CHNL3_CMD_ADDR A:(&baseOffset+0x4c1b000)
y.create.l HWIO_PMIC_ARB_OBS0_CHNL4_CMD_ADDR A:(&baseOffset+0x4c20000)
y.create.l HWIO_PMIC_ARB_OBS1_CHNL4_CMD_ADDR A:(&baseOffset+0x4c21000)
y.create.l HWIO_PMIC_ARB_OBS2_CHNL4_CMD_ADDR A:(&baseOffset+0x4c22000)
y.create.l HWIO_PMIC_ARB_OBS3_CHNL4_CMD_ADDR A:(&baseOffset+0x4c23000)
y.create.l HWIO_PMIC_ARB_OBS0_CHNL5_CMD_ADDR A:(&baseOffset+0x4c28000)
y.create.l HWIO_PMIC_ARB_OBS1_CHNL5_CMD_ADDR A:(&baseOffset+0x4c29000)
y.create.l HWIO_PMIC_ARB_OBS2_CHNL5_CMD_ADDR A:(&baseOffset+0x4c2a000)
y.create.l HWIO_PMIC_ARB_OBS3_CHNL5_CMD_ADDR A:(&baseOffset+0x4c2b000)
y.create.l HWIO_PMIC_ARB_OBS0_CHNL6_CMD_ADDR A:(&baseOffset+0x4c30000)
y.create.l HWIO_PMIC_ARB_OBS1_CHNL6_CMD_ADDR A:(&baseOffset+0x4c31000)
y.create.l HWIO_PMIC_ARB_OBS2_CHNL6_CMD_ADDR A:(&baseOffset+0x4c32000)
y.create.l HWIO_PMIC_ARB_OBS3_CHNL6_CMD_ADDR A:(&baseOffset+0x4c33000)
y.create.l HWIO_PMIC_ARB_OBS0_CHNL7_CMD_ADDR A:(&baseOffset+0x4c38000)
y.create.l HWIO_PMIC_ARB_OBS1_CHNL7_CMD_ADDR A:(&baseOffset+0x4c39000)
y.create.l HWIO_PMIC_ARB_OBS2_CHNL7_CMD_ADDR A:(&baseOffset+0x4c3a000)
y.create.l HWIO_PMIC_ARB_OBS3_CHNL7_CMD_ADDR A:(&baseOffset+0x4c3b000)
y.create.l HWIO_PMIC_ARB_OBS0_CHNL8_CMD_ADDR A:(&baseOffset+0x4c40000)
y.create.l HWIO_PMIC_ARB_OBS1_CHNL8_CMD_ADDR A:(&baseOffset+0x4c41000)
y.create.l HWIO_PMIC_ARB_OBS2_CHNL8_CMD_ADDR A:(&baseOffset+0x4c42000)
y.create.l HWIO_PMIC_ARB_OBS3_CHNL8_CMD_ADDR A:(&baseOffset+0x4c43000)
y.create.l HWIO_PMIC_ARB_OBS0_CHNL9_CMD_ADDR A:(&baseOffset+0x4c48000)
y.create.l HWIO_PMIC_ARB_OBS1_CHNL9_CMD_ADDR A:(&baseOffset+0x4c49000)
y.create.l HWIO_PMIC_ARB_OBS2_CHNL9_CMD_ADDR A:(&baseOffset+0x4c4a000)
y.create.l HWIO_PMIC_ARB_OBS3_CHNL9_CMD_ADDR A:(&baseOffset+0x4c4b000)
y.create.l HWIO_PMIC_ARB_OBS0_CHNL0_CONFIG_ADDR A:(&baseOffset+0x4c00004)
y.create.l HWIO_PMIC_ARB_OBS1_CHNL0_CONFIG_ADDR A:(&baseOffset+0x4c01004)
y.create.l HWIO_PMIC_ARB_OBS2_CHNL0_CONFIG_ADDR A:(&baseOffset+0x4c02004)
y.create.l HWIO_PMIC_ARB_OBS3_CHNL0_CONFIG_ADDR A:(&baseOffset+0x4c03004)
y.create.l HWIO_PMIC_ARB_OBS0_CHNL1_CONFIG_ADDR A:(&baseOffset+0x4c08004)
y.create.l HWIO_PMIC_ARB_OBS1_CHNL1_CONFIG_ADDR A:(&baseOffset+0x4c09004)
y.create.l HWIO_PMIC_ARB_OBS2_CHNL1_CONFIG_ADDR A:(&baseOffset+0x4c0a004)
y.create.l HWIO_PMIC_ARB_OBS3_CHNL1_CONFIG_ADDR A:(&baseOffset+0x4c0b004)
y.create.l HWIO_PMIC_ARB_OBS0_CHNL2_CONFIG_ADDR A:(&baseOffset+0x4c10004)
y.create.l HWIO_PMIC_ARB_OBS1_CHNL2_CONFIG_ADDR A:(&baseOffset+0x4c11004)
y.create.l HWIO_PMIC_ARB_OBS2_CHNL2_CONFIG_ADDR A:(&baseOffset+0x4c12004)
y.create.l HWIO_PMIC_ARB_OBS3_CHNL2_CONFIG_ADDR A:(&baseOffset+0x4c13004)
y.create.l HWIO_PMIC_ARB_OBS0_CHNL3_CONFIG_ADDR A:(&baseOffset+0x4c18004)
y.create.l HWIO_PMIC_ARB_OBS1_CHNL3_CONFIG_ADDR A:(&baseOffset+0x4c19004)
y.create.l HWIO_PMIC_ARB_OBS2_CHNL3_CONFIG_ADDR A:(&baseOffset+0x4c1a004)
y.create.l HWIO_PMIC_ARB_OBS3_CHNL3_CONFIG_ADDR A:(&baseOffset+0x4c1b004)
y.create.l HWIO_PMIC_ARB_OBS0_CHNL4_CONFIG_ADDR A:(&baseOffset+0x4c20004)
y.create.l HWIO_PMIC_ARB_OBS1_CHNL4_CONFIG_ADDR A:(&baseOffset+0x4c21004)
y.create.l HWIO_PMIC_ARB_OBS2_CHNL4_CONFIG_ADDR A:(&baseOffset+0x4c22004)
y.create.l HWIO_PMIC_ARB_OBS3_CHNL4_CONFIG_ADDR A:(&baseOffset+0x4c23004)
y.create.l HWIO_PMIC_ARB_OBS0_CHNL5_CONFIG_ADDR A:(&baseOffset+0x4c28004)
y.create.l HWIO_PMIC_ARB_OBS1_CHNL5_CONFIG_ADDR A:(&baseOffset+0x4c29004)
y.create.l HWIO_PMIC_ARB_OBS2_CHNL5_CONFIG_ADDR A:(&baseOffset+0x4c2a004)
y.create.l HWIO_PMIC_ARB_OBS3_CHNL5_CONFIG_ADDR A:(&baseOffset+0x4c2b004)
y.create.l HWIO_PMIC_ARB_OBS0_CHNL6_CONFIG_ADDR A:(&baseOffset+0x4c30004)
y.create.l HWIO_PMIC_ARB_OBS1_CHNL6_CONFIG_ADDR A:(&baseOffset+0x4c31004)
y.create.l HWIO_PMIC_ARB_OBS2_CHNL6_CONFIG_ADDR A:(&baseOffset+0x4c32004)
y.create.l HWIO_PMIC_ARB_OBS3_CHNL6_CONFIG_ADDR A:(&baseOffset+0x4c33004)
y.create.l HWIO_PMIC_ARB_OBS0_CHNL7_CONFIG_ADDR A:(&baseOffset+0x4c38004)
y.create.l HWIO_PMIC_ARB_OBS1_CHNL7_CONFIG_ADDR A:(&baseOffset+0x4c39004)
y.create.l HWIO_PMIC_ARB_OBS2_CHNL7_CONFIG_ADDR A:(&baseOffset+0x4c3a004)
y.create.l HWIO_PMIC_ARB_OBS3_CHNL7_CONFIG_ADDR A:(&baseOffset+0x4c3b004)
y.create.l HWIO_PMIC_ARB_OBS0_CHNL8_CONFIG_ADDR A:(&baseOffset+0x4c40004)
y.create.l HWIO_PMIC_ARB_OBS1_CHNL8_CONFIG_ADDR A:(&baseOffset+0x4c41004)
y.create.l HWIO_PMIC_ARB_OBS2_CHNL8_CONFIG_ADDR A:(&baseOffset+0x4c42004)
y.create.l HWIO_PMIC_ARB_OBS3_CHNL8_CONFIG_ADDR A:(&baseOffset+0x4c43004)
y.create.l HWIO_PMIC_ARB_OBS0_CHNL9_CONFIG_ADDR A:(&baseOffset+0x4c48004)
y.create.l HWIO_PMIC_ARB_OBS1_CHNL9_CONFIG_ADDR A:(&baseOffset+0x4c49004)
y.create.l HWIO_PMIC_ARB_OBS2_CHNL9_CONFIG_ADDR A:(&baseOffset+0x4c4a004)
y.create.l HWIO_PMIC_ARB_OBS3_CHNL9_CONFIG_ADDR A:(&baseOffset+0x4c4b004)
y.create.l HWIO_PMIC_ARB_OBS0_CHNL0_STATUS_ADDR A:(&baseOffset+0x4c00008)
y.create.l HWIO_PMIC_ARB_OBS1_CHNL0_STATUS_ADDR A:(&baseOffset+0x4c01008)
y.create.l HWIO_PMIC_ARB_OBS2_CHNL0_STATUS_ADDR A:(&baseOffset+0x4c02008)
y.create.l HWIO_PMIC_ARB_OBS3_CHNL0_STATUS_ADDR A:(&baseOffset+0x4c03008)
y.create.l HWIO_PMIC_ARB_OBS0_CHNL1_STATUS_ADDR A:(&baseOffset+0x4c08008)
y.create.l HWIO_PMIC_ARB_OBS1_CHNL1_STATUS_ADDR A:(&baseOffset+0x4c09008)
y.create.l HWIO_PMIC_ARB_OBS2_CHNL1_STATUS_ADDR A:(&baseOffset+0x4c0a008)
y.create.l HWIO_PMIC_ARB_OBS3_CHNL1_STATUS_ADDR A:(&baseOffset+0x4c0b008)
y.create.l HWIO_PMIC_ARB_OBS0_CHNL2_STATUS_ADDR A:(&baseOffset+0x4c10008)
y.create.l HWIO_PMIC_ARB_OBS1_CHNL2_STATUS_ADDR A:(&baseOffset+0x4c11008)
y.create.l HWIO_PMIC_ARB_OBS2_CHNL2_STATUS_ADDR A:(&baseOffset+0x4c12008)
y.create.l HWIO_PMIC_ARB_OBS3_CHNL2_STATUS_ADDR A:(&baseOffset+0x4c13008)
y.create.l HWIO_PMIC_ARB_OBS0_CHNL3_STATUS_ADDR A:(&baseOffset+0x4c18008)
y.create.l HWIO_PMIC_ARB_OBS1_CHNL3_STATUS_ADDR A:(&baseOffset+0x4c19008)
y.create.l HWIO_PMIC_ARB_OBS2_CHNL3_STATUS_ADDR A:(&baseOffset+0x4c1a008)
y.create.l HWIO_PMIC_ARB_OBS3_CHNL3_STATUS_ADDR A:(&baseOffset+0x4c1b008)
y.create.l HWIO_PMIC_ARB_OBS0_CHNL4_STATUS_ADDR A:(&baseOffset+0x4c20008)
y.create.l HWIO_PMIC_ARB_OBS1_CHNL4_STATUS_ADDR A:(&baseOffset+0x4c21008)
y.create.l HWIO_PMIC_ARB_OBS2_CHNL4_STATUS_ADDR A:(&baseOffset+0x4c22008)
y.create.l HWIO_PMIC_ARB_OBS3_CHNL4_STATUS_ADDR A:(&baseOffset+0x4c23008)
y.create.l HWIO_PMIC_ARB_OBS0_CHNL5_STATUS_ADDR A:(&baseOffset+0x4c28008)
y.create.l HWIO_PMIC_ARB_OBS1_CHNL5_STATUS_ADDR A:(&baseOffset+0x4c29008)
y.create.l HWIO_PMIC_ARB_OBS2_CHNL5_STATUS_ADDR A:(&baseOffset+0x4c2a008)
y.create.l HWIO_PMIC_ARB_OBS3_CHNL5_STATUS_ADDR A:(&baseOffset+0x4c2b008)
y.create.l HWIO_PMIC_ARB_OBS0_CHNL6_STATUS_ADDR A:(&baseOffset+0x4c30008)
y.create.l HWIO_PMIC_ARB_OBS1_CHNL6_STATUS_ADDR A:(&baseOffset+0x4c31008)
y.create.l HWIO_PMIC_ARB_OBS2_CHNL6_STATUS_ADDR A:(&baseOffset+0x4c32008)
y.create.l HWIO_PMIC_ARB_OBS3_CHNL6_STATUS_ADDR A:(&baseOffset+0x4c33008)
y.create.l HWIO_PMIC_ARB_OBS0_CHNL7_STATUS_ADDR A:(&baseOffset+0x4c38008)
y.create.l HWIO_PMIC_ARB_OBS1_CHNL7_STATUS_ADDR A:(&baseOffset+0x4c39008)
y.create.l HWIO_PMIC_ARB_OBS2_CHNL7_STATUS_ADDR A:(&baseOffset+0x4c3a008)
y.create.l HWIO_PMIC_ARB_OBS3_CHNL7_STATUS_ADDR A:(&baseOffset+0x4c3b008)
y.create.l HWIO_PMIC_ARB_OBS0_CHNL8_STATUS_ADDR A:(&baseOffset+0x4c40008)
y.create.l HWIO_PMIC_ARB_OBS1_CHNL8_STATUS_ADDR A:(&baseOffset+0x4c41008)
y.create.l HWIO_PMIC_ARB_OBS2_CHNL8_STATUS_ADDR A:(&baseOffset+0x4c42008)
y.create.l HWIO_PMIC_ARB_OBS3_CHNL8_STATUS_ADDR A:(&baseOffset+0x4c43008)
y.create.l HWIO_PMIC_ARB_OBS0_CHNL9_STATUS_ADDR A:(&baseOffset+0x4c48008)
y.create.l HWIO_PMIC_ARB_OBS1_CHNL9_STATUS_ADDR A:(&baseOffset+0x4c49008)
y.create.l HWIO_PMIC_ARB_OBS2_CHNL9_STATUS_ADDR A:(&baseOffset+0x4c4a008)
y.create.l HWIO_PMIC_ARB_OBS3_CHNL9_STATUS_ADDR A:(&baseOffset+0x4c4b008)
y.create.l HWIO_PMIC_ARB_OBS0_CHNL0_RDATA0_ADDR A:(&baseOffset+0x4c00018)
y.create.l HWIO_PMIC_ARB_OBS1_CHNL0_RDATA0_ADDR A:(&baseOffset+0x4c01018)
y.create.l HWIO_PMIC_ARB_OBS2_CHNL0_RDATA0_ADDR A:(&baseOffset+0x4c02018)
y.create.l HWIO_PMIC_ARB_OBS3_CHNL0_RDATA0_ADDR A:(&baseOffset+0x4c03018)
y.create.l HWIO_PMIC_ARB_OBS0_CHNL1_RDATA0_ADDR A:(&baseOffset+0x4c08018)
y.create.l HWIO_PMIC_ARB_OBS1_CHNL1_RDATA0_ADDR A:(&baseOffset+0x4c09018)
y.create.l HWIO_PMIC_ARB_OBS2_CHNL1_RDATA0_ADDR A:(&baseOffset+0x4c0a018)
y.create.l HWIO_PMIC_ARB_OBS3_CHNL1_RDATA0_ADDR A:(&baseOffset+0x4c0b018)
y.create.l HWIO_PMIC_ARB_OBS0_CHNL2_RDATA0_ADDR A:(&baseOffset+0x4c10018)
y.create.l HWIO_PMIC_ARB_OBS1_CHNL2_RDATA0_ADDR A:(&baseOffset+0x4c11018)
y.create.l HWIO_PMIC_ARB_OBS2_CHNL2_RDATA0_ADDR A:(&baseOffset+0x4c12018)
y.create.l HWIO_PMIC_ARB_OBS3_CHNL2_RDATA0_ADDR A:(&baseOffset+0x4c13018)
y.create.l HWIO_PMIC_ARB_OBS0_CHNL3_RDATA0_ADDR A:(&baseOffset+0x4c18018)
y.create.l HWIO_PMIC_ARB_OBS1_CHNL3_RDATA0_ADDR A:(&baseOffset+0x4c19018)
y.create.l HWIO_PMIC_ARB_OBS2_CHNL3_RDATA0_ADDR A:(&baseOffset+0x4c1a018)
y.create.l HWIO_PMIC_ARB_OBS3_CHNL3_RDATA0_ADDR A:(&baseOffset+0x4c1b018)
y.create.l HWIO_PMIC_ARB_OBS0_CHNL4_RDATA0_ADDR A:(&baseOffset+0x4c20018)
y.create.l HWIO_PMIC_ARB_OBS1_CHNL4_RDATA0_ADDR A:(&baseOffset+0x4c21018)
y.create.l HWIO_PMIC_ARB_OBS2_CHNL4_RDATA0_ADDR A:(&baseOffset+0x4c22018)
y.create.l HWIO_PMIC_ARB_OBS3_CHNL4_RDATA0_ADDR A:(&baseOffset+0x4c23018)
y.create.l HWIO_PMIC_ARB_OBS0_CHNL5_RDATA0_ADDR A:(&baseOffset+0x4c28018)
y.create.l HWIO_PMIC_ARB_OBS1_CHNL5_RDATA0_ADDR A:(&baseOffset+0x4c29018)
y.create.l HWIO_PMIC_ARB_OBS2_CHNL5_RDATA0_ADDR A:(&baseOffset+0x4c2a018)
y.create.l HWIO_PMIC_ARB_OBS3_CHNL5_RDATA0_ADDR A:(&baseOffset+0x4c2b018)
y.create.l HWIO_PMIC_ARB_OBS0_CHNL6_RDATA0_ADDR A:(&baseOffset+0x4c30018)
y.create.l HWIO_PMIC_ARB_OBS1_CHNL6_RDATA0_ADDR A:(&baseOffset+0x4c31018)
y.create.l HWIO_PMIC_ARB_OBS2_CHNL6_RDATA0_ADDR A:(&baseOffset+0x4c32018)
y.create.l HWIO_PMIC_ARB_OBS3_CHNL6_RDATA0_ADDR A:(&baseOffset+0x4c33018)
y.create.l HWIO_PMIC_ARB_OBS0_CHNL7_RDATA0_ADDR A:(&baseOffset+0x4c38018)
y.create.l HWIO_PMIC_ARB_OBS1_CHNL7_RDATA0_ADDR A:(&baseOffset+0x4c39018)
y.create.l HWIO_PMIC_ARB_OBS2_CHNL7_RDATA0_ADDR A:(&baseOffset+0x4c3a018)
y.create.l HWIO_PMIC_ARB_OBS3_CHNL7_RDATA0_ADDR A:(&baseOffset+0x4c3b018)
y.create.l HWIO_PMIC_ARB_OBS0_CHNL8_RDATA0_ADDR A:(&baseOffset+0x4c40018)
y.create.l HWIO_PMIC_ARB_OBS1_CHNL8_RDATA0_ADDR A:(&baseOffset+0x4c41018)
y.create.l HWIO_PMIC_ARB_OBS2_CHNL8_RDATA0_ADDR A:(&baseOffset+0x4c42018)
y.create.l HWIO_PMIC_ARB_OBS3_CHNL8_RDATA0_ADDR A:(&baseOffset+0x4c43018)
y.create.l HWIO_PMIC_ARB_OBS0_CHNL9_RDATA0_ADDR A:(&baseOffset+0x4c48018)
y.create.l HWIO_PMIC_ARB_OBS1_CHNL9_RDATA0_ADDR A:(&baseOffset+0x4c49018)
y.create.l HWIO_PMIC_ARB_OBS2_CHNL9_RDATA0_ADDR A:(&baseOffset+0x4c4a018)
y.create.l HWIO_PMIC_ARB_OBS3_CHNL9_RDATA0_ADDR A:(&baseOffset+0x4c4b018)
y.create.l HWIO_PMIC_ARB_OBS0_CHNL0_RDATA1_ADDR A:(&baseOffset+0x4c0001c)
y.create.l HWIO_PMIC_ARB_OBS1_CHNL0_RDATA1_ADDR A:(&baseOffset+0x4c0101c)
y.create.l HWIO_PMIC_ARB_OBS2_CHNL0_RDATA1_ADDR A:(&baseOffset+0x4c0201c)
y.create.l HWIO_PMIC_ARB_OBS3_CHNL0_RDATA1_ADDR A:(&baseOffset+0x4c0301c)
y.create.l HWIO_PMIC_ARB_OBS0_CHNL1_RDATA1_ADDR A:(&baseOffset+0x4c0801c)
y.create.l HWIO_PMIC_ARB_OBS1_CHNL1_RDATA1_ADDR A:(&baseOffset+0x4c0901c)
y.create.l HWIO_PMIC_ARB_OBS2_CHNL1_RDATA1_ADDR A:(&baseOffset+0x4c0a01c)
y.create.l HWIO_PMIC_ARB_OBS3_CHNL1_RDATA1_ADDR A:(&baseOffset+0x4c0b01c)
y.create.l HWIO_PMIC_ARB_OBS0_CHNL2_RDATA1_ADDR A:(&baseOffset+0x4c1001c)
y.create.l HWIO_PMIC_ARB_OBS1_CHNL2_RDATA1_ADDR A:(&baseOffset+0x4c1101c)
y.create.l HWIO_PMIC_ARB_OBS2_CHNL2_RDATA1_ADDR A:(&baseOffset+0x4c1201c)
y.create.l HWIO_PMIC_ARB_OBS3_CHNL2_RDATA1_ADDR A:(&baseOffset+0x4c1301c)
y.create.l HWIO_PMIC_ARB_OBS0_CHNL3_RDATA1_ADDR A:(&baseOffset+0x4c1801c)
y.create.l HWIO_PMIC_ARB_OBS1_CHNL3_RDATA1_ADDR A:(&baseOffset+0x4c1901c)
y.create.l HWIO_PMIC_ARB_OBS2_CHNL3_RDATA1_ADDR A:(&baseOffset+0x4c1a01c)
y.create.l HWIO_PMIC_ARB_OBS3_CHNL3_RDATA1_ADDR A:(&baseOffset+0x4c1b01c)
y.create.l HWIO_PMIC_ARB_OBS0_CHNL4_RDATA1_ADDR A:(&baseOffset+0x4c2001c)
y.create.l HWIO_PMIC_ARB_OBS1_CHNL4_RDATA1_ADDR A:(&baseOffset+0x4c2101c)
y.create.l HWIO_PMIC_ARB_OBS2_CHNL4_RDATA1_ADDR A:(&baseOffset+0x4c2201c)
y.create.l HWIO_PMIC_ARB_OBS3_CHNL4_RDATA1_ADDR A:(&baseOffset+0x4c2301c)
y.create.l HWIO_PMIC_ARB_OBS0_CHNL5_RDATA1_ADDR A:(&baseOffset+0x4c2801c)
y.create.l HWIO_PMIC_ARB_OBS1_CHNL5_RDATA1_ADDR A:(&baseOffset+0x4c2901c)
y.create.l HWIO_PMIC_ARB_OBS2_CHNL5_RDATA1_ADDR A:(&baseOffset+0x4c2a01c)
y.create.l HWIO_PMIC_ARB_OBS3_CHNL5_RDATA1_ADDR A:(&baseOffset+0x4c2b01c)
y.create.l HWIO_PMIC_ARB_OBS0_CHNL6_RDATA1_ADDR A:(&baseOffset+0x4c3001c)
y.create.l HWIO_PMIC_ARB_OBS1_CHNL6_RDATA1_ADDR A:(&baseOffset+0x4c3101c)
y.create.l HWIO_PMIC_ARB_OBS2_CHNL6_RDATA1_ADDR A:(&baseOffset+0x4c3201c)
y.create.l HWIO_PMIC_ARB_OBS3_CHNL6_RDATA1_ADDR A:(&baseOffset+0x4c3301c)
y.create.l HWIO_PMIC_ARB_OBS0_CHNL7_RDATA1_ADDR A:(&baseOffset+0x4c3801c)
y.create.l HWIO_PMIC_ARB_OBS1_CHNL7_RDATA1_ADDR A:(&baseOffset+0x4c3901c)
y.create.l HWIO_PMIC_ARB_OBS2_CHNL7_RDATA1_ADDR A:(&baseOffset+0x4c3a01c)
y.create.l HWIO_PMIC_ARB_OBS3_CHNL7_RDATA1_ADDR A:(&baseOffset+0x4c3b01c)
y.create.l HWIO_PMIC_ARB_OBS0_CHNL8_RDATA1_ADDR A:(&baseOffset+0x4c4001c)
y.create.l HWIO_PMIC_ARB_OBS1_CHNL8_RDATA1_ADDR A:(&baseOffset+0x4c4101c)
y.create.l HWIO_PMIC_ARB_OBS2_CHNL8_RDATA1_ADDR A:(&baseOffset+0x4c4201c)
y.create.l HWIO_PMIC_ARB_OBS3_CHNL8_RDATA1_ADDR A:(&baseOffset+0x4c4301c)
y.create.l HWIO_PMIC_ARB_OBS0_CHNL9_RDATA1_ADDR A:(&baseOffset+0x4c4801c)
y.create.l HWIO_PMIC_ARB_OBS1_CHNL9_RDATA1_ADDR A:(&baseOffset+0x4c4901c)
y.create.l HWIO_PMIC_ARB_OBS2_CHNL9_RDATA1_ADDR A:(&baseOffset+0x4c4a01c)
y.create.l HWIO_PMIC_ARB_OBS3_CHNL9_RDATA1_ADDR A:(&baseOffset+0x4c4b01c)
y.create.done
ENDDO