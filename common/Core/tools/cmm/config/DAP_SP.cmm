//============================================================================
//  Name:                                                                     
//    DAP_RPM.cmm
//
//  Description:                                                              
//    Setup script for the RPM 
//                                                                            
// Copyright (c) 2012 - 2014 by Qualcomm Technologies, Incorporated.  All Rights Reserved.        
//
//
//
//
//                      EDIT HISTORY FOR FILE
//  This section contains comments describing changes made to the module.
//  Notice that changes are listed in reverse chronological order.
//
// when       who             what, where, why
// --------   ---             ------------------------------------
// 07/22/2015 RSSRIDHA        Ported for MDM9x45
// 02/20/2015 JBILLING      Remove JTAG/SWD Hack
// 02/09/2015 JBILLING      Port for 8996
// 04/15/2014 AJCheriyan    SWDTARGET removed
// 04/04/2014 AJCheriyan    SWD support auto-detect
// 11/21/2013 AJCheriyan    Update for Luxor
// 04/13/2013 AJCheriyan    Support for QDSS Gen 2
// 04/02/2013 AJCheriyan    Added SWD support
// 02/11/2013 AJCheriyan    Added 8x26 support
// 08/26/2012 AJCheriyan    Dropped JTAG clock down to 20 MHz
// 08/25/2012 AJCheriyan    Boosted JTAG clock speed
// 07/10/2012 AJCheriyan    Created for B-family
//

// The script accepts two input arguments
// ARG0 - Chipset name
// ARG1 - Core number
// Ideal case, the argument 'ARG0' would not have to be used
// as the parameters for a sub-system should be the same
// across the entire family of chipsets

ENTRY &ARG0 &ARG1 &ARG2
GLOBAL &SP_HW_BLOCK_NAME &CURRENT_HW_BLOCK_NAME
&SP_HW_BLOCK_NAME="SP-CORTEXM3"
MAIN:
    &ARG0=STR.UPR("&ARG0")
    
    IF ("&ARG0"=="MSM8998")
    (

        SYSTEM.CPU SC300
        
        SYSTEM.JTAGCLOCK 10.0MHZ 
        SYStem.OPTION WAITRESET OFF
        SYSTEM.OPTION ENRESET OFF
        SYSTEM.OPTION RESBREAK OFF
        SYSTEM.CONFIG SLAVE ON
        
        SYStem.CONFIG COREBASE         E:0xE000E000
        SYStem.CONFIG ITMBASE          E:0xE0000000
        SYStem.CONFIG DWTBASE          E:0xE0010000
        SYStem.CONFIG ETMBASE          E:0xE0041000
        //SYStem.CONFIG TPIUBASE         APB:0x86040000

        SYStem.CONFIG MEMORYACCESSPORT 6.
        SYStem.CONFIG DEBUGACCESSPORT  1.
        SYStem.CONFIG AHBACCESSPORT    6.
        SYStem.CONFIG APBACCESSPORT    1.
        SYStem.CONFIG AXIACCESSPORT    0.

        SYStem.CONFIG DAPIRPOST 0.
        SYStem.CONFIG DAPDRPOST 0.
        SYStem.CONFIG DAPIRPOST 16.
        SYStem.CONFIG DAPDRPOST 2.

        SYStem.MEMACCESS DAP
        
        
        
    )
   
    &CURRENT_HW_BLOCK_NAME="&SP_HW_BLOCK_NAME"
    // Common settings for all chipsets
    IF ((("&ARG2"=="SWD")||("&ARG2"=="swd"))&&(CABLE.TWOWIRE()))
    (
        SYSTEM.CONFIG SWDP ON 
        SYSTEM.CONFIG DEBUGPORTTYPE SWD
    )

    // Launch startup scripts
    IF (OS.ENV(STARTUPCMM)!="")
    (
        &STARTUPSCRIPT=OS.ENV(STARTUPCMM)
        do &STARTUPSCRIPT
    )
        
    B.SEL PROGRAM AUTO

    RADIX HEX
    SETUP.VAR %HEX.ON
    MODE.HLL
    autostore
    
    
EXIT:
    ENDDO
