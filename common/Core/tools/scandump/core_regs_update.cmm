r.s x0 0x11223340AABBCCD0
r.s x1 0x11223341AABBCCD1
r.s x2 0x11223342AABBCCD2
r.s x3 0x11223343AABBCCD3
r.s x4 0x11223344AABBCCD4
r.s x5 0x11223345AABBCCD5
r.s x6 0x11223346AABBCCD6
r.s x7 0x11223347AABBCCD7
r.s x8 0x11223348AABBCCD8
r.s x9 0x11223349AABBCCD9
r.s x10 0x11223310AABBCC10
r.s x11 0x11223311AABBCC11
r.s x12 0x11223312AABBCC12
r.s x13 0x11223313AABBCC13
r.s x14 0x11223314AABBCC14
r.s x15 0x11223315AABBCC15
r.s x16 0x11223316AABBCC16
r.s x17 0x11223317AABBCC17
r.s x18 0x11223318AABBCC18
r.s x19 0x11223319AABBCC19
r.s x20 0x11223320AABBCC20
r.s x21 0x11223321AABBCC21
r.s x22 0x11223322AABBCC22
r.s x23 0x11223323AABBCC23
r.s x24 0x11223324AABBCC24
r.s x25 0x11223325AABBCC25
r.s x26 0x11223326AABBCC26
r.s x27 0x11223327AABBCC27
r.s x28 0x11223328AABBCC28
r.s x29 0x11223329AABBCC29
r.s x30 0x11223330AABBCC30

r.s sp_el3 0x11223341AABBCCD1
r.s elr_el3 0x11223341AABBCCD1
r.s spsr_el3 0x7038f
r.s sp_el2 0x11223341AABBCCD1
r.s elr_el2 0x11223341AABBCCD1
r.s spsr_el2 0xf380f
r.s sp_el1 0x11223341AABBCCD1
r.s elr_el1 0x11223341AABBCCD1
r.s spsr_el1 0x230ffff
r.s sp_el0 0x11223341AABBCCD1
