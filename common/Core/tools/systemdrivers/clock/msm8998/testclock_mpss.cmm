
;============================================================================
;
; *************** THIS SCRIPT WAS AUTOGENERATED ****************
;
; TARGET
;
;
; SCRIPT
;   TESTCLOCK.CMM
;
; GENERAL DESCRIPTION
;   This script can be used to route specific clocks to the clock test output.
;
; FUNCTIONS
;   N/A
;
;    Copyright (c) 2016 by QUALCOMM Technologies Inc.  All Rights Reserved.
;============================================================================



;-----------------------------------------------------------------------------
; Local variables
;-----------------------------------------------------------------------------

local &clk
local &clk_name
local &clk_state
local &clk_state_filter
local &clk_freq
local &header_printed
local &clk_test
local &clk_reg
local &clk_reg_str
local &clk_reg_name
local &clk_reg_cbcr_type
local &state_change
local &clock_count
local &multiplier
local &tcxo_count
local &match
local &clk_access_mode
local &clk_cmd_rcgr_addr
local &clk_cfg_rcgr_addr
local &clk_cmd_rcgr_val
local &clk_cfg_rcgr_val
local &clk_src_name
local &clk_src_sel
local &clk_src_div
local &clk_m_addr
local &clk_n_addr
local &clk_d_addr
local &clk_m_val
local &clk_n_val
local &clk_2d_val
local &chipset_name
local &frq_measure_ctl_addr
local &frq_measure_status_addr
local &xo_div4_cbcr_addr
local &dbg_clk_ctl_addr


;-----------------------------------------------------------------------------
; Initialize autogenerated constants
;-----------------------------------------------------------------------------

goto Init_Constants


Init_Constants:

; Chipset Name
&chipset_name="msm8998"

; Access Mode
&access_mode="a"


;GCC clock registers
&HWIO_GCC_AGGRE1_CNOC_AHB_CBCR_ADDR=0x18200c
&HWIO_GCC_AGGRE1_CNOC_PERIPH_AHB_CBCR_ADDR=0x182014
&HWIO_GCC_AGGRE1_NOC_AT_CBCR_ADDR=0x182010
&HWIO_GCC_AGGRE1_NOC_MSMPU_CFG_AHB_CBCR_ADDR=0x18d004
&HWIO_GCC_AGGRE1_NOC_XO_CBCR_ADDR=0x18202c
&HWIO_GCC_AGGRE1_SNOC_AXI_CBCR_ADDR=0x182008
&HWIO_GCC_AGGRE1_SNOC_MSMPU_CLIENT_AXI_CBCR_ADDR=0x18d014
&HWIO_GCC_AGGRE1_UFS_AXI_CBCR_ADDR=0x182028
&HWIO_GCC_AGGRE1_USB3_AXI_CBCR_ADDR=0x182024
&HWIO_GCC_AGGRE2_CNOC_AHB_CBCR_ADDR=0x183014
&HWIO_GCC_AGGRE2_CNOC_PERIPH_AHB_CBCR_ADDR=0x183050
&HWIO_GCC_AGGRE2_NOC_AT_CBCR_ADDR=0x183018
&HWIO_GCC_AGGRE2_NOC_IPA_CBCR_ADDR=0x18304c
&HWIO_GCC_AGGRE2_NOC_MSMPU_CFG_AHB_CBCR_ADDR=0x18d008
&HWIO_GCC_AGGRE2_SNOC_AXI_CBCR_ADDR=0x183008
&HWIO_GCC_AGGRE2_SNOC_EAST_AXI_CBCR_ADDR=0x18300c
&HWIO_GCC_AGGRE2_SNOC_MSMPU_CLIENT_AXI_CBCR_ADDR=0x18d018
&HWIO_GCC_AGGRE2_SNOC_NORTH_AXI_CBCR_ADDR=0x183010
&HWIO_GCC_AHB2PHY_EAST_CBCR_ADDR=0x107004
&HWIO_GCC_GCC_AHB_CBCR_ADDR=0x143000
&HWIO_GCC_APC0_VS_CBCR_ADDR=0x17a0dc
&HWIO_GCC_APC1_VS_CBCR_ADDR=0x17a0e0
&HWIO_GCC_APSS_QDSS_TSCTR_DIV2_CBCR_ADDR=0x148090
&HWIO_GCC_APSS_QDSS_TSCTR_DIV8_CBCR_ADDR=0x148094
&HWIO_GCC_BIMC_AT_CBCR_ADDR=0x144020
&HWIO_GCC_BIMC_CFG_AHB_CBCR_ADDR=0x14400c
&HWIO_GCC_BIMC_CBCR_ADDR=0x144018
&HWIO_GCC_BIMC_DDR_CPLL0_CBCR_ADDR=0x146004
&HWIO_GCC_BIMC_DDR_CPLL1_CBCR_ADDR=0x146008
&HWIO_GCC_BIMC_DTTS_XO_CBCR_ADDR=0x144028
&HWIO_GCC_BIMC_GFX_CBCR_ADDR=0x146040
&HWIO_GCC_BIMC_HMSS_AXI_CBCR_ADDR=0x148004
&HWIO_GCC_BIMC_MSS_Q6_AXI_CBCR_ADDR=0x14401c
&HWIO_GCC_BIMC_NIUS_AXI_CBCR_ADDR=0x104034
&HWIO_GCC_BIMC_NIUS_CFG_AHB_CBCR_ADDR=0x104038
&HWIO_GCC_BIMC_NIUS_HS_AXI_CBCR_ADDR=0x104030
&HWIO_GCC_BIMC_PIMEM_AXI_CBCR_ADDR=0x10a028
&HWIO_GCC_BIMC_SLEEP_CBCR_ADDR=0x144010
&HWIO_GCC_BIMC_SYSNOC_AXI_CBCR_ADDR=0x144014
&HWIO_GCC_BIMC_SYSNOC_HS_AXI_CBCR_ADDR=0x144024
&HWIO_GCC_BIMC_XO_CBCR_ADDR=0x144008
&HWIO_GCC_BLSP1_AHB_CBCR_ADDR=0x117004
&HWIO_GCC_BLSP1_QUP1_I2C_APPS_CBCR_ADDR=0x119008
&HWIO_GCC_BLSP1_QUP1_SPI_APPS_CBCR_ADDR=0x119004
&HWIO_GCC_BLSP1_QUP2_I2C_APPS_CBCR_ADDR=0x11b008
&HWIO_GCC_BLSP1_QUP2_SPI_APPS_CBCR_ADDR=0x11b004
&HWIO_GCC_BLSP1_QUP3_I2C_APPS_CBCR_ADDR=0x11d008
&HWIO_GCC_BLSP1_QUP3_SPI_APPS_CBCR_ADDR=0x11d004
&HWIO_GCC_BLSP1_QUP4_I2C_APPS_CBCR_ADDR=0x11f008
&HWIO_GCC_BLSP1_QUP4_SPI_APPS_CBCR_ADDR=0x11f004
&HWIO_GCC_BLSP1_QUP5_I2C_APPS_CBCR_ADDR=0x121008
&HWIO_GCC_BLSP1_QUP5_SPI_APPS_CBCR_ADDR=0x121004
&HWIO_GCC_BLSP1_QUP6_I2C_APPS_CBCR_ADDR=0x123008
&HWIO_GCC_BLSP1_QUP6_SPI_APPS_CBCR_ADDR=0x123004
&HWIO_GCC_BLSP1_SLEEP_CBCR_ADDR=0x117008
&HWIO_GCC_BLSP1_UART1_APPS_CBCR_ADDR=0x11a004
&HWIO_GCC_BLSP1_UART1_SIM_CBCR_ADDR=0x11a008
&HWIO_GCC_BLSP1_UART2_APPS_CBCR_ADDR=0x11c004
&HWIO_GCC_BLSP1_UART2_SIM_CBCR_ADDR=0x11c008
&HWIO_GCC_BLSP1_UART3_APPS_CBCR_ADDR=0x11e004
&HWIO_GCC_BLSP1_UART3_SIM_CBCR_ADDR=0x11e008
&HWIO_GCC_BLSP2_AHB_CBCR_ADDR=0x125004
&HWIO_GCC_BLSP2_QUP1_I2C_APPS_CBCR_ADDR=0x126008
&HWIO_GCC_BLSP2_QUP1_SPI_APPS_CBCR_ADDR=0x126004
&HWIO_GCC_BLSP2_QUP2_I2C_APPS_CBCR_ADDR=0x128008
&HWIO_GCC_BLSP2_QUP2_SPI_APPS_CBCR_ADDR=0x128004
&HWIO_GCC_BLSP2_QUP3_I2C_APPS_CBCR_ADDR=0x12a008
&HWIO_GCC_BLSP2_QUP3_SPI_APPS_CBCR_ADDR=0x12a004
&HWIO_GCC_BLSP2_QUP4_I2C_APPS_CBCR_ADDR=0x12c008
&HWIO_GCC_BLSP2_QUP4_SPI_APPS_CBCR_ADDR=0x12c004
&HWIO_GCC_BLSP2_QUP5_I2C_APPS_CBCR_ADDR=0x12e008
&HWIO_GCC_BLSP2_QUP5_SPI_APPS_CBCR_ADDR=0x12e004
&HWIO_GCC_BLSP2_QUP6_I2C_APPS_CBCR_ADDR=0x130008
&HWIO_GCC_BLSP2_QUP6_SPI_APPS_CBCR_ADDR=0x130004
&HWIO_GCC_BLSP2_SLEEP_CBCR_ADDR=0x125008
&HWIO_GCC_BLSP2_UART1_APPS_CBCR_ADDR=0x127004
&HWIO_GCC_BLSP2_UART1_SIM_CBCR_ADDR=0x127008
&HWIO_GCC_BLSP2_UART2_APPS_CBCR_ADDR=0x129004
&HWIO_GCC_BLSP2_UART2_SIM_CBCR_ADDR=0x129008
&HWIO_GCC_BLSP2_UART3_APPS_CBCR_ADDR=0x12b004
&HWIO_GCC_BLSP2_UART3_SIM_CBCR_ADDR=0x12b008
&HWIO_GCC_BOOT_ROM_AHB_CBCR_ADDR=0x138004
&HWIO_GCC_CE1_AHB_CBCR_ADDR=0x14100c
&HWIO_GCC_CE1_AXI_CBCR_ADDR=0x141008
&HWIO_GCC_CE1_CBCR_ADDR=0x141004
&HWIO_GCC_CENTER_APB_CBCR_ADDR=0x10c050
&HWIO_GCC_CFG_NOC_AH2PHY_XO_CBCR_ADDR=0x105034
&HWIO_GCC_CFG_NOC_AHB_CBCR_ADDR=0x105004
&HWIO_GCC_CFG_NOC_DCD_XO_CBCR_ADDR=0x105024
&HWIO_GCC_CFG_NOC_DDR_CFG_CBCR_ADDR=0x105014
&HWIO_GCC_CFG_NOC_EAST_AHB_CBCR_ADDR=0x105010
&HWIO_GCC_CFG_NOC_EAST_DCD_XO_CBCR_ADDR=0x10502c
&HWIO_GCC_CFG_NOC_NORTH_AHB_CBCR_ADDR=0x10500c
&HWIO_GCC_CFG_NOC_NORTH_DCD_XO_CBCR_ADDR=0x105030
&HWIO_GCC_CFG_NOC_USB3_AXI_CBCR_ADDR=0x105018
&HWIO_GCC_CFG_NOC_WEST_AHB_CBCR_ADDR=0x105008
&HWIO_GCC_CFG_NOC_WEST_DCD_XO_CBCR_ADDR=0x105028
&HWIO_GCC_CM_PHY_REFGEN1_CBCR_ADDR=0x122004
&HWIO_GCC_CM_PHY_REFGEN2_CBCR_ADDR=0x124004
&HWIO_GCC_CNOC_BUS_TIMEOUT0_AHB_CBCR_ADDR=0x14b004
&HWIO_GCC_CNOC_BUS_TIMEOUT10_AHB_CBCR_ADDR=0x180014
&HWIO_GCC_CNOC_BUS_TIMEOUT11_AHB_CBCR_ADDR=0x18001c
&HWIO_GCC_CNOC_BUS_TIMEOUT12_AHB_CBCR_ADDR=0x180024
&HWIO_GCC_CNOC_BUS_TIMEOUT13_AHB_CBCR_ADDR=0x18002c
&HWIO_GCC_CNOC_BUS_TIMEOUT14_AHB_CBCR_ADDR=0x180034
&HWIO_GCC_CNOC_BUS_TIMEOUT1_AHB_CBCR_ADDR=0x14b00c
&HWIO_GCC_CNOC_BUS_TIMEOUT2_AHB_CBCR_ADDR=0x14b014
&HWIO_GCC_CNOC_BUS_TIMEOUT3_AHB_CBCR_ADDR=0x14b01c
&HWIO_GCC_CNOC_BUS_TIMEOUT4_AHB_CBCR_ADDR=0x14b024
&HWIO_GCC_CNOC_BUS_TIMEOUT5_AHB_CBCR_ADDR=0x14b02c
&HWIO_GCC_CNOC_BUS_TIMEOUT6_AHB_CBCR_ADDR=0x14b034
&HWIO_GCC_CNOC_BUS_TIMEOUT7_AHB_CBCR_ADDR=0x14b03c
&HWIO_GCC_CNOC_BUS_TIMEOUT8_AHB_CBCR_ADDR=0x180004
&HWIO_GCC_CNOC_BUS_TIMEOUT9_AHB_CBCR_ADDR=0x18000c
&HWIO_GCC_CNOC_MST_RPM_AHB_CBCR_ADDR=0x13c014
&HWIO_GCC_CNOC_PERIPH_BUS_TIMEOUT1_AHB_CBCR_ADDR=0x14a008
&HWIO_GCC_CNOC_PERIPH_BUS_TIMEOUT2_AHB_CBCR_ADDR=0x14a010
&HWIO_GCC_CNOC_PERIPH_EAST_AHB_CBCR_ADDR=0x105020
&HWIO_GCC_CNOC_PERIPH_WEST_AHB_CBCR_ADDR=0x10501c
&HWIO_GCC_DCC_AHB_CBCR_ADDR=0x184004
&HWIO_GCC_DDR_DIM_CFG_CBCR_ADDR=0x146000
&HWIO_GCC_DDR_DIM_SLEEP_CBCR_ADDR=0x14600c
&HWIO_GCC_EAST_APB_CBCR_ADDR=0x10c044
&HWIO_GCC_EAST_AT_CBCR_ADDR=0x10c014
&HWIO_GCC_GLM_AHB_CBCR_ADDR=0x18b004
&HWIO_GCC_GLM_CBCR_ADDR=0x18b008
&HWIO_GCC_GLM_XO_CBCR_ADDR=0x18b00c
&HWIO_GCC_GP1_CBCR_ADDR=0x164000
&HWIO_GCC_GP2_CBCR_ADDR=0x165000
&HWIO_GCC_GP3_CBCR_ADDR=0x166000
&HWIO_GCC_GPU_AT_CBCR_ADDR=0x171008
&HWIO_GCC_GPU_BIMC_GFX_CBCR_ADDR=0x171010
&HWIO_GCC_GPU_BIMC_GFX_SRC_CBCR_ADDR=0x17100c
&HWIO_GCC_GPU_CFG_AHB_CBCR_ADDR=0x171004
&HWIO_GCC_GPU_SNOC_DVM_GFX_CBCR_ADDR=0x171018
&HWIO_GCC_GPU_TRIG_CBCR_ADDR=0x171014
&HWIO_GCC_GPU_VS_CBCR_ADDR=0x17a0d8
&HWIO_GCC_HMSS_AHB_CBCR_ADDR=0x148000
&HWIO_GCC_HMSS_AT_CBCR_ADDR=0x148010
&HWIO_GCC_HMSS_DVM_BUS_CBCR_ADDR=0x14808c
&HWIO_GCC_HMSS_RBCPR_CBCR_ADDR=0x148008
&HWIO_GCC_HMSS_TRIG_CBCR_ADDR=0x14800c
&HWIO_GCC_GCC_IM_SLEEP_CBCR_ADDR=0x14300c
&HWIO_GCC_IMEM_AXI_CBCR_ADDR=0x108004
&HWIO_GCC_IMEM_CFG_AHB_CBCR_ADDR=0x108008
&HWIO_GCC_IPA_2X_CBCR_ADDR=0x189008
&HWIO_GCC_IPA_AHB_CBCR_ADDR=0x189010
&HWIO_GCC_IPA_CBCR_ADDR=0x18900c
&HWIO_GCC_IPA_SLEEP_CBCR_ADDR=0x189014
&HWIO_GCC_LPASS_AT_CBCR_ADDR=0x147020
&HWIO_GCC_LPASS_CORE_SMMU_AHB_CBCR_ADDR=0x147014
&HWIO_GCC_LPASS_CORE_SMMU_CLIENT_CBCR_ADDR=0x147028
&HWIO_GCC_LPASS_CORE_SMMU_CLIENT_SRC_CBCR_ADDR=0x147024
&HWIO_GCC_LPASS_Q6_AXI_CBCR_ADDR=0x147000
&HWIO_GCC_LPASS_Q6_SMMU_AHB_CBCR_ADDR=0x147010
&HWIO_GCC_LPASS_Q6_SMMU_AXI_CBCR_ADDR=0x147008
&HWIO_GCC_LPASS_Q6_SMMU_AXI_SRC_CBCR_ADDR=0x147004
&HWIO_GCC_LPASS_SMMU_AON_AHB_CBCR_ADDR=0x147018
&HWIO_GCC_LPASS_SWAY_CBCR_ADDR=0x14700c
&HWIO_GCC_LPASS_TRIG_CBCR_ADDR=0x14701c
&HWIO_GCC_MCCC_CFG_AHB_CBCR_ADDR=0x146044
&HWIO_GCC_MMSS_AT_CBCR_ADDR=0x109008
&HWIO_GCC_MMSS_NOC_AT_CBCR_ADDR=0x109034
&HWIO_GCC_MMSS_NOC_CFG_AHB_CBCR_ADDR=0x109004
&HWIO_GCC_MMSS_QM_AHB_CBCR_ADDR=0x109030
&HWIO_GCC_MMSS_QM_CORE_CBCR_ADDR=0x10900c
&HWIO_GCC_MMSS_SYS_NOC_AXI_CBCR_ADDR=0x109000
&HWIO_GCC_MMSS_TRIG_CBCR_ADDR=0x109010
&HWIO_GCC_MPM_AHB_CBCR_ADDR=0x13b008
&HWIO_GCC_MSG_RAM_AHB_CBCR_ADDR=0x139004
&HWIO_GCC_MSS_AT_CBCR_ADDR=0x18a00c
&HWIO_GCC_MSS_CFG_AHB_CBCR_ADDR=0x18a000
&HWIO_GCC_MSS_MNOC_BIMC_AXI_CBCR_ADDR=0x18a004
&HWIO_GCC_MSS_MSMPU_CFG_AHB_CBCR_ADDR=0x18d010
&HWIO_GCC_MSS_MSMPU_CLIENT_AXI_CBCR_ADDR=0x18d020
&HWIO_GCC_MSS_Q6_BIMC_AXI_CBCR_ADDR=0x18a040
&HWIO_GCC_MSS_Q6_MSMPU_CFG_AHB_CBCR_ADDR=0x18d00c
&HWIO_GCC_MSS_Q6_MSMPU_CLIENT_AXI_CBCR_ADDR=0x18d01c
&HWIO_GCC_MSS_SNOC_AXI_CBCR_ADDR=0x18a03c
&HWIO_GCC_MSS_TRIG_CBCR_ADDR=0x18a008
&HWIO_GCC_MSS_VS_CBCR_ADDR=0x17a0d4
&HWIO_GCC_NORTH_APB_CBCR_ADDR=0x10c04c
&HWIO_GCC_NORTH_AT_CBCR_ADDR=0x10c018
&HWIO_GCC_OBT_ODT_CBCR_ADDR=0x173018
&HWIO_GCC_PCIE_0_AUX_CBCR_ADDR=0x16b014
&HWIO_GCC_PCIE_0_CFG_AHB_CBCR_ADDR=0x16b010
&HWIO_GCC_PCIE_0_MSTR_AXI_CBCR_ADDR=0x16b00c
&HWIO_GCC_PCIE_0_PIPE_CBCR_ADDR=0x16b018
&HWIO_GCC_PCIE_0_SLV_AXI_CBCR_ADDR=0x16b008
&HWIO_GCC_PCIE_PHY_AUX_CBCR_ADDR=0x16f004
&HWIO_GCC_PDM2_CBCR_ADDR=0x13300c
&HWIO_GCC_PDM_AHB_CBCR_ADDR=0x133004
&HWIO_GCC_PDM_XO4_CBCR_ADDR=0x133008
&HWIO_GCC_PIMEM_AHB_CBCR_ADDR=0x10a020
&HWIO_GCC_PIMEM_AXI_CBCR_ADDR=0x10a004
&HWIO_GCC_PRNG_AHB_CBCR_ADDR=0x134004
&HWIO_GCC_QDSS_APB2JTAG_CBCR_ADDR=0x14c004
&HWIO_GCC_QDSS_CENTER_AT_CBCR_ADDR=0x10c00c
&HWIO_GCC_QDSS_CFG_AHB_CBCR_ADDR=0x10c008
&HWIO_GCC_QDSS_DAP_AHB_CBCR_ADDR=0x10c004
&HWIO_GCC_QDSS_DAP_CBCR_ADDR=0x10c040
&HWIO_GCC_QDSS_ETR_USB_CBCR_ADDR=0x10c01c
&HWIO_GCC_QDSS_STM_CBCR_ADDR=0x10c020
&HWIO_GCC_QDSS_TRACECLKIN_CBCR_ADDR=0x10c024
&HWIO_GCC_QDSS_TRIG_CBCR_ADDR=0x10c03c
&HWIO_GCC_QDSS_TSCTR_DIV16_CBCR_ADDR=0x10c038
&HWIO_GCC_QDSS_TSCTR_DIV2_CBCR_ADDR=0x10c028
&HWIO_GCC_QDSS_TSCTR_DIV3_CBCR_ADDR=0x10c02c
&HWIO_GCC_QDSS_TSCTR_DIV4_CBCR_ADDR=0x10c030
&HWIO_GCC_QDSS_TSCTR_DIV8_CBCR_ADDR=0x10c034
&HWIO_GCC_QDSS_XO_CBCR_ADDR=0x10c054
&HWIO_GCC_QREFS_VBG_CAL_CBCR_ADDR=0x18802c
&HWIO_GCC_RBCPR_CX_AHB_CBCR_ADDR=0x14e008
&HWIO_GCC_RBCPR_CX_CBCR_ADDR=0x14e004
&HWIO_GCC_RBCPR_MX_AHB_CBCR_ADDR=0x14f008
&HWIO_GCC_RBCPR_MX_CBCR_ADDR=0x14f004
&HWIO_GCC_RPM_BUS_AHB_CBCR_ADDR=0x13c004
&HWIO_GCC_RPM_MST_M2_CNOC_AHB_CBCR_ADDR=0x13c010
&HWIO_GCC_RPM_PROC_HCLK_CBCR_ADDR=0x13c000
&HWIO_GCC_RPM_SLEEP_CBCR_ADDR=0x13c008
&HWIO_GCC_RPM_TIMER_CBCR_ADDR=0x13c00c
&HWIO_GCC_SDCC2_AHB_CBCR_ADDR=0x114008
&HWIO_GCC_SDCC2_APPS_CBCR_ADDR=0x114004
&HWIO_GCC_SDCC4_AHB_CBCR_ADDR=0x116008
&HWIO_GCC_SDCC4_APPS_CBCR_ADDR=0x116004
&HWIO_GCC_SEC_CTRL_ACC_CBCR_ADDR=0x13d004
&HWIO_GCC_SEC_CTRL_AHB_CBCR_ADDR=0x13d008
&HWIO_GCC_SEC_CTRL_BOOT_ROM_PATCH_CBCR_ADDR=0x13d014
&HWIO_GCC_SEC_CTRL_CBCR_ADDR=0x13d00c
&HWIO_GCC_SEC_CTRL_SENSE_CBCR_ADDR=0x13d010
&HWIO_GCC_SKL_AHB_CBCR_ADDR=0x18c004
&HWIO_GCC_SMMU_AGGRE1_AHB_CBCR_ADDR=0x182020
&HWIO_GCC_SMMU_AGGRE1_AXI_CBCR_ADDR=0x18201c
&HWIO_GCC_SMMU_AGGRE1_AXI_SRC_CBCR_ADDR=0x182018
&HWIO_GCC_SMMU_AGGRE2_AHB_CBCR_ADDR=0x183024
&HWIO_GCC_SMMU_AGGRE2_AXI_CBCR_ADDR=0x183020
&HWIO_GCC_SMMU_AGGRE2_AXI_SRC_CBCR_ADDR=0x18301c
&HWIO_GCC_SNOC_BUS_TIMEOUT0_AHB_CBCR_ADDR=0x149004
&HWIO_GCC_SNOC_BUS_TIMEOUT1_AHB_CBCR_ADDR=0x14900c
&HWIO_GCC_SNOC_BUS_TIMEOUT3_AHB_CBCR_ADDR=0x149014
&HWIO_GCC_SNOC_CNOC_AHB_CBCR_ADDR=0x104018
&HWIO_GCC_SPDM_BIMC_CY_CBCR_ADDR=0x140010
&HWIO_GCC_SPDM_CFG_AHB_CBCR_ADDR=0x140004
&HWIO_GCC_SPDM_DEBUG_CY_CBCR_ADDR=0x140018
&HWIO_GCC_SPDM_FF_CBCR_ADDR=0x14000c
&HWIO_GCC_SPDM_MSTR_AHB_CBCR_ADDR=0x140008
&HWIO_GCC_SPDM_PNOC_CY_CBCR_ADDR=0x14001c
&HWIO_GCC_SPDM_RPM_CY_CBCR_ADDR=0x140020
&HWIO_GCC_SPDM_SNOC_CY_CBCR_ADDR=0x140014
&HWIO_GCC_SPMI_AHB_CBCR_ADDR=0x13f00c
&HWIO_GCC_SPMI_CNOC_AHB_CBCR_ADDR=0x13f008
&HWIO_GCC_SPMI_SER_CBCR_ADDR=0x13f004
&HWIO_GCC_SPSS_CFG_AHB_CBCR_ADDR=0x172008
&HWIO_GCC_SPSS_SCSR_CBCR_ADDR=0x17200c
&HWIO_GCC_SPSS_SEC_CTRL_CBCR_ADDR=0x172010
&HWIO_GCC_SPSS_SNOC_EMM_CBCR_ADDR=0x172004
&HWIO_GCC_SPSS_TRIG_CBCR_ADDR=0x172018
&HWIO_GCC_SPSS_XO_CBCR_ADDR=0x172014
&HWIO_GCC_SRAM_SENSOR_XO_CBCR_ADDR=0x12d004
&HWIO_GCC_SSC_APB_CBCR_ADDR=0x16301c
&HWIO_GCC_SSC_AT_CBCR_ADDR=0x163014
&HWIO_GCC_SSC_CNOC_AHBS_CBCR_ADDR=0x16300c
&HWIO_GCC_SSC_CNOC_MPU_CBCR_ADDR=0x163010
&HWIO_GCC_SSC_SNOC_AHBM_CBCR_ADDR=0x163004
&HWIO_GCC_SSC_XO_CBCR_ADDR=0x163018
&HWIO_GCC_SYS_NOC_AT_CBCR_ADDR=0x10401c
&HWIO_GCC_SYS_NOC_AXI_CBCR_ADDR=0x104004
&HWIO_GCC_SYS_NOC_DCD_XO_CBCR_ADDR=0x10403c
&HWIO_GCC_SYS_NOC_EAST_AXI_CBCR_ADDR=0x10400c
&HWIO_GCC_SYS_NOC_HMSS_AHB_CBCR_ADDR=0x104014
&HWIO_GCC_SYS_NOC_HS_AXI_CBCR_ADDR=0x10402c
&HWIO_GCC_SYS_NOC_PIMEM_AXI_CBCR_ADDR=0x10a024
&HWIO_GCC_SYS_NOC_QDSS_STM_AXI_CBCR_ADDR=0x104010
&HWIO_GCC_SYS_NOC_SSC_Q6_AXI_CBCR_ADDR=0x163008
&HWIO_GCC_SYS_NOC_WEST_AXI_CBCR_ADDR=0x104008
&HWIO_GCC_TCSR_AHB_CBCR_ADDR=0x137004
&HWIO_GCC_TIC_CFG_AHB_CBCR_ADDR=0x110000
&HWIO_GCC_TLMM_CBCR_ADDR=0x13a010
&HWIO_GCC_TLMM_EAST_AHB_CBCR_ADDR=0x13a00c
&HWIO_GCC_TLMM_NORTH_AHB_CBCR_ADDR=0x13a004
&HWIO_GCC_TLMM_WEST_AHB_CBCR_ADDR=0x13a008
&HWIO_GCC_TSIF_AHB_CBCR_ADDR=0x136004
&HWIO_GCC_TSIF_INACTIVITY_TIMERS_CBCR_ADDR=0x13600c
&HWIO_GCC_TSIF_REF_CBCR_ADDR=0x136008
&HWIO_GCC_UFS_AHB_CBCR_ADDR=0x17500c
&HWIO_GCC_UFS_AXI_CBCR_ADDR=0x175008
&HWIO_GCC_UFS_ICE_CORE_CBCR_ADDR=0x17600c
&HWIO_GCC_UFS_PHY_AUX_CBCR_ADDR=0x176040
&HWIO_GCC_UFS_RX_SYMBOL_0_CBCR_ADDR=0x175014
&HWIO_GCC_UFS_RX_SYMBOL_1_CBCR_ADDR=0x17605c
&HWIO_GCC_UFS_TX_SYMBOL_0_CBCR_ADDR=0x175010
&HWIO_GCC_UFS_UNIPRO_CORE_CBCR_ADDR=0x176008
&HWIO_GCC_USB30_MASTER_CBCR_ADDR=0x10f008
&HWIO_GCC_USB30_MOCK_UTMI_CBCR_ADDR=0x10f010
&HWIO_GCC_USB30_SLEEP_CBCR_ADDR=0x10f00c
&HWIO_GCC_USB3_PHY_AUX_CBCR_ADDR=0x150000
&HWIO_GCC_USB3_PHY_PIPE_CBCR_ADDR=0x150004
&HWIO_GCC_USB_PHY_CFG_AHB2PHY_CBCR_ADDR=0x16a004
&HWIO_GCC_VDDA_VS_CBCR_ADDR=0x17a00c
&HWIO_GCC_VDDCX_VS_CBCR_ADDR=0x17a004
&HWIO_GCC_VDDMX_VS_CBCR_ADDR=0x17a008
&HWIO_GCC_VS_CTRL_CBCR_ADDR=0x17a010
&HWIO_GCC_WCSS_AHB_S0_CBCR_ADDR=0x111004
&HWIO_GCC_WCSS_APB_CBCR_ADDR=0x11101c
&HWIO_GCC_WCSS_AT_CBCR_ADDR=0x111014
&HWIO_GCC_WCSS_AXI_M_CBCR_ADDR=0x111008
&HWIO_GCC_WCSS_ECAHB_CBCR_ADDR=0x11100c
&HWIO_GCC_WCSS_SHDREG_AHB_CBCR_ADDR=0x111010
&HWIO_GCC_WCSS_TSCTR_DIV2_CBCR_ADDR=0x111018
&HWIO_GCC_WEST_APB_CBCR_ADDR=0x10c048
&HWIO_GCC_WEST_AT_CBCR_ADDR=0x10c010
&HWIO_GCC_GCC_XO_CBCR_ADDR=0x143004
&HWIO_GCC_GCC_XO_DIV4_CBCR_ADDR=0x143008

;MSS clock registers
&HWIO_MSS_AXI_MNOC_CBCR_ADDR=0x41a9118
&HWIO_MSS_AXI_NAV_CBCR_ADDR=0x41aa0bc
&HWIO_MSS_AXI_NAV_SAMPLE_CBCR_ADDR=0x41aa0c0
&HWIO_MSS_BIT_COXM_CBCR_ADDR=0x41aa0ec
&HWIO_MSS_BUS_COXM_CBCR_ADDR=0x41aa0e8
&HWIO_MSS_BUS_CRYPTO_CBCR_ADDR=0x41aa0c8
&HWIO_MSS_BUS_MGPI_CBCR_ADDR=0x41aa100
&HWIO_MSS_BUS_NAV_CBCR_ADDR=0x41aa0b8
&HWIO_MSS_BUS_RBCPR_CBCR_ADDR=0x41aa0f8
&HWIO_MSS_BUS_RFC_CBCR_ADDR=0x41aa11c
&HWIO_MSS_BUS_SLAVE_TIMEOUT_CBCR_ADDR=0x41aa104
&HWIO_MSS_BUS_STMR_CBCR_ADDR=0x41aa10c
&HWIO_MSS_BUS_UIM0_CBCR_ADDR=0x41aa04c
&HWIO_MSS_BUS_UIM1_CBCR_ADDR=0x41aa06c
&HWIO_MSS_BUS_UIM2_CBCR_ADDR=0x41aa08c
&HWIO_MSS_BUS_UIM3_CBCR_ADDR=0x41aa0ac
&HWIO_MSS_CARD_SRC_UIM0_CBCR_ADDR=0x41aa044
&HWIO_MSS_CARD_SRC_UIM1_CBCR_ADDR=0x41aa064
&HWIO_MSS_CARD_SRC_UIM2_CBCR_ADDR=0x41aa084
&HWIO_MSS_CARD_SRC_UIM3_CBCR_ADDR=0x41aa0a4
&HWIO_MSS_RBCPR_REF_CBCR_ADDR=0x41aa0fc
&HWIO_MSS_UART_BIT_UIM0_CBCR_ADDR=0x41aa048
&HWIO_MSS_UART_BIT_UIM1_CBCR_ADDR=0x41aa068
&HWIO_MSS_UART_BIT_UIM2_CBCR_ADDR=0x41aa088
&HWIO_MSS_UART_BIT_UIM3_CBCR_ADDR=0x41aa0a8
&HWIO_MSS_XO_MDM_CBCR_ADDR=0x41a911c
&HWIO_MSS_XO_NAV_CBCR_ADDR=0x41aa0c4

;NAV clock registers

;WCSS clock registers
&HWIO_WCSS_HM_A_WCSS_CLK_CTL_PHY1_11AC_RADIO_ADC_0_CBCR_ADDR=0x189d6060
&HWIO_WCSS_HM_A_WCSS_CLK_CTL_PHY1_11AC_RADIO_ADC_1_CBCR_ADDR=0x189d6064
&HWIO_WCSS_HM_A_WCSS_CLK_CTL_PHY2_11AC_RADIO_ADC_0_CBCR_ADDR=0x189d6068
&HWIO_WCSS_HM_A_WCSS_CLK_CTL_PHY2_11AC_RADIO_ADC_1_CBCR_ADDR=0x189d606c
&HWIO_WCSS_HM_A_WCSS_CLK_CTL_WCSS_AHB_TSLV_CBCR_ADDR=0x189d1028
&HWIO_WCSS_HM_A_WCSS_CLK_CTL_WCSS_CSS_APB_CBCR_ADDR=0x189d1014
&HWIO_WCSS_HM_A_WCSS_CLK_CTL_WCSS_CSS_NOC_CBCR_ADDR=0x189d1008
&HWIO_WCSS_HM_A_WCSS_CLK_CTL_WCSS_CSS_PHY1_T240_CBCR_ADDR=0x189d1044
&HWIO_WCSS_HM_A_WCSS_CLK_CTL_WCSS_CSS_PHY2_T240_CBCR_ADDR=0x189d1048
&HWIO_WCSS_HM_A_WCSS_CLK_CTL_WCSS_CSS_WSI_CBCR_ADDR=0x189d6034
&HWIO_WCSS_HM_A_WCSS_CLK_CTL_WCSS_DAC_SM_CBCR_ADDR=0x189d604c
&HWIO_WCSS_HM_A_WCSS_CLK_CTL_WCSS_DBG_APB_CBCR_ADDR=0x189d2014
&HWIO_WCSS_HM_A_WCSS_CLK_CTL_WCSS_DBG_ATB_CBCR_ADDR=0x189d2010
&HWIO_WCSS_HM_A_WCSS_CLK_CTL_WCSS_DBG_CSS_APB_CBCR_ADDR=0x189d103c
&HWIO_WCSS_HM_A_WCSS_CLK_CTL_WCSS_DBG_CSS_ATB_CBCR_ADDR=0x189d1038
&HWIO_WCSS_HM_A_WCSS_CLK_CTL_WCSS_DBG_CSS_TS_CBCR_ADDR=0x189d1040
&HWIO_WCSS_HM_A_WCSS_CLK_CTL_WCSS_DBG_TS_CBCR_ADDR=0x189d2018
&HWIO_WCSS_HM_A_WCSS_CLK_CTL_WCSS_DEBUG_CBCR_ADDR=0x189d60f4
&HWIO_WCSS_HM_A_WCSS_CLK_CTL_WCSS_PHY1_160_CBCR_ADDR=0x189d3048
&HWIO_WCSS_HM_A_WCSS_CLK_CTL_WCSS_PHY1_20_CBCR_ADDR=0x189d3060
&HWIO_WCSS_HM_A_WCSS_CLK_CTL_WCSS_PHY1_30_CBCR_ADDR=0x189d3078
&HWIO_WCSS_HM_A_WCSS_CLK_CTL_WCSS_PHY1_320_CBCR_ADDR=0x189d301c
&HWIO_WCSS_HM_A_WCSS_CLK_CTL_WCSS_PHY1_40_CBCR_ADDR=0x189d3058
&HWIO_WCSS_HM_A_WCSS_CLK_CTL_WCSS_PHY1_80_CBCR_ADDR=0x189d3050
&HWIO_WCSS_HM_A_WCSS_CLK_CTL_WCSS_PHY1_APB_CBCR_ADDR=0x189d1020
&HWIO_WCSS_HM_A_WCSS_CLK_CTL_WCSS_PHY1_BW_CBCR_ADDR=0x189d3024
&HWIO_WCSS_HM_A_WCSS_CLK_CTL_WCSS_PHY1_BWX2_CBCR_ADDR=0x189d302c
&HWIO_WCSS_HM_A_WCSS_CLK_CTL_WCSS_PHY1_CBCR_ADDR=0x189d3040
&HWIO_WCSS_HM_A_WCSS_CLK_CTL_WCSS_PHY1_DFS_CBCR_ADDR=0x189d3038
&HWIO_WCSS_HM_A_WCSS_CLK_CTL_WCSS_PHY1_T240_CBCR_ADDR=0x189d3074
&HWIO_WCSS_HM_A_WCSS_CLK_CTL_WCSS_PHY1_TADC_CBCR_ADDR=0x189d3070
&HWIO_WCSS_HM_A_WCSS_CLK_CTL_WCSS_PHY1_TDAC_CBCR_ADDR=0x189d3068
&HWIO_WCSS_HM_A_WCSS_CLK_CTL_WCSS_PHY1_X2_CBCR_ADDR=0x189d3030
&HWIO_WCSS_HM_A_WCSS_CLK_CTL_WCSS_PHY2_160_CBCR_ADDR=0x189d4048
&HWIO_WCSS_HM_A_WCSS_CLK_CTL_WCSS_PHY2_20_CBCR_ADDR=0x189d4060
&HWIO_WCSS_HM_A_WCSS_CLK_CTL_WCSS_PHY2_30_CBCR_ADDR=0x189d4080
&HWIO_WCSS_HM_A_WCSS_CLK_CTL_WCSS_PHY2_320_CBCR_ADDR=0x189d401c
&HWIO_WCSS_HM_A_WCSS_CLK_CTL_WCSS_PHY2_40_CBCR_ADDR=0x189d4058
&HWIO_WCSS_HM_A_WCSS_CLK_CTL_WCSS_PHY2_80_CBCR_ADDR=0x189d4050
&HWIO_WCSS_HM_A_WCSS_CLK_CTL_WCSS_PHY2_APB_CBCR_ADDR=0x189d1024
&HWIO_WCSS_HM_A_WCSS_CLK_CTL_WCSS_PHY2_BW_CBCR_ADDR=0x189d4024
&HWIO_WCSS_HM_A_WCSS_CLK_CTL_WCSS_PHY2_BWX2_CBCR_ADDR=0x189d402c
&HWIO_WCSS_HM_A_WCSS_CLK_CTL_WCSS_PHY2_CBCR_ADDR=0x189d4040
&HWIO_WCSS_HM_A_WCSS_CLK_CTL_WCSS_PHY2_DFS_CBCR_ADDR=0x189d4038
&HWIO_WCSS_HM_A_WCSS_CLK_CTL_WCSS_PHY2_T240_CBCR_ADDR=0x189d4078
&HWIO_WCSS_HM_A_WCSS_CLK_CTL_WCSS_PHY2_TADC_CBCR_ADDR=0x189d4070
&HWIO_WCSS_HM_A_WCSS_CLK_CTL_WCSS_PHY2_TDAC_CBCR_ADDR=0x189d4068
&HWIO_WCSS_HM_A_WCSS_CLK_CTL_WCSS_PHY2_X2_CBCR_ADDR=0x189d4030
&HWIO_WCSS_HM_A_WCSS_CLK_CTL_WCSS_RFACTRL_APB_CBCR_ADDR=0x189d60cc
&HWIO_WCSS_HM_A_WCSS_CLK_CTL_WCSS_RFACTRL_CBCR_ADDR=0x189d60e0
&HWIO_WCSS_HM_A_WCSS_CLK_CTL_WCSS_RFACTRL_DAC_APB_CBCR_ADDR=0x189d60e4
&MACRO_TOO_LONG_4=0x189d60d8
&MACRO_TOO_LONG_5=0x189d60dc
&HWIO_WCSS_HM_A_WCSS_CLK_CTL_WCSS_RFACTRL_PHY1_80_CBCR_ADDR=0x189d60d0
&HWIO_WCSS_HM_A_WCSS_CLK_CTL_WCSS_RFACTRL_PHY2_80_CBCR_ADDR=0x189d60d4
&HWIO_WCSS_HM_A_WCSS_CLK_CTL_WCSS_TOP_AHB_CBCR_ADDR=0x189d1010
&HWIO_WCSS_HM_A_WCSS_CLK_CTL_WCSS_TOP_AXI_CBCR_ADDR=0x189d100c
&HWIO_WCSS_HM_A_WCSS_CLK_CTL_WCSS_TOP_DAC_APB_CBCR_ADDR=0x189d605c
&HWIO_WCSS_HM_A_WCSS_CLK_CTL_WCSS_TOP_REF_CBCR_ADDR=0x189d6024
&HWIO_WCSS_HM_A_WCSS_CLK_CTL_WCSS_TOP_SLP_CBCR_ADDR=0x189d600c
&HWIO_WCSS_HM_A_WCSS_CLK_CTL_WCSS_WCSSDBG_CFG_APB_CBCR_ADDR=0x189d2008
&HWIO_WCSS_HM_A_WCSS_CLK_CTL_WCSS_WCSSDBG_TRC_CBCR_ADDR=0x189d200c
&HWIO_WCSS_HM_A_WCSS_CLK_CTL_WCSS_WMAC1_APB_CBCR_ADDR=0x189d1018
&HWIO_WCSS_HM_A_WCSS_CLK_CTL_WCSS_WMAC1_CSS_MAC_CBCR_ADDR=0x189d3008
&HWIO_WCSS_HM_A_WCSS_CLK_CTL_WCSS_WMAC1_MAC_CBCR_ADDR=0x189d300c
&HWIO_WCSS_HM_A_WCSS_CLK_CTL_WCSS_WMAC2_APB_CBCR_ADDR=0x189d101c
&HWIO_WCSS_HM_A_WCSS_CLK_CTL_WCSS_WMAC2_CSS_MAC_CBCR_ADDR=0x189d4008
&HWIO_WCSS_HM_A_WCSS_CLK_CTL_WCSS_WMAC2_MAC_CBCR_ADDR=0x189d400c

; CMD and CFG RCGRs for clocks with configurable frequencies
&HWIO_GCC_ACC_CMD_RCGR_ADDR=0x13e000
&HWIO_GCC_ACC_CFG_RCGR_ADDR=0x13e004
&HWIO_GCC_APC0_VS_CMD_RCGR_ADDR=0x17a0a4
&HWIO_GCC_APC0_VS_CFG_RCGR_ADDR=0x17a0a8
&HWIO_GCC_APC1_VS_CMD_RCGR_ADDR=0x17a0bc
&HWIO_GCC_APC1_VS_CFG_RCGR_ADDR=0x17a0c0
&HWIO_GCC_BIMC_DDR_XO_CMD_RCGR_ADDR=0x145000
&HWIO_GCC_BIMC_DDR_XO_CFG_RCGR_ADDR=0x145004
&HWIO_GCC_BLSP1_QUP1_I2C_APPS_CMD_RCGR_ADDR=0x119020
&HWIO_GCC_BLSP1_QUP1_I2C_APPS_CFG_RCGR_ADDR=0x119024
&HWIO_GCC_BLSP1_QUP1_SPI_APPS_CMD_RCGR_ADDR=0x11900c
&HWIO_GCC_BLSP1_QUP1_SPI_APPS_CFG_RCGR_ADDR=0x119010
&HWIO_GCC_BLSP1_QUP2_I2C_APPS_CMD_RCGR_ADDR=0x11b020
&HWIO_GCC_BLSP1_QUP2_I2C_APPS_CFG_RCGR_ADDR=0x11b024
&HWIO_GCC_BLSP1_QUP2_SPI_APPS_CMD_RCGR_ADDR=0x11b00c
&HWIO_GCC_BLSP1_QUP2_SPI_APPS_CFG_RCGR_ADDR=0x11b010
&HWIO_GCC_BLSP1_QUP3_I2C_APPS_CMD_RCGR_ADDR=0x11d020
&HWIO_GCC_BLSP1_QUP3_I2C_APPS_CFG_RCGR_ADDR=0x11d024
&HWIO_GCC_BLSP1_QUP3_SPI_APPS_CMD_RCGR_ADDR=0x11d00c
&HWIO_GCC_BLSP1_QUP3_SPI_APPS_CFG_RCGR_ADDR=0x11d010
&HWIO_GCC_BLSP1_QUP4_I2C_APPS_CMD_RCGR_ADDR=0x11f020
&HWIO_GCC_BLSP1_QUP4_I2C_APPS_CFG_RCGR_ADDR=0x11f024
&HWIO_GCC_BLSP1_QUP4_SPI_APPS_CMD_RCGR_ADDR=0x11f00c
&HWIO_GCC_BLSP1_QUP4_SPI_APPS_CFG_RCGR_ADDR=0x11f010
&HWIO_GCC_BLSP1_QUP5_I2C_APPS_CMD_RCGR_ADDR=0x121020
&HWIO_GCC_BLSP1_QUP5_I2C_APPS_CFG_RCGR_ADDR=0x121024
&HWIO_GCC_BLSP1_QUP5_SPI_APPS_CMD_RCGR_ADDR=0x12100c
&HWIO_GCC_BLSP1_QUP5_SPI_APPS_CFG_RCGR_ADDR=0x121010
&HWIO_GCC_BLSP1_QUP6_I2C_APPS_CMD_RCGR_ADDR=0x123020
&HWIO_GCC_BLSP1_QUP6_I2C_APPS_CFG_RCGR_ADDR=0x123024
&HWIO_GCC_BLSP1_QUP6_SPI_APPS_CMD_RCGR_ADDR=0x12300c
&HWIO_GCC_BLSP1_QUP6_SPI_APPS_CFG_RCGR_ADDR=0x123010
&HWIO_GCC_BLSP1_UART1_APPS_CMD_RCGR_ADDR=0x11a00c
&HWIO_GCC_BLSP1_UART1_APPS_CFG_RCGR_ADDR=0x11a010
&HWIO_GCC_BLSP1_UART2_APPS_CMD_RCGR_ADDR=0x11c00c
&HWIO_GCC_BLSP1_UART2_APPS_CFG_RCGR_ADDR=0x11c010
&HWIO_GCC_BLSP1_UART3_APPS_CMD_RCGR_ADDR=0x11e00c
&HWIO_GCC_BLSP1_UART3_APPS_CFG_RCGR_ADDR=0x11e010
&HWIO_GCC_BLSP2_QUP1_I2C_APPS_CMD_RCGR_ADDR=0x126020
&HWIO_GCC_BLSP2_QUP1_I2C_APPS_CFG_RCGR_ADDR=0x126024
&HWIO_GCC_BLSP2_QUP1_SPI_APPS_CMD_RCGR_ADDR=0x12600c
&HWIO_GCC_BLSP2_QUP1_SPI_APPS_CFG_RCGR_ADDR=0x126010
&HWIO_GCC_BLSP2_QUP2_I2C_APPS_CMD_RCGR_ADDR=0x128020
&HWIO_GCC_BLSP2_QUP2_I2C_APPS_CFG_RCGR_ADDR=0x128024
&HWIO_GCC_BLSP2_QUP2_SPI_APPS_CMD_RCGR_ADDR=0x12800c
&HWIO_GCC_BLSP2_QUP2_SPI_APPS_CFG_RCGR_ADDR=0x128010
&HWIO_GCC_BLSP2_QUP3_I2C_APPS_CMD_RCGR_ADDR=0x12a020
&HWIO_GCC_BLSP2_QUP3_I2C_APPS_CFG_RCGR_ADDR=0x12a024
&HWIO_GCC_BLSP2_QUP3_SPI_APPS_CMD_RCGR_ADDR=0x12a00c
&HWIO_GCC_BLSP2_QUP3_SPI_APPS_CFG_RCGR_ADDR=0x12a010
&HWIO_GCC_BLSP2_QUP4_I2C_APPS_CMD_RCGR_ADDR=0x12c020
&HWIO_GCC_BLSP2_QUP4_I2C_APPS_CFG_RCGR_ADDR=0x12c024
&HWIO_GCC_BLSP2_QUP4_SPI_APPS_CMD_RCGR_ADDR=0x12c00c
&HWIO_GCC_BLSP2_QUP4_SPI_APPS_CFG_RCGR_ADDR=0x12c010
&HWIO_GCC_BLSP2_QUP5_I2C_APPS_CMD_RCGR_ADDR=0x12e020
&HWIO_GCC_BLSP2_QUP5_I2C_APPS_CFG_RCGR_ADDR=0x12e024
&HWIO_GCC_BLSP2_QUP5_SPI_APPS_CMD_RCGR_ADDR=0x12e00c
&HWIO_GCC_BLSP2_QUP5_SPI_APPS_CFG_RCGR_ADDR=0x12e010
&HWIO_GCC_BLSP2_QUP6_I2C_APPS_CMD_RCGR_ADDR=0x130020
&HWIO_GCC_BLSP2_QUP6_I2C_APPS_CFG_RCGR_ADDR=0x130024
&HWIO_GCC_BLSP2_QUP6_SPI_APPS_CMD_RCGR_ADDR=0x13000c
&HWIO_GCC_BLSP2_QUP6_SPI_APPS_CFG_RCGR_ADDR=0x130010
&HWIO_GCC_BLSP2_UART1_APPS_CMD_RCGR_ADDR=0x12700c
&HWIO_GCC_BLSP2_UART1_APPS_CFG_RCGR_ADDR=0x127010
&HWIO_GCC_BLSP2_UART2_APPS_CMD_RCGR_ADDR=0x12900c
&HWIO_GCC_BLSP2_UART2_APPS_CFG_RCGR_ADDR=0x129010
&HWIO_GCC_BLSP2_UART3_APPS_CMD_RCGR_ADDR=0x12b00c
&HWIO_GCC_BLSP2_UART3_APPS_CFG_RCGR_ADDR=0x12b010
&HWIO_GCC_BLSP_UART_SIM_CMD_RCGR_ADDR=0x118000
&HWIO_GCC_BLSP_UART_SIM_CFG_RCGR_ADDR=0x118004
&HWIO_GCC_CE1_CMD_RCGR_ADDR=0x141010
&HWIO_GCC_CE1_CFG_RCGR_ADDR=0x141014
&HWIO_GCC_CNOC_PERIPH_CMD_RCGR_ADDR=0x105050
&HWIO_GCC_CNOC_PERIPH_CFG_RCGR_ADDR=0x105054
&HWIO_GCC_CONFIG_NOC_CMD_RCGR_ADDR=0x105038
&HWIO_GCC_CONFIG_NOC_CFG_RCGR_ADDR=0x10503c
&HWIO_GCC_GCC_XO_CMD_RCGR_ADDR=0x14302c
&HWIO_GCC_GCC_XO_CFG_RCGR_ADDR=0x143030
&HWIO_GCC_GP1_CMD_RCGR_ADDR=0x164004
&HWIO_GCC_GP1_CFG_RCGR_ADDR=0x164008
&HWIO_GCC_GP2_CMD_RCGR_ADDR=0x165004
&HWIO_GCC_GP2_CFG_RCGR_ADDR=0x165008
&HWIO_GCC_GP3_CMD_RCGR_ADDR=0x166004
&HWIO_GCC_GP3_CFG_RCGR_ADDR=0x166008
&HWIO_GCC_GPU_VS_CMD_RCGR_ADDR=0x17a08c
&HWIO_GCC_GPU_VS_CFG_RCGR_ADDR=0x17a090
&HWIO_GCC_HMSS_AHB_CMD_RCGR_ADDR=0x148014
&HWIO_GCC_HMSS_AHB_CFG_RCGR_ADDR=0x148018
&HWIO_GCC_HMSS_RBCPR_CMD_RCGR_ADDR=0x148044
&HWIO_GCC_HMSS_RBCPR_CFG_RCGR_ADDR=0x148048
&HWIO_GCC_MSS_VS_CMD_RCGR_ADDR=0x17a074
&HWIO_GCC_MSS_VS_CFG_RCGR_ADDR=0x17a078
&HWIO_GCC_PCIE_AUX_CMD_RCGR_ADDR=0x16c000
&HWIO_GCC_PCIE_AUX_CFG_RCGR_ADDR=0x16c004
&HWIO_GCC_PDM2_CMD_RCGR_ADDR=0x133010
&HWIO_GCC_PDM2_CFG_RCGR_ADDR=0x133014
&HWIO_GCC_PIMEM_AXI_CMD_RCGR_ADDR=0x10a008
&HWIO_GCC_PIMEM_AXI_CFG_RCGR_ADDR=0x10a00c
&HWIO_GCC_QDSS_APB_TRIG_CMD_RCGR_ADDR=0x10e030
&HWIO_GCC_QDSS_APB_TRIG_CFG_RCGR_ADDR=0x10e034
&HWIO_GCC_QDSS_ATB_A_CMD_RCGR_ADDR=0x10d000
&HWIO_GCC_QDSS_ATB_A_CFG_RCGR_ADDR=0x10d004
&HWIO_GCC_QDSS_STM_CMD_RCGR_ADDR=0x10d048
&HWIO_GCC_QDSS_STM_CFG_RCGR_ADDR=0x10d04c
&HWIO_GCC_QDSS_TRACECLKIN_CMD_RCGR_ADDR=0x10e000
&HWIO_GCC_QDSS_TRACECLKIN_CFG_RCGR_ADDR=0x10e004
&HWIO_GCC_QDSS_TSCTR_CMD_RCGR_ADDR=0x10e018
&HWIO_GCC_QDSS_TSCTR_CFG_RCGR_ADDR=0x10e01c
&HWIO_GCC_RBCPR_CX_CMD_RCGR_ADDR=0x14e00c
&HWIO_GCC_RBCPR_CX_CFG_RCGR_ADDR=0x14e010
&HWIO_GCC_RBCPR_MX_CMD_RCGR_ADDR=0x14f00c
&HWIO_GCC_RBCPR_MX_CFG_RCGR_ADDR=0x14f010
&HWIO_GCC_RPM_CMD_RCGR_ADDR=0x13c018
&HWIO_GCC_RPM_CFG_RCGR_ADDR=0x13c01c
&HWIO_GCC_SDCC2_APPS_CMD_RCGR_ADDR=0x114010
&HWIO_GCC_SDCC2_APPS_CFG_RCGR_ADDR=0x114014
&HWIO_GCC_SDCC4_APPS_CMD_RCGR_ADDR=0x116010
&HWIO_GCC_SDCC4_APPS_CFG_RCGR_ADDR=0x116014
&HWIO_GCC_SPMI_AHB_CMD_RCGR_ADDR=0x13f028
&HWIO_GCC_SPMI_AHB_CFG_RCGR_ADDR=0x13f02c
&HWIO_GCC_SPMI_SER_CMD_RCGR_ADDR=0x13f010
&HWIO_GCC_SPMI_SER_CFG_RCGR_ADDR=0x13f014
&HWIO_GCC_SYS_NOC_HS_AXI_CMD_RCGR_ADDR=0x104040
&HWIO_GCC_SYS_NOC_HS_AXI_CFG_RCGR_ADDR=0x104044
&HWIO_GCC_SYSTEM_NOC_CMD_RCGR_ADDR=0x104020
&HWIO_GCC_SYSTEM_NOC_CFG_RCGR_ADDR=0x104024
&HWIO_GCC_TSIF_REF_CMD_RCGR_ADDR=0x136010
&HWIO_GCC_TSIF_REF_CFG_RCGR_ADDR=0x136014
&HWIO_GCC_UFS_AXI_CMD_RCGR_ADDR=0x175018
&HWIO_GCC_UFS_AXI_CFG_RCGR_ADDR=0x17501c
&HWIO_GCC_USB30_MASTER_CMD_RCGR_ADDR=0x10f014
&HWIO_GCC_USB30_MASTER_CFG_RCGR_ADDR=0x10f018
&HWIO_GCC_USB30_MOCK_UTMI_CMD_RCGR_ADDR=0x10f028
&HWIO_GCC_USB30_MOCK_UTMI_CFG_RCGR_ADDR=0x10f02c
&HWIO_GCC_USB3_PHY_AUX_CMD_RCGR_ADDR=0x15000c
&HWIO_GCC_USB3_PHY_AUX_CFG_RCGR_ADDR=0x150010
&HWIO_GCC_VDDA_VS_CMD_RCGR_ADDR=0x17a044
&HWIO_GCC_VDDA_VS_CFG_RCGR_ADDR=0x17a048
&HWIO_GCC_VDDCX_VS_CMD_RCGR_ADDR=0x17a014
&HWIO_GCC_VDDCX_VS_CFG_RCGR_ADDR=0x17a018
&HWIO_GCC_VDDMX_VS_CMD_RCGR_ADDR=0x17a02c
&HWIO_GCC_VDDMX_VS_CFG_RCGR_ADDR=0x17a030
&HWIO_GCC_VS_CTRL_CMD_RCGR_ADDR=0x17a05c
&HWIO_GCC_VS_CTRL_CFG_RCGR_ADDR=0x17a060
&HWIO_WCSS_HM_A_WCSS_CLK_CTL_DBG_ATB_CMD_RCGR_ADDR=0x189d201c
&HWIO_WCSS_HM_A_WCSS_CLK_CTL_DBG_ATB_CFG_RCGR_ADDR=0x189d2020
&HWIO_WCSS_HM_A_WCSS_CLK_CTL_NOC_CMD_RCGR_ADDR=0x189d1030
&HWIO_WCSS_HM_A_WCSS_CLK_CTL_NOC_CFG_RCGR_ADDR=0x189d1034
&HWIO_WCSS_HM_A_WCSS_CLK_CTL_PHY1_CMD_RCGR_ADDR=0x189d307c
&HWIO_WCSS_HM_A_WCSS_CLK_CTL_PHY1_CFG_RCGR_ADDR=0x189d3080
&HWIO_WCSS_HM_A_WCSS_CLK_CTL_PHY2_CMD_RCGR_ADDR=0x189d4084
&HWIO_WCSS_HM_A_WCSS_CLK_CTL_PHY2_CFG_RCGR_ADDR=0x189d4088
&HWIO_WCSS_HM_A_WCSS_CLK_CTL_REF_CMD_RCGR_ADDR=0x189d602c
&HWIO_WCSS_HM_A_WCSS_CLK_CTL_REF_CFG_RCGR_ADDR=0x189d6030
&HWIO_WCSS_HM_A_WCSS_CLK_CTL_RFACTRL_CMD_RCGR_ADDR=0x189d60e8
&HWIO_WCSS_HM_A_WCSS_CLK_CTL_RFACTRL_CFG_RCGR_ADDR=0x189d60ec
&HWIO_WCSS_HM_A_WCSS_CLK_CTL_SLP_CMD_RCGR_ADDR=0x189d6014
&HWIO_WCSS_HM_A_WCSS_CLK_CTL_SLP_CFG_RCGR_ADDR=0x189d6018
&HWIO_WCSS_HM_A_WCSS_CLK_CTL_WMAC1_CMD_RCGR_ADDR=0x189d3014
&HWIO_WCSS_HM_A_WCSS_CLK_CTL_WMAC1_CFG_RCGR_ADDR=0x189d3018
&HWIO_WCSS_HM_A_WCSS_CLK_CTL_WMAC2_CMD_RCGR_ADDR=0x189d4014
&HWIO_WCSS_HM_A_WCSS_CLK_CTL_WMAC2_CFG_RCGR_ADDR=0x189d4018
&HWIO_WCSS_HM_A_WCSS_CLK_CTL_WSI_CMD_RCGR_ADDR=0x189d603c
&HWIO_WCSS_HM_A_WCSS_CLK_CTL_WSI_CFG_RCGR_ADDR=0x189d6040

; Utility registers
&HWIO_GCC_GCC_XO_DIV4_CBCR_ADDR=0x143008
&HWIO_GCC_PLLTEST_PAD_CFG_ADDR=0x16200c
&HWIO_GCC_CLOCK_FRQ_MEASURE_STATUS_ADDR=0x162008
&HWIO_GCC_CLOCK_FRQ_MEASURE_CTL_ADDR=0x162004
&HWIO_GCC_GCC_DEBUG_CLK_CTL_ADDR=0x162000
; Vote registers
v.new int[2] \vote_regs
v.a \vote_regs[0]=0x157004
v.a \vote_regs[1]=0x157008

; Constants for setting clock frequencies
&HAL_CLK_CMD_CFG_UPDATE_FMSK=0x1
&HAL_CLK_CFG_CGR_SRC_SEL_SHFT=0x8
&HAL_CLK_CFG_CGR_SRC_DIV_SHFT=0x0
&HAL_CLK_CFG_CGR_SRC_SEL_FMSK=0x700
&HAL_CLK_CFG_CGR_SRC_DIV_FMSK=0x1f
&HAL_CLK_CFG_CGR_MODE_FMSK=0x3000
&HAL_CLK_CFG_CFG_DUAL_EDGE_MODE_VAL=0x2
&HAL_CLK_CFG_CGR_MODE_SHFT=0xc
&HAL_CLK_M_REG_OFFSET=0x8
&HAL_CLK_N_REG_OFFSET=0xc
&HAL_CLK_D_REG_OFFSET=0x10


; Test Masks
&CLK_TEST_TYPE_MASK=(0x00007FFF)
&CLK_TEST_SEL_MASK=(0x000F0000)
&CLK_TEST_SUB_MUX_MASK=(0xF0000000)

; APCS Debug register
&HWIO_APCS_ALIAS0_GLB_CLK_DIAG_ADDR=0x1791101c

; APCS Test Mask
&CLK_APCS_TEST=(0x1<<0x10)

; GCC Debug register
&HWIO_GCC_GCC_DEBUG_CLK_CTL_ADDR=0x162000

; GCC Test Mask
&CLK_GCC_TEST=(0x2<<0x10)

; GPU Debug register
&HWIO_GPUCC_DEBUG_CLK_CTL_ADDR=0x5065120

; GPU Test Mask
&CLK_GPU_TEST=(0x3<<0x10)

; LPASS Debug register
&HWIO_LPASS_DBG_CLK_ADDR=0x17040000

; LPASS Test Mask
&CLK_LPASS_TEST=(0x4<<0x10)

; LPASS_Q6 Debug register
&HWIO_LPASS_QDSP6SS_TEST_CLK_CTL_ADDR=0x17302010

; LPASS_Q6 Test Mask
&CLK_LPASS_Q6_TEST=(0x5<<0x10)

; MMSS Debug register
&HWIO_MMSS_DEBUG_CLK_CTL_ADDR=0xc8c0900

; MMSS Test Mask
&CLK_MMSS_TEST=(0x6<<0x10)

; MSS Debug register
&HWIO_MSS_DEBUG_CLOCK_CTL_ADDR=0x41a8014

; MSS Test Mask
&CLK_MSS_TEST=(0x7<<0x10)

; MSS_Q6 Debug register
&HWIO_MSS_QDSP6SS_TEST_CLK_CTL_ADDR=0x4082010

; MSS_Q6 Test Mask
&CLK_MSS_Q6_TEST=(0x8<<0x10)

; SSC Debug register
&HWIO_SSC_SCC_SCC_DEBUG_CLK_CTL_ADDR=0x5e20048

; SSC Test Mask
&CLK_SSC_TEST=(0x9<<0x10)

; SSC_Q6 Debug register
&HWIO_SSC_QDSP6SS_TEST_CLK_CTL_ADDR=0x5c02010

; SSC_Q6 Test Mask
&CLK_SSC_Q6_TEST=(0xa<<0x10)

; WCSS Debug register
&HWIO_WCSS_HM_A_WCSS_CLK_CTL_WCSS_DEBUG_CLK_ADDR=0x189d6f00

; WCSS Test Mask
&CLK_WCSS_TEST=(0xb<<0x10)


; GCC test clocks
&CLK_TEST_GCC_SEC_CTRL_ACC_CLK=(&CLK_GCC_TEST|0x088)
&CLK_TEST_GCC_APC0_VS_CLK=(&CLK_GCC_TEST|0x101)
&CLK_TEST_GCC_APC1_VS_CLK=(&CLK_GCC_TEST|0x102)
&CLK_TEST_GCC_BIMC_CLK=(&CLK_GCC_TEST|0x0A2)
&CLK_TEST_GCC_SPDM_BIMC_CY_CLK=(&CLK_GCC_TEST|0x093)
&CLK_TEST_GCC_BIMC_DDR_CPLL0_CLK=(&CLK_GCC_TEST|0x0A9)
&CLK_TEST_GCC_BIMC_DDR_CPLL1_CLK=(&CLK_GCC_TEST|0x0AA)
&CLK_TEST_GCC_BIMC_DTTS_XO_CLK=(&CLK_GCC_TEST|0x0A7)
&CLK_TEST_GCC_BIMC_XO_CLK=(&CLK_GCC_TEST|0x09E)
&CLK_TEST_GCC_CFG_NOC_DDR_CFG_CLK=(&CLK_GCC_TEST|0x012)
&CLK_TEST_GCC_CNOC_BUS_TIMEOUT5_AHB_CLK=(&CLK_GCC_TEST|0x0CC)
&CLK_TEST_GCC_DDR_DIM_CFG_CLK=(&CLK_GCC_TEST|0x0A8)
&CLK_TEST_GCC_BIMC_HMSS_AXI_CLK=(&CLK_GCC_TEST|0x0BB)
&CLK_TEST_GCC_BLSP1_QUP1_I2C_APPS_CLK=(&CLK_GCC_TEST|0x04D)
&CLK_TEST_GCC_BLSP1_QUP1_SPI_APPS_CLK=(&CLK_GCC_TEST|0x04C)
&CLK_TEST_GCC_BLSP1_QUP2_I2C_APPS_CLK=(&CLK_GCC_TEST|0x051)
&CLK_TEST_GCC_BLSP1_QUP2_SPI_APPS_CLK=(&CLK_GCC_TEST|0x050)
&CLK_TEST_GCC_BLSP1_QUP3_I2C_APPS_CLK=(&CLK_GCC_TEST|0x055)
&CLK_TEST_GCC_BLSP1_QUP3_SPI_APPS_CLK=(&CLK_GCC_TEST|0x054)
&CLK_TEST_GCC_BLSP1_QUP4_I2C_APPS_CLK=(&CLK_GCC_TEST|0x059)
&CLK_TEST_GCC_BLSP1_QUP4_SPI_APPS_CLK=(&CLK_GCC_TEST|0x058)
&CLK_TEST_GCC_BLSP1_QUP5_I2C_APPS_CLK=(&CLK_GCC_TEST|0x05B)
&CLK_TEST_GCC_BLSP1_QUP5_SPI_APPS_CLK=(&CLK_GCC_TEST|0x05A)
&CLK_TEST_GCC_BLSP1_QUP6_I2C_APPS_CLK=(&CLK_GCC_TEST|0x05D)
&CLK_TEST_GCC_BLSP1_QUP6_SPI_APPS_CLK=(&CLK_GCC_TEST|0x05C)
&CLK_TEST_GCC_BLSP1_UART1_APPS_CLK=(&CLK_GCC_TEST|0x04E)
&CLK_TEST_GCC_BLSP1_UART2_APPS_CLK=(&CLK_GCC_TEST|0x052)
&CLK_TEST_GCC_BLSP1_UART3_APPS_CLK=(&CLK_GCC_TEST|0x056)
&CLK_TEST_GCC_BLSP2_QUP1_I2C_APPS_CLK=(&CLK_GCC_TEST|0x061)
&CLK_TEST_GCC_BLSP2_QUP1_SPI_APPS_CLK=(&CLK_GCC_TEST|0x060)
&CLK_TEST_GCC_BLSP2_QUP2_I2C_APPS_CLK=(&CLK_GCC_TEST|0x065)
&CLK_TEST_GCC_BLSP2_QUP2_SPI_APPS_CLK=(&CLK_GCC_TEST|0x064)
&CLK_TEST_GCC_BLSP2_QUP3_I2C_APPS_CLK=(&CLK_GCC_TEST|0x069)
&CLK_TEST_GCC_BLSP2_QUP3_SPI_APPS_CLK=(&CLK_GCC_TEST|0x068)
&CLK_TEST_GCC_BLSP2_QUP4_I2C_APPS_CLK=(&CLK_GCC_TEST|0x06D)
&CLK_TEST_GCC_BLSP2_QUP4_SPI_APPS_CLK=(&CLK_GCC_TEST|0x06C)
&CLK_TEST_GCC_BLSP2_QUP5_I2C_APPS_CLK=(&CLK_GCC_TEST|0x06F)
&CLK_TEST_GCC_BLSP2_QUP5_SPI_APPS_CLK=(&CLK_GCC_TEST|0x06E)
&CLK_TEST_GCC_BLSP2_QUP6_I2C_APPS_CLK=(&CLK_GCC_TEST|0x071)
&CLK_TEST_GCC_BLSP2_QUP6_SPI_APPS_CLK=(&CLK_GCC_TEST|0x070)
&CLK_TEST_GCC_BLSP2_UART1_APPS_CLK=(&CLK_GCC_TEST|0x062)
&CLK_TEST_GCC_BLSP2_UART2_APPS_CLK=(&CLK_GCC_TEST|0x066)
&CLK_TEST_GCC_BLSP2_UART3_APPS_CLK=(&CLK_GCC_TEST|0x06A)
&CLK_TEST_GCC_BLSP1_UART1_SIM_CLK=(&CLK_GCC_TEST|0x04F)
&CLK_TEST_GCC_BLSP1_UART2_SIM_CLK=(&CLK_GCC_TEST|0x053)
&CLK_TEST_GCC_BLSP1_UART3_SIM_CLK=(&CLK_GCC_TEST|0x057)
&CLK_TEST_GCC_BLSP2_UART1_SIM_CLK=(&CLK_GCC_TEST|0x063)
&CLK_TEST_GCC_BLSP2_UART2_SIM_CLK=(&CLK_GCC_TEST|0x067)
&CLK_TEST_GCC_BLSP2_UART3_SIM_CLK=(&CLK_GCC_TEST|0x06B)
&CLK_TEST_GCC_CE1_CLK=(&CLK_GCC_TEST|0x097)
&CLK_TEST_GCC_AGGRE1_CNOC_PERIPH_AHB_CLK=(&CLK_GCC_TEST|0x106)
&CLK_TEST_GCC_AGGRE2_CNOC_PERIPH_AHB_CLK=(&CLK_GCC_TEST|0x118)
&CLK_TEST_GCC_BLSP1_AHB_CLK=(&CLK_GCC_TEST|0x04A)
&CLK_TEST_GCC_BLSP2_AHB_CLK=(&CLK_GCC_TEST|0x05E)
&CLK_TEST_GCC_CNOC_PERIPH_BUS_TIMEOUT1_AHB_CLK=(&CLK_GCC_TEST|0x0C5)
&CLK_TEST_GCC_CNOC_PERIPH_BUS_TIMEOUT2_AHB_CLK=(&CLK_GCC_TEST|0x0C6)
&CLK_TEST_GCC_CNOC_PERIPH_EAST_AHB_CLK=(&CLK_GCC_TEST|0x016)
&CLK_TEST_GCC_CNOC_PERIPH_WEST_AHB_CLK=(&CLK_GCC_TEST|0x015)
&CLK_TEST_GCC_PDM_AHB_CLK=(&CLK_GCC_TEST|0x072)
&CLK_TEST_GCC_SDCC2_AHB_CLK=(&CLK_GCC_TEST|0x047)
&CLK_TEST_GCC_SDCC4_AHB_CLK=(&CLK_GCC_TEST|0x049)
&CLK_TEST_GCC_SPDM_PNOC_CY_CLK=(&CLK_GCC_TEST|0x095)
&CLK_TEST_GCC_TSIF_AHB_CLK=(&CLK_GCC_TEST|0x076)
&CLK_TEST_GCC_USB_PHY_CFG_AHB2PHY_CLK=(&CLK_GCC_TEST|0x045)
&CLK_TEST_GCC_AGGRE1_CNOC_AHB_CLK=(&CLK_GCC_TEST|0x104)
&CLK_TEST_GCC_AGGRE1_NOC_MSMPU_CFG_AHB_CLK=(&CLK_GCC_TEST|0x12A)
&CLK_TEST_GCC_AGGRE2_CNOC_AHB_CLK=(&CLK_GCC_TEST|0x111)
&CLK_TEST_GCC_AGGRE2_NOC_MSMPU_CFG_AHB_CLK=(&CLK_GCC_TEST|0x12B)
&CLK_TEST_GCC_AHB_CLK=(&CLK_GCC_TEST|0x09A)
&CLK_TEST_GCC_BIMC_CFG_AHB_CLK=(&CLK_GCC_TEST|0x09F)
&CLK_TEST_GCC_BIMC_NIUS_CFG_AHB_CLK=(&CLK_GCC_TEST|0x00C)
&CLK_TEST_GCC_BOOT_ROM_AHB_CLK=(&CLK_GCC_TEST|0x07A)
&CLK_TEST_GCC_CE1_AHB_CLK=(&CLK_GCC_TEST|0x099)
&CLK_TEST_GCC_CFG_NOC_AHB_CLK=(&CLK_GCC_TEST|0x00E)
&CLK_TEST_GCC_CFG_NOC_EAST_AHB_CLK=(&CLK_GCC_TEST|0x011)
&CLK_TEST_GCC_CFG_NOC_NORTH_AHB_CLK=(&CLK_GCC_TEST|0x010)
&CLK_TEST_GCC_CFG_NOC_WEST_AHB_CLK=(&CLK_GCC_TEST|0x00F)
&CLK_TEST_GCC_CNOC_BUS_TIMEOUT0_AHB_CLK=(&CLK_GCC_TEST|0x0C7)
&CLK_TEST_GCC_CNOC_BUS_TIMEOUT10_AHB_CLK=(&CLK_GCC_TEST|0x0D1)
&CLK_TEST_GCC_CNOC_BUS_TIMEOUT11_AHB_CLK=(&CLK_GCC_TEST|0x0D2)
&CLK_TEST_GCC_CNOC_BUS_TIMEOUT12_AHB_CLK=(&CLK_GCC_TEST|0x0D3)
&CLK_TEST_GCC_CNOC_BUS_TIMEOUT1_AHB_CLK=(&CLK_GCC_TEST|0x0C8)
&CLK_TEST_GCC_CNOC_BUS_TIMEOUT2_AHB_CLK=(&CLK_GCC_TEST|0x0C9)
&CLK_TEST_GCC_CNOC_BUS_TIMEOUT3_AHB_CLK=(&CLK_GCC_TEST|0x0CA)
&CLK_TEST_GCC_CNOC_BUS_TIMEOUT4_AHB_CLK=(&CLK_GCC_TEST|0x0CB)
&CLK_TEST_GCC_CNOC_BUS_TIMEOUT6_AHB_CLK=(&CLK_GCC_TEST|0x0CD)
&CLK_TEST_GCC_CNOC_BUS_TIMEOUT7_AHB_CLK=(&CLK_GCC_TEST|0x0CE)
&CLK_TEST_GCC_CNOC_BUS_TIMEOUT8_AHB_CLK=(&CLK_GCC_TEST|0x0CF)
&CLK_TEST_GCC_CNOC_BUS_TIMEOUT9_AHB_CLK=(&CLK_GCC_TEST|0x0D0)
&CLK_TEST_GCC_CNOC_MST_RPM_AHB_CLK=(&CLK_GCC_TEST|0x087)
&CLK_TEST_GCC_DCC_AHB_CLK=(&CLK_GCC_TEST|0x119)
&CLK_TEST_GCC_GLM_AHB_CLK=(&CLK_GCC_TEST|0x126)
&CLK_TEST_GCC_GPU_CFG_AHB_CLK=(&CLK_GCC_TEST|0x13B)
&CLK_TEST_GCC_IMEM_CFG_AHB_CLK=(&CLK_GCC_TEST|0x01E)
&CLK_TEST_GCC_IPA_AHB_CLK=(&CLK_GCC_TEST|0x11C)
&CLK_TEST_GCC_LPASS_CORE_SMMU_AHB_CLK=(&CLK_GCC_TEST|0x0B3)
&CLK_TEST_GCC_LPASS_Q6_SMMU_AHB_CLK=(&CLK_GCC_TEST|0x0B2)
&CLK_TEST_GCC_LPASS_SMMU_AON_AHB_CLK=(&CLK_GCC_TEST|0x0B4)
&CLK_TEST_GCC_MCCC_CFG_AHB_CLK=(&CLK_GCC_TEST|0x0AD)
&CLK_TEST_GCC_MMSS_NOC_CFG_AHB_CLK=(&CLK_GCC_TEST|0x020)
&CLK_TEST_GCC_MMSS_QM_AHB_CLK=(&CLK_GCC_TEST|0x025)
&CLK_TEST_GCC_MPM_AHB_CLK=(&CLK_GCC_TEST|0x080)
&CLK_TEST_GCC_MSG_RAM_AHB_CLK=(&CLK_GCC_TEST|0x07B)
&CLK_TEST_GCC_MSS_CFG_AHB_CLK=(&CLK_GCC_TEST|0x11F)
&CLK_TEST_GCC_MSS_MSMPU_CFG_AHB_CLK=(&CLK_GCC_TEST|0x12D)
&CLK_TEST_GCC_MSS_Q6_MSMPU_CFG_AHB_CLK=(&CLK_GCC_TEST|0x12C)
&CLK_TEST_GCC_PCIE_0_CFG_AHB_CLK=(&CLK_GCC_TEST|0x0E4)
&CLK_TEST_GCC_PIMEM_AHB_CLK=(&CLK_GCC_TEST|0x028)
&CLK_TEST_GCC_PRNG_AHB_CLK=(&CLK_GCC_TEST|0x075)
&CLK_TEST_GCC_QDSS_CFG_AHB_CLK=(&CLK_GCC_TEST|0x02A)
&CLK_TEST_GCC_QDSS_DAP_AHB_CLK=(&CLK_GCC_TEST|0x029)
&CLK_TEST_GCC_RBCPR_CX_AHB_CLK=(&CLK_GCC_TEST|0x0D9)
&CLK_TEST_GCC_RBCPR_MX_AHB_CLK=(&CLK_GCC_TEST|0x0DB)
&CLK_TEST_GCC_RPM_MST_M2_CNOC_AHB_CLK=(&CLK_GCC_TEST|0x086)
&CLK_TEST_GCC_SEC_CTRL_AHB_CLK=(&CLK_GCC_TEST|0x089)
&CLK_TEST_GCC_SEC_CTRL_BOOT_ROM_PATCH_CLK=(&CLK_GCC_TEST|0x08C)
&CLK_TEST_GCC_SKL_AHB_CLK=(&CLK_GCC_TEST|0x129)
&CLK_TEST_GCC_SMMU_AGGRE1_AHB_CLK=(&CLK_GCC_TEST|0x109)
&CLK_TEST_GCC_SMMU_AGGRE2_AHB_CLK=(&CLK_GCC_TEST|0x115)
&CLK_TEST_GCC_SNOC_CNOC_AHB_CLK=(&CLK_GCC_TEST|0x005)
&CLK_TEST_GCC_SPDM_CFG_AHB_CLK=(&CLK_GCC_TEST|0x090)
&CLK_TEST_GCC_SPDM_MSTR_AHB_CLK=(&CLK_GCC_TEST|0x091)
&CLK_TEST_GCC_SPMI_CNOC_AHB_CLK=(&CLK_GCC_TEST|0x08E)
&CLK_TEST_GCC_SPSS_CFG_AHB_CLK=(&CLK_GCC_TEST|0x143)
&CLK_TEST_GCC_SPSS_SCSR_CLK=(&CLK_GCC_TEST|0x144)
&CLK_TEST_GCC_SSC_CNOC_AHBS_CLK=(&CLK_GCC_TEST|0x0F5)
&CLK_TEST_GCC_SSC_CNOC_MPU_CLK=(&CLK_GCC_TEST|0x0F6)
&CLK_TEST_GCC_TCSR_AHB_CLK=(&CLK_GCC_TEST|0x079)
&CLK_TEST_GCC_TIC_CFG_AHB_CLK=(&CLK_GCC_TEST|0x01C)
&CLK_TEST_GCC_TLMM_CLK=(&CLK_GCC_TEST|0x07F)
&CLK_TEST_GCC_TLMM_EAST_AHB_CLK=(&CLK_GCC_TEST|0x07E)
&CLK_TEST_GCC_TLMM_NORTH_AHB_CLK=(&CLK_GCC_TEST|0x07C)
&CLK_TEST_GCC_TLMM_WEST_AHB_CLK=(&CLK_GCC_TEST|0x07D)
&CLK_TEST_GCC_UFS_AHB_CLK=(&CLK_GCC_TEST|0x0EB)
&CLK_TEST_GCC_BIMC_SLEEP_CLK=(&CLK_GCC_TEST|0x0A0)
&CLK_TEST_GCC_BLSP1_SLEEP_CLK=(&CLK_GCC_TEST|0x04B)
&CLK_TEST_GCC_BLSP2_SLEEP_CLK=(&CLK_GCC_TEST|0x05F)
&CLK_TEST_GCC_DDR_DIM_SLEEP_CLK=(&CLK_GCC_TEST|0x0AB)
&CLK_TEST_GCC_IM_SLEEP_CLK=(&CLK_GCC_TEST|0x09D)
&CLK_TEST_GCC_IPA_SLEEP_CLK=(&CLK_GCC_TEST|0x11D)
&CLK_TEST_GCC_RPM_SLEEP_CLK=(&CLK_GCC_TEST|0x084)
&CLK_TEST_GCC_TSIF_INACTIVITY_TIMERS_CLK=(&CLK_GCC_TEST|0x078)
&CLK_TEST_GCC_USB30_SLEEP_CLK=(&CLK_GCC_TEST|0x03F)
&CLK_TEST_GCC_AGGRE1_NOC_XO_CLK=(&CLK_GCC_TEST|0x10C)
&CLK_TEST_GCC_AHB2PHY_EAST_CLK=(&CLK_GCC_TEST|0x14A)
&CLK_TEST_GCC_CFG_NOC_AH2PHY_XO_CLK=(&CLK_GCC_TEST|0x01B)
&CLK_TEST_GCC_CFG_NOC_DCD_XO_CLK=(&CLK_GCC_TEST|0x017)
&CLK_TEST_GCC_CFG_NOC_EAST_DCD_XO_CLK=(&CLK_GCC_TEST|0x019)
&CLK_TEST_GCC_CFG_NOC_NORTH_DCD_XO_CLK=(&CLK_GCC_TEST|0x01A)
&CLK_TEST_GCC_CFG_NOC_WEST_DCD_XO_CLK=(&CLK_GCC_TEST|0x018)
&CLK_TEST_GCC_CM_PHY_REFGEN1_CLK=(&CLK_GCC_TEST|0x14B)
&CLK_TEST_GCC_CM_PHY_REFGEN2_CLK=(&CLK_GCC_TEST|0x14C)
&CLK_TEST_GCC_CNOC_BUS_TIMEOUT13_AHB_CLK=(&CLK_GCC_TEST|0x0D4)
&CLK_TEST_GCC_GLM_XO_CLK=(&CLK_GCC_TEST|0x128)
&CLK_TEST_GCC_PDM_XO4_CLK=(&CLK_GCC_TEST|0x073)
&CLK_TEST_GCC_QDSS_XO_CLK=(&CLK_GCC_TEST|0x03D)
&CLK_TEST_GCC_QREFS_VBG_CAL_CLK=(&CLK_GCC_TEST|0x132)
&CLK_TEST_GCC_RPM_TIMER_CLK=(&CLK_GCC_TEST|0x085)
&CLK_TEST_GCC_SPDM_FF_CLK=(&CLK_GCC_TEST|0x092)
&CLK_TEST_GCC_SPSS_XO_CLK=(&CLK_GCC_TEST|0x146)
&CLK_TEST_GCC_SRAM_SENSOR_XO_CLK=(&CLK_GCC_TEST|0x14D)
&CLK_TEST_GCC_SSC_XO_CLK=(&CLK_GCC_TEST|0x0F8)
&CLK_TEST_GCC_SYS_NOC_DCD_XO_CLK=(&CLK_GCC_TEST|0x00D)
&CLK_TEST_GCC_XO_CLK=(&CLK_GCC_TEST|0x09B)
&CLK_TEST_GCC_XO_DIV4_CLK=(&CLK_GCC_TEST|0x09C)
&CLK_TEST_GCC_GLM_CLK=(&CLK_GCC_TEST|0x127)
&CLK_TEST_GCC_GP1_CLK=(&CLK_GCC_TEST|0x0DF)
&CLK_TEST_GCC_GP2_CLK=(&CLK_GCC_TEST|0x0E0)
&CLK_TEST_GCC_GP3_CLK=(&CLK_GCC_TEST|0x0E1)
&CLK_TEST_GCC_BIMC_GFX_CLK=(&CLK_GCC_TEST|0x0AC)
&CLK_TEST_GCC_GPU_BIMC_GFX_CLK=(&CLK_GCC_TEST|0x13F)
&CLK_TEST_GCC_GPU_BIMC_GFX_SRC_CLK=(&CLK_GCC_TEST|0x13E)
&CLK_TEST_GCC_GPU_SNOC_DVM_GFX_CLK=(&CLK_GCC_TEST|0x141)
&CLK_TEST_GCC_GPU_VS_CLK=(&CLK_GCC_TEST|0x100)
&CLK_TEST_GCC_HMSS_AHB_CLK=(&CLK_GCC_TEST|0x0BA)
&CLK_TEST_GCC_SNOC_BUS_TIMEOUT0_AHB_CLK=(&CLK_GCC_TEST|0x0C1)
&CLK_TEST_GCC_SYS_NOC_HMSS_AHB_CLK=(&CLK_GCC_TEST|0x004)
&CLK_TEST_GCC_HMSS_RBCPR_CLK=(&CLK_GCC_TEST|0x0BC)
&CLK_TEST_GCC_AGGRE2_NOC_IPA_CLK=(&CLK_GCC_TEST|0x117)
&CLK_TEST_GCC_IPA_2X_CLK=(&CLK_GCC_TEST|0x11A)
&CLK_TEST_GCC_IPA_CLK=(&CLK_GCC_TEST|0x11B)
&CLK_TEST_GCC_MMSS_QM_CORE_CLK=(&CLK_GCC_TEST|0x023)
&CLK_TEST_GCC_BIMC_MSS_Q6_AXI_CLK=(&CLK_GCC_TEST|0x0A3)
&CLK_TEST_GCC_MSS_Q6_BIMC_AXI_CLK=(&CLK_GCC_TEST|0x124)
&CLK_TEST_GCC_MSS_Q6_MSMPU_CLIENT_AXI_CLK=(&CLK_GCC_TEST|0x130)
&CLK_TEST_GCC_MSS_VS_CLK=(&CLK_GCC_TEST|0x0FF)
&CLK_TEST_GCC_OBT_ODT_CLK=(&CLK_GCC_TEST|0x0E9)
&CLK_TEST_GCC_PCIE_0_PIPE_CLK=(&CLK_GCC_TEST|0x0E6)
&CLK_TEST_GCC_PCIE_0_AUX_CLK=(&CLK_GCC_TEST|0x0E5)
&CLK_TEST_GCC_PCIE_PHY_AUX_CLK=(&CLK_GCC_TEST|0x0E8)
&CLK_TEST_GCC_PDM2_CLK=(&CLK_GCC_TEST|0x074)
&CLK_TEST_GCC_BIMC_PIMEM_AXI_CLK=(&CLK_GCC_TEST|0x0A6)
&CLK_TEST_GCC_PIMEM_AXI_CLK=(&CLK_GCC_TEST|0x027)
&CLK_TEST_GCC_SYS_NOC_PIMEM_AXI_CLK=(&CLK_GCC_TEST|0x008)
&CLK_TEST_GCC_CENTER_APB_CLK=(&CLK_GCC_TEST|0x03C)
&CLK_TEST_GCC_EAST_APB_CLK=(&CLK_GCC_TEST|0x039)
&CLK_TEST_GCC_GPU_TRIG_CLK=(&CLK_GCC_TEST|0x140)
&CLK_TEST_GCC_HMSS_TRIG_CLK=(&CLK_GCC_TEST|0x0BD)
&CLK_TEST_GCC_LPASS_TRIG_CLK=(&CLK_GCC_TEST|0x0B5)
&CLK_TEST_GCC_MMSS_TRIG_CLK=(&CLK_GCC_TEST|0x024)
&CLK_TEST_GCC_MSS_TRIG_CLK=(&CLK_GCC_TEST|0x121)
&CLK_TEST_GCC_NORTH_APB_CLK=(&CLK_GCC_TEST|0x03B)
&CLK_TEST_GCC_QDSS_APB2JTAG_CLK=(&CLK_GCC_TEST|0x0D7)
&CLK_TEST_GCC_QDSS_DAP_CLK=(&CLK_GCC_TEST|0x038)
&CLK_TEST_GCC_QDSS_TRIG_CLK=(&CLK_GCC_TEST|0x037)
&CLK_TEST_GCC_SPSS_TRIG_CLK=(&CLK_GCC_TEST|0x147)
&CLK_TEST_GCC_SSC_APB_CLK=(&CLK_GCC_TEST|0x0F9)
&CLK_TEST_GCC_WCSS_APB_CLK=(&CLK_GCC_TEST|0x139)
&CLK_TEST_GCC_WEST_APB_CLK=(&CLK_GCC_TEST|0x03A)
&CLK_TEST_GCC_AGGRE1_NOC_AT_CLK=(&CLK_GCC_TEST|0x105)
&CLK_TEST_GCC_AGGRE2_NOC_AT_CLK=(&CLK_GCC_TEST|0x112)
&CLK_TEST_GCC_EAST_AT_CLK=(&CLK_GCC_TEST|0x02D)
&CLK_TEST_GCC_GPU_AT_CLK=(&CLK_GCC_TEST|0x13C)
&CLK_TEST_GCC_HMSS_AT_CLK=(&CLK_GCC_TEST|0x0BE)
&CLK_TEST_GCC_MMSS_AT_CLK=(&CLK_GCC_TEST|0x021)
&CLK_TEST_GCC_MMSS_NOC_AT_CLK=(&CLK_GCC_TEST|0x026)
&CLK_TEST_GCC_QDSS_CENTER_AT_CLK=(&CLK_GCC_TEST|0x02B)
&CLK_TEST_GCC_SYS_NOC_AT_CLK=(&CLK_GCC_TEST|0x006)
&CLK_TEST_GCC_WCSS_AT_CLK=(&CLK_GCC_TEST|0x137)
&CLK_TEST_GCC_WEST_AT_CLK=(&CLK_GCC_TEST|0x02C)
&CLK_TEST_GCC_BIMC_AT_CLK=(&CLK_GCC_TEST|0x0A4)
&CLK_TEST_GCC_MSS_AT_CLK=(&CLK_GCC_TEST|0x122)
&CLK_TEST_GCC_LPASS_AT_CLK=(&CLK_GCC_TEST|0x0B6)
&CLK_TEST_GCC_NORTH_AT_CLK=(&CLK_GCC_TEST|0x02E)
&CLK_TEST_GCC_SSC_AT_CLK=(&CLK_GCC_TEST|0x0F7)
&CLK_TEST_GCC_QDSS_STM_CLK=(&CLK_GCC_TEST|0x030)
&CLK_TEST_GCC_SYS_NOC_QDSS_STM_AXI_CLK=(&CLK_GCC_TEST|0x003)
&CLK_TEST_GCC_QDSS_TRACECLKIN_CLK=(&CLK_GCC_TEST|0x031)
&CLK_TEST_GCC_QDSS_TSCTR_DIV16_CLK=(&CLK_GCC_TEST|0x036)
&CLK_TEST_GCC_QDSS_TSCTR_DIV2_CLK=(&CLK_GCC_TEST|0x032)
&CLK_TEST_GCC_QDSS_TSCTR_DIV3_CLK=(&CLK_GCC_TEST|0x033)
&CLK_TEST_GCC_QDSS_TSCTR_DIV4_CLK=(&CLK_GCC_TEST|0x034)
&CLK_TEST_GCC_QDSS_TSCTR_DIV8_CLK=(&CLK_GCC_TEST|0x035)
&CLK_TEST_GCC_WCSS_TSCTR_DIV2_CLK=(&CLK_GCC_TEST|0x138)
&CLK_TEST_GCC_APSS_QDSS_TSCTR_DIV2_CLK=(&CLK_GCC_TEST|0x160)
&CLK_TEST_GCC_APSS_QDSS_TSCTR_DIV8_CLK=(&CLK_GCC_TEST|0x161)
&CLK_TEST_GCC_RBCPR_CX_CLK=(&CLK_GCC_TEST|0x0D8)
&CLK_TEST_GCC_RBCPR_MX_CLK=(&CLK_GCC_TEST|0x0DA)
&CLK_TEST_GCC_RPM_BUS_AHB_CLK=(&CLK_GCC_TEST|0x083)
&CLK_TEST_GCC_RPM_PROC_FCLK=(&CLK_GCC_TEST|0x081)
&CLK_TEST_GCC_RPM_PROC_HCLK=(&CLK_GCC_TEST|0x082)
&CLK_TEST_GCC_SPDM_RPM_CY_CLK=(&CLK_GCC_TEST|0x096)
&CLK_TEST_GCC_SDCC2_APPS_CLK=(&CLK_GCC_TEST|0x046)
&CLK_TEST_GCC_SDCC4_APPS_CLK=(&CLK_GCC_TEST|0x048)
&CLK_TEST_GCC_SEC_CTRL_CLK=(&CLK_GCC_TEST|0x08A)
&CLK_TEST_GCC_SEC_CTRL_SENSE_CLK=(&CLK_GCC_TEST|0x08B)
&CLK_TEST_GCC_SPSS_SEC_CTRL_CLK=(&CLK_GCC_TEST|0x145)
&CLK_TEST_GCC_SPMI_AHB_CLK=(&CLK_GCC_TEST|0x08F)
&CLK_TEST_GCC_SPMI_SER_CLK=(&CLK_GCC_TEST|0x08D)
&CLK_TEST_GCC_BIMC_NIUS_HS_AXI_CLK=(&CLK_GCC_TEST|0x00A)
&CLK_TEST_GCC_BIMC_SYSNOC_HS_AXI_CLK=(&CLK_GCC_TEST|0x0A5)
&CLK_TEST_GCC_LPASS_Q6_AXI_CLK=(&CLK_GCC_TEST|0x0AE)
&CLK_TEST_GCC_LPASS_Q6_SMMU_AXI_CLK=(&CLK_GCC_TEST|0x0B0)
&CLK_TEST_GCC_LPASS_Q6_SMMU_AXI_SRC_CLK=(&CLK_GCC_TEST|0x0AF)
&CLK_TEST_GCC_MSS_MNOC_BIMC_AXI_CLK=(&CLK_GCC_TEST|0x120)
&CLK_TEST_GCC_MSS_MSMPU_CLIENT_AXI_CLK=(&CLK_GCC_TEST|0x131)
&CLK_TEST_GCC_SYS_NOC_HS_AXI_CLK=(&CLK_GCC_TEST|0x009)
&CLK_TEST_GCC_AGGRE1_SNOC_AXI_CLK=(&CLK_GCC_TEST|0x103)
&CLK_TEST_GCC_AGGRE1_SNOC_MSMPU_CLIENT_AXI_CLK=(&CLK_GCC_TEST|0x12E)
&CLK_TEST_GCC_AGGRE2_SNOC_AXI_CLK=(&CLK_GCC_TEST|0x10E)
&CLK_TEST_GCC_AGGRE2_SNOC_EAST_AXI_CLK=(&CLK_GCC_TEST|0x10F)
&CLK_TEST_GCC_AGGRE2_SNOC_MSMPU_CLIENT_AXI_CLK=(&CLK_GCC_TEST|0x12F)
&CLK_TEST_GCC_AGGRE2_SNOC_NORTH_AXI_CLK=(&CLK_GCC_TEST|0x110)
&CLK_TEST_GCC_BIMC_NIUS_AXI_CLK=(&CLK_GCC_TEST|0x00B)
&CLK_TEST_GCC_BIMC_SYSNOC_AXI_CLK=(&CLK_GCC_TEST|0x0A1)
&CLK_TEST_GCC_CE1_AXI_CLK=(&CLK_GCC_TEST|0x098)
&CLK_TEST_GCC_HMSS_DVM_BUS_CLK=(&CLK_GCC_TEST|0x0BF)
&CLK_TEST_GCC_IMEM_AXI_CLK=(&CLK_GCC_TEST|0x01D)
&CLK_TEST_GCC_LPASS_CORE_SMMU_CLIENT_CLK=(&CLK_GCC_TEST|0x0B8)
&CLK_TEST_GCC_LPASS_CORE_SMMU_CLIENT_SRC_CLK=(&CLK_GCC_TEST|0x0B7)
&CLK_TEST_GCC_LPASS_SWAY_CLK=(&CLK_GCC_TEST|0x0B1)
&CLK_TEST_GCC_MMSS_SYS_NOC_AXI_CLK=(&CLK_GCC_TEST|0x01F)
&CLK_TEST_GCC_MSS_SNOC_AXI_CLK=(&CLK_GCC_TEST|0x123)
&CLK_TEST_GCC_PCIE_0_MSTR_AXI_CLK=(&CLK_GCC_TEST|0x0E3)
&CLK_TEST_GCC_PCIE_0_SLV_AXI_CLK=(&CLK_GCC_TEST|0x0E2)
&CLK_TEST_GCC_QDSS_ETR_USB_CLK=(&CLK_GCC_TEST|0x02F)
&CLK_TEST_GCC_SMMU_AGGRE1_AXI_CLK=(&CLK_GCC_TEST|0x108)
&CLK_TEST_GCC_SMMU_AGGRE1_AXI_SRC_CLK=(&CLK_GCC_TEST|0x107)
&CLK_TEST_GCC_SMMU_AGGRE2_AXI_CLK=(&CLK_GCC_TEST|0x114)
&CLK_TEST_GCC_SMMU_AGGRE2_AXI_SRC_CLK=(&CLK_GCC_TEST|0x113)
&CLK_TEST_GCC_SNOC_BUS_TIMEOUT1_AHB_CLK=(&CLK_GCC_TEST|0x0C2)
&CLK_TEST_GCC_SNOC_BUS_TIMEOUT3_AHB_CLK=(&CLK_GCC_TEST|0x0C3)
&CLK_TEST_GCC_SPDM_SNOC_CY_CLK=(&CLK_GCC_TEST|0x094)
&CLK_TEST_GCC_SPSS_SNOC_EMM_CLK=(&CLK_GCC_TEST|0x142)
&CLK_TEST_GCC_SSC_SNOC_AHBM_CLK=(&CLK_GCC_TEST|0x0F3)
&CLK_TEST_GCC_SYS_NOC_AXI_CLK=(&CLK_GCC_TEST|0x000)
&CLK_TEST_GCC_SYS_NOC_EAST_AXI_CLK=(&CLK_GCC_TEST|0x002)
&CLK_TEST_GCC_SYS_NOC_SSC_Q6_AXI_CLK=(&CLK_GCC_TEST|0x0F4)
&CLK_TEST_GCC_SYS_NOC_WEST_AXI_CLK=(&CLK_GCC_TEST|0x001)
&CLK_TEST_GCC_WCSS_AHB_S0_CLK=(&CLK_GCC_TEST|0x133)
&CLK_TEST_GCC_WCSS_AXI_M_CLK=(&CLK_GCC_TEST|0x134)
&CLK_TEST_GCC_WCSS_ECAHB_CLK=(&CLK_GCC_TEST|0x135)
&CLK_TEST_GCC_WCSS_SHDREG_AHB_CLK=(&CLK_GCC_TEST|0x136)
&CLK_TEST_GCC_CFG_NOC_TIC_CLK=(&CLK_GCC_TEST|0x013)
&CLK_TEST_GCC_TSIF_REF_CLK=(&CLK_GCC_TEST|0x077)
&CLK_TEST_GCC_AGGRE1_UFS_AXI_CLK=(&CLK_GCC_TEST|0x10B)
&CLK_TEST_GCC_UFS_AXI_CLK=(&CLK_GCC_TEST|0x0EA)
&CLK_TEST_GCC_UFS_ICE_CORE_CLK=(&CLK_GCC_TEST|0x0F1)
&CLK_TEST_GCC_UFS_PHY_AUX_CLK=(&CLK_GCC_TEST|0x0F2)
&CLK_TEST_GCC_UFS_RX_SYMBOL_0_CLK=(&CLK_GCC_TEST|0x0ED)
&CLK_TEST_GCC_UFS_RX_SYMBOL_1_CLK=(&CLK_GCC_TEST|0x162)
&CLK_TEST_GCC_UFS_TX_SYMBOL_0_CLK=(&CLK_GCC_TEST|0x0EC)
&CLK_TEST_GCC_UFS_UNIPRO_CORE_CLK=(&CLK_GCC_TEST|0x0F0)
&CLK_TEST_GCC_AGGRE1_USB3_AXI_CLK=(&CLK_GCC_TEST|0x10A)
&CLK_TEST_GCC_CFG_NOC_USB3_AXI_CLK=(&CLK_GCC_TEST|0x014)
&CLK_TEST_GCC_CNOC_BUS_TIMEOUT14_AHB_CLK=(&CLK_GCC_TEST|0x0D5)
&CLK_TEST_GCC_USB30_MASTER_CLK=(&CLK_GCC_TEST|0x03E)
&CLK_TEST_GCC_USB30_MOCK_UTMI_CLK=(&CLK_GCC_TEST|0x040)
&CLK_TEST_GCC_USB3_PHY_AUX_CLK=(&CLK_GCC_TEST|0x041)
&CLK_TEST_GCC_USB3_PHY_PIPE_CLK=(&CLK_GCC_TEST|0x042)
&CLK_TEST_GCC_VDDA_VS_CLK=(&CLK_GCC_TEST|0x0FD)
&CLK_TEST_GCC_VDDCX_VS_CLK=(&CLK_GCC_TEST|0x0FB)
&CLK_TEST_GCC_VDDMX_VS_CLK=(&CLK_GCC_TEST|0x0FC)
&CLK_TEST_GCC_VS_CTRL_CLK=(&CLK_GCC_TEST|0x0FE)
&CLK_TEST_GCC_AGGRE1_NOC_QOSGEN_EXTREF=(&CLK_GCC_TEST|0x10D)
&CLK_TEST_GCC_AGGRE2_NOC_QOSGEN_EXTREF=(&CLK_GCC_TEST|0x116)
&CLK_TEST_GCC_CNOC_BUS_TIMEOUT_EXTREF=(&CLK_GCC_TEST|0x0D6)
&CLK_TEST_GCC_SNOC_BUS_TIMEOUT_EXTREF=(&CLK_GCC_TEST|0x0C4)
&CLK_TEST_GCC_SNOC_QOSGEN_EXTREF=(&CLK_GCC_TEST|0x007)
&CLK_TEST_GPU_GCC_DBG_CLK=(&CLK_GCC_TEST|0x13D)
&CLK_TEST_HMSS_GCC_DBG_CLK=(&CLK_GCC_TEST|0x0C0)
&CLK_TEST_LPASS_GCC_DBG_CLK=(&CLK_GCC_TEST|0x0B9)
&CLK_TEST_MMSS_GCC_DBG_CLK=(&CLK_GCC_TEST|0x022)
&CLK_TEST_MPM_GCC_TEMP0_SENSOR_RINGOSC_CLK=(&CLK_GCC_TEST|0x0DD)
&CLK_TEST_MPM_GCC_TEMP1_SENSOR_RINGOSC_CLK=(&CLK_GCC_TEST|0x0DE)
&CLK_TEST_MSS_GCC_DBG_CLK=(&CLK_GCC_TEST|0x125)
&CLK_TEST_NAV_GCC_DBG_CLK=(&CLK_GCC_TEST|0x149)
&CLK_TEST_PCIE_0_PIPE_CLK=(&CLK_GCC_TEST|0x15F)
&CLK_TEST_QUSB2PHY_GCC_CLK_TEST_PRIM=(&CLK_GCC_TEST|0x0DC)
&CLK_TEST_QUSB2PHY_PRIM_GCC_USB30_UTMI_CLK=(&CLK_GCC_TEST|0x044)
&CLK_TEST_SPSS_GCC_DBG_CLK=(&CLK_GCC_TEST|0x148)
&CLK_TEST_SSC_GCC_DBG_CLK=(&CLK_GCC_TEST|0x0FA)
&CLK_TEST_UFS_RX_SYMBOL_0_CLK=(&CLK_GCC_TEST|0x0EF)
&CLK_TEST_UFS_RX_SYMBOL_1_CLK=(&CLK_GCC_TEST|0x163)
&CLK_TEST_UFS_TX_SYMBOL_0_CLK=(&CLK_GCC_TEST|0x0EE)
&CLK_TEST_USB3_PHY_WRAPPER_GCC_USB3_PIPE_CLK=(&CLK_GCC_TEST|0x043)
&CLK_TEST_WCSS_GCC_DBG_CLK=(&CLK_GCC_TEST|0x13A)

; MSS test clocks
&CLK_TEST_CLK_SRC_BIT_COXM_MND=(&CLK_MSS_TEST|0x041)
&CLK_TEST_CLK_BIT_COXM=(&CLK_MSS_TEST|0x043)
&CLK_TEST_CLK_SRC_BUS_MSS_CONFIG=(&CLK_MSS_TEST|0x100)
&CLK_TEST_CLK_BUS_CONFIG=(&CLK_MSS_TEST|0x049)
&CLK_TEST_CLK_BUS_COXM=(&CLK_MSS_TEST|0x04C)
&CLK_TEST_CLK_BUS_CRYPTO=(&CLK_MSS_TEST|0x04D)
&CLK_TEST_CLK_BUS_MGPI=(&CLK_MSS_TEST|0x04E)
&CLK_TEST_CLK_BUS_MVC=(&CLK_MSS_TEST|0x04F)
&CLK_TEST_CLK_BUS_NAV=(&CLK_MSS_TEST|0x2C0)
&CLK_TEST_CLK_BUS_PLL_OUTCTRL=(&CLK_MSS_TEST|0x04A)
&CLK_TEST_CLK_BUS_Q6=(&CLK_MSS_TEST|0x180)
&CLK_TEST_CLK_BUS_RBCPR=(&CLK_MSS_TEST|0x04B)
&CLK_TEST_CLK_BUS_RFC=(&CLK_MSS_TEST|0x077)
&CLK_TEST_CLK_BUS_SLAVE_TIMEOUT=(&CLK_MSS_TEST|0x052)
&CLK_TEST_CLK_BUS_STMR=(&CLK_MSS_TEST|0x051)
&CLK_TEST_CLK_BUS_UIM0=(&CLK_MSS_TEST|0x053)
&CLK_TEST_CLK_BUS_UIM1=(&CLK_MSS_TEST|0x054)
&CLK_TEST_CLK_BUS_UIM2=(&CLK_MSS_TEST|0x055)
&CLK_TEST_CLK_BUS_UIM3=(&CLK_MSS_TEST|0x056)
&CLK_TEST_MSS_DGR_AHB_CLK=(&CLK_MSS_TEST|0x380)
&CLK_TEST_CLK_SRC_BUS_MSS_CONFIG=(&CLK_MSS_TEST|0x100)
&CLK_TEST_GCC_MSS_MFAB_AXI_CLK_SRC=(&CLK_MSS_TEST|0x1C0)
&CLK_TEST_CLK_AXI_MNOC=(&CLK_MSS_TEST|0x1C0)
&CLK_TEST_CLK_AXI_MNOC_Q6=(&CLK_MSS_TEST|0x1C0)
&CLK_TEST_CLK_AXI_NAV_SAMPLE=(&CLK_MSS_TEST|0x1C0)
&CLK_TEST_GCC_MSS_NAV_CE_AXI_CLK_SRC=(&CLK_MSS_TEST|0x300)
&CLK_TEST_CLK_AXI_NAV=(&CLK_MSS_TEST|0x300)
&CLK_TEST_CLK_SRC_RBCPR_REF=(&CLK_MSS_TEST|0x042)
&CLK_TEST_CLK_RBCPR_REF=(&CLK_MSS_TEST|0x044)
&CLK_TEST_CLK_SRC_UIM0_MND=(&CLK_MSS_TEST|0x05A)
&CLK_TEST_CLK_UART_BIT_UIM0=(&CLK_MSS_TEST|0x063)
&CLK_TEST_CLK_SRC_UIM1_MND=(&CLK_MSS_TEST|0x05B)
&CLK_TEST_CLK_UART_BIT_UIM1=(&CLK_MSS_TEST|0x064)
&CLK_TEST_CLK_SRC_UIM2_MND=(&CLK_MSS_TEST|0x05C)
&CLK_TEST_CLK_UART_BIT_UIM2=(&CLK_MSS_TEST|0x065)
&CLK_TEST_CLK_SRC_UIM3_MND=(&CLK_MSS_TEST|0x05D)
&CLK_TEST_CLK_UART_BIT_UIM3=(&CLK_MSS_TEST|0x066)
&CLK_TEST_CLK_CARD_SRC_UIM0=(&CLK_MSS_TEST|0x05E)
&CLK_TEST_CLK_CARD_SRC_UIM1=(&CLK_MSS_TEST|0x05F)
&CLK_TEST_CLK_CARD_SRC_UIM2=(&CLK_MSS_TEST|0x061)
&CLK_TEST_CLK_CARD_SRC_UIM3=(&CLK_MSS_TEST|0x062)
&CLK_TEST_CLK_XO_MDM=(&CLK_MSS_TEST|0x240)
&CLK_TEST_CLK_XO_NAV=(&CLK_MSS_TEST|0x340)
&CLK_TEST_CLK_MDM=(&CLK_MSS_TEST|0x6B)
&CLK_TEST_MSS_QDSP6SS_Q6_CORE_CLK=(&CLK_MSS_Q6_TEST|0x1)
&CLK_TEST_MSS_QDSP6SS_AXI_M_CLK=(&CLK_MSS_Q6_TEST|0x2)
&CLK_TEST_MSS_QDSP6SS_LDO_NMO_OUT=(&CLK_MSS_Q6_TEST|0x3)
&CLK_TEST_MSS_QDSP6SS_AHB_M_CLK=(&CLK_MSS_Q6_TEST|0x4)
&CLK_TEST_MSS_QDSP6SS_AHB_S_CLK=(&CLK_MSS_Q6_TEST|0x5)
&CLK_TEST_MSS_QDSP6SS_XO_CLK=(&CLK_MSS_Q6_TEST|0x6)
&CLK_TEST_MSS_QDSP6SS_SLEEP_CLK=(&CLK_MSS_Q6_TEST|0x7)
&CLK_TEST_MSS_QDSP6SS_JTAG_TCK=(&CLK_MSS_Q6_TEST|0x8)
&CLK_TEST_MSS_QDSP6SS_ATB_CLK=(&CLK_MSS_Q6_TEST|0x9)
&CLK_TEST_MSS_QDSP6SS_APB_CLK=(&CLK_MSS_Q6_TEST|0xA)
&CLK_TEST_MSS_QDSP6SS_TIMESTAMP_CLK=(&CLK_MSS_Q6_TEST|0xB)
&CLK_TEST_CLK_AXI_CRYPTO=(&CLK_MSS_TEST|0x046)
&CLK_TEST_CLK_BUS_PSEUDO_HM_RCG=(&CLK_MSS_TEST|0x0C0)
&CLK_TEST_CLK_TIMEOUT_SLP=(&CLK_MSS_TEST|0x047)
&CLK_TEST_CLK_XO_CX=(&CLK_MSS_TEST|0x045)
&CLK_TEST_DBG_DTR_CLKSIG=(&CLK_MSS_TEST|0x067)
&CLK_TEST_DBG_MODEM_CLKSIG=(&CLK_MSS_TEST|0x06B)
&CLK_TEST_DBG_NAV_CLKSIG=(&CLK_MSS_TEST|0x06A)
&CLK_TEST_DBG_Q6_CLKSIG=(&CLK_MSS_TEST|0x069)
&CLK_TEST_DTR1_PLL_DTEST=(&CLK_MSS_TEST|0x06C)
&CLK_TEST_DTR1_PLL_LOCK_DET=(&CLK_MSS_TEST|0x072)
&CLK_TEST_DTR2_PLL_DTEST=(&CLK_MSS_TEST|0x06D)
&CLK_TEST_DTR2_PLL_LOCK_DET=(&CLK_MSS_TEST|0x073)
&CLK_TEST_GCC_MSS_MFAB_AXI_CLK_SRC=(&CLK_MSS_TEST|0x1C0)
&CLK_TEST_GCC_MSS_NAV_CE_AXI_CLK_SRC=(&CLK_MSS_TEST|0x300)
&CLK_TEST_MODEM_OFFLINE_PLL_DTEST=(&CLK_MSS_TEST|0x071)
&CLK_TEST_MSS_DGR_AXI_CLK=(&CLK_MSS_TEST|0x3C0)
&CLK_TEST_MSS_OFFLINE_PLL_LOCK_DET=(&CLK_MSS_TEST|0x076)
&CLK_TEST_NAV_PLL_DTEST=(&CLK_MSS_TEST|0x06F)
&CLK_TEST_NAV_PLL_LOCK_DET=(&CLK_MSS_TEST|0x075)
&CLK_TEST_Q6_PLL_DTEST=(&CLK_MSS_TEST|0x06E)
&CLK_TEST_Q6_PLL_LOCK_DET=(&CLK_MSS_TEST|0x074)

; NAV test clocks

; WCSS test clocks
&CLK_TEST_WCSS_DBG_APB_CLK=(&CLK_WCSS_TEST|0x007)
&CLK_TEST_WCSS_DBG_ATB_CLK=(&CLK_WCSS_TEST|0x006)
&CLK_TEST_WCSS_DBG_CSS_APB_CLK=(&CLK_WCSS_TEST|0x036)
&CLK_TEST_WCSS_DBG_CSS_ATB_CLK=(&CLK_WCSS_TEST|0x035)
&CLK_TEST_WCSS_DBG_CSS_TS_CLK=(&CLK_WCSS_TEST|0x037)
&CLK_TEST_WCSS_DBG_TS_CLK=(&CLK_WCSS_TEST|0x008)
&CLK_TEST_WCSS_AHB_TSLV_CLK=(&CLK_WCSS_TEST|0x005)
&CLK_TEST_WCSS_CSS_APB_CLK=(&CLK_WCSS_TEST|0x004)
&CLK_TEST_WCSS_CSS_NOC_CLK=(&CLK_WCSS_TEST|0x001)
&CLK_TEST_WCSS_PHY1_APB_CLK=(&CLK_WCSS_TEST|0x00A)
&CLK_TEST_WCSS_PHY2_APB_CLK=(&CLK_WCSS_TEST|0x01B)
&CLK_TEST_WCSS_RFACTRL_APB_CLK=(&CLK_WCSS_TEST|0x039)
&CLK_TEST_WCSS_RFACTRL_DAC_APB_CLK=(&CLK_WCSS_TEST|0x03E)
&CLK_TEST_WCSS_TOP_AHB_CLK=(&CLK_WCSS_TEST|0x003)
&CLK_TEST_WCSS_TOP_AXI_CLK=(&CLK_WCSS_TEST|0x002)
&CLK_TEST_WCSS_TOP_DAC_APB_CLK=(&CLK_WCSS_TEST|0x038)
&CLK_TEST_WCSS_WCSSDBG_CFG_APB_CLK=(&CLK_WCSS_TEST|0x03F)
&CLK_TEST_WCSS_WMAC1_APB_CLK=(&CLK_WCSS_TEST|0x009)
&CLK_TEST_WCSS_WMAC2_APB_CLK=(&CLK_WCSS_TEST|0x01A)
&CLK_TEST_WCSS_PHY1_160_CLK=(&CLK_WCSS_TEST|0x012)
&CLK_TEST_WCSS_PHY1_20_CLK=(&CLK_WCSS_TEST|0x015)
&CLK_TEST_WCSS_PHY1_30_CLK=(&CLK_WCSS_TEST|0x019)
&CLK_TEST_WCSS_PHY1_320_CLK=(&CLK_WCSS_TEST|0x00D)
&CLK_TEST_WCSS_PHY1_40_CLK=(&CLK_WCSS_TEST|0x014)
&CLK_TEST_WCSS_PHY1_80_CLK=(&CLK_WCSS_TEST|0x013)
&CLK_TEST_WCSS_PHY1_BW_CLK=(&CLK_WCSS_TEST|0x00E)
&CLK_TEST_WCSS_PHY1_BWX2_CLK=(&CLK_WCSS_TEST|0x00F)
&CLK_TEST_WCSS_PHY1_CLK=(&CLK_WCSS_TEST|0x011)
&CLK_TEST_WCSS_PHY1_DFS_CLK=(&CLK_WCSS_TEST|0x033)
&CLK_TEST_WCSS_PHY1_T240_CLK=(&CLK_WCSS_TEST|0x018)
&CLK_TEST_WCSS_PHY1_TADC_CLK=(&CLK_WCSS_TEST|0x017)
&CLK_TEST_WCSS_PHY1_TDAC_CLK=(&CLK_WCSS_TEST|0x016)
&CLK_TEST_WCSS_PHY1_X2_CLK=(&CLK_WCSS_TEST|0x010)
&CLK_TEST_WCSS_RFACTRL_PHY1_80_CLK=(&CLK_WCSS_TEST|0x03A)
&CLK_TEST_PHY1_11AC_RADIO_ADC_0_CLK=(&CLK_WCSS_TEST|0x02E)
&CLK_TEST_WCSS_RFACTRL_PHY1_11AC_RADIO_ADC_0_CLK=(&CLK_WCSS_TEST|0x03C)
&CLK_TEST_WCSS_PHY1_160_CLK=(&CLK_WCSS_TEST|0x012)
&CLK_TEST_WCSS_PHY1_20_CLK=(&CLK_WCSS_TEST|0x015)
&CLK_TEST_WCSS_PHY1_30_CLK=(&CLK_WCSS_TEST|0x019)
&CLK_TEST_WCSS_PHY1_320_CLK=(&CLK_WCSS_TEST|0x00D)
&CLK_TEST_WCSS_PHY1_40_CLK=(&CLK_WCSS_TEST|0x014)
&CLK_TEST_WCSS_PHY1_80_CLK=(&CLK_WCSS_TEST|0x013)
&CLK_TEST_WCSS_PHY1_BW_CLK=(&CLK_WCSS_TEST|0x00E)
&CLK_TEST_WCSS_PHY1_BWX2_CLK=(&CLK_WCSS_TEST|0x00F)
&CLK_TEST_WCSS_PHY1_CLK=(&CLK_WCSS_TEST|0x011)
&CLK_TEST_WCSS_PHY1_DFS_CLK=(&CLK_WCSS_TEST|0x033)
&CLK_TEST_WCSS_PHY1_T240_CLK=(&CLK_WCSS_TEST|0x018)
&CLK_TEST_WCSS_PHY1_TADC_CLK=(&CLK_WCSS_TEST|0x017)
&CLK_TEST_WCSS_PHY1_TDAC_CLK=(&CLK_WCSS_TEST|0x016)
&CLK_TEST_WCSS_PHY1_X2_CLK=(&CLK_WCSS_TEST|0x010)
&CLK_TEST_WCSS_RFACTRL_PHY1_80_CLK=(&CLK_WCSS_TEST|0x03A)
&CLK_TEST_WCSS_PHY2_160_CLK=(&CLK_WCSS_TEST|0x023)
&CLK_TEST_WCSS_PHY2_20_CLK=(&CLK_WCSS_TEST|0x026)
&CLK_TEST_WCSS_PHY2_30_CLK=(&CLK_WCSS_TEST|0x02A)
&CLK_TEST_WCSS_PHY2_320_CLK=(&CLK_WCSS_TEST|0x01E)
&CLK_TEST_WCSS_PHY2_40_CLK=(&CLK_WCSS_TEST|0x025)
&CLK_TEST_WCSS_PHY2_80_CLK=(&CLK_WCSS_TEST|0x024)
&CLK_TEST_WCSS_PHY2_BW_CLK=(&CLK_WCSS_TEST|0x01F)
&CLK_TEST_WCSS_PHY2_BWX2_CLK=(&CLK_WCSS_TEST|0x020)
&CLK_TEST_WCSS_PHY2_CLK=(&CLK_WCSS_TEST|0x022)
&CLK_TEST_WCSS_PHY2_DFS_CLK=(&CLK_WCSS_TEST|0x034)
&CLK_TEST_WCSS_PHY2_T240_CLK=(&CLK_WCSS_TEST|0x029)
&CLK_TEST_WCSS_PHY2_TADC_CLK=(&CLK_WCSS_TEST|0x028)
&CLK_TEST_WCSS_PHY2_TDAC_CLK=(&CLK_WCSS_TEST|0x027)
&CLK_TEST_WCSS_PHY2_X2_CLK=(&CLK_WCSS_TEST|0x021)
&CLK_TEST_WCSS_RFACTRL_PHY2_80_CLK=(&CLK_WCSS_TEST|0x03B)
&CLK_TEST_PHY2_11AC_RADIO_ADC_0_CLK=(&CLK_WCSS_TEST|0x030)
&CLK_TEST_WCSS_PHY2_160_CLK=(&CLK_WCSS_TEST|0x023)
&CLK_TEST_WCSS_PHY2_20_CLK=(&CLK_WCSS_TEST|0x026)
&CLK_TEST_WCSS_PHY2_30_CLK=(&CLK_WCSS_TEST|0x02A)
&CLK_TEST_WCSS_PHY2_320_CLK=(&CLK_WCSS_TEST|0x01E)
&CLK_TEST_WCSS_PHY2_40_CLK=(&CLK_WCSS_TEST|0x025)
&CLK_TEST_WCSS_PHY2_80_CLK=(&CLK_WCSS_TEST|0x024)
&CLK_TEST_WCSS_PHY2_BW_CLK=(&CLK_WCSS_TEST|0x01F)
&CLK_TEST_WCSS_PHY2_BWX2_CLK=(&CLK_WCSS_TEST|0x020)
&CLK_TEST_WCSS_PHY2_CLK=(&CLK_WCSS_TEST|0x022)
&CLK_TEST_WCSS_PHY2_DFS_CLK=(&CLK_WCSS_TEST|0x034)
&CLK_TEST_WCSS_PHY2_T240_CLK=(&CLK_WCSS_TEST|0x029)
&CLK_TEST_WCSS_PHY2_TADC_CLK=(&CLK_WCSS_TEST|0x028)
&CLK_TEST_WCSS_PHY2_TDAC_CLK=(&CLK_WCSS_TEST|0x027)
&CLK_TEST_WCSS_PHY2_X2_CLK=(&CLK_WCSS_TEST|0x021)
&CLK_TEST_WCSS_RFACTRL_PHY2_80_CLK=(&CLK_WCSS_TEST|0x03B)
&CLK_TEST_PHY1_11AC_RADIO_ADC_1_CLK=(&CLK_WCSS_TEST|0x02F)
&CLK_TEST_WCSS_RFACTRL_PHY1_11AC_RADIO_ADC_1_CLK=(&CLK_WCSS_TEST|0x03D)
&CLK_TEST_PHY2_11AC_RADIO_ADC_1_CLK=(&CLK_WCSS_TEST|0x031)
&CLK_TEST_WCSS_TOP_REF_CLK=(&CLK_WCSS_TEST|0x02C)
&CLK_TEST_WCSS_RFACTRL_CLK=(&CLK_WCSS_TEST|0x032)
&CLK_TEST_WCSS_TOP_SLP_CLK=(&CLK_WCSS_TEST|0x02B)
&CLK_TEST_WCSS_WMAC1_CSS_MAC_CLK=(&CLK_WCSS_TEST|0x00B)
&CLK_TEST_WCSS_WMAC1_MAC_CLK=(&CLK_WCSS_TEST|0x00C)
&CLK_TEST_WCSS_WMAC2_CSS_MAC_CLK=(&CLK_WCSS_TEST|0x01C)
&CLK_TEST_WCSS_WMAC2_MAC_CLK=(&CLK_WCSS_TEST|0x01D)
&CLK_TEST_WCSS_CSS_WSI_CLK=(&CLK_WCSS_TEST|0x02D)

;-----------------------------------------------------------------------------
; Init testclock
;-----------------------------------------------------------------------------

; Grab the entire launch command line.
local &launch_cmd_line
entry %LINE &launch_cmd_line

local &ARGS
&ARGS=os.ppd()
gosub __acquire_args_cmm &ARGS\..
entry &ARGS

local &AID
local &opts
local &create_area_param
local &success
local &testclock_main_window
local &testclock_main_area
local &log_output
local &log_filename
local &prev_clk_grp
local &input_filename
local &got_input_filename
local &arg
local &num_unread
local &prev_cmd_line
local &clk_err
local &help_use_same_window
local &tc_mode
local &area_exists
local &show_area

local &reset_window
&reset_window=0

&input_filename="c:\temp\testclock.txt"
&log_output=0
&prev_clk_grp=""
&prev_cmd_line=""

; Check if testclock was invoked in '__help_same_window__' mode.
&help_use_same_window=string.scan("&launch_cmd_line", "__help_same_window__", 0)
if (&help_use_same_window!=-1)
(
  &launch_cmd_line=string.replace("&launch_cmd_line", "__help_same_window__", "", 1.)
)

; Detect '__tc__' mode.
&tc_mode=string.scan("&launch_cmd_line", "__tc__", 0)
if (&tc_mode!=-1)
(
  &tc_mode=1
  &launch_cmd_line=string.replace("&launch_cmd_line", "__tc__", "", 1.)
)
else
(
  &tc_mode=0
)

; Clear any leftover help/history windows.
WINCLEAR testclock_help_window
WINCLEAR testclock_hist_window

; Check if a T32 area was given.
&testclock_main_area=string.ScanAndExtract("&launch_cmd_line", "super_script_area=", "_NF_")

; Create new areas.
&create_area_param="2 TESTCLOCK_HELP 130. 1000. TESTCLOCK_HIST , ,"
if ("&testclock_main_area"=="_NF_")
(
  &testclock_main_area="TESTCLOCK"

  &area_exists=1

  ;
  ; Allow 'tc' mode to avoid clearing the area ('area.create' clears areas if
  ; it is given row/col dimensions for the area buffer)
  ;
  if (&tc_mode!=0)
  (
    gosub wa_does_area_exist TESTCLOCK
    entry &area_exists
  )

  if ((&tc_mode==0)||(&area_exists==0))
  (
    &create_area_param="3 TESTCLOCK 180. 1000. TESTCLOCK_HELP 130. 1000. TESTCLOCK_HIST , ,"
  )
)
else
(
  ; Cut the 'super_script_area' argument out of the launch command line.
  &launch_cmd_line=string.replace("&launch_cmd_line", "super_script_area=&testclock_main_area", "", 1.)

  ; Create the given area if it doesn't already exist.
  gosub wa_does_area_exist &testclock_main_area
  entry &area_exists
  if (&area_exists==0)
  (
    &create_area_param="3 &testclock_main_area 180. 1000. TESTCLOCK_HELP 130. 1000. TESTCLOCK_HIST , ,"
  )
)

gosub wa_area_create_list &create_area_param
entry &success
if (&success==0)
(
  area.select
  print %ERROR "ERROR: Failed to create areas for testclock.cmm."
  enddo
)

; Check if a T32 window was given.
&testclock_main_window=string.ScanAndExtract("&launch_cmd_line", "super_script_window=", "_NF_")
if ("&testclock_main_window"=="_NF_")
(
  &testclock_main_window="testclock_main_window"
)
else
(
  ; Cut the 'super_script_window' argument out of the launch command line.
  &launch_cmd_line=string.replace("&launch_cmd_line", "super_script_window=&testclock_main_window", "", 1.)
)

; Create a new window if needed.
if (WIN.EXIST("&testclock_main_window")==FALSE())
(
  local &x_start
  local &y_start
  local &x_len
  local &y_len

  ; Check if there are previously saved window settings.
  gosub wa_find_saved_window_settings &testclock_main_window
  entry &x_start &y_start &x_len &y_len

  if (&x_start!=-1)
  (
    ; Use the previous window settings.
    winpos &x_start &y_start &x_len &y_len 0. 0. &testclock_main_window
  )
  else
  (
    gosub Default_WINPOS_Main
  )
)

; Check if a show-area option was given.
&show_area=string.ScanAndExtract("&launch_cmd_line", "show_area=", "_NF_")
if ("&show_area"=="_NF_")
(
  &show_area=1.
)
else
(
  ; Cut the 'show_area' argument out of the launch command line.
  &launch_cmd_line=string.replace("&launch_cmd_line", "show_area=&show_area", "", 1.)
)

area.select &testclock_main_area
if (&show_area==0.)
(
  ; Force an exit if the area is not shown, because no input prompt will appear.
  &launch_cmd_line="&launch_cmd_line x"
)
else
(
  area.view &testclock_main_area
)

; Initialize the argument bufferer with the launch command line.
do &ARGS create_client clk_drv &testclock_main_area &launch_cmd_line
entry &AID
if ("&AID"=="ARGS_ERR")
(
  do &ARGS get_error
  entry &clk_err

  print %ERROR "ERROR: Failed to create an ARGS client:"
  print %ERROR "       '&clk_err'."
  enddo
)

; Set bufferer options.
&opts="print_errors=1 help_cmd=? help_sub=Display_Help"
&opts="&opts hist_cmd=hist hist_sub=Display_Hist"
do &ARGS set_opts &AID &opts
entry &clk_err
if ("&clk_err"=="ARGS_ERR")
(
  do &ARGS get_error
  entry &clk_err

  print %ERROR "ERROR: Failed to set ARGS options:"
  print %ERROR "       '&clk_err'."

  enddo
)

; Set generic testclock error handler.
ON ERROR gosub
(
  print %ERROR "ERROR: Testclock error occurred:"
  print %ERROR "       Last command='&arg'. Last clock group='&clk'."
  return
)

; Print banner before entering main loop.
print " "
print "[-------------------- [&chipset_name] TEST CLOCK TOOL --------------------]"
print " "


;-----------------------------------------------------------------------------
; Argument handler main loop
;-----------------------------------------------------------------------------

Main_Loop:
(
  &clk_err=""

  ;
  ; Reset testclock argument handler state.
  ;
  &repeat_prev_cmd=0
  &header_printed=0
  &state_change=""
  &got_input_filename=0

  ;
  ; Get next command header arg.
  ;
  do &ARGS get_num_unread &AID
  entry &num_unread
  if (&num_unread==0)
  (
    local &line

    do &ARGS get_cmd_line &AID
    entry %LINE &line

    if (("&line"!=".")&&("&line"!=""))
    (
      &prev_cmd_line="&line"
    )

    ; If the history window is open, go ahead and update it.
    if (WIN.EXIST("testclock_hist_window")==TRUE())
    (
      gosub Display_Hist SKIP_VIEW
    )

    print " "
    print "[testclock.cmm] Version: <04/30/2015>"
  )

  do &ARGS get_arg &AID Enter command ('?' for help) >
  entry &arg

  gosub wa_save_window_settings testclock_hist_window
  gosub wa_save_window_settings &testclock_main_window

  ;
  ; Pre-process the command header arg.
  ;
  if (("&arg"==".")||("&arg"==""))
  (
    if ("&prev_cmd_line"=="")
    (
      print %ERROR "No previous command to repeat."
      goto Main_Loop
    )

    ; Prepare to repeat the previous command line.
    do &ARGS reset_cmd_line &AID &prev_cmd_line
    do &ARGS get_arg &AID
    entry &arg

    &repeat_prev_cmd=1
  )

  if (("&arg"=="on")||("&arg"=="off")||("&arg"=="set"))
  (
    ; Set state change command.
    &state_change="&arg"

    ; Check if a new clock selection is specified.
    do &ARGS get_num_unread &AID
    entry &num_unread
    if (&num_unread==0)
    (
      ; Use previous clock selection for state change operation.
      if ("&prev_clk_grp"=="")
      (
        print %ERROR "Command '&arg' failed. No clock(s) were previously selected."
        goto Handle_Args
      )
      &arg="&prev_clk_grp"
    )
    else
    (
      ; Extract new clock selection from buffered command line.
      do &ARGS get_arg &AID
      entry &arg
    )

    if ("&arg"=="file")
    (
      ; Check if a new clock file input is specified.
      do &ARGS get_num_unread &AID
      entry &num_unread
      if (&num_unread!=0)
      (
        ; Extract new clock file input from buffered command line.
        do &ARGS get_arg &AID
        entry &input_filename
      )

      ; Record that the file name is already known.
      &got_input_filename=1
    )
  )

  ;
  ; Execute the command operation.
  ;
  if ("&arg"=="x")
  (
    goto Exit_Testclock
  )
  else if ("&arg"=="wr")
  (
    &reset_window=1

    ; Reset the window size/position to default settings.
    winclear testclock_help_window
    winclear testclock_hist_window
    winclear &testclock_main_window

    gosub Default_WINPOS_Main

    if (&show_area!=0.)
    (
      area.view &testclock_main_area
    )
  )
  else if ("&arg"=="gpio")
  (
    gosub Configure_GPIO
  )
  else if ("&arg"=="log")
  (
    ; Check if output is already being logged.
    if (&log_output==0)
    (
      ; Output not currently logged--prompt user for new log file name
      local &filename
      do &ARGS get_arg &AID Enter log output file (default 'c:\temp\testclock_out.log') >
      entry &filename

      if ("&filename"=="close")
      (
        print %ERROR "No open output log to close."
      )
      else
      (
        if ("&filename"=="")
        (
          &log_filename="c:\temp\testclock_out.log"
        )
        else
        (
          &log_filename="&filename"
        )
        print "Logging testclock output to '&log_filename'."

        ; Open the output log file.
        (
          ON ERROR gosub
          (
            print %ERROR "ERROR: Failed to open clock output log '&log_filename'."
            &clk_err="failed_to_open_log_out"
            return
          )
          AREA.open &testclock_main_area &log_filename
        )

        if ("&clk_err"!="failed_to_open_log_out")
        (
          &log_output=1
        )
      )
    )
    else
    (
      local &log_arg

      do &ARGS get_arg &AID Stop logging output and close '&log_filename'? [close|n] >
      entry &log_arg

      if ("&log_arg"=="close")
      (
        AREA.close &testclock_main_area
        &log_output=0
        print "Closed '&log_filename' and stopped logging output."
      )
      else
      (
        print "Did not close the open output log '&log_filename'."
      )
    )
  )
  else if ("&arg"=="file")
  (
    local &input_line

    ; Get the input filename if necessary.
    if (&got_input_filename==0)
    (
      local &prompt_filename

      do &ARGS get_arg &AID Enter input file (default 'c:\temp\testclock.txt') >
      entry &prompt_filename

      if ("&prompt_filename"!="")
      (
        &input_filename="&prompt_filename"
      )
    )

    ; Open the clock input file
    (
      ON ERROR gosub
      (
        print %ERROR "ERROR: Failed to open clock list file '&input_filename'."
        &clk_err="failed_to_open_file_in"
        return
      )
      OPEN #1 &input_filename /Read
    )

    if ("&clk_err"!="failed_to_open_file_in")
    (
      print "Operating on list of clocks from '&input_filename'."

      READ #1 %line &input_line
      WHILE !EOF()
      (
        &input_line=string.trim("&input_line")
        if ("&input_line"!="")
        (
          gosub Find_Print_Clock &input_line
        )

        READ #1 %line &input_line
      )
      CLOSE #1
    )

    &prev_clk_grp="&arg"
  )
  else if (("&arg"=="all")||("&arg"=="all_on")||("&arg"=="all_off"))
  (
    &clk_state_filter="&arg"
    gosub Print_All
    &prev_clk_grp="&arg"
  )
  else
  (
    ; Assume argument is a clock group
    local &printed_ss_clock_info
    gosub Print_All_SS &arg
    entry &printed_ss_clock_info

    if (&printed_ss_clock_info==0)
    (
      ; Didn't match a SS clock group--attempt to operate on non-SS clock group
      gosub Find_Print_Clock &arg
    )

    &prev_clk_grp="&arg"
  )

  goto Main_Loop
)

;
; Sets up the default window position/size for the main window.
;
Default_WINPOS_Main:
(
  winpos 0. 0. 150. 100% 0. 0. &testclock_main_window
  return
)

;
; Sets up the default window position/size for the history window.
;
Default_WINPOS_Hist:
(
  winpos 155. 0. 50. 50% 0. 0. testclock_hist_window
  return
)

;-----------------------------------------------------------------------------
; Exit testclock
;-----------------------------------------------------------------------------

Exit_Testclock:
(
  local &num_unread &exit_arg

  winclear testclock_help_window

  if ((&tc_mode==0)||(&reset_window!=0))  ; skip saving a second time for 'tc' mode.
  (
    gosub wa_save_window_settings testclock_hist_window
    gosub wa_save_window_settings &testclock_main_window
  )

  ; Close the output log if needed.
  if (&log_output!=0)
  (
    area.close &testclock_main_area
  )

  winclear testclock_hist_window

  do &ARGS get_num_unread &AID
  entry &num_unread
  if (&num_unread>0.)
  (
    ; Don't hide the main window if the '.' exit option is given.
    do &ARGS get_arg &AID
    entry &exit_arg
    if ("&exit_arg"!=".")
    (
      winclear &testclock_main_window
    )
  )
  else
  (
    winclear &testclock_main_window
  )

  if (&show_area!=0.)
  (
    area.select
    print "Exited [&chipset_name] 'testclock.cmm'."
  )

  ; Return the clock frequency of the last measured clock (will be empty if
  ; no clock frequency was measured).
  enddo &clk_freq
)

;-----------------------------------------------------------------------------
; Display history
;-----------------------------------------------------------------------------

Display_Hist:
(
  local &skip_view
  entry &skip_view

  ; Display the help area if required.
  if ("&skip_view"=="")
  (
    if (WIN.EXIST("testclock_hist_window")==FALSE())
    (
      local &x_start
      local &y_start
      local &x_len
      local &y_len

      ; Check if there are previously saved window settings.
      gosub wa_find_saved_window_settings testclock_hist_window
      entry &x_start &y_start &x_len &y_len

      if (&x_start!=-1)
      (
        ; Use the previous window settings.
        winpos &x_start &y_start &x_len &y_len 0. 0. testclock_hist_window
      )
      else
      (
        gosub Default_WINPOS_Hist
      )
    )

    area.view TESTCLOCK_HIST
    wintop testclock_hist_window
  )

  area.clear TESTCLOCK_HIST
  area.select TESTCLOCK_HIST

  ; Print the history entries.
  print " "
  print "[--- [&chipset_name] testclock.cmm history: ---]"
  print " "
  do &ARGS print_hist &AID

  ; Switch back to the main demo window.
  area.select &testclock_main_area

  return
)

;-----------------------------------------------------------------------------
; Display help
;-----------------------------------------------------------------------------

Display_Help:
(
  ;-----------------------------------------------------------------------------
  ; Display available clock sources that can be output to the clock test output
  ; and prompt for selection.
  ;-----------------------------------------------------------------------------

  ; If the history window is open, go ahead and update it.
  if (WIN.EXIST("testclock_hist_window")==TRUE())
  (
    gosub Display_Hist SKIP_VIEW
  )

  if (&help_use_same_window==-1)
  (
    if (WIN.EXIST("testclock_help_window")==FALSE())
    (
      WINPOS , , , , , , testclock_help_window
    )

    area.view TESTCLOCK_HELP
    area.clear TESTCLOCK_HELP
    area.select TESTCLOCK_HELP

    winresize 130. 38.
  )

  print " "
  print " "
  gosub Print_Clock_Help
  print " "
  print " "

  print "Returns the frequency in MHz of the last measured clock if any clock freqeuncy was"
  print "measured, else returns nothing."
  print " "

  print "*** Launch Options ***"
  print " "
  print "  super_script_window=<name> - Specifies a T32 window to be used."
  print "  super_script_area=<name>   - Specifies a T32 area to be used."
  print "  show_area=<0|1>            - If zero, testclock's area is not displayed (1 by default)."
  print " "

  print "*** Commands ***"
  print " "
  print "  <clk_group>      - Print the status of a single clock or clock group."
  print "  on/off [clks]    - Modifies on/off state of clock(s). If a new clock group"
  print "                     isn't given, the previously selected clock group is used."

  ; TODO: actually support this or remove?
  ;print "  set         - sets the clock to one of supported frequencies"

  print "  gpio             - Enable GPIO's for clock output."
  print "  log <name|close> - Begin/end logging output to a file (closes upon 'x' exit)."
  print "  x [.]            - Exit [and leave the main window displayed]."
  print "  ?                - Display help message."
  print "  .                - Repeat previous command. Entering an empty line will also"
  print "                     repeat the previous command."
  print "  hist             - Display a testclock history window."
  print "  wr               - Reset the script window size/position."
  print " "

  print "*** Clock Groups ***"
  print " "
  print "  all          - All clocks."
  print "  all_on       - All clocks that are on."
  print "  all_off      - All clocks that are off."
  print "  <ss>_all     - All subsystem clocks."
  print "  <wildcard>   - Search query."
  print "  buses        - All bus clocks."
  print "  cpus         - All cpu clocks."
  print "  file <name>  - File specifying enumerated clocks (separated by newlines)."
  print "                 If a file name is not given, the previous input file is"
  print "                 used (default 'c:\temp\testclock.txt')."
  print " "

  area.select &testclock_main_area

  return
)



;;;;;;;;;;;;;;;;;;;;;;;;;;;;;;;;;;;;;;;;;;;;;;;;;;;;;;;;;;;;;;;;;;;;;;;;;;;;;;
;
; Lauterbach T32 "Window/Area" Utility Subs:
;
;   bool    wa_does_area_exist ( string area )
;
;   bool    wa_try_area_create ( string area, [int cols, int rows] )
;
;   bool    wa_area_create_list (
;             int num, [string area, int cols, int rows], ... )
;
;   string  wa_get_substr_ws ( string src_str, int read_idx )
;
;   int[4]  wa_extract_stored_win_dim ( string file_name, string window_name )
;
;   bool    wa_save_window_settings ( string window_name, [flag print_error] )
;
;   int[4]  wa_find_saved_window_settings ( string window_name )
;
;   bool    wa_delete_saved_window_settings (
;             string window_name, [flag print_error] )
;
;   bool    wa_delete_saved_window_settings_ext (
;             string window, string script, [flag print_error] )
;
;;;;;;;;;;;;;;;;;;;;;;;;;;;;;;;;;;;;;;;;;;;;;;;;;;;;;;;;;;;;;;;;;;;;;;;;;;;;;;

;
; bool wa_does_area_exist ( string area )
;
; Returns non-zero if the given area currently exists.
;
; SIDE EFFECTS:  Selects the tested area if it exists, or the default area.
;
wa_does_area_exist:
(
  local &area_name
  entry &area_name

  ON ERROR gosub
  (
    ; Clear the error message.
    area.select
    print " "

    &clk_err="!"
    return
  )

  &clk_err=""
  area.select &area_name

  if ("&clk_err"=="")
  (
    return 1
  )
  else
  (
    return 0
  )
)

;
; bool wa_try_area_create ( string area, [int cols, int rows] )
;
; Attempts to create an area (see 'area.create'). Returns non-zero if the 
; area is successfully created. If the 'area.create' operation fails, the
; caller may run 'area.reset' then re-try creating the area. The 'rows' and
; 'cols' arguments can be bypassed by omitting both.
;
; T32 has a maximum number of concurrent areas (only 10 at the time of
; writing this sub). Unfortunately these areas can only be deleted in bulk
; with the highly destructive 'area.reset' (although some T32 documentation
; incorrectly states that 'area.close <area_name>' destroys the area, it
; doesn't--it only closes the area's output logging).
;
; Furthermore, areas aren't destroyed automatically upon script exit, so
; if a user were to run multiple scripts with multiple areas they could
; quickly exhaust the 10-area limit and then find that subsequent script
; launches always fail, potentially with confusing error messages. This
; utility sub is intended to mitigate this risk without having to immidiately
; resort to running a global 'area.reset' during script initialization.
;
wa_try_area_create:
(
  local &area_name
  local &cols
  local &rows

  entry &area_name &cols &rows

  ON ERROR gosub
  (
    &clk_err="!"
    return
  )

  &clk_err=""
  area.create &area_name &cols &rows

  if ("&clk_err"=="")
  (
    return 1
  )
  else
  (
    return 0
  )
)

;
; bool wa_area_create_list ( int num, [string area, int cols, int rows], ... )
;
; Attempts to create a list of areas. Will run the global 'area.reset' command
; upon the first failure, and return 0 upon the second failure. Otherwise
; returns non-zero upon success.
;
wa_area_create_list:
(
  local &success
  local &already_failed
  local &area_name
  local &cols
  local &rows
  local &area_idx
  local &num
  local &input_line
  local &line_idx
  local &area_list_line_idx

  entry %LINE &input_line

  ; Get the number of areas to create.
  gosub wa_get_substr_ws "&input_line" 0.
  entry &num &area_list_line_idx
  if ("&num"=="")
  (
    print %ERROR "ERROR: wa_area_create_list() detected invalid input: '&input_line'."
    return 0
  )

  &already_failed=0

wa_area_create_list_process_areas:

  ; Create each area.
  &area_idx=0
  &line_idx=&area_list_line_idx
  while (&area_idx<&num)
  (
    ; Read in the area information.
    gosub wa_get_substr_ws "&input_line" &line_idx
    entry &area_name &line_idx
    if ("&area_name"=="")
    (
      goto wa_area_create_list_too_few_args
    )
    gosub wa_get_substr_ws "&input_line" &line_idx
    entry &cols &line_idx
    if ("&cols"=="")
    (
      goto wa_area_create_list_too_few_args
    )
    gosub wa_get_substr_ws "&input_line" &line_idx
    entry &rows &line_idx
    if ("&rows"=="")
    (
      goto wa_area_create_list_too_few_args
    )

    ; Check if the row/col argument was bypassed.
    if (("&cols"==",")||("&rows"==","))
    (
      ; Apply a sanity check for row/col bypass.
      if (("&cols"!=",")||("&rows"!=","))
      (
        print %ERROR "ERROR: wa_area_create_list() detected invalid row/col settings for '&area_name'."
        print %ERROR "       Row/col must both be an integer or both be ',' (got row='&row', col='&col'). "
        return 0
      )

      &cols=""
      &rows=""
    )

    ; Attempt to create the area.
    gosub wa_try_area_create &area_name &cols &rows
    entry &success

    if (&success==0)
    (
      ; Already failed => infinite impending failures.
      if (&already_failed!=0)
      (
        print %ERROR %Decimal "ERROR: wa_area_create_list() failed to create &num areas."
        return 0
      )

      ; Delete all areas and try creating the area list once more.
      &already_failed=1
      area.reset
      winclear
      goto wa_area_create_list_process_areas
    )

    &area_idx=&area_idx+1
  )

  return 1

wa_area_create_list_too_few_args:

  print %ERROR "ERROR: wa_area_create_list() detected too few arguments (num_areas='&num')."
  return 0
)

;
; string wa_get_substr_ws ( string src_str, int read_idx )
;
; Returns the next sub-string word from a source string, or nothing if there
; is no such word. The words are split by spaces.
;
; Example: <gosub args_get_next_substr_ws "a  bc  de" 1.>
;          Returns "bc 5" (sans quotes).
;
wa_get_substr_ws:
(
  local &src_str
  local &src_len
  local &read_idx
  local &sub_str
  local &start_idx

  entry &src_str &read_idx

  if (&read_idx<0)
  (
    ; Negative read index--return empty string (and no index).
    return
  )

  &src_len=string.length(&src_str)

  ; Find the start of non-whitespace segment.
  while (&read_idx<&src_len)
  (
    if (string.char(&src_str, &read_idx)!=' ')
    (
      &start_idx=&read_idx
      goto wa_get_substr_ws_find_end_idx
    )

    &read_idx=&read_idx+1
  )

  ; No non-whitespace found--return empty string (and no index).
  return

wa_get_substr_ws_find_end_idx:

  ; Find the end of non-whitespace segment.
  &read_idx=&read_idx+1
  while (&read_idx<&src_len)
  (
    if (string.char(&src_str, &read_idx)==' ')
    (
      ; Cut out leading and trailing whitespace
      &sub_str=string.mid(&src_str, &start_idx, &read_idx-&start_idx)

      goto wa_get_substr_ws_return_substr
    )

    &read_idx=&read_idx+1
  )

  ; No trailing white-space found--cut out any leading whitespace.
  &sub_str=string.cut(&src_str, &start_idx)

wa_get_substr_ws_return_substr:

  return &sub_str &read_idx
)

;
; int[2] wa_extract_stored_win_dim ( string file_name,  string window_name )
;
; Returns the settings for the given window extracted from a previously
; stored file. Returns -1 if the window settings aren't found.
;
; Returns: {x_start, y_start, x_length, y_length}
;          (all values are in row or column units).
;
wa_extract_stored_win_dim:
(
  local &window_name
  local &file_name
  local &x_start
  local &y_start
  local &x_len
  local &y_len
  local &line_in
  local &idx

  entry &file_name &window_name

  &x_start=-1
  &y_start=-1
  &y_len=-1
  &x_start=-1

  ; Open the input file.
  (
    &clk_err=""
    ON ERROR gosub
    (
      print %ERROR "ERROR: wa_extract_stored_win_dim() failed to open '&file_name'."
      &clk_err="!"
      return
    )
    OPEN #1 &file_name /Read
  )

  if ("&clk_err"!="")
  (
    goto wa_extract_stored_win_dim_error
  )

  ; Scan the input file for "winpos ... window_name".
  WHILE TRUE()
  (
    READ #1 %line &line_in
    if (EOF()==TRUE())
    (
      goto wa_extract_stored_win_dim_error
    )
    &line_in=string.lower("&line_in")

    ; Search for 'winpos' line header and cut it out if found.
    &idx=string.scan("&line_in", "winpos", 0)
    if (&idx!=-1)
    (
      &line_in=string.cut("&line_in", &idx+6.)

      ; Search for the specified window name.
      if (string.scan("&line_in", "&window_name", 0)!=-1)
      (
        ; Extract the specified window's settings.
        gosub wa_get_substr_ws "&line_in" 0.
        entry &x_start &idx
        if ("&x_start"=="")
        (
          goto wa_extract_stored_win_dim_error
        )
        gosub wa_get_substr_ws "&line_in" &idx
        entry &y_start &idx
        if ("&y_start"=="")
        (
          goto wa_extract_stored_win_dim_error
        )
        gosub wa_get_substr_ws "&line_in" &idx
        entry &x_len &idx
        if ("&x_len"=="")
        (
          goto wa_extract_stored_win_dim_error
        )
        gosub wa_get_substr_ws "&line_in" &idx
        entry &y_len &idx
        if ("&y_len"=="")
        (
          goto wa_extract_stored_win_dim_error
        )

        CLOSE #1
        return &x_start &y_start &x_len &y_len
      )
    )
  )

wa_extract_stored_win_dim_error:

  CLOSE #1
  return -1 -1 -1 -1
)

;
; bool wa_save_window_settings ( string window_name, [flag print_error] )
;
; Saves a script's window configuration (position + size).
; See restore_window_settings() for the restore operation.
; Returns non-zero if the store operation succeeded.
;
; This is provided as a method to allow scripts to save/restore their window
; settings accross multiple script sessions. T32's "store <file> win" tool
; is insufficient to do this since it will only save/restore *all* T32 windows,
; not targeted windows.
;
wa_save_window_settings:
(
  local &file
  local &window_name
  local &script_name
  local &extn_less_dim_fname
  local &print_error

  &clk_err=""
  ON ERROR gosub
  (
    &clk_err="!"
    return
  )

  entry &window_name &print_error

  ; Store the full window configuration in a file under the temporary directory.
  &script_name=os.ppf()
  &script_name=os.file.name("&script_name")
  &extn_less_dim_fname="__&(script_name)_&(window_name)_dim"
  &extn_less_dim_fname=string.replace("&extn_less_dim_fname", ".", "_", 0.)

  &file=os.ptd()
  &file="&(file)\&(extn_less_dim_fname).cmm"
  store &file win

  if ("&clk_err"=="")
  (
    return 1
  )
  else
  (
    if ("&print_error"!="")
    (
      print %ERROR "ERROR: wa_save_window_settings() failed to store settings for '&window_name'."
    )
    return 0
  )
)

;
; int[4] wa_find_saved_window_settings ( string window_name )
;
; Returns the settings for the given window extracted from a previously
; save. Returns -1 if the window settings aren't found.
;
; Returns: {x_start, y_start, x_length, y_length}
;          (all values are in row or column units).
;
; This is provided as a method to allow scripts to save/restore their window
; settings accross multiple script sessions. T32's "store <file> win" tool
; is insufficient to do this since it will only save/restore *all* T32 windows,
; not targeted windows.
;
wa_find_saved_window_settings:
(
  local &x_start
  local &y_start
  local &x_len
  local &y_len
  local &window_name
  local &file
  local &script_name
  local &extn_less_dim_fname
  local &first

  entry &window_name

  &script_name=os.ppf()
  &script_name=os.file.name("&script_name")
  &extn_less_dim_fname="__&(script_name)_&(window_name)_dim"
  &extn_less_dim_fname=string.replace("&extn_less_dim_fname", ".", "_", 0.)

  &first=0.
  (
    ON ERROR gosub
    (
      var.newglobal char \&extn_less_dim_fname
      &first=1.
      return
    )

    var.assign \&extn_less_dim_fname = 0
  )

  &file=os.ptd()
  &file="&(file)\&(extn_less_dim_fname).cmm"

  if (&first!=0.)
  (
    ;
    ; Don't attempt to restore on the first time--instead delete the save.
    ; This prevents issues where a new T32 session is opened in a smaller
    ; window but the launched script maintains its old oversize dimensions.
    ;
    (
      ON ERROR continue
      del &file
    )
    return -1 -1 -1 -1
  )

  if (os.file.access("&file", "R")==FALSE())
  (
    return -1 -1 -1 -1
  )

  ; Search for previously saved settings for this window.
  gosub wa_extract_stored_win_dim &file &window_name
  entry &x_start &y_start &x_len &y_len

  return &x_start &y_start &x_len &y_len
)

;
; bool wa_delete_saved_window_settings ( string window_name, [flag print_error] )
;
; Deletes a window settings file.
;
wa_delete_saved_window_settings:
(
  local &success
  local &file
  local &script_name
  local &window_name
  local &extn_less_dim_fname
  local &print_error

  entry &window_name &print_error

  ; Check if the window's saved settings file exists.
  &script_name=os.ppf()
  &script_name=os.file.name("&script_name")
  &extn_less_dim_fname="__&(script_name)_&(window_name)_dim"
  &extn_less_dim_fname=string.replace("&extn_less_dim_fname", ".", "_", 0.)

  &file=os.ptd()
  &file="&(file)\&(extn_less_dim_fname).cmm"
  if (os.file.access("&file", "W")==TRUE())
  (
    ; Delete the file.
    del &file
    &success=1
  )
  else
  (
    if ("&print_error"!="")
    (
      print %ERROR "ERROR: wa_delete_saved_window_settings() failed to delete window settings for '&window_name'."
    )
    &success=0
  )

  return &success
)

;
; bool wa_delete_saved_window_settings_ext ( string window, string script, [flag print_error] )
;
; Deletes a window settings file.
;
wa_delete_saved_window_settings_ext:
(
  local &success
  local &file
  local &script_name
  local &extn_less_dim_fname
  local &window_name
  local &print_error

  entry &window_name &script_name &print_error

  &extn_less_dim_fname="__&(script_name)_&(window_name)_dim"
  &extn_less_dim_fname=string.replace("&extn_less_dim_fname", ".", "_", 0.)

  &file=os.ptd()
  &file="&(file)\&(extn_less_dim_fname).cmm"
  if (os.file.access("&file", "W")==TRUE())
  (
    ; Delete the file.
    del &file
    &success=1
  )
  else
  (
    if ("&print_error"!="")
    (
      print %ERROR "ERROR: delete_saved_window_settings() failed to delete window settings for '&window_name'."
    )
    &success=0
  )

  return &success
)

;;;;;;;;;;;;; End of "Lauterbach T32 "Window/Area" Utility Subs" ;;;;;;;;;;;;;



;;;;;;;;;;;;;;;;;;;;;;;;;;;;;;;;;;;;;;;;;;;;;;;;;;;;;;;;;;;;;;;;;;;;;;;;;;;;;;
;
; Lauterbach T32 "ARGS Aquisition" Utility Subs:
;
;   string      __acquire_args_cmm ( string expected_args_dir )
;
;   int         __cmp_file_ts ( string path_a, string path_b )
;
;   int         __get_file_date_int ( string path, [flag ERR_FATAL] )
;
;   (int, int)  __str_get_next_dec_int ( int idx, string str_in)
;
;;;;;;;;;;;;;;;;;;;;;;;;;;;;;;;;;;;;;;;;;;;;;;;;;;;;;;;;;;;;;;;;;;;;;;;;;;;;;;

;
; string __acquire_args_cmm ( string expected_args_dir )
;
; Returns a path to an 'args.cmm' script.
;
; Aborts the scripts upon any failure.
;
__acquire_args_cmm:
(
  local &args_path
  local &server_args_path
  local &expected_args_dir

  entry &expected_args_dir

  ON ERROR gosub
  (
    area.select
    area.view
    print " "
    print %ERROR "Caught error in '__acquire_args_cmm'. Failed to fulfill 'args.cmm' dependency."
    enddo
  )

  &args_path="&expected_args_dir\args.cmm"

  ; Check if the expected 'args.cmm' file exists.
  if (os.file(&args_path)==FALSE())
  (
    ; The expected 'args.cmm' is missing. Attempt to copy it from the server.
    &server_args_path="\\ben\corebsp_labdata_0001\sysdrv\args\args.cmm"

    &args_path=os.ptd()
    &args_path="&args_path\__temp_args.cmm"

    ; Check if a local temp server copy already exists.
    if (os.file(&args_path)==FALSE())
    (
      ; The local temp copy does not exist--attempt to create it.
      if (os.file(&server_args_path)==FALSE())
      (
        area.select
        area.view
        print " "
        print %ERROR "ERROR: '&expected_args_dir\args.cmm', '&args_path\__temp_args.cmm' and"
        print %ERROR "       '&server_args_path' do not exist. Missing required 'args.cmm' file."
        enddo
      )
      if (os.file.access("&server_args_path", "R")==FALSE())
      (
        area.select
        area.view
        print " "
        print %ERROR "ERROR: '&expected_args_dir\args.cmm' and '&args_path\__temp_args.cmm' do not exist and"
        print %ERROR "       '&server_args_path' is not readable. Missing required 'args.cmm' file."
        enddo
      )

      copy &server_args_path &args_path
      if (os.file(&args_path)==FALSE())
      (
        ; Just try to use the server version if for some reason the copy to the
        ; T32 temp directory failed.
        &args_path="&server_args_path"
      )
    )
    else
    (
      ; The local temp 'args.cmm' exists. Check if it matches the server version.
      ; If the server version isn't found, the temp copy is used.
      if ((os.file(&server_args_path)==TRUE())&&(os.file.access("&server_args_path", "R")==TRUE()))
      (
        local &args_cmp_ret

        gosub __cmp_file_ts &server_args_path &args_path
        entry &args_cmp_ret

        if (&args_cmp_ret>0.)
        (
          ; The server copy is newer than the local temp copy--attempt to refresh.
          del &args_path
          copy &server_args_path &args_path

          if (os.file(&args_path)==FALSE())
          (
            ; Just try to use the server version if for some reason the copy to the
            ; T32 temp directory failed.
            &args_path="&server_args_path"
          )
        )
      )
    )
  )

  return &args_path
)

;
; int __cmp_file_ts ( string path_a, string path_b )
;
; Returns positive number if the first file is newer than the second file,
; else returns zero if the two files have identical timestamps, else returns
; a negative number. Assumes that both files exist.
;
; Aborts the scripts upon any failure.
;
__cmp_file_ts:
(
  local &path_a
  local &path_b

  entry &path_a &path_b

  gosub __get_file_date_int &path_a ERR_FATAL
  entry &path_a

  gosub __get_file_date_int &path_b ERR_FATAL
  entry &path_b

  &path_a=(&path_a-&path_b)
  return &path_a
)

;
; int __get_file_date_int ( string path, [flag ERR_FATAL] )
;
; Returns an integer representation of the given file's timestamp data string
; (see 'os.file.date()').
;
; Upon failure, if the 'ERR_FATAL' flag is given an error message is printed
; and the script is aborted, else -1 is returned.
;
; NOTES:  This subroutine is greatly complicated by the fact that (at the time
;         of its authoring) Lauterbach does not provide a way to obtain a
;         1971-based file time-stamp integer, instead only providing methods
;         get various file date strings of various formats which are not even
;         consistant with the given Lauterbach documentation!
;
__get_file_date_int:
(
  local &year
  local &month
  local &day
  local &date_int
  local &date_str
  local &hour_min_sec_am_pm_str
  local &get_file_date_int_err

  local &path
  local &err_fatal

  entry &path &err_fatal

  &get_file_date_int_err=""
  ON ERROR gosub
  (
    if ("&err_fatal"=="")
    (
      &get_file_date_int_err="!"
      return
    )
    else
    (
      ; Abort if fatal error flag was given.
      area.select
      area.view
      print " "
      print %ERROR "Caught fatal error in __get_file_date_int(), file = '&path'."
      enddo
    )
  )

  ;
  ; Don't use raw 'os.file.date()' as it's format doesn't match Lauterbach's
  ; documentation which indicates that it might be regionalized. Instead use a
  ; combination of the two date string formats, in order to get the AM/PM
  ; included in the time string, but with a more reliable "year/month/day"
  ; format for the date string.
  ;
  &hour_min_sec_am_pm_str=os.file.date(&path)
  gosub __str_get_next_dec_int 0. "&hour_min_sec_am_pm_str"
  entry &year &date_idx
  gosub __str_get_next_dec_int &date_idx "&hour_min_sec_am_pm_str"
  entry &year &date_idx
  gosub __str_get_next_dec_int &date_idx "&hour_min_sec_am_pm_str"
  entry &year &date_idx
  &hour_min_sec_am_pm_str=string.cut("&hour_min_sec_am_pm_str", &date_idx)
  &hour_min_sec_am_pm_str=string.trim("&hour_min_sec_am_pm_str")

  &date_str=os.file.date2(&path)
  &date_str="&date_str &hour_min_sec_am_pm_str"
  &date_str=string.trim("&date_str")

  if ("&get_file_date_int_err"=="")
  (
    ; Determine the 1971 year second-offset (assumes each month is <= 31 days).
    gosub __str_get_next_dec_int 0. "&date_str"
    entry &year &date_idx
    &date_int=((&year-1971.)*32140800.)

    if ("&get_file_date_int_err"=="")
    (
      ; Read the month (assumes each month is <= 31 days).
      gosub __str_get_next_dec_int &date_idx "&date_str"
      entry &month &date_idx
      &date_int=(&date_int+(&month*2678400.))

      if ("&get_file_date_int_err"=="")
      (
        ; Read the day.
        gosub __str_get_next_dec_int &date_idx "&date_str"
        entry &day &date_idx
        &date_int=(&date_int+(&day*86400.))

        if ("&get_file_date_int_err"=="")
        (
          ; Read the hour/minute/second/AM-PM.
          local &hour
          local &min
          local &sec
          local &am_pm_str
          gosub __str_get_next_dec_int &date_idx "&date_str"
          entry &hour &date_idx

          if ("&get_file_date_int_err"=="")
          (
            gosub __str_get_next_dec_int &date_idx "&date_str"
            entry &min &date_idx

            if ("&get_file_date_int_err"=="")
            (
              gosub __str_get_next_dec_int &date_idx "&date_str"
              entry &sec &date_idx

              if ("&get_file_date_int_err"=="")
              (
                &am_pm_str=string.cut("&date_str", &date_idx)
                &am_pm_str=string.trim("&am_pm_str")
                &am_pm_str=string.lower("&am_pm_str")
                if ("&am_pm_str"=="pm")
                (
                  &hour=(&hour+12.)
                )

                ; Calculate the final date integer and return it.
                &date_int=(&date_int+(&hour*3600.)+(&min*60.)+&sec)
                if ("&get_file_date_int_err"=="")
                (
                  return &date_int
                )
              )
            )
          )
        )
      )
    )
  )

  ; Otherwise return an error code.
  return -1.
)

;
; (int, int) __str_get_next_dec_int ( int idx, string str_in )
;
; Returns the next integer value extracted from the given string and start
; index along with the next string read index. The integer value is derived
; from the string's first digit sequence which is treated as a decimal
; formatted number. Returns an empty string if no such digit section is found.
;
; NOTES: The 'str_in' input should be wrapped in double quotes.
;
__str_get_next_dec_int:
(
  local &int_val
  local &int_start_idx
  local &char
  local &len

  local &idx
  local &str_in

  entry &idx &str_in

  &int_start_idx=""
  &char=1.
  while (&char>0.)
  (
    &char=string.char(&str_in, &idx)

    if ("&int_start_idx"=="")
    (
      if ((&char>='0')&&(&char<='9'))
      (
        &int_start_idx=&idx
      )
    )
    else
    (
      if ((&char<'0')||(&char>'9'))
      (
        &len=(&idx-&int_start_idx)
        &int_val=string.mid(&str_in, &int_start_idx, &len)
        &int_val="&(int_val)."
        &idx=(&idx+1.)

        return &int_val &idx
      )
    )

    &idx=&idx+1.
  )

  return ""
)

;;;;;;;;;;; End of "Lauterbach T32 "ARGS Aquisition" Utility Subs" ;;;;;;;;;;;


;-----------------------------------------------------------------------------
; Determine clock frequency.
;-----------------------------------------------------------------------------

Calc_Clock_Freq:

  local &l2cpucpselr_val
  local &l2cpucpcpdr_val

  ; Save current values
  &xo_div4_cbcr=data.long(&access_mode:&xo_div4_cbcr_addr)
  
  ; Measure a short run
  &tcxo_count=0x800
  
  ; Config XO DIV4 comparator clock
  data.set &access_mode:&xo_div4_cbcr_addr %LONG data.long(&access_mode:&xo_div4_cbcr_addr)|0x1
  
  ; Start with the counter disabled 
  &measure_ctl=data.long(&access_mode:&frq_measure_ctl_addr)
  &measure_ctl=&measure_ctl&~0x1FFFFF
  data.set &access_mode:&frq_measure_ctl_addr %LONG &measure_ctl
  
  ; Program the starting counter value, high enough to get good accuracy
  &measure_ctl=&measure_ctl|&tcxo_count
  
  ; Start the counting
  &measure_ctl=&measure_ctl|0x100000
  data.set &access_mode:&frq_measure_ctl_addr %LONG &measure_ctl
  
  ; Wait for the counters to finish
  wait 1.ms
  while (data.long(&access_mode:&frq_measure_status_addr)&0x2000000)==0
  (
  )
  
  ; Turn off the test clock and read the clock count
  &measure_ctl=data.long(&access_mode:&frq_measure_ctl_addr)
  data.set &access_mode:&frq_measure_ctl_addr %LONG (&measure_ctl&~0x100000)
  
  &short_clock_count=data.long(&access_mode:&frq_measure_status_addr)&0x1FFFFFF
  
  ; Restore the registers
  data.set &access_mode:&xo_div4_cbcr_addr %LONG &xo_div4_cbcr
 
  ; Now do a longer count and compare
  ; Save current values
  &xo_div4_cbcr=data.long(&access_mode:&xo_div4_cbcr_addr)
  
  &tcxo_count=0x8000
  
  ; Config XO DIV4 comparator clock
  data.set &access_mode:&xo_div4_cbcr_addr %LONG data.long(&access_mode:&xo_div4_cbcr_addr)|0x1
  
  ; Start with the counter disabled 
  &measure_ctl=data.long(&access_mode:&frq_measure_ctl_addr)
  &measure_ctl=&measure_ctl&~0x1FFFFF
  data.set &access_mode:&frq_measure_ctl_addr %LONG &measure_ctl
  
  ; Program the starting counter value, high enough to get good accuracy
  &measure_ctl=&measure_ctl|&tcxo_count
  
  ; Start the counting
  &measure_ctl=&measure_ctl|0x100000
  data.set &access_mode:&frq_measure_ctl_addr %LONG &measure_ctl
  
  ; Wait for the counters to finish
  wait 1.ms
  while (data.long(&access_mode:&frq_measure_status_addr)&0x2000000)==0
  (
  )
  
  ; Turn off the test clock and read the clock count
  &measure_ctl=data.long(&access_mode:&frq_measure_ctl_addr)
  data.set &access_mode:&frq_measure_ctl_addr %LONG (&measure_ctl&~0x100000)
  
  &clock_count=data.long(&access_mode:&frq_measure_status_addr)&0x1FFFFFF
  
  ; Calculate the frequency.  Function is provided by
  ; Power Control 42.8.1.2 Measurement technique
  ; f ring = f tcxo/4 * (Nring + 1.5) / (TCtcxo + 3.5)
  ;
  ; The formula below is the equivalent one converted
  ; to integer arithmetic.
  ; 
  ; We add half of the denominator value to the dividend
  ; to guard against rounding errors inherent to
  ; integer arithmetic.
  ;
  
  if &clock_count==&short_clock_count
  (
    &clk_freq=0
  )
  else
  (
    &clk_freq=4.8*(&clock_count+1.5)/(&tcxo_count+3.5)
  )
  
  ; Restore the registers
  data.set &access_mode:&xo_div4_cbcr_addr %LONG &xo_div4_cbcr

  return




PRINT_SET_CLOCK_FREQ_WARNING:

  print " "
  print "Warning: This feature is in beta and does not account for voltage requirements. Clock driver state will be out of sync."
  print " "

  return



;-----------------------------------------------------------------------------
; Set clock frequency.
;-----------------------------------------------------------------------------

Set_Clock_Freq:

  ; Use testpll.cmm to turn on required source
  do testpll.cmm on &clk_src_name

  ; Convert src divider to appropriate register value
  if (&clk_src_div!=0)
  (
    &clk_src_div=&clk_src_div-1
  )

  ; Read current cmd_rcgr and cfg_rcgr values
  &clk_cmd_rcgr_val=data.long(&access_mode:&clk_cmd_rcgr_addr)
  &clk_cfg_rcgr_val=data.long(&access_mode:&clk_cfg_rcgr_addr)

  ; Clear src_sel, src_div, and mode fields
  &clk_cfg_rcgr_val=&clk_cfg_rcgr_val&~(&HAL_CLK_CFG_CGR_SRC_SEL_FMSK|&HAL_CLK_CFG_CGR_SRC_DIV_FMSK|&HAL_CLK_CFG_CGR_MODE_FMSK)

  ; Program src_sel and src_div
  &clk_cfg_rcgr_val=&clk_cfg_rcgr_val|((&clk_src_sel<<&HAL_CLK_CFG_CGR_SRC_SEL_SHFT)&(&HAL_CLK_CFG_CGR_SRC_SEL_FMSK))
  &clk_cfg_rcgr_val=&clk_cfg_rcgr_val|((&clk_src_div<<&HAL_CLK_CFG_CGR_SRC_DIV_SHFT)&(&HAL_CLK_CFG_CGR_SRC_DIV_FMSK))

  ; Program M, N, D registers if necessary
  if (&clk_m_val!=0.)&&(&clk_m_val<&clk_n_val)
  (
    &clk_m_addr=&clk_cmd_rcgr_addr+&HAL_CLK_M_REG_OFFSET
    &clk_n_addr=&clk_cmd_rcgr_addr+&HAL_CLK_N_REG_OFFSET
    &clk_2d_addr=&clk_cmd_rcgr_addr+&HAL_CLK_D_REG_OFFSET

    ; Write to M register
    data.set &access_mode:&clk_m_addr %long &clk_m_val
    
    ; Write to N register
    data.set &access_mode:&clk_n_addr %long ~(&clk_n_val-&clk_m_val)
    
    ; Write to D register
    data.set &access_mode:&clk_2d_addr %long ~&clk_2d_val
    
    ; Dual edge mode
    &clk_cfg_rcgr_val=&clk_cfg_rcgr_val|((&HAL_CLK_CFG_CFG_DUAL_EDGE_MODE_VAL<<&HAL_CLK_CFG_CGR_MODE_SHFT)&(&HAL_CLK_CFG_CGR_MODE_FMSK))
  )
  
  ; Write to cfg_rcgr
  data.set &access_mode:&clk_cfg_rcgr_addr %long &clk_cfg_rcgr_val

  ; Write to cmd_rcgr to trigger update
  data.set &access_mode:&clk_cmd_rcgr_addr %long (&clk_cmd_rcgr_val|&HAL_CLK_CMD_CFG_UPDATE_FMSK)

  ; Wait for update to finish
  wait 1.ms
  while (data.long(&access_mode:&clk_cmd_rcgr_addr)&(&HAL_CLK_CMD_CFG_UPDATE_FMSK))!=0
  (
  )

  return




;-----------------------------------------------------------------------------
; Display clock info header
;-----------------------------------------------------------------------------

Print_Header:

  if &header_printed==0
  (
    print " "
    print "Clock                                      State      Frequency (MHz)         CBCR Addr : Value        CBCR Type "
    print "---------------------------------------------------------------------------------------------------------------- "

    &header_printed=1
  )

  return




;-----------------------------------------------------------------------------
; Display clock info line
;-----------------------------------------------------------------------------

Print_Clk_Info_Line:
(
  local &is_on &clk_reg_val &clk_reg_val_str &on_reg &on_mask &clk_freq_str

  ;-----------------------------------------------------------------------------
  ; Toggle clock state if requested
  ;-----------------------------------------------------------------------------
  if (&clk_reg!=0)
  (
    if &clk_vote_bit!=-1.
    (
      &vote_idx=&clk_vote_bit/32.
      &on_reg=v.value(\vote_regs[&vote_idx])
      &on_mask=(1<<(&clk_vote_bit-(32.*&vote_idx)))
    )
    else
    (
      &on_reg="&clk_reg"
      &on_mask=0x1
    )

    if "&state_change"=="on"
    (
      data.set &access_mode:&on_reg %LONG (data.long(&access_mode:&on_reg)|&on_mask)
    )
    else if "&state_change"=="off"
    (
      data.set &access_mode:&on_reg %LONG (data.long(&access_mode:&on_reg)&~(&on_mask))
    )
  )

  if "&state_change"=="set"
  (
    gosub Set_Clock_Freq_Enter
  )

  ;-----------------------------------------------------------------------------
  ; Print the clock header
  ;-----------------------------------------------------------------------------
  gosub Print_Header

  ;-----------------------------------------------------------------------------
  ; Test if clock is on
  ;-----------------------------------------------------------------------------
  
  if (&clk_reg!=0)
  (
    if (data.long(&access_mode:&clk_reg)&(0x80000000))==0x0
    (
      &clk_state="ON "
      &is_on=1
    )
    else
    (
      &clk_state="OFF"
      &clk_freq=0
      &is_on=0
    )
  )
  else
  (
    &clk_state=" ? " 
    &is_on=-1
  )
  
  ;-----------------------------------------------------------------------------
  ; Calculate the clock frequency based on the TCXO counter
  ;-----------------------------------------------------------------------------

  if (&clk_test!=0)&&((&is_on==1)||(&is_on==-1))
  (
    gosub Program_Clk_Test

    ; Set dividers before calculation to ensure clock is within range of
    ; the frequency counter. Clear dividers after calculation so they
    ; don't affect frequency when probing with a scope.
    gosub Set_Dividers
    gosub Calc_Clock_Freq
    gosub Clear_Dividers

    if (&clk_freq==0)
    (
      &clk_freq_str=FORMAT.DECIMAL(14., 0x0)
    )
    else
    (
      &clk_freq=&clk_freq*&clk_multiplier
      &clk_freq_str=FORMAT.FLOAT(12., 0x6, &clk_freq) 
    )

    if (&is_on==-1)
    (
      if (&clk_freq==0)
      (
        &is_on=0
      )
      else
      (
        &is_on=1
      )
    )
  )
  else if (&is_on==0)
  (
    &clk_freq_str=FORMAT.DECIMAL(14., 0x0)
  )
  else
  (
    &clk_freq_str="  Not Testable"
  )
  
  if ((("&clk_state_filter"=="all_on")&&(&is_on==0))||(("&clk_state_filter"=="all_off")&&(&is_on==1)))
  (
    return
  )

  if (&clk_reg!=0)
  (
    &clk_reg_val=FORMAT.HEX(0x8, data.long(&access_mode:&clk_reg))
    &clk_reg_val_str="0x&clk_reg_val"
    
    &clk_reg=FORMAT.HEX(0x8, &clk_reg)
    &clk_reg_str="0x&clk_reg"
  )
  else
  (
    &clk_reg_str="----------" 
    &clk_reg_val_str="----------"
  )

  ; Format clock name width

  &left_width="                                           "
  &padding=STRING.CUT("&left_width", STRING.LEN("&clk_name"))

  print "&clk_name&padding &clk_state       &clk_freq_str         &clk_reg_str : &clk_reg_val_str   &clk_reg_cbcr_type"

  return
)



;-----------------------------------------------------------------------------
; Program the clk_test register
;-----------------------------------------------------------------------------

Program_Clk_Test:

  &testval=&clk_test&(&CLK_TEST_TYPE_MASK)
  &selval=&clk_test&(&CLK_TEST_SEL_MASK)

  ; APCS
  if &selval==&CLK_APCS_TEST
  (

    
    &apcs_alias0_glb_clk_diag_reg=&HWIO_APCS_ALIAS0_GLB_CLK_DIAG_ADDR
    &apcs_alias0_glb_clk_diag_val=(data.long(&access_mode:&apcs_alias0_glb_clk_diag_reg)&~0xffffffff)|(0x0&0xffffffff)
    &apcs_alias0_glb_clk_diag_val=&apcs_alias0_glb_clk_diag_val&~(0x37300<<8.)
    data.set &access_mode:&apcs_alias0_glb_clk_diag_reg %LONG &apcs_alias0_glb_clk_diag_val&~0x37300|((&testval<<8.)&0x37300)

    
    &gcc_gcc_debug_clk_ctl_reg=&HWIO_GCC_GCC_DEBUG_CLK_CTL_ADDR
    &gcc_gcc_debug_clk_ctl_val=(data.long(&access_mode:&gcc_gcc_debug_clk_ctl_reg)&~0xffffffff)|(0x10000&0xffffffff)
    &gcc_gcc_debug_clk_ctl_val=&gcc_gcc_debug_clk_ctl_val&~(0x3ff<<0.)
    data.set &access_mode:&gcc_gcc_debug_clk_ctl_reg %LONG &gcc_gcc_debug_clk_ctl_val&~0x3ff|((0xc0<<0.)&0x3ff)



    ; Frequency counter utility registers.
    &frq_measure_ctl_addr=&HWIO_GCC_CLOCK_FRQ_MEASURE_CTL_ADDR
    &frq_measure_status_addr=&HWIO_GCC_CLOCK_FRQ_MEASURE_STATUS_ADDR
    &xo_div4_cbcr_addr=&HWIO_GCC_GCC_XO_DIV4_CBCR_ADDR

  )

  ; GCC
  else if &selval==&CLK_GCC_TEST
  (

    
    &gcc_gcc_debug_clk_ctl_reg=&HWIO_GCC_GCC_DEBUG_CLK_CTL_ADDR
    &gcc_gcc_debug_clk_ctl_val=(data.long(&access_mode:&gcc_gcc_debug_clk_ctl_reg)&~0xffffffff)|(0x10000&0xffffffff)
    &gcc_gcc_debug_clk_ctl_val=&gcc_gcc_debug_clk_ctl_val&~(0x3ff<<0.)
    data.set &access_mode:&gcc_gcc_debug_clk_ctl_reg %LONG &gcc_gcc_debug_clk_ctl_val&~0x3ff|((&testval<<0.)&0x3ff)



    ; Frequency counter utility registers.
    &frq_measure_ctl_addr=&HWIO_GCC_CLOCK_FRQ_MEASURE_CTL_ADDR
    &frq_measure_status_addr=&HWIO_GCC_CLOCK_FRQ_MEASURE_STATUS_ADDR
    &xo_div4_cbcr_addr=&HWIO_GCC_GCC_XO_DIV4_CBCR_ADDR

  )

  ; GPU
  else if &selval==&CLK_GPU_TEST
  (

    
    &gpucc_debug_clk_ctl_reg=&HWIO_GPUCC_DEBUG_CLK_CTL_ADDR
    &gpucc_debug_clk_ctl_val=(data.long(&access_mode:&gpucc_debug_clk_ctl_reg)&~0xffffffff)|(0x50600&0xffffffff)
    &gpucc_debug_clk_ctl_val=&gpucc_debug_clk_ctl_val&~(0xf<<0.)
    data.set &access_mode:&gpucc_debug_clk_ctl_reg %LONG &gpucc_debug_clk_ctl_val&~0xf|((&testval<<0.)&0xf)

    
    &gcc_gcc_debug_clk_ctl_reg=&HWIO_GCC_GCC_DEBUG_CLK_CTL_ADDR
    &gcc_gcc_debug_clk_ctl_val=(data.long(&access_mode:&gcc_gcc_debug_clk_ctl_reg)&~0xffffffff)|(0x10000&0xffffffff)
    &gcc_gcc_debug_clk_ctl_val=&gcc_gcc_debug_clk_ctl_val&~(0x3ff<<0.)
    data.set &access_mode:&gcc_gcc_debug_clk_ctl_reg %LONG &gcc_gcc_debug_clk_ctl_val&~0x3ff|((0x13d<<0.)&0x3ff)



    ; Frequency counter utility registers.
    &frq_measure_ctl_addr=&HWIO_GCC_CLOCK_FRQ_MEASURE_CTL_ADDR
    &frq_measure_status_addr=&HWIO_GCC_CLOCK_FRQ_MEASURE_STATUS_ADDR
    &xo_div4_cbcr_addr=&HWIO_GCC_GCC_XO_DIV4_CBCR_ADDR

  )

  ; LPASS
  else if &selval==&CLK_LPASS_TEST
  (

    
    &lpass_dbg_clk_reg=&HWIO_LPASS_DBG_CLK_ADDR
    &lpass_dbg_clk_val=(data.long(&access_mode:&lpass_dbg_clk_reg)&~0xffffffff)|(0x100000&0xffffffff)
    &lpass_dbg_clk_val=&lpass_dbg_clk_val&~(0xffff<<0.)
    data.set &access_mode:&lpass_dbg_clk_reg %LONG &lpass_dbg_clk_val&~0xffff|((&testval<<0.)&0xffff)

    
    &gcc_gcc_debug_clk_ctl_reg=&HWIO_GCC_GCC_DEBUG_CLK_CTL_ADDR
    &gcc_gcc_debug_clk_ctl_val=(data.long(&access_mode:&gcc_gcc_debug_clk_ctl_reg)&~0xffffffff)|(0x10000&0xffffffff)
    &gcc_gcc_debug_clk_ctl_val=&gcc_gcc_debug_clk_ctl_val&~(0x3ff<<0.)
    data.set &access_mode:&gcc_gcc_debug_clk_ctl_reg %LONG &gcc_gcc_debug_clk_ctl_val&~0x3ff|((0xb9<<0.)&0x3ff)



    ; Frequency counter utility registers.
    &frq_measure_ctl_addr=&HWIO_GCC_CLOCK_FRQ_MEASURE_CTL_ADDR
    &frq_measure_status_addr=&HWIO_GCC_CLOCK_FRQ_MEASURE_STATUS_ADDR
    &xo_div4_cbcr_addr=&HWIO_GCC_GCC_XO_DIV4_CBCR_ADDR

  )

  ; LPASS_Q6
  else if &selval==&CLK_LPASS_Q6_TEST
  (

    
    &lpass_qdsp6ss_test_clk_ctl_reg=&HWIO_LPASS_QDSP6SS_TEST_CLK_CTL_ADDR
    &lpass_qdsp6ss_test_clk_ctl_val=(data.long(&access_mode:&lpass_qdsp6ss_test_clk_ctl_reg)&~0xffffffff)|(0x40&0xffffffff)
    &lpass_qdsp6ss_test_clk_ctl_val=&lpass_qdsp6ss_test_clk_ctl_val&~(0x1f<<0.)
    data.set &access_mode:&lpass_qdsp6ss_test_clk_ctl_reg %LONG &lpass_qdsp6ss_test_clk_ctl_val&~0x1f|((&testval<<0.)&0x1f)

    
    &lpass_dbg_clk_reg=&HWIO_LPASS_DBG_CLK_ADDR
    &lpass_dbg_clk_val=(data.long(&access_mode:&lpass_dbg_clk_reg)&~0xffffffff)|(0x100000&0xffffffff)
    &lpass_dbg_clk_val=&lpass_dbg_clk_val&~(0xffff<<0.)
    data.set &access_mode:&lpass_dbg_clk_reg %LONG &lpass_dbg_clk_val&~0xffff|((0x1<<0.)&0xffff)

    
    &gcc_gcc_debug_clk_ctl_reg=&HWIO_GCC_GCC_DEBUG_CLK_CTL_ADDR
    &gcc_gcc_debug_clk_ctl_val=(data.long(&access_mode:&gcc_gcc_debug_clk_ctl_reg)&~0xffffffff)|(0x10000&0xffffffff)
    &gcc_gcc_debug_clk_ctl_val=&gcc_gcc_debug_clk_ctl_val&~(0x3ff<<0.)
    data.set &access_mode:&gcc_gcc_debug_clk_ctl_reg %LONG &gcc_gcc_debug_clk_ctl_val&~0x3ff|((0xb9<<0.)&0x3ff)



    ; Frequency counter utility registers.
    &frq_measure_ctl_addr=&HWIO_GCC_CLOCK_FRQ_MEASURE_CTL_ADDR
    &frq_measure_status_addr=&HWIO_GCC_CLOCK_FRQ_MEASURE_STATUS_ADDR
    &xo_div4_cbcr_addr=&HWIO_GCC_GCC_XO_DIV4_CBCR_ADDR

  )

  ; MMSS
  else if &selval==&CLK_MMSS_TEST
  (

    
    &mmss_debug_clk_ctl_reg=&HWIO_MMSS_DEBUG_CLK_CTL_ADDR
    &mmss_debug_clk_ctl_val=(data.long(&access_mode:&mmss_debug_clk_ctl_reg)&~0xffffffff)|(0x56000&0xffffffff)
    &mmss_debug_clk_ctl_val=&mmss_debug_clk_ctl_val&~(0xfff<<0.)
    data.set &access_mode:&mmss_debug_clk_ctl_reg %LONG &mmss_debug_clk_ctl_val&~0xfff|((&testval<<0.)&0xfff)

    
    &gcc_gcc_debug_clk_ctl_reg=&HWIO_GCC_GCC_DEBUG_CLK_CTL_ADDR
    &gcc_gcc_debug_clk_ctl_val=(data.long(&access_mode:&gcc_gcc_debug_clk_ctl_reg)&~0xffffffff)|(0x10000&0xffffffff)
    &gcc_gcc_debug_clk_ctl_val=&gcc_gcc_debug_clk_ctl_val&~(0x3ff<<0.)
    data.set &access_mode:&gcc_gcc_debug_clk_ctl_reg %LONG &gcc_gcc_debug_clk_ctl_val&~0x3ff|((0x22<<0.)&0x3ff)



    ; Frequency counter utility registers.
    &frq_measure_ctl_addr=&HWIO_GCC_CLOCK_FRQ_MEASURE_CTL_ADDR
    &frq_measure_status_addr=&HWIO_GCC_CLOCK_FRQ_MEASURE_STATUS_ADDR
    &xo_div4_cbcr_addr=&HWIO_GCC_GCC_XO_DIV4_CBCR_ADDR

  )

  ; MSS
  else if &selval==&CLK_MSS_TEST
  (

    
    &mss_debug_clock_ctl_reg=&HWIO_MSS_DEBUG_CLOCK_CTL_ADDR
    &mss_debug_clock_ctl_val=(data.long(&access_mode:&mss_debug_clock_ctl_reg)&~0xffffffff)|(0x0&0xffffffff)
    &mss_debug_clock_ctl_val=&mss_debug_clock_ctl_val&~(0x7ff<<0.)
    data.set &access_mode:&mss_debug_clock_ctl_reg %LONG &mss_debug_clock_ctl_val&~0x7ff|((&testval<<0.)&0x7ff)

    
    &gcc_gcc_debug_clk_ctl_reg=&HWIO_GCC_GCC_DEBUG_CLK_CTL_ADDR
    &gcc_gcc_debug_clk_ctl_val=(data.long(&access_mode:&gcc_gcc_debug_clk_ctl_reg)&~0xffffffff)|(0x10000&0xffffffff)
    &gcc_gcc_debug_clk_ctl_val=&gcc_gcc_debug_clk_ctl_val&~(0x3ff<<0.)
    data.set &access_mode:&gcc_gcc_debug_clk_ctl_reg %LONG &gcc_gcc_debug_clk_ctl_val&~0x3ff|((0x125<<0.)&0x3ff)



    ; Frequency counter utility registers.
    &frq_measure_ctl_addr=&HWIO_GCC_CLOCK_FRQ_MEASURE_CTL_ADDR
    &frq_measure_status_addr=&HWIO_GCC_CLOCK_FRQ_MEASURE_STATUS_ADDR
    &xo_div4_cbcr_addr=&HWIO_GCC_GCC_XO_DIV4_CBCR_ADDR

  )

  ; MSS_Q6
  else if &selval==&CLK_MSS_Q6_TEST
  (

    
    &mss_qdsp6ss_test_clk_ctl_reg=&HWIO_MSS_QDSP6SS_TEST_CLK_CTL_ADDR
    &mss_qdsp6ss_test_clk_ctl_val=(data.long(&access_mode:&mss_qdsp6ss_test_clk_ctl_reg)&~0xffffffff)|(0x40&0xffffffff)
    &mss_qdsp6ss_test_clk_ctl_val=&mss_qdsp6ss_test_clk_ctl_val&~(0x1f<<0.)
    data.set &access_mode:&mss_qdsp6ss_test_clk_ctl_reg %LONG &mss_qdsp6ss_test_clk_ctl_val&~0x1f|((&testval<<0.)&0x1f)

    
    &mss_debug_clock_ctl_reg=&HWIO_MSS_DEBUG_CLOCK_CTL_ADDR
    &mss_debug_clock_ctl_val=(data.long(&access_mode:&mss_debug_clock_ctl_reg)&~0xffffffff)|(0x0&0xffffffff)
    &mss_debug_clock_ctl_val=&mss_debug_clock_ctl_val&~(0x7ff<<0.)
    data.set &access_mode:&mss_debug_clock_ctl_reg %LONG &mss_debug_clock_ctl_val&~0x7ff|((0x69<<0.)&0x7ff)

    
    &gcc_gcc_debug_clk_ctl_reg=&HWIO_GCC_GCC_DEBUG_CLK_CTL_ADDR
    &gcc_gcc_debug_clk_ctl_val=(data.long(&access_mode:&gcc_gcc_debug_clk_ctl_reg)&~0xffffffff)|(0x10000&0xffffffff)
    &gcc_gcc_debug_clk_ctl_val=&gcc_gcc_debug_clk_ctl_val&~(0x3ff<<0.)
    data.set &access_mode:&gcc_gcc_debug_clk_ctl_reg %LONG &gcc_gcc_debug_clk_ctl_val&~0x3ff|((0x125<<0.)&0x3ff)



    ; Frequency counter utility registers.
    &frq_measure_ctl_addr=&HWIO_GCC_CLOCK_FRQ_MEASURE_CTL_ADDR
    &frq_measure_status_addr=&HWIO_GCC_CLOCK_FRQ_MEASURE_STATUS_ADDR
    &xo_div4_cbcr_addr=&HWIO_GCC_GCC_XO_DIV4_CBCR_ADDR

  )

  ; SSC
  else if &selval==&CLK_SSC_TEST
  (

    
    &ssc_scc_scc_debug_clk_ctl_reg=&HWIO_SSC_SCC_SCC_DEBUG_CLK_CTL_ADDR
    &ssc_scc_scc_debug_clk_ctl_val=(data.long(&access_mode:&ssc_scc_scc_debug_clk_ctl_reg)&~0xffffffff)|(0x1&0xffffffff)
    &ssc_scc_scc_debug_clk_ctl_val=&ssc_scc_scc_debug_clk_ctl_val&~(0x7e<<1.)
    data.set &access_mode:&ssc_scc_scc_debug_clk_ctl_reg %LONG &ssc_scc_scc_debug_clk_ctl_val&~0x7e|((&testval<<1.)&0x7e)

    
    &gcc_gcc_debug_clk_ctl_reg=&HWIO_GCC_GCC_DEBUG_CLK_CTL_ADDR
    &gcc_gcc_debug_clk_ctl_val=(data.long(&access_mode:&gcc_gcc_debug_clk_ctl_reg)&~0xffffffff)|(0x10000&0xffffffff)
    &gcc_gcc_debug_clk_ctl_val=&gcc_gcc_debug_clk_ctl_val&~(0x3ff<<0.)
    data.set &access_mode:&gcc_gcc_debug_clk_ctl_reg %LONG &gcc_gcc_debug_clk_ctl_val&~0x3ff|((0xfa<<0.)&0x3ff)



    ; Frequency counter utility registers.
    &frq_measure_ctl_addr=&HWIO_GCC_CLOCK_FRQ_MEASURE_CTL_ADDR
    &frq_measure_status_addr=&HWIO_GCC_CLOCK_FRQ_MEASURE_STATUS_ADDR
    &xo_div4_cbcr_addr=&HWIO_GCC_GCC_XO_DIV4_CBCR_ADDR

  )

  ; SSC_Q6
  else if &selval==&CLK_SSC_Q6_TEST
  (

    
    &ssc_qdsp6ss_test_clk_ctl_reg=&HWIO_SSC_QDSP6SS_TEST_CLK_CTL_ADDR
    &ssc_qdsp6ss_test_clk_ctl_val=(data.long(&access_mode:&ssc_qdsp6ss_test_clk_ctl_reg)&~0xffffffff)|(0x40&0xffffffff)
    &ssc_qdsp6ss_test_clk_ctl_val=&ssc_qdsp6ss_test_clk_ctl_val&~(0x1f<<0.)
    data.set &access_mode:&ssc_qdsp6ss_test_clk_ctl_reg %LONG &ssc_qdsp6ss_test_clk_ctl_val&~0x1f|((&testval<<0.)&0x1f)

    
    &ssc_scc_scc_debug_clk_ctl_reg=&HWIO_SSC_SCC_SCC_DEBUG_CLK_CTL_ADDR
    &ssc_scc_scc_debug_clk_ctl_val=(data.long(&access_mode:&ssc_scc_scc_debug_clk_ctl_reg)&~0xffffffff)|(0x1&0xffffffff)
    &ssc_scc_scc_debug_clk_ctl_val=&ssc_scc_scc_debug_clk_ctl_val&~(0x7e<<1.)
    data.set &access_mode:&ssc_scc_scc_debug_clk_ctl_reg %LONG &ssc_scc_scc_debug_clk_ctl_val&~0x7e|((0x1e<<1.)&0x7e)

    
    &gcc_gcc_debug_clk_ctl_reg=&HWIO_GCC_GCC_DEBUG_CLK_CTL_ADDR
    &gcc_gcc_debug_clk_ctl_val=(data.long(&access_mode:&gcc_gcc_debug_clk_ctl_reg)&~0xffffffff)|(0x10000&0xffffffff)
    &gcc_gcc_debug_clk_ctl_val=&gcc_gcc_debug_clk_ctl_val&~(0x3ff<<0.)
    data.set &access_mode:&gcc_gcc_debug_clk_ctl_reg %LONG &gcc_gcc_debug_clk_ctl_val&~0x3ff|((0xfa<<0.)&0x3ff)



    ; Frequency counter utility registers.
    &frq_measure_ctl_addr=&HWIO_GCC_CLOCK_FRQ_MEASURE_CTL_ADDR
    &frq_measure_status_addr=&HWIO_GCC_CLOCK_FRQ_MEASURE_STATUS_ADDR
    &xo_div4_cbcr_addr=&HWIO_GCC_GCC_XO_DIV4_CBCR_ADDR

  )

  ; WCSS
  else if &selval==&CLK_WCSS_TEST
  (

    
    &wcss_hm_a_wcss_clk_ctl_wcss_debug_clk_reg=&HWIO_WCSS_HM_A_WCSS_CLK_CTL_WCSS_DEBUG_CLK_ADDR
    &wcss_hm_a_wcss_clk_ctl_wcss_debug_clk_val=(data.long(&access_mode:&wcss_hm_a_wcss_clk_ctl_wcss_debug_clk_reg)&~0xffffffff)|(0x0&0xffffffff)
    &wcss_hm_a_wcss_clk_ctl_wcss_debug_clk_val=&wcss_hm_a_wcss_clk_ctl_wcss_debug_clk_val&~(0x7ff<<0.)
    data.set &access_mode:&wcss_hm_a_wcss_clk_ctl_wcss_debug_clk_reg %LONG &wcss_hm_a_wcss_clk_ctl_wcss_debug_clk_val&~0x7ff|((&testval<<0.)&0x7ff)

    
    &gcc_gcc_debug_clk_ctl_reg=&HWIO_GCC_GCC_DEBUG_CLK_CTL_ADDR
    &gcc_gcc_debug_clk_ctl_val=(data.long(&access_mode:&gcc_gcc_debug_clk_ctl_reg)&~0xffffffff)|(0x10000&0xffffffff)
    &gcc_gcc_debug_clk_ctl_val=&gcc_gcc_debug_clk_ctl_val&~(0x3ff<<0.)
    data.set &access_mode:&gcc_gcc_debug_clk_ctl_reg %LONG &gcc_gcc_debug_clk_ctl_val&~0x3ff|((0x13a<<0.)&0x3ff)


    data.set &access_mode:0x189d60f4 %long 0x1 ; WCSS_HM_A_WCSS_CLK_CTL_WCSS_DEBUG_CBCR

    ; Frequency counter utility registers.
    &frq_measure_ctl_addr=&HWIO_GCC_CLOCK_FRQ_MEASURE_CTL_ADDR
    &frq_measure_status_addr=&HWIO_GCC_CLOCK_FRQ_MEASURE_STATUS_ADDR
    &xo_div4_cbcr_addr=&HWIO_GCC_GCC_XO_DIV4_CBCR_ADDR

  )
 
  return
  

Configure_GPIO:
    
    
    &val=data.long(&access_mode:&HWIO_GCC_PLLTEST_PAD_CFG_ADDR)|0xa1000
    data.set &access_mode:&HWIO_GCC_PLLTEST_PAD_CFG_ADDR %LONG &val
    print "PLLTEST_PAD enabled in GCC_PLLTEST_PAD_CFG."

    return

Set_Dividers:
    
    &val=(data.long(&access_mode:&HWIO_GCC_GCC_DEBUG_CLK_CTL_ADDR)&~0xf000)|(0x3<<12.)
    data.set &access_mode:&HWIO_GCC_GCC_DEBUG_CLK_CTL_ADDR %LONG &val

    return

Clear_Dividers:
    
    &val=(data.long(&access_mode:&HWIO_GCC_GCC_DEBUG_CLK_CTL_ADDR)&~0xf000)
    data.set &access_mode:&HWIO_GCC_GCC_DEBUG_CLK_CTL_ADDR %LONG &val

    return


Print_Clock_Help:


  print " "
  print "*****************************************************  GCC   ******************************************************"

  print " "
  print "[ STANDALONEBCR ]" 
  print "  " 
  print " "
  print "[ AGGRE1_NOC ]" 
  print "  " 
  print " "
  print "[ AGGRE2_NOC ]" 
  print "  " 
  print " "
  print "[ BIMC ]" 
  print " gcc_bimc_clk                       gcc_spdm_bimc_cy_clk               gcc_bimc_dtts_xo_clk                " 
  print " gcc_bimc_xo_clk                    gcc_cfg_noc_ddr_cfg_clk            gcc_cnoc_bus_timeout5_ahb_clk       " 
  print " gcc_ddr_dim_cfg_clk                 " 
  print " "
  print "[ BLSP1 ]" 
  print " gcc_blsp1_uart1_sim_clk            gcc_blsp1_uart2_sim_clk            gcc_blsp1_uart3_sim_clk             " 
  print " gcc_blsp2_uart1_sim_clk            gcc_blsp2_uart2_sim_clk            gcc_blsp2_uart3_sim_clk             " 
  print " "
  print "[ BLSP1_QUP1 ]" 
  print " gcc_blsp1_qup1_i2c_apps_clk        gcc_blsp1_qup1_spi_apps_clk         " 
  print " "
  print "[ BLSP1_QUP2 ]" 
  print " gcc_blsp1_qup2_i2c_apps_clk        gcc_blsp1_qup2_spi_apps_clk         " 
  print " "
  print "[ BLSP1_QUP3 ]" 
  print " gcc_blsp1_qup3_i2c_apps_clk        gcc_blsp1_qup3_spi_apps_clk         " 
  print " "
  print "[ BLSP1_QUP4 ]" 
  print " gcc_blsp1_qup4_i2c_apps_clk        gcc_blsp1_qup4_spi_apps_clk         " 
  print " "
  print "[ BLSP1_QUP5 ]" 
  print " gcc_blsp1_qup5_i2c_apps_clk        gcc_blsp1_qup5_spi_apps_clk         " 
  print " "
  print "[ BLSP1_QUP6 ]" 
  print " gcc_blsp1_qup6_i2c_apps_clk        gcc_blsp1_qup6_spi_apps_clk         " 
  print " "
  print "[ BLSP1_UART1 ]" 
  print " gcc_blsp1_uart1_apps_clk            " 
  print " "
  print "[ BLSP1_UART2 ]" 
  print " gcc_blsp1_uart2_apps_clk            " 
  print " "
  print "[ BLSP1_UART3 ]" 
  print " gcc_blsp1_uart3_apps_clk            " 
  print " "
  print "[ BLSP2_QUP1 ]" 
  print " gcc_blsp2_qup1_i2c_apps_clk        gcc_blsp2_qup1_spi_apps_clk         " 
  print " "
  print "[ BLSP2_QUP2 ]" 
  print " gcc_blsp2_qup2_i2c_apps_clk        gcc_blsp2_qup2_spi_apps_clk         " 
  print " "
  print "[ BLSP2_QUP3 ]" 
  print " gcc_blsp2_qup3_i2c_apps_clk        gcc_blsp2_qup3_spi_apps_clk         " 
  print " "
  print "[ BLSP2_QUP4 ]" 
  print " gcc_blsp2_qup4_i2c_apps_clk        gcc_blsp2_qup4_spi_apps_clk         " 
  print " "
  print "[ BLSP2_QUP5 ]" 
  print " gcc_blsp2_qup5_i2c_apps_clk        gcc_blsp2_qup5_spi_apps_clk         " 
  print " "
  print "[ BLSP2_QUP6 ]" 
  print " gcc_blsp2_qup6_i2c_apps_clk        gcc_blsp2_qup6_spi_apps_clk         " 
  print " "
  print "[ BLSP2_UART1 ]" 
  print " gcc_blsp2_uart1_apps_clk            " 
  print " "
  print "[ BLSP2_UART2 ]" 
  print " gcc_blsp2_uart2_apps_clk            " 
  print " "
  print "[ BLSP2_UART3 ]" 
  print " gcc_blsp2_uart3_apps_clk            " 
  print " "
  print "[ CE1 ]" 
  print " gcc_ce1_clk                         " 
  print " "
  print "[ CONFIG_NOC ]" 
  print " gcc_aggre1_cnoc_periph_ahb_clk     gcc_aggre2_cnoc_periph_ahb_clk     gcc_blsp1_ahb_clk                   " 
  print " gcc_blsp2_ahb_clk                  gcc_cnoc_periph_bus_timeout1_ahb_clkgcc_cnoc_periph_bus_timeout2_ahb_clk " 
  print " gcc_cnoc_periph_east_ahb_clk       gcc_cnoc_periph_west_ahb_clk       gcc_pdm_ahb_clk                     " 
  print " gcc_sdcc2_ahb_clk                  gcc_sdcc4_ahb_clk                  gcc_spdm_pnoc_cy_clk                " 
  print " gcc_tsif_ahb_clk                   gcc_usb_phy_cfg_ahb2phy_clk        gcc_aggre1_cnoc_ahb_clk             " 
  print " gcc_aggre1_noc_msmpu_cfg_ahb_clk   gcc_aggre2_cnoc_ahb_clk            gcc_aggre2_noc_msmpu_cfg_ahb_clk    " 
  print " gcc_ahb_clk                        gcc_bimc_cfg_ahb_clk               gcc_bimc_nius_cfg_ahb_clk           " 
  print " gcc_boot_rom_ahb_clk               gcc_ce1_ahb_clk                    gcc_cfg_noc_ahb_clk                 " 
  print " gcc_cfg_noc_east_ahb_clk           gcc_cfg_noc_north_ahb_clk          gcc_cfg_noc_west_ahb_clk            " 
  print " gcc_cnoc_bus_timeout0_ahb_clk      gcc_cnoc_bus_timeout10_ahb_clk     gcc_cnoc_bus_timeout11_ahb_clk      " 
  print " gcc_cnoc_bus_timeout12_ahb_clk     gcc_cnoc_bus_timeout1_ahb_clk      gcc_cnoc_bus_timeout2_ahb_clk       " 
  print " gcc_cnoc_bus_timeout3_ahb_clk      gcc_cnoc_bus_timeout4_ahb_clk      gcc_cnoc_bus_timeout6_ahb_clk       " 
  print " gcc_cnoc_bus_timeout7_ahb_clk      gcc_cnoc_bus_timeout8_ahb_clk      gcc_cnoc_bus_timeout9_ahb_clk       " 
  print " gcc_cnoc_mst_rpm_ahb_clk           gcc_dcc_ahb_clk                    gcc_glm_ahb_clk                     " 
  print " gcc_gpu_cfg_ahb_clk                gcc_imem_cfg_ahb_clk               gcc_ipa_ahb_clk                     " 
  print " gcc_lpass_core_smmu_ahb_clk        gcc_lpass_q6_smmu_ahb_clk          gcc_lpass_smmu_aon_ahb_clk          " 
  print " gcc_mccc_cfg_ahb_clk               gcc_mmss_noc_cfg_ahb_clk           gcc_mmss_qm_ahb_clk                 " 
  print " gcc_mpm_ahb_clk                    gcc_msg_ram_ahb_clk                gcc_mss_cfg_ahb_clk                 " 
  print " gcc_mss_msmpu_cfg_ahb_clk          gcc_mss_q6_msmpu_cfg_ahb_clk       gcc_pcie_0_cfg_ahb_clk              " 
  print " gcc_pimem_ahb_clk                  gcc_prng_ahb_clk                   gcc_qdss_cfg_ahb_clk                " 
  print " gcc_qdss_dap_ahb_clk               gcc_rbcpr_cx_ahb_clk               gcc_rbcpr_mx_ahb_clk                " 
  print " gcc_rpm_mst_m2_cnoc_ahb_clk        gcc_sec_ctrl_ahb_clk               gcc_sec_ctrl_boot_rom_patch_clk     " 
  print " gcc_skl_ahb_clk                    gcc_smmu_aggre1_ahb_clk            gcc_smmu_aggre2_ahb_clk             " 
  print " gcc_snoc_cnoc_ahb_clk              gcc_spdm_cfg_ahb_clk               gcc_spdm_mstr_ahb_clk               " 
  print " gcc_spmi_cnoc_ahb_clk              gcc_spss_cfg_ahb_clk               gcc_spss_scsr_clk                   " 
  print " gcc_ssc_cnoc_ahbs_clk              gcc_ssc_cnoc_mpu_clk               gcc_tcsr_ahb_clk                    " 
  print " gcc_tic_cfg_ahb_clk                gcc_tlmm_clk                       gcc_tlmm_east_ahb_clk               " 
  print " gcc_tlmm_north_ahb_clk             gcc_tlmm_west_ahb_clk              gcc_ufs_ahb_clk                     " 
  print " "
  print "[ DDR_DIM_WRAPPER ]" 
  print " gcc_bimc_ddr_cpll0_clk             gcc_bimc_ddr_cpll1_clk              " 
  print " "
  print "[ DEBUG ]" 
  print " gcc_spdm_debug_cy_clk               " 
  print " "
  print "[ EXTERNAL RAW CLOCKS ]" 
  print " gcc_cfg_noc_tic_clk                gcc_tic_clk                         " 
  print " "
  print "[ GCC ]" 
  print " gcc_bimc_sleep_clk                 gcc_blsp1_sleep_clk                gcc_blsp2_sleep_clk                 " 
  print " gcc_ddr_dim_sleep_clk              gcc_im_sleep_clk                   gcc_ipa_sleep_clk                   " 
  print " gcc_rpm_sleep_clk                  gcc_tsif_inactivity_timers_clk     gcc_usb30_sleep_clk                 " 
  print " gcc_aggre1_noc_xo_clk              gcc_ahb2phy_east_clk               gcc_cfg_noc_ah2phy_xo_clk           " 
  print " gcc_cfg_noc_dcd_xo_clk             gcc_cfg_noc_east_dcd_xo_clk        gcc_cfg_noc_north_dcd_xo_clk        " 
  print " gcc_cfg_noc_west_dcd_xo_clk        gcc_cm_phy_refgen1_clk             gcc_cm_phy_refgen2_clk              " 
  print " gcc_cnoc_bus_timeout13_ahb_clk     gcc_glm_xo_clk                     gcc_pdm_xo4_clk                     " 
  print " gcc_qdss_xo_clk                    gcc_qrefs_vbg_cal_clk              gcc_rpm_timer_clk                   " 
  print " gcc_spdm_ff_clk                    gcc_spss_xo_clk                    gcc_sram_sensor_xo_clk              " 
  print " gcc_ssc_xo_clk                     gcc_sys_noc_dcd_xo_clk             gcc_xo_clk                          " 
  print " gcc_xo_div4_clk                     " 
  print " "
  print "[ GLM ]" 
  print " gcc_glm_clk                         " 
  print " "
  print "[ GP1 ]" 
  print " gcc_gp1_clk                         " 
  print " "
  print "[ GP2 ]" 
  print " gcc_gp2_clk                         " 
  print " "
  print "[ GP3 ]" 
  print " gcc_gp3_clk                         " 
  print " "
  print "[ GPU ]" 
  print " gcc_bimc_gfx_clk                   gcc_gpu_bimc_gfx_clk               gcc_gpu_bimc_gfx_src_clk            " 
  print " gcc_gpu_snoc_dvm_gfx_clk            " 
  print " "
  print "[ HMSS ]" 
  print " gcc_bimc_hmss_axi_clk              gcc_hmss_ahb_clk                   gcc_snoc_bus_timeout0_ahb_clk       " 
  print " gcc_sys_noc_hmss_ahb_clk           gcc_hmss_rbcpr_clk                  " 
  print " "
  print "[ IPA ]" 
  print " gcc_aggre2_noc_ipa_clk             gcc_ipa_2x_clk                     gcc_ipa_clk                         " 
  print " "
  print "[ MMSS ]" 
  print " gcc_mmss_qm_core_clk                " 
  print " "
  print "[ MSS ]" 
  print " gcc_bimc_mss_q6_axi_clk            gcc_mss_q6_bimc_axi_clk            gcc_mss_q6_msmpu_client_axi_clk     " 
  print " "
  print "[ OBT_ODT ]" 
  print " gcc_obt_odt_clk                     " 
  print " "
  print "[ PCIE_0 ]" 
  print " gcc_pcie_0_pipe_clk                gcc_pcie_0_aux_clk                 gcc_pcie_phy_aux_clk                " 
  print " "
  print "[ PDM ]" 
  print " gcc_pdm2_clk                        " 
  print " "
  print "[ PIMEM ]" 
  print " gcc_bimc_pimem_axi_clk             gcc_pimem_axi_clk                  gcc_sys_noc_pimem_axi_clk           " 
  print " "
  print "[ QDSS ]" 
  print " gcc_center_apb_clk                 gcc_east_apb_clk                   gcc_gpu_trig_clk                    " 
  print " gcc_hmss_trig_clk                  gcc_lpass_trig_clk                 gcc_mmss_trig_clk                   " 
  print " gcc_mss_trig_clk                   gcc_north_apb_clk                  gcc_qdss_apb2jtag_clk               " 
  print " gcc_qdss_dap_clk                   gcc_qdss_trig_clk                  gcc_spss_trig_clk                   " 
  print " gcc_ssc_apb_clk                    gcc_wcss_apb_clk                   gcc_west_apb_clk                    " 
  print " gcc_aggre1_noc_at_clk              gcc_aggre2_noc_at_clk              gcc_east_at_clk                     " 
  print " gcc_gpu_at_clk                     gcc_hmss_at_clk                    gcc_mmss_at_clk                     " 
  print " gcc_mmss_noc_at_clk                gcc_qdss_center_at_clk             gcc_sys_noc_at_clk                  " 
  print " gcc_wcss_at_clk                    gcc_west_at_clk                    gcc_bimc_at_clk                     " 
  print " gcc_mss_at_clk                     gcc_lpass_at_clk                   gcc_north_at_clk                    " 
  print " gcc_ssc_at_clk                     gcc_qdss_stm_clk                   gcc_sys_noc_qdss_stm_axi_clk        " 
  print " gcc_qdss_traceclkin_clk            gcc_qdss_tsctr_div16_clk           gcc_qdss_tsctr_div2_clk             " 
  print " gcc_qdss_tsctr_div3_clk            gcc_qdss_tsctr_div4_clk            gcc_qdss_tsctr_div8_clk             " 
  print " gcc_wcss_tsctr_div2_clk            gcc_apss_qdss_tsctr_div2_clk       gcc_apss_qdss_tsctr_div8_clk        " 
  print " "
  print "[ RBCPR_CX ]" 
  print " gcc_rbcpr_cx_clk                    " 
  print " "
  print "[ RBCPR_MX ]" 
  print " gcc_rbcpr_mx_clk                    " 
  print " "
  print "[ RPM ]" 
  print " gcc_rpm_bus_ahb_clk                gcc_rpm_proc_fclk                  gcc_rpm_proc_hclk                   " 
  print " gcc_spdm_rpm_cy_clk                 " 
  print " "
  print "[ SDCC2 ]" 
  print " gcc_sdcc2_apps_clk                  " 
  print " "
  print "[ SDCC4 ]" 
  print " gcc_sdcc4_apps_clk                  " 
  print " "
  print "[ SEC_CTRL ]" 
  print " gcc_sec_ctrl_acc_clk               gcc_sec_ctrl_clk                   gcc_sec_ctrl_sense_clk              " 
  print " gcc_spss_sec_ctrl_clk               " 
  print " "
  print "[ SPMI ]" 
  print " gcc_spmi_ahb_clk                   gcc_spmi_ser_clk                    " 
  print " "
  print "[ SYSTEM_NOC ]" 
  print " gcc_bimc_nius_hs_axi_clk           gcc_bimc_sysnoc_hs_axi_clk         gcc_lpass_q6_axi_clk                " 
  print " gcc_lpass_q6_smmu_axi_clk          gcc_lpass_q6_smmu_axi_src_clk      gcc_mss_mnoc_bimc_axi_clk           " 
  print " gcc_mss_msmpu_client_axi_clk       gcc_sys_noc_hs_axi_clk             gcc_aggre1_snoc_axi_clk             " 
  print " gcc_aggre1_snoc_msmpu_client_axi_clkgcc_aggre2_snoc_axi_clk            gcc_aggre2_snoc_east_axi_clk        " 
  print " gcc_aggre2_snoc_msmpu_client_axi_clkgcc_aggre2_snoc_north_axi_clk      gcc_bimc_nius_axi_clk               " 
  print " gcc_bimc_sysnoc_axi_clk            gcc_ce1_axi_clk                    gcc_hmss_dvm_bus_clk                " 
  print " gcc_imem_axi_clk                   gcc_lpass_core_smmu_client_clk     gcc_lpass_core_smmu_client_src_clk  " 
  print " gcc_lpass_sway_clk                 gcc_mmss_sys_noc_axi_clk           gcc_mss_snoc_axi_clk                " 
  print " gcc_pcie_0_mstr_axi_clk            gcc_pcie_0_slv_axi_clk             gcc_qdss_etr_usb_clk                " 
  print " gcc_smmu_aggre1_axi_clk            gcc_smmu_aggre1_axi_src_clk        gcc_smmu_aggre2_axi_clk             " 
  print " gcc_smmu_aggre2_axi_src_clk        gcc_snoc_bus_timeout1_ahb_clk      gcc_snoc_bus_timeout3_ahb_clk       " 
  print " gcc_spdm_snoc_cy_clk               gcc_spss_snoc_emm_clk              gcc_ssc_snoc_ahbm_clk               " 
  print " gcc_sys_noc_axi_clk                gcc_sys_noc_east_axi_clk           gcc_sys_noc_ssc_q6_axi_clk          " 
  print " gcc_sys_noc_west_axi_clk           gcc_wcss_ahb_s0_clk                gcc_wcss_axi_m_clk                  " 
  print " gcc_wcss_ecahb_clk                 gcc_wcss_shdreg_ahb_clk             " 
  print " "
  print "[ TSIF ]" 
  print " gcc_tsif_ref_clk                    " 
  print " "
  print "[ UFS ]" 
  print " gcc_aggre1_ufs_axi_clk             gcc_ufs_axi_clk                    gcc_ufs_ice_core_clk                " 
  print " gcc_ufs_phy_aux_clk                gcc_ufs_rx_symbol_0_clk            gcc_ufs_rx_symbol_1_clk             " 
  print " gcc_ufs_tx_symbol_0_clk            gcc_ufs_unipro_core_clk             " 
  print " "
  print "[ USB_30 ]" 
  print " gcc_aggre1_usb3_axi_clk            gcc_cfg_noc_usb3_axi_clk           gcc_cnoc_bus_timeout14_ahb_clk      " 
  print " gcc_usb30_master_clk               gcc_usb30_mock_utmi_clk            gcc_usb3_phy_aux_clk                " 
  print " gcc_usb3_phy_pipe_clk               " 
  print " "
  print "[ VS ]" 
  print " gcc_apc0_vs_clk                    gcc_apc1_vs_clk                    gcc_gpu_vs_clk                      " 
  print " gcc_mss_vs_clk                     gcc_vdda_vs_clk                    gcc_vddcx_vs_clk                    " 
  print " gcc_vddmx_vs_clk                   gcc_vs_ctrl_clk                     " 
  print " "
  print "[ EXT ]" 
  print " gcc_aggre1_noc_qosgen_extref       gcc_aggre2_noc_qosgen_extref       gcc_cnoc_bus_timeout_extref         " 
  print " gcc_snoc_bus_timeout_extref        gcc_snoc_qosgen_extref             gpu_gcc_dbg_clk                     " 
  print " hmss_gcc_dbg_clk                   lpass_gcc_dbg_clk                  mmss_gcc_dbg_clk                    " 
  print " mpm_gcc_temp0_sensor_ringosc_clk   mpm_gcc_temp1_sensor_ringosc_clk   mss_gcc_dbg_clk                     " 
  print " nav_gcc_dbg_clk                    pcie_0_pipe_clk                    qusb2phy_gcc_clk_test_prim          " 
  print " qusb2phy_prim_gcc_usb30_utmi_clk   spss_gcc_dbg_clk                   ssc_gcc_dbg_clk                     " 
  print " ufs_rx_symbol_0_clk                ufs_rx_symbol_1_clk                ufs_tx_symbol_0_clk                 " 
  print " usb3_phy_wrapper_gcc_usb3_pipe_clk wcss_gcc_dbg_clk                    " 

  print " "
  print "*****************************************************  MSS   ******************************************************"

  print " "
  print "[ BUS ]" 
  print " clk_src_bus_mss_config             clk_bus_config                     clk_bus_coxm                        " 
  print " clk_bus_crypto                     clk_bus_mgpi                       clk_bus_mvc                         " 
  print " clk_bus_nav                        clk_bus_pll_outctrl                clk_bus_q6                          " 
  print " clk_bus_rbcpr                      clk_bus_rfc                        clk_bus_slave_timeout               " 
  print " clk_bus_stmr                       clk_bus_uim0                       clk_bus_uim1                        " 
  print " clk_bus_uim2                       clk_bus_uim3                       mss_dgr_ahb_clk                     " 
  print " mss_dgr_freerun_ahb_clk            clk_src_bus_mss_config              " 
  print " "
  print "[ COXM ]" 
  print " clk_src_bit_coxm_mnd               clk_bit_coxm                        " 
  print " "
  print "[ EXTERNAL RAW CLOCKS ]" 
  print " gcc_mss_mfab_axi_clk_src           clk_axi_mnoc                       clk_axi_mnoc_q6                     " 
  print " clk_axi_nav_sample                 gcc_mss_nav_ce_axi_clk_src         clk_axi_nav                         " 
  print " clk_card_src_uim0                  clk_card_src_uim1                  clk_card_src_uim2                   " 
  print " clk_card_src_uim3                  clk_xo_mdm                         clk_xo_nav                          " 
  print " "
  print "[ Q6 ]" 
  print "  " 
  print " "
  print "[ RBCPR ]" 
  print " clk_src_rbcpr_ref                  clk_rbcpr_ref                       " 
  print " "
  print "[ UIM ]" 
  print " clk_src_uim0_mnd                   clk_uart_bit_uim0                  clk_src_uim1_mnd                    " 
  print " clk_uart_bit_uim1                  clk_src_uim2_mnd                   clk_uart_bit_uim2                   " 
  print " clk_src_uim3_mnd                   clk_uart_bit_uim3                   " 
  print " "
  print "[ XO ]" 
  print "  " 
  print " "
  print "[ MSS_MODEM_CORE ]" 
  print " clk_mdm                             " 
  print " "
  print "[ MSS_QDSP6_CORE ]" 
  print " mss_qdsp6ss_q6_core_clk            mss_qdsp6ss_axi_m_clk              mss_qdsp6ss_ldo_nmo_out             " 
  print " mss_qdsp6ss_ahb_m_clk              mss_qdsp6ss_ahb_s_clk              mss_qdsp6ss_xo_clk                  " 
  print " mss_qdsp6ss_sleep_clk              mss_qdsp6ss_jtag_tck               mss_qdsp6ss_atb_clk                 " 
  print " mss_qdsp6ss_apb_clk                mss_qdsp6ss_timestamp_clk           " 
  print " "
  print "[ EXT ]" 
  print " clk_axi_crypto                     clk_bus_pseudo_hm_rcg              clk_timeout_slp                     " 
  print " clk_xo_cx                          dbg_dtr_clksig                     dbg_modem_clksig                    " 
  print " dbg_nav_clksig                     dbg_q6_clksig                      dtr1_pll_dtest                      " 
  print " dtr1_pll_lock_det                  dtr2_pll_dtest                     dtr2_pll_lock_det                   " 
  print " gcc_mss_mfab_axi_clk_src           gcc_mss_nav_ce_axi_clk_src         modem_offline_pll_dtest             " 
  print " mss_dgr_axi_clk                    mss_offline_pll_lock_det           nav_pll_dtest                       " 
  print " nav_pll_lock_det                   q6_pll_dtest                       q6_pll_lock_det                     " 

  print " "
  print "*****************************************************  NAV   ******************************************************"

  print " "
  print "[ EXTERNAL RAW CLOCKS ]" 
  print " stmr_xo_clk                        xo_gdsc_clk                         " 
  print " "
  print "[ NAV SS ]" 
  print " bb_core_clk                        bb_qlink_clk                       cp_clk                              " 
  print " dma_clk                            dp_clk                             gnss_adc_ret_clk                    " 
  print " adc1_clk                           bp1_src_clk                        bp2_src_clk                         " 
  print " bp3_src_clk                        bp_mbs_src_clk                     wtr_core_clk                        " 
  print " "
  print "[ EXT ]" 
  print "  " 

  print " "
  print "*****************************************************  WCSS  ******************************************************"

  print " "
  print "[ DBG_OUT ]" 
  print " wcss_debug_clkout_cbc_out           " 
  print " "
  print "[ EXTERNAL RAW CLOCKS ]" 
  print " phy1_11ac_radio_adc_0_clk          wcss_rfactrl_phy1_11ac_radio_adc_0_clkphy2_11ac_radio_adc_0_clk           " 
  print " "
  print "[ WCSS_CSS ]" 
  print " wcss_ahb_tslv_clk                  wcss_css_apb_clk                   wcss_css_noc_clk                    " 
  print " wcss_phy1_apb_clk                  wcss_phy2_apb_clk                  wcss_rfactrl_apb_clk                " 
  print " wcss_rfactrl_dac_apb_clk           wcss_top_ahb_clk                   wcss_top_axi_clk                    " 
  print " wcss_top_dac_apb_clk               wcss_wcssdbg_cfg_apb_clk           wcss_wcssdbg_trc_clk                " 
  print " wcss_wmac1_apb_clk                 wcss_wmac2_apb_clk                 wcss_css_wsi_clk                    " 
  print " "
  print "[ WCSS_DBG ]" 
  print " wcss_dbg_apb_clk                   wcss_dbg_atb_clk                   wcss_dbg_css_apb_clk                " 
  print " wcss_dbg_css_atb_clk               wcss_dbg_css_ts_clk                wcss_dbg_ts_clk                     " 
  print " "
  print "[ WCSS_REF ]" 
  print " wcss_dac_sm_clk                    wcss_top_ref_clk                    " 
  print " "
  print "[ WCSS_RFACTRL ]" 
  print " wcss_rfactrl_clk                    " 
  print " "
  print "[ WCSS_SLP ]" 
  print " wcss_top_slp_clk                    " 
  print " "
  print "[ WCSS_WLAN1 ]" 
  print " wcss_css_phy1_t240_clk             wcss_phy1_160_clk                  wcss_phy1_20_clk                    " 
  print " wcss_phy1_30_clk                   wcss_phy1_320_clk                  wcss_phy1_40_clk                    " 
  print " wcss_phy1_80_clk                   wcss_phy1_bw_clk                   wcss_phy1_bwx2_clk                  " 
  print " wcss_phy1_clk                      wcss_phy1_dfs_clk                  wcss_phy1_t240_clk                  " 
  print " wcss_phy1_tadc_clk                 wcss_phy1_tdac_clk                 wcss_phy1_x2_clk                    " 
  print " wcss_rfactrl_phy1_80_clk           wcss_css_phy1_t240_clk             wcss_phy1_160_clk                   " 
  print " wcss_phy1_20_clk                   wcss_phy1_30_clk                   wcss_phy1_320_clk                   " 
  print " wcss_phy1_40_clk                   wcss_phy1_80_clk                   wcss_phy1_bw_clk                    " 
  print " wcss_phy1_bwx2_clk                 wcss_phy1_clk                      wcss_phy1_dfs_clk                   " 
  print " wcss_phy1_t240_clk                 wcss_phy1_tadc_clk                 wcss_phy1_tdac_clk                  " 
  print " wcss_phy1_x2_clk                   wcss_rfactrl_phy1_80_clk           phy1_11ac_radio_adc_1_clk           " 
  print " wcss_rfactrl_phy1_11ac_radio_adc_1_clkwcss_wmac1_css_mac_clk             wcss_wmac1_mac_clk                  " 
  print " "
  print "[ WCSS_WLAN2 ]" 
  print " wcss_css_phy2_t240_clk             wcss_phy2_160_clk                  wcss_phy2_20_clk                    " 
  print " wcss_phy2_30_clk                   wcss_phy2_320_clk                  wcss_phy2_40_clk                    " 
  print " wcss_phy2_80_clk                   wcss_phy2_bw_clk                   wcss_phy2_bwx2_clk                  " 
  print " wcss_phy2_clk                      wcss_phy2_dfs_clk                  wcss_phy2_t240_clk                  " 
  print " wcss_phy2_tadc_clk                 wcss_phy2_tdac_clk                 wcss_phy2_x2_clk                    " 
  print " wcss_rfactrl_phy2_80_clk           wcss_css_phy2_t240_clk             wcss_phy2_160_clk                   " 
  print " wcss_phy2_20_clk                   wcss_phy2_30_clk                   wcss_phy2_320_clk                   " 
  print " wcss_phy2_40_clk                   wcss_phy2_80_clk                   wcss_phy2_bw_clk                    " 
  print " wcss_phy2_bwx2_clk                 wcss_phy2_clk                      wcss_phy2_dfs_clk                   " 
  print " wcss_phy2_t240_clk                 wcss_phy2_tadc_clk                 wcss_phy2_tdac_clk                  " 
  print " wcss_phy2_x2_clk                   wcss_rfactrl_phy2_80_clk           phy2_11ac_radio_adc_1_clk           " 
  print " wcss_wmac2_css_mac_clk             wcss_wmac2_mac_clk                  " 
  print " "
  print "[ EXT ]" 
  print "  " 

  return



Print_All:

  gosub Find_Print_Clock gcc_sec_ctrl_acc_clk
  gosub Find_Print_Clock gcc_apc0_vs_clk
  gosub Find_Print_Clock gcc_apc1_vs_clk
  gosub Find_Print_Clock gcc_bimc_clk
  gosub Find_Print_Clock gcc_spdm_bimc_cy_clk
  gosub Find_Print_Clock gcc_bimc_ddr_cpll0_clk
  gosub Find_Print_Clock gcc_bimc_ddr_cpll1_clk
  gosub Find_Print_Clock gcc_bimc_dtts_xo_clk
  gosub Find_Print_Clock gcc_bimc_xo_clk
  gosub Find_Print_Clock gcc_cfg_noc_ddr_cfg_clk
  gosub Find_Print_Clock gcc_cnoc_bus_timeout5_ahb_clk
  gosub Find_Print_Clock gcc_ddr_dim_cfg_clk
  gosub Find_Print_Clock gcc_bimc_hmss_axi_clk
  gosub Find_Print_Clock gcc_blsp1_qup1_i2c_apps_clk
  gosub Find_Print_Clock gcc_blsp1_qup1_spi_apps_clk
  gosub Find_Print_Clock gcc_blsp1_qup2_i2c_apps_clk
  gosub Find_Print_Clock gcc_blsp1_qup2_spi_apps_clk
  gosub Find_Print_Clock gcc_blsp1_qup3_i2c_apps_clk
  gosub Find_Print_Clock gcc_blsp1_qup3_spi_apps_clk
  gosub Find_Print_Clock gcc_blsp1_qup4_i2c_apps_clk
  gosub Find_Print_Clock gcc_blsp1_qup4_spi_apps_clk
  gosub Find_Print_Clock gcc_blsp1_qup5_i2c_apps_clk
  gosub Find_Print_Clock gcc_blsp1_qup5_spi_apps_clk
  gosub Find_Print_Clock gcc_blsp1_qup6_i2c_apps_clk
  gosub Find_Print_Clock gcc_blsp1_qup6_spi_apps_clk
  gosub Find_Print_Clock gcc_blsp1_uart1_apps_clk
  gosub Find_Print_Clock gcc_blsp1_uart2_apps_clk
  gosub Find_Print_Clock gcc_blsp1_uart3_apps_clk
  gosub Find_Print_Clock gcc_blsp2_qup1_i2c_apps_clk
  gosub Find_Print_Clock gcc_blsp2_qup1_spi_apps_clk
  gosub Find_Print_Clock gcc_blsp2_qup2_i2c_apps_clk
  gosub Find_Print_Clock gcc_blsp2_qup2_spi_apps_clk
  gosub Find_Print_Clock gcc_blsp2_qup3_i2c_apps_clk
  gosub Find_Print_Clock gcc_blsp2_qup3_spi_apps_clk
  gosub Find_Print_Clock gcc_blsp2_qup4_i2c_apps_clk
  gosub Find_Print_Clock gcc_blsp2_qup4_spi_apps_clk
  gosub Find_Print_Clock gcc_blsp2_qup5_i2c_apps_clk
  gosub Find_Print_Clock gcc_blsp2_qup5_spi_apps_clk
  gosub Find_Print_Clock gcc_blsp2_qup6_i2c_apps_clk
  gosub Find_Print_Clock gcc_blsp2_qup6_spi_apps_clk
  gosub Find_Print_Clock gcc_blsp2_uart1_apps_clk
  gosub Find_Print_Clock gcc_blsp2_uart2_apps_clk
  gosub Find_Print_Clock gcc_blsp2_uart3_apps_clk
  gosub Find_Print_Clock gcc_blsp1_uart1_sim_clk
  gosub Find_Print_Clock gcc_blsp1_uart2_sim_clk
  gosub Find_Print_Clock gcc_blsp1_uart3_sim_clk
  gosub Find_Print_Clock gcc_blsp2_uart1_sim_clk
  gosub Find_Print_Clock gcc_blsp2_uart2_sim_clk
  gosub Find_Print_Clock gcc_blsp2_uart3_sim_clk
  gosub Find_Print_Clock gcc_ce1_clk
  gosub Find_Print_Clock gcc_aggre1_cnoc_periph_ahb_clk
  gosub Find_Print_Clock gcc_aggre2_cnoc_periph_ahb_clk
  gosub Find_Print_Clock gcc_blsp1_ahb_clk
  gosub Find_Print_Clock gcc_blsp2_ahb_clk
  gosub Find_Print_Clock gcc_cnoc_periph_bus_timeout1_ahb_clk
  gosub Find_Print_Clock gcc_cnoc_periph_bus_timeout2_ahb_clk
  gosub Find_Print_Clock gcc_cnoc_periph_east_ahb_clk
  gosub Find_Print_Clock gcc_cnoc_periph_west_ahb_clk
  gosub Find_Print_Clock gcc_pdm_ahb_clk
  gosub Find_Print_Clock gcc_sdcc2_ahb_clk
  gosub Find_Print_Clock gcc_sdcc4_ahb_clk
  gosub Find_Print_Clock gcc_spdm_pnoc_cy_clk
  gosub Find_Print_Clock gcc_tsif_ahb_clk
  gosub Find_Print_Clock gcc_usb_phy_cfg_ahb2phy_clk
  gosub Find_Print_Clock gcc_aggre1_cnoc_ahb_clk
  gosub Find_Print_Clock gcc_aggre1_noc_msmpu_cfg_ahb_clk
  gosub Find_Print_Clock gcc_aggre2_cnoc_ahb_clk
  gosub Find_Print_Clock gcc_aggre2_noc_msmpu_cfg_ahb_clk
  gosub Find_Print_Clock gcc_ahb_clk
  gosub Find_Print_Clock gcc_bimc_cfg_ahb_clk
  gosub Find_Print_Clock gcc_bimc_nius_cfg_ahb_clk
  gosub Find_Print_Clock gcc_boot_rom_ahb_clk
  gosub Find_Print_Clock gcc_ce1_ahb_clk
  gosub Find_Print_Clock gcc_cfg_noc_ahb_clk
  gosub Find_Print_Clock gcc_cfg_noc_east_ahb_clk
  gosub Find_Print_Clock gcc_cfg_noc_north_ahb_clk
  gosub Find_Print_Clock gcc_cfg_noc_west_ahb_clk
  gosub Find_Print_Clock gcc_cnoc_bus_timeout0_ahb_clk
  gosub Find_Print_Clock gcc_cnoc_bus_timeout10_ahb_clk
  gosub Find_Print_Clock gcc_cnoc_bus_timeout11_ahb_clk
  gosub Find_Print_Clock gcc_cnoc_bus_timeout12_ahb_clk
  gosub Find_Print_Clock gcc_cnoc_bus_timeout1_ahb_clk
  gosub Find_Print_Clock gcc_cnoc_bus_timeout2_ahb_clk
  gosub Find_Print_Clock gcc_cnoc_bus_timeout3_ahb_clk
  gosub Find_Print_Clock gcc_cnoc_bus_timeout4_ahb_clk
  gosub Find_Print_Clock gcc_cnoc_bus_timeout6_ahb_clk
  gosub Find_Print_Clock gcc_cnoc_bus_timeout7_ahb_clk
  gosub Find_Print_Clock gcc_cnoc_bus_timeout8_ahb_clk
  gosub Find_Print_Clock gcc_cnoc_bus_timeout9_ahb_clk
  gosub Find_Print_Clock gcc_cnoc_mst_rpm_ahb_clk
  gosub Find_Print_Clock gcc_dcc_ahb_clk
  gosub Find_Print_Clock gcc_glm_ahb_clk
  gosub Find_Print_Clock gcc_gpu_cfg_ahb_clk
  gosub Find_Print_Clock gcc_imem_cfg_ahb_clk
  gosub Find_Print_Clock gcc_ipa_ahb_clk
  gosub Find_Print_Clock gcc_lpass_core_smmu_ahb_clk
  gosub Find_Print_Clock gcc_lpass_q6_smmu_ahb_clk
  gosub Find_Print_Clock gcc_lpass_smmu_aon_ahb_clk
  gosub Find_Print_Clock gcc_mccc_cfg_ahb_clk
  gosub Find_Print_Clock gcc_mmss_noc_cfg_ahb_clk
  gosub Find_Print_Clock gcc_mmss_qm_ahb_clk
  gosub Find_Print_Clock gcc_mpm_ahb_clk
  gosub Find_Print_Clock gcc_msg_ram_ahb_clk
  gosub Find_Print_Clock gcc_mss_cfg_ahb_clk
  gosub Find_Print_Clock gcc_mss_msmpu_cfg_ahb_clk
  gosub Find_Print_Clock gcc_mss_q6_msmpu_cfg_ahb_clk
  gosub Find_Print_Clock gcc_pcie_0_cfg_ahb_clk
  gosub Find_Print_Clock gcc_pimem_ahb_clk
  gosub Find_Print_Clock gcc_prng_ahb_clk
  gosub Find_Print_Clock gcc_qdss_cfg_ahb_clk
  gosub Find_Print_Clock gcc_qdss_dap_ahb_clk
  gosub Find_Print_Clock gcc_rbcpr_cx_ahb_clk
  gosub Find_Print_Clock gcc_rbcpr_mx_ahb_clk
  gosub Find_Print_Clock gcc_rpm_mst_m2_cnoc_ahb_clk
  gosub Find_Print_Clock gcc_sec_ctrl_ahb_clk
  gosub Find_Print_Clock gcc_sec_ctrl_boot_rom_patch_clk
  gosub Find_Print_Clock gcc_skl_ahb_clk
  gosub Find_Print_Clock gcc_smmu_aggre1_ahb_clk
  gosub Find_Print_Clock gcc_smmu_aggre2_ahb_clk
  gosub Find_Print_Clock gcc_snoc_cnoc_ahb_clk
  gosub Find_Print_Clock gcc_spdm_cfg_ahb_clk
  gosub Find_Print_Clock gcc_spdm_mstr_ahb_clk
  gosub Find_Print_Clock gcc_spmi_cnoc_ahb_clk
  gosub Find_Print_Clock gcc_spss_cfg_ahb_clk
  gosub Find_Print_Clock gcc_spss_scsr_clk
  gosub Find_Print_Clock gcc_ssc_cnoc_ahbs_clk
  gosub Find_Print_Clock gcc_ssc_cnoc_mpu_clk
  gosub Find_Print_Clock gcc_tcsr_ahb_clk
  gosub Find_Print_Clock gcc_tic_cfg_ahb_clk
  gosub Find_Print_Clock gcc_tlmm_clk
  gosub Find_Print_Clock gcc_tlmm_east_ahb_clk
  gosub Find_Print_Clock gcc_tlmm_north_ahb_clk
  gosub Find_Print_Clock gcc_tlmm_west_ahb_clk
  gosub Find_Print_Clock gcc_ufs_ahb_clk
  gosub Find_Print_Clock gcc_spdm_debug_cy_clk
  gosub Find_Print_Clock gcc_bimc_sleep_clk
  gosub Find_Print_Clock gcc_blsp1_sleep_clk
  gosub Find_Print_Clock gcc_blsp2_sleep_clk
  gosub Find_Print_Clock gcc_ddr_dim_sleep_clk
  gosub Find_Print_Clock gcc_im_sleep_clk
  gosub Find_Print_Clock gcc_ipa_sleep_clk
  gosub Find_Print_Clock gcc_rpm_sleep_clk
  gosub Find_Print_Clock gcc_tsif_inactivity_timers_clk
  gosub Find_Print_Clock gcc_usb30_sleep_clk
  gosub Find_Print_Clock gcc_aggre1_noc_xo_clk
  gosub Find_Print_Clock gcc_ahb2phy_east_clk
  gosub Find_Print_Clock gcc_cfg_noc_ah2phy_xo_clk
  gosub Find_Print_Clock gcc_cfg_noc_dcd_xo_clk
  gosub Find_Print_Clock gcc_cfg_noc_east_dcd_xo_clk
  gosub Find_Print_Clock gcc_cfg_noc_north_dcd_xo_clk
  gosub Find_Print_Clock gcc_cfg_noc_west_dcd_xo_clk
  gosub Find_Print_Clock gcc_cm_phy_refgen1_clk
  gosub Find_Print_Clock gcc_cm_phy_refgen2_clk
  gosub Find_Print_Clock gcc_cnoc_bus_timeout13_ahb_clk
  gosub Find_Print_Clock gcc_glm_xo_clk
  gosub Find_Print_Clock gcc_pdm_xo4_clk
  gosub Find_Print_Clock gcc_qdss_xo_clk
  gosub Find_Print_Clock gcc_qrefs_vbg_cal_clk
  gosub Find_Print_Clock gcc_rpm_timer_clk
  gosub Find_Print_Clock gcc_spdm_ff_clk
  gosub Find_Print_Clock gcc_spss_xo_clk
  gosub Find_Print_Clock gcc_sram_sensor_xo_clk
  gosub Find_Print_Clock gcc_ssc_xo_clk
  gosub Find_Print_Clock gcc_sys_noc_dcd_xo_clk
  gosub Find_Print_Clock gcc_xo_clk
  gosub Find_Print_Clock gcc_xo_div4_clk
  gosub Find_Print_Clock gcc_glm_clk
  gosub Find_Print_Clock gcc_gp1_clk
  gosub Find_Print_Clock gcc_gp2_clk
  gosub Find_Print_Clock gcc_gp3_clk
  gosub Find_Print_Clock gcc_bimc_gfx_clk
  gosub Find_Print_Clock gcc_gpu_bimc_gfx_clk
  gosub Find_Print_Clock gcc_gpu_bimc_gfx_src_clk
  gosub Find_Print_Clock gcc_gpu_snoc_dvm_gfx_clk
  gosub Find_Print_Clock gcc_gpu_vs_clk
  gosub Find_Print_Clock gcc_hmss_ahb_clk
  gosub Find_Print_Clock gcc_snoc_bus_timeout0_ahb_clk
  gosub Find_Print_Clock gcc_sys_noc_hmss_ahb_clk
  gosub Find_Print_Clock gcc_hmss_rbcpr_clk
  gosub Find_Print_Clock gcc_aggre2_noc_ipa_clk
  gosub Find_Print_Clock gcc_ipa_2x_clk
  gosub Find_Print_Clock gcc_ipa_clk
  gosub Find_Print_Clock gcc_mmss_qm_core_clk
  gosub Find_Print_Clock gcc_bimc_mss_q6_axi_clk
  gosub Find_Print_Clock gcc_mss_q6_bimc_axi_clk
  gosub Find_Print_Clock gcc_mss_q6_msmpu_client_axi_clk
  gosub Find_Print_Clock gcc_mss_vs_clk
  gosub Find_Print_Clock gcc_obt_odt_clk
  gosub Find_Print_Clock gcc_pcie_0_pipe_clk
  gosub Find_Print_Clock gcc_pcie_0_aux_clk
  gosub Find_Print_Clock gcc_pcie_phy_aux_clk
  gosub Find_Print_Clock gcc_pdm2_clk
  gosub Find_Print_Clock gcc_bimc_pimem_axi_clk
  gosub Find_Print_Clock gcc_pimem_axi_clk
  gosub Find_Print_Clock gcc_sys_noc_pimem_axi_clk
  gosub Find_Print_Clock gcc_center_apb_clk
  gosub Find_Print_Clock gcc_east_apb_clk
  gosub Find_Print_Clock gcc_gpu_trig_clk
  gosub Find_Print_Clock gcc_hmss_trig_clk
  gosub Find_Print_Clock gcc_lpass_trig_clk
  gosub Find_Print_Clock gcc_mmss_trig_clk
  gosub Find_Print_Clock gcc_mss_trig_clk
  gosub Find_Print_Clock gcc_north_apb_clk
  gosub Find_Print_Clock gcc_qdss_apb2jtag_clk
  gosub Find_Print_Clock gcc_qdss_dap_clk
  gosub Find_Print_Clock gcc_qdss_trig_clk
  gosub Find_Print_Clock gcc_spss_trig_clk
  gosub Find_Print_Clock gcc_ssc_apb_clk
  gosub Find_Print_Clock gcc_wcss_apb_clk
  gosub Find_Print_Clock gcc_west_apb_clk
  gosub Find_Print_Clock gcc_aggre1_noc_at_clk
  gosub Find_Print_Clock gcc_aggre2_noc_at_clk
  gosub Find_Print_Clock gcc_east_at_clk
  gosub Find_Print_Clock gcc_gpu_at_clk
  gosub Find_Print_Clock gcc_hmss_at_clk
  gosub Find_Print_Clock gcc_mmss_at_clk
  gosub Find_Print_Clock gcc_mmss_noc_at_clk
  gosub Find_Print_Clock gcc_qdss_center_at_clk
  gosub Find_Print_Clock gcc_sys_noc_at_clk
  gosub Find_Print_Clock gcc_wcss_at_clk
  gosub Find_Print_Clock gcc_west_at_clk
  gosub Find_Print_Clock gcc_bimc_at_clk
  gosub Find_Print_Clock gcc_mss_at_clk
  gosub Find_Print_Clock gcc_lpass_at_clk
  gosub Find_Print_Clock gcc_north_at_clk
  gosub Find_Print_Clock gcc_ssc_at_clk
  gosub Find_Print_Clock gcc_qdss_stm_clk
  gosub Find_Print_Clock gcc_sys_noc_qdss_stm_axi_clk
  gosub Find_Print_Clock gcc_qdss_traceclkin_clk
  gosub Find_Print_Clock gcc_qdss_tsctr_div16_clk
  gosub Find_Print_Clock gcc_qdss_tsctr_div2_clk
  gosub Find_Print_Clock gcc_qdss_tsctr_div3_clk
  gosub Find_Print_Clock gcc_qdss_tsctr_div4_clk
  gosub Find_Print_Clock gcc_qdss_tsctr_div8_clk
  gosub Find_Print_Clock gcc_wcss_tsctr_div2_clk
  gosub Find_Print_Clock gcc_apss_qdss_tsctr_div2_clk
  gosub Find_Print_Clock gcc_apss_qdss_tsctr_div8_clk
  gosub Find_Print_Clock gcc_rbcpr_cx_clk
  gosub Find_Print_Clock gcc_rbcpr_mx_clk
  gosub Find_Print_Clock gcc_rpm_bus_ahb_clk
  gosub Find_Print_Clock gcc_rpm_proc_fclk
  gosub Find_Print_Clock gcc_rpm_proc_hclk
  gosub Find_Print_Clock gcc_spdm_rpm_cy_clk
  gosub Find_Print_Clock gcc_sdcc2_apps_clk
  gosub Find_Print_Clock gcc_sdcc4_apps_clk
  gosub Find_Print_Clock gcc_sec_ctrl_clk
  gosub Find_Print_Clock gcc_sec_ctrl_sense_clk
  gosub Find_Print_Clock gcc_spss_sec_ctrl_clk
  gosub Find_Print_Clock gcc_spmi_ahb_clk
  gosub Find_Print_Clock gcc_spmi_ser_clk
  gosub Find_Print_Clock gcc_bimc_nius_hs_axi_clk
  gosub Find_Print_Clock gcc_bimc_sysnoc_hs_axi_clk
  gosub Find_Print_Clock gcc_lpass_q6_axi_clk
  gosub Find_Print_Clock gcc_lpass_q6_smmu_axi_clk
  gosub Find_Print_Clock gcc_lpass_q6_smmu_axi_src_clk
  gosub Find_Print_Clock gcc_mss_mnoc_bimc_axi_clk
  gosub Find_Print_Clock gcc_mss_msmpu_client_axi_clk
  gosub Find_Print_Clock gcc_sys_noc_hs_axi_clk
  gosub Find_Print_Clock gcc_aggre1_snoc_axi_clk
  gosub Find_Print_Clock gcc_aggre1_snoc_msmpu_client_axi_clk
  gosub Find_Print_Clock gcc_aggre2_snoc_axi_clk
  gosub Find_Print_Clock gcc_aggre2_snoc_east_axi_clk
  gosub Find_Print_Clock gcc_aggre2_snoc_msmpu_client_axi_clk
  gosub Find_Print_Clock gcc_aggre2_snoc_north_axi_clk
  gosub Find_Print_Clock gcc_bimc_nius_axi_clk
  gosub Find_Print_Clock gcc_bimc_sysnoc_axi_clk
  gosub Find_Print_Clock gcc_ce1_axi_clk
  gosub Find_Print_Clock gcc_hmss_dvm_bus_clk
  gosub Find_Print_Clock gcc_imem_axi_clk
  gosub Find_Print_Clock gcc_lpass_core_smmu_client_clk
  gosub Find_Print_Clock gcc_lpass_core_smmu_client_src_clk
  gosub Find_Print_Clock gcc_lpass_sway_clk
  gosub Find_Print_Clock gcc_mmss_sys_noc_axi_clk
  gosub Find_Print_Clock gcc_mss_snoc_axi_clk
  gosub Find_Print_Clock gcc_pcie_0_mstr_axi_clk
  gosub Find_Print_Clock gcc_pcie_0_slv_axi_clk
  gosub Find_Print_Clock gcc_qdss_etr_usb_clk
  gosub Find_Print_Clock gcc_smmu_aggre1_axi_clk
  gosub Find_Print_Clock gcc_smmu_aggre1_axi_src_clk
  gosub Find_Print_Clock gcc_smmu_aggre2_axi_clk
  gosub Find_Print_Clock gcc_smmu_aggre2_axi_src_clk
  gosub Find_Print_Clock gcc_snoc_bus_timeout1_ahb_clk
  gosub Find_Print_Clock gcc_snoc_bus_timeout3_ahb_clk
  gosub Find_Print_Clock gcc_spdm_snoc_cy_clk
  gosub Find_Print_Clock gcc_spss_snoc_emm_clk
  gosub Find_Print_Clock gcc_ssc_snoc_ahbm_clk
  gosub Find_Print_Clock gcc_sys_noc_axi_clk
  gosub Find_Print_Clock gcc_sys_noc_east_axi_clk
  gosub Find_Print_Clock gcc_sys_noc_ssc_q6_axi_clk
  gosub Find_Print_Clock gcc_sys_noc_west_axi_clk
  gosub Find_Print_Clock gcc_wcss_ahb_s0_clk
  gosub Find_Print_Clock gcc_wcss_axi_m_clk
  gosub Find_Print_Clock gcc_wcss_ecahb_clk
  gosub Find_Print_Clock gcc_wcss_shdreg_ahb_clk
  gosub Find_Print_Clock gcc_cfg_noc_tic_clk
  gosub Find_Print_Clock gcc_tic_clk
  gosub Find_Print_Clock gcc_tsif_ref_clk
  gosub Find_Print_Clock gcc_aggre1_ufs_axi_clk
  gosub Find_Print_Clock gcc_ufs_axi_clk
  gosub Find_Print_Clock gcc_ufs_ice_core_clk
  gosub Find_Print_Clock gcc_ufs_phy_aux_clk
  gosub Find_Print_Clock gcc_ufs_rx_symbol_0_clk
  gosub Find_Print_Clock gcc_ufs_rx_symbol_1_clk
  gosub Find_Print_Clock gcc_ufs_tx_symbol_0_clk
  gosub Find_Print_Clock gcc_ufs_unipro_core_clk
  gosub Find_Print_Clock gcc_aggre1_usb3_axi_clk
  gosub Find_Print_Clock gcc_cfg_noc_usb3_axi_clk
  gosub Find_Print_Clock gcc_cnoc_bus_timeout14_ahb_clk
  gosub Find_Print_Clock gcc_usb30_master_clk
  gosub Find_Print_Clock gcc_usb30_mock_utmi_clk
  gosub Find_Print_Clock gcc_usb3_phy_aux_clk
  gosub Find_Print_Clock gcc_usb3_phy_pipe_clk
  gosub Find_Print_Clock gcc_vdda_vs_clk
  gosub Find_Print_Clock gcc_vddcx_vs_clk
  gosub Find_Print_Clock gcc_vddmx_vs_clk
  gosub Find_Print_Clock gcc_vs_ctrl_clk
  gosub Find_Print_Clock gcc_aggre1_noc_qosgen_extref
  gosub Find_Print_Clock gcc_aggre2_noc_qosgen_extref
  gosub Find_Print_Clock gcc_cnoc_bus_timeout_extref
  gosub Find_Print_Clock gcc_snoc_bus_timeout_extref
  gosub Find_Print_Clock gcc_snoc_qosgen_extref
  gosub Find_Print_Clock gpu_gcc_dbg_clk
  gosub Find_Print_Clock hmss_gcc_dbg_clk
  gosub Find_Print_Clock lpass_gcc_dbg_clk
  gosub Find_Print_Clock mmss_gcc_dbg_clk
  gosub Find_Print_Clock mpm_gcc_temp0_sensor_ringosc_clk
  gosub Find_Print_Clock mpm_gcc_temp1_sensor_ringosc_clk
  gosub Find_Print_Clock mss_gcc_dbg_clk
  gosub Find_Print_Clock nav_gcc_dbg_clk
  gosub Find_Print_Clock pcie_0_pipe_clk
  gosub Find_Print_Clock qusb2phy_gcc_clk_test_prim
  gosub Find_Print_Clock qusb2phy_prim_gcc_usb30_utmi_clk
  gosub Find_Print_Clock spss_gcc_dbg_clk
  gosub Find_Print_Clock ssc_gcc_dbg_clk
  gosub Find_Print_Clock ufs_rx_symbol_0_clk
  gosub Find_Print_Clock ufs_rx_symbol_1_clk
  gosub Find_Print_Clock ufs_tx_symbol_0_clk
  gosub Find_Print_Clock usb3_phy_wrapper_gcc_usb3_pipe_clk
  gosub Find_Print_Clock wcss_gcc_dbg_clk
  gosub Find_Print_Clock clk_src_bit_coxm_mnd
  gosub Find_Print_Clock clk_bit_coxm
  gosub Find_Print_Clock clk_src_bus_mss_config
  gosub Find_Print_Clock clk_bus_config
  gosub Find_Print_Clock clk_bus_coxm
  gosub Find_Print_Clock clk_bus_crypto
  gosub Find_Print_Clock clk_bus_mgpi
  gosub Find_Print_Clock clk_bus_mvc
  gosub Find_Print_Clock clk_bus_nav
  gosub Find_Print_Clock clk_bus_pll_outctrl
  gosub Find_Print_Clock clk_bus_q6
  gosub Find_Print_Clock clk_bus_rbcpr
  gosub Find_Print_Clock clk_bus_rfc
  gosub Find_Print_Clock clk_bus_slave_timeout
  gosub Find_Print_Clock clk_bus_stmr
  gosub Find_Print_Clock clk_bus_uim0
  gosub Find_Print_Clock clk_bus_uim1
  gosub Find_Print_Clock clk_bus_uim2
  gosub Find_Print_Clock clk_bus_uim3
  gosub Find_Print_Clock mss_dgr_ahb_clk
  gosub Find_Print_Clock mss_dgr_freerun_ahb_clk
  gosub Find_Print_Clock clk_src_bus_mss_config
  gosub Find_Print_Clock gcc_mss_mfab_axi_clk_src
  gosub Find_Print_Clock clk_axi_mnoc
  gosub Find_Print_Clock clk_axi_mnoc_q6
  gosub Find_Print_Clock clk_axi_nav_sample
  gosub Find_Print_Clock gcc_mss_nav_ce_axi_clk_src
  gosub Find_Print_Clock clk_axi_nav
  gosub Find_Print_Clock clk_src_rbcpr_ref
  gosub Find_Print_Clock clk_rbcpr_ref
  gosub Find_Print_Clock clk_src_uim0_mnd
  gosub Find_Print_Clock clk_uart_bit_uim0
  gosub Find_Print_Clock clk_src_uim1_mnd
  gosub Find_Print_Clock clk_uart_bit_uim1
  gosub Find_Print_Clock clk_src_uim2_mnd
  gosub Find_Print_Clock clk_uart_bit_uim2
  gosub Find_Print_Clock clk_src_uim3_mnd
  gosub Find_Print_Clock clk_uart_bit_uim3
  gosub Find_Print_Clock clk_card_src_uim0
  gosub Find_Print_Clock clk_card_src_uim1
  gosub Find_Print_Clock clk_card_src_uim2
  gosub Find_Print_Clock clk_card_src_uim3
  gosub Find_Print_Clock clk_xo_mdm
  gosub Find_Print_Clock clk_xo_nav
  gosub Find_Print_Clock clk_mdm
  gosub Find_Print_Clock mss_qdsp6ss_q6_core_clk
  gosub Find_Print_Clock mss_qdsp6ss_axi_m_clk
  gosub Find_Print_Clock mss_qdsp6ss_ldo_nmo_out
  gosub Find_Print_Clock mss_qdsp6ss_ahb_m_clk
  gosub Find_Print_Clock mss_qdsp6ss_ahb_s_clk
  gosub Find_Print_Clock mss_qdsp6ss_xo_clk
  gosub Find_Print_Clock mss_qdsp6ss_sleep_clk
  gosub Find_Print_Clock mss_qdsp6ss_jtag_tck
  gosub Find_Print_Clock mss_qdsp6ss_atb_clk
  gosub Find_Print_Clock mss_qdsp6ss_apb_clk
  gosub Find_Print_Clock mss_qdsp6ss_timestamp_clk
  gosub Find_Print_Clock clk_axi_crypto
  gosub Find_Print_Clock clk_bus_pseudo_hm_rcg
  gosub Find_Print_Clock clk_timeout_slp
  gosub Find_Print_Clock clk_xo_cx
  gosub Find_Print_Clock dbg_dtr_clksig
  gosub Find_Print_Clock dbg_modem_clksig
  gosub Find_Print_Clock dbg_nav_clksig
  gosub Find_Print_Clock dbg_q6_clksig
  gosub Find_Print_Clock dtr1_pll_dtest
  gosub Find_Print_Clock dtr1_pll_lock_det
  gosub Find_Print_Clock dtr2_pll_dtest
  gosub Find_Print_Clock dtr2_pll_lock_det
  gosub Find_Print_Clock gcc_mss_mfab_axi_clk_src
  gosub Find_Print_Clock gcc_mss_nav_ce_axi_clk_src
  gosub Find_Print_Clock modem_offline_pll_dtest
  gosub Find_Print_Clock mss_dgr_axi_clk
  gosub Find_Print_Clock mss_offline_pll_lock_det
  gosub Find_Print_Clock nav_pll_dtest
  gosub Find_Print_Clock nav_pll_lock_det
  gosub Find_Print_Clock q6_pll_dtest
  gosub Find_Print_Clock q6_pll_lock_det
  gosub Find_Print_Clock bb_core_clk
  gosub Find_Print_Clock bb_qlink_clk
  gosub Find_Print_Clock cp_clk
  gosub Find_Print_Clock dma_clk
  gosub Find_Print_Clock dp_clk
  gosub Find_Print_Clock gnss_adc_ret_clk
  gosub Find_Print_Clock adc1_clk
  gosub Find_Print_Clock bp1_src_clk
  gosub Find_Print_Clock bp2_src_clk
  gosub Find_Print_Clock bp3_src_clk
  gosub Find_Print_Clock bp_mbs_src_clk
  gosub Find_Print_Clock wtr_core_clk
  gosub Find_Print_Clock stmr_xo_clk
  gosub Find_Print_Clock xo_gdsc_clk
  gosub Find_Print_Clock wcss_dbg_apb_clk
  gosub Find_Print_Clock wcss_dbg_atb_clk
  gosub Find_Print_Clock wcss_dbg_css_apb_clk
  gosub Find_Print_Clock wcss_dbg_css_atb_clk
  gosub Find_Print_Clock wcss_dbg_css_ts_clk
  gosub Find_Print_Clock wcss_dbg_ts_clk
  gosub Find_Print_Clock wcss_ahb_tslv_clk
  gosub Find_Print_Clock wcss_css_apb_clk
  gosub Find_Print_Clock wcss_css_noc_clk
  gosub Find_Print_Clock wcss_phy1_apb_clk
  gosub Find_Print_Clock wcss_phy2_apb_clk
  gosub Find_Print_Clock wcss_rfactrl_apb_clk
  gosub Find_Print_Clock wcss_rfactrl_dac_apb_clk
  gosub Find_Print_Clock wcss_top_ahb_clk
  gosub Find_Print_Clock wcss_top_axi_clk
  gosub Find_Print_Clock wcss_top_dac_apb_clk
  gosub Find_Print_Clock wcss_wcssdbg_cfg_apb_clk
  gosub Find_Print_Clock wcss_wcssdbg_trc_clk
  gosub Find_Print_Clock wcss_wmac1_apb_clk
  gosub Find_Print_Clock wcss_wmac2_apb_clk
  gosub Find_Print_Clock wcss_css_phy1_t240_clk
  gosub Find_Print_Clock wcss_phy1_160_clk
  gosub Find_Print_Clock wcss_phy1_20_clk
  gosub Find_Print_Clock wcss_phy1_30_clk
  gosub Find_Print_Clock wcss_phy1_320_clk
  gosub Find_Print_Clock wcss_phy1_40_clk
  gosub Find_Print_Clock wcss_phy1_80_clk
  gosub Find_Print_Clock wcss_phy1_bw_clk
  gosub Find_Print_Clock wcss_phy1_bwx2_clk
  gosub Find_Print_Clock wcss_phy1_clk
  gosub Find_Print_Clock wcss_phy1_dfs_clk
  gosub Find_Print_Clock wcss_phy1_t240_clk
  gosub Find_Print_Clock wcss_phy1_tadc_clk
  gosub Find_Print_Clock wcss_phy1_tdac_clk
  gosub Find_Print_Clock wcss_phy1_x2_clk
  gosub Find_Print_Clock wcss_rfactrl_phy1_80_clk
  gosub Find_Print_Clock phy1_11ac_radio_adc_0_clk
  gosub Find_Print_Clock wcss_rfactrl_phy1_11ac_radio_adc_0_clk
  gosub Find_Print_Clock wcss_css_phy1_t240_clk
  gosub Find_Print_Clock wcss_phy1_160_clk
  gosub Find_Print_Clock wcss_phy1_20_clk
  gosub Find_Print_Clock wcss_phy1_30_clk
  gosub Find_Print_Clock wcss_phy1_320_clk
  gosub Find_Print_Clock wcss_phy1_40_clk
  gosub Find_Print_Clock wcss_phy1_80_clk
  gosub Find_Print_Clock wcss_phy1_bw_clk
  gosub Find_Print_Clock wcss_phy1_bwx2_clk
  gosub Find_Print_Clock wcss_phy1_clk
  gosub Find_Print_Clock wcss_phy1_dfs_clk
  gosub Find_Print_Clock wcss_phy1_t240_clk
  gosub Find_Print_Clock wcss_phy1_tadc_clk
  gosub Find_Print_Clock wcss_phy1_tdac_clk
  gosub Find_Print_Clock wcss_phy1_x2_clk
  gosub Find_Print_Clock wcss_rfactrl_phy1_80_clk
  gosub Find_Print_Clock wcss_css_phy2_t240_clk
  gosub Find_Print_Clock wcss_phy2_160_clk
  gosub Find_Print_Clock wcss_phy2_20_clk
  gosub Find_Print_Clock wcss_phy2_30_clk
  gosub Find_Print_Clock wcss_phy2_320_clk
  gosub Find_Print_Clock wcss_phy2_40_clk
  gosub Find_Print_Clock wcss_phy2_80_clk
  gosub Find_Print_Clock wcss_phy2_bw_clk
  gosub Find_Print_Clock wcss_phy2_bwx2_clk
  gosub Find_Print_Clock wcss_phy2_clk
  gosub Find_Print_Clock wcss_phy2_dfs_clk
  gosub Find_Print_Clock wcss_phy2_t240_clk
  gosub Find_Print_Clock wcss_phy2_tadc_clk
  gosub Find_Print_Clock wcss_phy2_tdac_clk
  gosub Find_Print_Clock wcss_phy2_x2_clk
  gosub Find_Print_Clock wcss_rfactrl_phy2_80_clk
  gosub Find_Print_Clock phy2_11ac_radio_adc_0_clk
  gosub Find_Print_Clock wcss_css_phy2_t240_clk
  gosub Find_Print_Clock wcss_phy2_160_clk
  gosub Find_Print_Clock wcss_phy2_20_clk
  gosub Find_Print_Clock wcss_phy2_30_clk
  gosub Find_Print_Clock wcss_phy2_320_clk
  gosub Find_Print_Clock wcss_phy2_40_clk
  gosub Find_Print_Clock wcss_phy2_80_clk
  gosub Find_Print_Clock wcss_phy2_bw_clk
  gosub Find_Print_Clock wcss_phy2_bwx2_clk
  gosub Find_Print_Clock wcss_phy2_clk
  gosub Find_Print_Clock wcss_phy2_dfs_clk
  gosub Find_Print_Clock wcss_phy2_t240_clk
  gosub Find_Print_Clock wcss_phy2_tadc_clk
  gosub Find_Print_Clock wcss_phy2_tdac_clk
  gosub Find_Print_Clock wcss_phy2_x2_clk
  gosub Find_Print_Clock wcss_rfactrl_phy2_80_clk
  gosub Find_Print_Clock phy1_11ac_radio_adc_1_clk
  gosub Find_Print_Clock wcss_rfactrl_phy1_11ac_radio_adc_1_clk
  gosub Find_Print_Clock phy2_11ac_radio_adc_1_clk
  gosub Find_Print_Clock wcss_dac_sm_clk
  gosub Find_Print_Clock wcss_top_ref_clk
  gosub Find_Print_Clock wcss_rfactrl_clk
  gosub Find_Print_Clock wcss_top_slp_clk
  gosub Find_Print_Clock wcss_debug_clkout_cbc_out
  gosub Find_Print_Clock wcss_wmac1_css_mac_clk
  gosub Find_Print_Clock wcss_wmac1_mac_clk
  gosub Find_Print_Clock wcss_wmac2_css_mac_clk
  gosub Find_Print_Clock wcss_wmac2_mac_clk
  gosub Find_Print_Clock wcss_css_wsi_clk

  return


Print_All_SS:
(
  local &choice
  entry &choice

  if ("&choice"=="gcc_all")
  (
    gosub Find_Print_Clock gcc_sec_ctrl_acc_clk
    gosub Find_Print_Clock gcc_apc0_vs_clk
    gosub Find_Print_Clock apc0_vs_pll0_clk_src
    gosub Find_Print_Clock gcc_apc1_vs_clk
    gosub Find_Print_Clock apc1_vs_pll0_clk_src
    gosub Find_Print_Clock gcc_bimc_clk
    gosub Find_Print_Clock gcc_spdm_bimc_cy_clk
    gosub Find_Print_Clock gcc_bimc_ddr_cpll0_clk
    gosub Find_Print_Clock gcc_bimc_ddr_cpll1_clk
    gosub Find_Print_Clock gcc_bimc_dtts_xo_clk
    gosub Find_Print_Clock gcc_bimc_xo_clk
    gosub Find_Print_Clock gcc_cfg_noc_ddr_cfg_clk
    gosub Find_Print_Clock gcc_cnoc_bus_timeout5_ahb_clk
    gosub Find_Print_Clock gcc_ddr_dim_cfg_clk
    gosub Find_Print_Clock gcc_bimc_hmss_axi_clk
    gosub Find_Print_Clock gcc_blsp1_qup1_i2c_apps_clk
    gosub Find_Print_Clock gcc_blsp1_qup1_spi_apps_clk
    gosub Find_Print_Clock gcc_blsp1_qup2_i2c_apps_clk
    gosub Find_Print_Clock gcc_blsp1_qup2_spi_apps_clk
    gosub Find_Print_Clock gcc_blsp1_qup3_i2c_apps_clk
    gosub Find_Print_Clock gcc_blsp1_qup3_spi_apps_clk
    gosub Find_Print_Clock gcc_blsp1_qup4_i2c_apps_clk
    gosub Find_Print_Clock gcc_blsp1_qup4_spi_apps_clk
    gosub Find_Print_Clock gcc_blsp1_qup5_i2c_apps_clk
    gosub Find_Print_Clock gcc_blsp1_qup5_spi_apps_clk
    gosub Find_Print_Clock gcc_blsp1_qup6_i2c_apps_clk
    gosub Find_Print_Clock gcc_blsp1_qup6_spi_apps_clk
    gosub Find_Print_Clock gcc_blsp1_uart1_apps_clk
    gosub Find_Print_Clock gcc_blsp1_uart2_apps_clk
    gosub Find_Print_Clock gcc_blsp1_uart3_apps_clk
    gosub Find_Print_Clock gcc_blsp2_qup1_i2c_apps_clk
    gosub Find_Print_Clock gcc_blsp2_qup1_spi_apps_clk
    gosub Find_Print_Clock gcc_blsp2_qup2_i2c_apps_clk
    gosub Find_Print_Clock gcc_blsp2_qup2_spi_apps_clk
    gosub Find_Print_Clock gcc_blsp2_qup3_i2c_apps_clk
    gosub Find_Print_Clock gcc_blsp2_qup3_spi_apps_clk
    gosub Find_Print_Clock gcc_blsp2_qup4_i2c_apps_clk
    gosub Find_Print_Clock gcc_blsp2_qup4_spi_apps_clk
    gosub Find_Print_Clock gcc_blsp2_qup5_i2c_apps_clk
    gosub Find_Print_Clock gcc_blsp2_qup5_spi_apps_clk
    gosub Find_Print_Clock gcc_blsp2_qup6_i2c_apps_clk
    gosub Find_Print_Clock gcc_blsp2_qup6_spi_apps_clk
    gosub Find_Print_Clock gcc_blsp2_uart1_apps_clk
    gosub Find_Print_Clock gcc_blsp2_uart2_apps_clk
    gosub Find_Print_Clock gcc_blsp2_uart3_apps_clk
    gosub Find_Print_Clock gcc_blsp1_uart1_sim_clk
    gosub Find_Print_Clock gcc_blsp1_uart2_sim_clk
    gosub Find_Print_Clock gcc_blsp1_uart3_sim_clk
    gosub Find_Print_Clock gcc_blsp2_uart1_sim_clk
    gosub Find_Print_Clock gcc_blsp2_uart2_sim_clk
    gosub Find_Print_Clock gcc_blsp2_uart3_sim_clk
    gosub Find_Print_Clock gcc_ce1_clk
    gosub Find_Print_Clock gcc_aggre1_cnoc_periph_ahb_clk
    gosub Find_Print_Clock gcc_aggre2_cnoc_periph_ahb_clk
    gosub Find_Print_Clock gcc_blsp1_ahb_clk
    gosub Find_Print_Clock gcc_blsp2_ahb_clk
    gosub Find_Print_Clock gcc_cnoc_periph_bus_timeout1_ahb_clk
    gosub Find_Print_Clock gcc_cnoc_periph_bus_timeout2_ahb_clk
    gosub Find_Print_Clock gcc_cnoc_periph_east_ahb_clk
    gosub Find_Print_Clock gcc_cnoc_periph_west_ahb_clk
    gosub Find_Print_Clock gcc_pdm_ahb_clk
    gosub Find_Print_Clock gcc_sdcc2_ahb_clk
    gosub Find_Print_Clock gcc_sdcc4_ahb_clk
    gosub Find_Print_Clock gcc_spdm_pnoc_cy_clk
    gosub Find_Print_Clock gcc_tsif_ahb_clk
    gosub Find_Print_Clock gcc_usb_phy_cfg_ahb2phy_clk
    gosub Find_Print_Clock gcc_aggre1_cnoc_ahb_clk
    gosub Find_Print_Clock gcc_aggre1_noc_msmpu_cfg_ahb_clk
    gosub Find_Print_Clock gcc_aggre2_cnoc_ahb_clk
    gosub Find_Print_Clock gcc_aggre2_noc_msmpu_cfg_ahb_clk
    gosub Find_Print_Clock gcc_ahb_clk
    gosub Find_Print_Clock gcc_bimc_cfg_ahb_clk
    gosub Find_Print_Clock gcc_bimc_nius_cfg_ahb_clk
    gosub Find_Print_Clock gcc_boot_rom_ahb_clk
    gosub Find_Print_Clock gcc_ce1_ahb_clk
    gosub Find_Print_Clock gcc_cfg_noc_ahb_clk
    gosub Find_Print_Clock gcc_cfg_noc_east_ahb_clk
    gosub Find_Print_Clock gcc_cfg_noc_north_ahb_clk
    gosub Find_Print_Clock gcc_cfg_noc_west_ahb_clk
    gosub Find_Print_Clock gcc_cnoc_bus_timeout0_ahb_clk
    gosub Find_Print_Clock gcc_cnoc_bus_timeout10_ahb_clk
    gosub Find_Print_Clock gcc_cnoc_bus_timeout11_ahb_clk
    gosub Find_Print_Clock gcc_cnoc_bus_timeout12_ahb_clk
    gosub Find_Print_Clock gcc_cnoc_bus_timeout1_ahb_clk
    gosub Find_Print_Clock gcc_cnoc_bus_timeout2_ahb_clk
    gosub Find_Print_Clock gcc_cnoc_bus_timeout3_ahb_clk
    gosub Find_Print_Clock gcc_cnoc_bus_timeout4_ahb_clk
    gosub Find_Print_Clock gcc_cnoc_bus_timeout6_ahb_clk
    gosub Find_Print_Clock gcc_cnoc_bus_timeout7_ahb_clk
    gosub Find_Print_Clock gcc_cnoc_bus_timeout8_ahb_clk
    gosub Find_Print_Clock gcc_cnoc_bus_timeout9_ahb_clk
    gosub Find_Print_Clock gcc_cnoc_mst_rpm_ahb_clk
    gosub Find_Print_Clock gcc_dcc_ahb_clk
    gosub Find_Print_Clock gcc_glm_ahb_clk
    gosub Find_Print_Clock gcc_gpu_cfg_ahb_clk
    gosub Find_Print_Clock gcc_imem_cfg_ahb_clk
    gosub Find_Print_Clock gcc_ipa_ahb_clk
    gosub Find_Print_Clock gcc_lpass_core_smmu_ahb_clk
    gosub Find_Print_Clock gcc_lpass_q6_smmu_ahb_clk
    gosub Find_Print_Clock gcc_lpass_smmu_aon_ahb_clk
    gosub Find_Print_Clock gcc_mccc_cfg_ahb_clk
    gosub Find_Print_Clock gcc_mmss_noc_cfg_ahb_clk
    gosub Find_Print_Clock gcc_mmss_qm_ahb_clk
    gosub Find_Print_Clock gcc_mpm_ahb_clk
    gosub Find_Print_Clock gcc_msg_ram_ahb_clk
    gosub Find_Print_Clock gcc_mss_cfg_ahb_clk
    gosub Find_Print_Clock gcc_mss_msmpu_cfg_ahb_clk
    gosub Find_Print_Clock gcc_mss_q6_msmpu_cfg_ahb_clk
    gosub Find_Print_Clock gcc_pcie_0_cfg_ahb_clk
    gosub Find_Print_Clock gcc_pimem_ahb_clk
    gosub Find_Print_Clock gcc_prng_ahb_clk
    gosub Find_Print_Clock gcc_qdss_cfg_ahb_clk
    gosub Find_Print_Clock gcc_qdss_dap_ahb_clk
    gosub Find_Print_Clock gcc_rbcpr_cx_ahb_clk
    gosub Find_Print_Clock gcc_rbcpr_mx_ahb_clk
    gosub Find_Print_Clock gcc_rpm_mst_m2_cnoc_ahb_clk
    gosub Find_Print_Clock gcc_sec_ctrl_ahb_clk
    gosub Find_Print_Clock gcc_sec_ctrl_boot_rom_patch_clk
    gosub Find_Print_Clock gcc_skl_ahb_clk
    gosub Find_Print_Clock gcc_smmu_aggre1_ahb_clk
    gosub Find_Print_Clock gcc_smmu_aggre2_ahb_clk
    gosub Find_Print_Clock gcc_snoc_cnoc_ahb_clk
    gosub Find_Print_Clock gcc_spdm_cfg_ahb_clk
    gosub Find_Print_Clock gcc_spdm_mstr_ahb_clk
    gosub Find_Print_Clock gcc_spmi_cnoc_ahb_clk
    gosub Find_Print_Clock gcc_spss_cfg_ahb_clk
    gosub Find_Print_Clock gcc_spss_scsr_clk
    gosub Find_Print_Clock gcc_ssc_cnoc_ahbs_clk
    gosub Find_Print_Clock gcc_ssc_cnoc_mpu_clk
    gosub Find_Print_Clock gcc_tcsr_ahb_clk
    gosub Find_Print_Clock gcc_tic_cfg_ahb_clk
    gosub Find_Print_Clock gcc_tlmm_clk
    gosub Find_Print_Clock gcc_tlmm_east_ahb_clk
    gosub Find_Print_Clock gcc_tlmm_north_ahb_clk
    gosub Find_Print_Clock gcc_tlmm_west_ahb_clk
    gosub Find_Print_Clock gcc_ufs_ahb_clk
    gosub Find_Print_Clock gcc_spdm_debug_cy_clk
    gosub Find_Print_Clock gcc_bimc_sleep_clk
    gosub Find_Print_Clock gcc_blsp1_sleep_clk
    gosub Find_Print_Clock gcc_blsp2_sleep_clk
    gosub Find_Print_Clock gcc_ddr_dim_sleep_clk
    gosub Find_Print_Clock gcc_im_sleep_clk
    gosub Find_Print_Clock gcc_ipa_sleep_clk
    gosub Find_Print_Clock gcc_rpm_sleep_clk
    gosub Find_Print_Clock gcc_tsif_inactivity_timers_clk
    gosub Find_Print_Clock gcc_usb30_sleep_clk
    gosub Find_Print_Clock gcc_aggre1_noc_xo_clk
    gosub Find_Print_Clock gcc_ahb2phy_east_clk
    gosub Find_Print_Clock gcc_cfg_noc_ah2phy_xo_clk
    gosub Find_Print_Clock gcc_cfg_noc_dcd_xo_clk
    gosub Find_Print_Clock gcc_cfg_noc_east_dcd_xo_clk
    gosub Find_Print_Clock gcc_cfg_noc_north_dcd_xo_clk
    gosub Find_Print_Clock gcc_cfg_noc_west_dcd_xo_clk
    gosub Find_Print_Clock gcc_cm_phy_refgen1_clk
    gosub Find_Print_Clock gcc_cm_phy_refgen2_clk
    gosub Find_Print_Clock gcc_cnoc_bus_timeout13_ahb_clk
    gosub Find_Print_Clock gcc_glm_xo_clk
    gosub Find_Print_Clock gcc_pdm_xo4_clk
    gosub Find_Print_Clock gcc_qdss_xo_clk
    gosub Find_Print_Clock gcc_qrefs_vbg_cal_clk
    gosub Find_Print_Clock gcc_rpm_timer_clk
    gosub Find_Print_Clock gcc_spdm_ff_clk
    gosub Find_Print_Clock gcc_spss_xo_clk
    gosub Find_Print_Clock gcc_sram_sensor_xo_clk
    gosub Find_Print_Clock gcc_ssc_xo_clk
    gosub Find_Print_Clock gcc_sys_noc_dcd_xo_clk
    gosub Find_Print_Clock gcc_xo_clk
    gosub Find_Print_Clock gcc_xo_div4_clk
    gosub Find_Print_Clock gcc_glm_clk
    gosub Find_Print_Clock gcc_gp1_clk
    gosub Find_Print_Clock gcc_gp2_clk
    gosub Find_Print_Clock gcc_gp3_clk
    gosub Find_Print_Clock gcc_bimc_gfx_clk
    gosub Find_Print_Clock gcc_gpu_bimc_gfx_clk
    gosub Find_Print_Clock gcc_gpu_bimc_gfx_src_clk
    gosub Find_Print_Clock gcc_gpu_snoc_dvm_gfx_clk
    gosub Find_Print_Clock gcc_gpu_vs_clk
    gosub Find_Print_Clock gpu_vs_pll0_clk_src
    gosub Find_Print_Clock gcc_hmss_ahb_clk
    gosub Find_Print_Clock gcc_snoc_bus_timeout0_ahb_clk
    gosub Find_Print_Clock gcc_sys_noc_hmss_ahb_clk
    gosub Find_Print_Clock gcc_hmss_rbcpr_clk
    gosub Find_Print_Clock gcc_aggre2_noc_ipa_clk
    gosub Find_Print_Clock gcc_ipa_2x_clk
    gosub Find_Print_Clock gcc_ipa_clk
    gosub Find_Print_Clock gcc_mmss_qm_core_clk
    gosub Find_Print_Clock gcc_bimc_mss_q6_axi_clk
    gosub Find_Print_Clock gcc_mss_q6_bimc_axi_clk
    gosub Find_Print_Clock gcc_mss_q6_msmpu_client_axi_clk
    gosub Find_Print_Clock gcc_mss_vs_clk
    gosub Find_Print_Clock mss_vs_pll0_clk_src
    gosub Find_Print_Clock gcc_obt_odt_clk
    gosub Find_Print_Clock gcc_pcie_0_pipe_clk
    gosub Find_Print_Clock pcie_0_pipe_clk_src
    gosub Find_Print_Clock gcc_pcie_0_aux_clk
    gosub Find_Print_Clock gcc_pcie_phy_aux_clk
    gosub Find_Print_Clock gcc_pdm2_clk
    gosub Find_Print_Clock gcc_bimc_pimem_axi_clk
    gosub Find_Print_Clock gcc_pimem_axi_clk
    gosub Find_Print_Clock gcc_sys_noc_pimem_axi_clk
    gosub Find_Print_Clock gcc_center_apb_clk
    gosub Find_Print_Clock gcc_east_apb_clk
    gosub Find_Print_Clock gcc_gpu_trig_clk
    gosub Find_Print_Clock gcc_hmss_trig_clk
    gosub Find_Print_Clock gcc_lpass_trig_clk
    gosub Find_Print_Clock gcc_mmss_trig_clk
    gosub Find_Print_Clock gcc_mss_trig_clk
    gosub Find_Print_Clock gcc_north_apb_clk
    gosub Find_Print_Clock gcc_qdss_apb2jtag_clk
    gosub Find_Print_Clock gcc_qdss_dap_clk
    gosub Find_Print_Clock gcc_qdss_trig_clk
    gosub Find_Print_Clock gcc_spss_trig_clk
    gosub Find_Print_Clock gcc_ssc_apb_clk
    gosub Find_Print_Clock gcc_wcss_apb_clk
    gosub Find_Print_Clock gcc_west_apb_clk
    gosub Find_Print_Clock gcc_aggre1_noc_at_clk
    gosub Find_Print_Clock gcc_aggre2_noc_at_clk
    gosub Find_Print_Clock gcc_east_at_clk
    gosub Find_Print_Clock gcc_gpu_at_clk
    gosub Find_Print_Clock gcc_hmss_at_clk
    gosub Find_Print_Clock gcc_mmss_at_clk
    gosub Find_Print_Clock gcc_mmss_noc_at_clk
    gosub Find_Print_Clock gcc_qdss_center_at_clk
    gosub Find_Print_Clock gcc_sys_noc_at_clk
    gosub Find_Print_Clock gcc_wcss_at_clk
    gosub Find_Print_Clock gcc_west_at_clk
    gosub Find_Print_Clock gcc_bimc_at_clk
    gosub Find_Print_Clock gcc_mss_at_clk
    gosub Find_Print_Clock gcc_lpass_at_clk
    gosub Find_Print_Clock gcc_north_at_clk
    gosub Find_Print_Clock gcc_ssc_at_clk
    gosub Find_Print_Clock gcc_qdss_stm_clk
    gosub Find_Print_Clock gcc_sys_noc_qdss_stm_axi_clk
    gosub Find_Print_Clock gcc_qdss_traceclkin_clk
    gosub Find_Print_Clock gcc_qdss_tsctr_div16_clk
    gosub Find_Print_Clock gcc_qdss_tsctr_div2_clk
    gosub Find_Print_Clock gcc_qdss_tsctr_div3_clk
    gosub Find_Print_Clock gcc_qdss_tsctr_div4_clk
    gosub Find_Print_Clock gcc_qdss_tsctr_div8_clk
    gosub Find_Print_Clock gcc_wcss_tsctr_div2_clk
    gosub Find_Print_Clock gcc_apss_qdss_tsctr_div2_clk
    gosub Find_Print_Clock gcc_apss_qdss_tsctr_div8_clk
    gosub Find_Print_Clock gcc_rbcpr_cx_clk
    gosub Find_Print_Clock gcc_rbcpr_mx_clk
    gosub Find_Print_Clock gcc_rpm_bus_ahb_clk
    gosub Find_Print_Clock gcc_rpm_proc_fclk
    gosub Find_Print_Clock gcc_rpm_proc_hclk
    gosub Find_Print_Clock gcc_spdm_rpm_cy_clk
    gosub Find_Print_Clock gcc_sdcc2_apps_clk
    gosub Find_Print_Clock gcc_sdcc4_apps_clk
    gosub Find_Print_Clock gcc_sec_ctrl_clk
    gosub Find_Print_Clock gcc_sec_ctrl_sense_clk
    gosub Find_Print_Clock gcc_spss_sec_ctrl_clk
    gosub Find_Print_Clock sec_ctrl_acc_clk_src
    gosub Find_Print_Clock gcc_spmi_ahb_clk
    gosub Find_Print_Clock gcc_spmi_ser_clk
    gosub Find_Print_Clock gcc_bimc_nius_hs_axi_clk
    gosub Find_Print_Clock gcc_bimc_sysnoc_hs_axi_clk
    gosub Find_Print_Clock gcc_lpass_q6_axi_clk
    gosub Find_Print_Clock gcc_lpass_q6_smmu_axi_clk
    gosub Find_Print_Clock gcc_lpass_q6_smmu_axi_src_clk
    gosub Find_Print_Clock gcc_mss_mnoc_bimc_axi_clk
    gosub Find_Print_Clock gcc_mss_msmpu_client_axi_clk
    gosub Find_Print_Clock gcc_sys_noc_hs_axi_clk
    gosub Find_Print_Clock gcc_aggre1_snoc_axi_clk
    gosub Find_Print_Clock gcc_aggre1_snoc_msmpu_client_axi_clk
    gosub Find_Print_Clock gcc_aggre2_snoc_axi_clk
    gosub Find_Print_Clock gcc_aggre2_snoc_east_axi_clk
    gosub Find_Print_Clock gcc_aggre2_snoc_msmpu_client_axi_clk
    gosub Find_Print_Clock gcc_aggre2_snoc_north_axi_clk
    gosub Find_Print_Clock gcc_bimc_nius_axi_clk
    gosub Find_Print_Clock gcc_bimc_sysnoc_axi_clk
    gosub Find_Print_Clock gcc_ce1_axi_clk
    gosub Find_Print_Clock gcc_hmss_dvm_bus_clk
    gosub Find_Print_Clock gcc_imem_axi_clk
    gosub Find_Print_Clock gcc_lpass_core_smmu_client_clk
    gosub Find_Print_Clock gcc_lpass_core_smmu_client_src_clk
    gosub Find_Print_Clock gcc_lpass_sway_clk
    gosub Find_Print_Clock gcc_mmss_sys_noc_axi_clk
    gosub Find_Print_Clock gcc_mss_snoc_axi_clk
    gosub Find_Print_Clock gcc_pcie_0_mstr_axi_clk
    gosub Find_Print_Clock gcc_pcie_0_slv_axi_clk
    gosub Find_Print_Clock gcc_qdss_etr_usb_clk
    gosub Find_Print_Clock gcc_smmu_aggre1_axi_clk
    gosub Find_Print_Clock gcc_smmu_aggre1_axi_src_clk
    gosub Find_Print_Clock gcc_smmu_aggre2_axi_clk
    gosub Find_Print_Clock gcc_smmu_aggre2_axi_src_clk
    gosub Find_Print_Clock gcc_snoc_bus_timeout1_ahb_clk
    gosub Find_Print_Clock gcc_snoc_bus_timeout3_ahb_clk
    gosub Find_Print_Clock gcc_spdm_snoc_cy_clk
    gosub Find_Print_Clock gcc_spss_snoc_emm_clk
    gosub Find_Print_Clock gcc_ssc_snoc_ahbm_clk
    gosub Find_Print_Clock gcc_sys_noc_axi_clk
    gosub Find_Print_Clock gcc_sys_noc_east_axi_clk
    gosub Find_Print_Clock gcc_sys_noc_ssc_q6_axi_clk
    gosub Find_Print_Clock gcc_sys_noc_west_axi_clk
    gosub Find_Print_Clock gcc_wcss_ahb_s0_clk
    gosub Find_Print_Clock gcc_wcss_axi_m_clk
    gosub Find_Print_Clock gcc_wcss_ecahb_clk
    gosub Find_Print_Clock gcc_wcss_shdreg_ahb_clk
    gosub Find_Print_Clock gcc_cfg_noc_tic_clk
    gosub Find_Print_Clock gcc_tic_clk
    gosub Find_Print_Clock gcc_tsif_ref_clk
    gosub Find_Print_Clock gcc_aggre1_ufs_axi_clk
    gosub Find_Print_Clock gcc_ufs_axi_clk
    gosub Find_Print_Clock gcc_ufs_ice_core_clk
    gosub Find_Print_Clock gcc_ufs_phy_aux_clk
    gosub Find_Print_Clock gcc_ufs_rx_symbol_0_clk
    gosub Find_Print_Clock ufs_rx_symbol_0_clk_src
    gosub Find_Print_Clock gcc_ufs_rx_symbol_1_clk
    gosub Find_Print_Clock ufs_rx_symbol_1_clk_src
    gosub Find_Print_Clock gcc_ufs_tx_symbol_0_clk
    gosub Find_Print_Clock ufs_tx_symbol_0_clk_src
    gosub Find_Print_Clock gcc_ufs_unipro_core_clk
    gosub Find_Print_Clock gcc_aggre1_usb3_axi_clk
    gosub Find_Print_Clock gcc_cfg_noc_usb3_axi_clk
    gosub Find_Print_Clock gcc_cnoc_bus_timeout14_ahb_clk
    gosub Find_Print_Clock gcc_usb30_master_clk
    gosub Find_Print_Clock gcc_usb30_mock_utmi_clk
    gosub Find_Print_Clock gcc_usb3_phy_aux_clk
    gosub Find_Print_Clock gcc_usb3_phy_pipe_clk
    gosub Find_Print_Clock usb3_phy_pipe_clk_src
    gosub Find_Print_Clock gcc_vdda_vs_clk
    gosub Find_Print_Clock vdda_vs_pll0_clk_src
    gosub Find_Print_Clock gcc_vddcx_vs_clk
    gosub Find_Print_Clock vddcx_vs_pll0_clk_src
    gosub Find_Print_Clock gcc_vddmx_vs_clk
    gosub Find_Print_Clock vddmx_vs_pll0_clk_src
    gosub Find_Print_Clock gcc_vs_ctrl_clk
    gosub Find_Print_Clock gcc_aggre1_noc_qosgen_extref
    gosub Find_Print_Clock gcc_aggre2_noc_qosgen_extref
    gosub Find_Print_Clock gcc_cnoc_bus_timeout_extref
    gosub Find_Print_Clock gcc_snoc_bus_timeout_extref
    gosub Find_Print_Clock gcc_snoc_qosgen_extref
    gosub Find_Print_Clock gpu_gcc_dbg_clk
    gosub Find_Print_Clock hmss_gcc_dbg_clk
    gosub Find_Print_Clock lpass_gcc_dbg_clk
    gosub Find_Print_Clock mmss_gcc_dbg_clk
    gosub Find_Print_Clock mpm_gcc_temp0_sensor_ringosc_clk
    gosub Find_Print_Clock mpm_gcc_temp1_sensor_ringosc_clk
    gosub Find_Print_Clock mss_gcc_dbg_clk
    gosub Find_Print_Clock nav_gcc_dbg_clk
    gosub Find_Print_Clock pcie_0_pipe_clk
    gosub Find_Print_Clock qusb2phy_gcc_clk_test_prim
    gosub Find_Print_Clock qusb2phy_prim_gcc_usb30_utmi_clk
    gosub Find_Print_Clock spss_gcc_dbg_clk
    gosub Find_Print_Clock ssc_gcc_dbg_clk
    gosub Find_Print_Clock ufs_rx_symbol_0_clk
    gosub Find_Print_Clock ufs_rx_symbol_1_clk
    gosub Find_Print_Clock ufs_tx_symbol_0_clk
    gosub Find_Print_Clock usb3_phy_wrapper_gcc_usb3_pipe_clk
    gosub Find_Print_Clock wcss_gcc_dbg_clk
    return 1.
  )
  if ("&choice"=="mss_all")
  (
    gosub Find_Print_Clock clk_src_bit_coxm_mnd
    gosub Find_Print_Clock clk_bit_coxm
    gosub Find_Print_Clock clk_src_bus_mss_config
    gosub Find_Print_Clock clk_bus_config
    gosub Find_Print_Clock clk_bus_coxm
    gosub Find_Print_Clock clk_bus_crypto
    gosub Find_Print_Clock clk_bus_mgpi
    gosub Find_Print_Clock clk_bus_mvc
    gosub Find_Print_Clock clk_bus_nav
    gosub Find_Print_Clock clk_bus_pll_outctrl
    gosub Find_Print_Clock clk_bus_q6
    gosub Find_Print_Clock clk_bus_rbcpr
    gosub Find_Print_Clock clk_bus_rfc
    gosub Find_Print_Clock clk_bus_slave_timeout
    gosub Find_Print_Clock clk_bus_stmr
    gosub Find_Print_Clock clk_bus_uim0
    gosub Find_Print_Clock clk_bus_uim1
    gosub Find_Print_Clock clk_bus_uim2
    gosub Find_Print_Clock clk_bus_uim3
    gosub Find_Print_Clock mss_dgr_ahb_clk
    gosub Find_Print_Clock mss_dgr_freerun_ahb_clk
    gosub Find_Print_Clock clk_src_bus_mss_config
    gosub Find_Print_Clock clk_q6
    gosub Find_Print_Clock gcc_mss_mfab_axi_clk_src
    gosub Find_Print_Clock clk_axi_mnoc
    gosub Find_Print_Clock clk_axi_mnoc_q6
    gosub Find_Print_Clock clk_axi_nav_sample
    gosub Find_Print_Clock gcc_mss_nav_ce_axi_clk_src
    gosub Find_Print_Clock clk_axi_nav
    gosub Find_Print_Clock clk_src_rbcpr_ref
    gosub Find_Print_Clock clk_rbcpr_ref
    gosub Find_Print_Clock clk_src_uim0_mnd
    gosub Find_Print_Clock clk_uart_bit_uim0
    gosub Find_Print_Clock clk_src_uim1_mnd
    gosub Find_Print_Clock clk_uart_bit_uim1
    gosub Find_Print_Clock clk_src_uim2_mnd
    gosub Find_Print_Clock clk_uart_bit_uim2
    gosub Find_Print_Clock clk_src_uim3_mnd
    gosub Find_Print_Clock clk_uart_bit_uim3
    gosub Find_Print_Clock clk_card_src_uim0
    gosub Find_Print_Clock clk_card_src_uim1
    gosub Find_Print_Clock clk_card_src_uim2
    gosub Find_Print_Clock clk_card_src_uim3
    gosub Find_Print_Clock clk_xo_mdm
    gosub Find_Print_Clock clk_xo_nav
    gosub Find_Print_Clock clk_src_bus_xo
    gosub Find_Print_Clock clk_mdm
    gosub Find_Print_Clock mss_qdsp6ss_q6_core_clk
    gosub Find_Print_Clock mss_qdsp6ss_axi_m_clk
    gosub Find_Print_Clock mss_qdsp6ss_ldo_nmo_out
    gosub Find_Print_Clock mss_qdsp6ss_ahb_m_clk
    gosub Find_Print_Clock mss_qdsp6ss_ahb_s_clk
    gosub Find_Print_Clock mss_qdsp6ss_xo_clk
    gosub Find_Print_Clock mss_qdsp6ss_sleep_clk
    gosub Find_Print_Clock mss_qdsp6ss_jtag_tck
    gosub Find_Print_Clock mss_qdsp6ss_atb_clk
    gosub Find_Print_Clock mss_qdsp6ss_apb_clk
    gosub Find_Print_Clock mss_qdsp6ss_timestamp_clk
    gosub Find_Print_Clock clk_axi_crypto
    gosub Find_Print_Clock clk_bus_pseudo_hm_rcg
    gosub Find_Print_Clock clk_timeout_slp
    gosub Find_Print_Clock clk_xo_cx
    gosub Find_Print_Clock dbg_dtr_clksig
    gosub Find_Print_Clock dbg_modem_clksig
    gosub Find_Print_Clock dbg_nav_clksig
    gosub Find_Print_Clock dbg_q6_clksig
    gosub Find_Print_Clock dtr1_pll_dtest
    gosub Find_Print_Clock dtr1_pll_lock_det
    gosub Find_Print_Clock dtr2_pll_dtest
    gosub Find_Print_Clock dtr2_pll_lock_det
    gosub Find_Print_Clock gcc_mss_mfab_axi_clk_src
    gosub Find_Print_Clock gcc_mss_nav_ce_axi_clk_src
    gosub Find_Print_Clock modem_offline_pll_dtest
    gosub Find_Print_Clock mss_dgr_axi_clk
    gosub Find_Print_Clock mss_offline_pll_lock_det
    gosub Find_Print_Clock nav_pll_dtest
    gosub Find_Print_Clock nav_pll_lock_det
    gosub Find_Print_Clock q6_pll_dtest
    gosub Find_Print_Clock q6_pll_lock_det
    return 1.
  )
  if ("&choice"=="nav_all")
  (
    gosub Find_Print_Clock bb_core_clk
    gosub Find_Print_Clock bb_qlink_clk
    gosub Find_Print_Clock cp_clk
    gosub Find_Print_Clock dma_clk
    gosub Find_Print_Clock dp_clk
    gosub Find_Print_Clock gnss_adc_ret_clk
    gosub Find_Print_Clock adc1_clk
    gosub Find_Print_Clock bp1_src_clk
    gosub Find_Print_Clock bp2_src_clk
    gosub Find_Print_Clock bp3_src_clk
    gosub Find_Print_Clock bp_mbs_src_clk
    gosub Find_Print_Clock wtr_core_clk
    gosub Find_Print_Clock stmr_xo_clk
    gosub Find_Print_Clock xo_gdsc_clk
    return 1.
  )
  if ("&choice"=="wcss_all")
  (
    gosub Find_Print_Clock wcss_dbg_apb_clk
    gosub Find_Print_Clock wcss_dbg_atb_clk
    gosub Find_Print_Clock wcss_dbg_css_apb_clk
    gosub Find_Print_Clock wcss_dbg_css_atb_clk
    gosub Find_Print_Clock wcss_dbg_css_ts_clk
    gosub Find_Print_Clock wcss_dbg_ts_clk
    gosub Find_Print_Clock dbg_atb_gfmux_clk_src
    gosub Find_Print_Clock wcss_ahb_tslv_clk
    gosub Find_Print_Clock wcss_css_apb_clk
    gosub Find_Print_Clock wcss_css_noc_clk
    gosub Find_Print_Clock wcss_phy1_apb_clk
    gosub Find_Print_Clock wcss_phy2_apb_clk
    gosub Find_Print_Clock wcss_rfactrl_apb_clk
    gosub Find_Print_Clock wcss_rfactrl_dac_apb_clk
    gosub Find_Print_Clock wcss_top_ahb_clk
    gosub Find_Print_Clock wcss_top_axi_clk
    gosub Find_Print_Clock wcss_top_dac_apb_clk
    gosub Find_Print_Clock wcss_wcssdbg_cfg_apb_clk
    gosub Find_Print_Clock wcss_wcssdbg_trc_clk
    gosub Find_Print_Clock wcss_wmac1_apb_clk
    gosub Find_Print_Clock wcss_wmac2_apb_clk
    gosub Find_Print_Clock wcss_css_phy1_t240_clk
    gosub Find_Print_Clock wcss_phy1_160_clk
    gosub Find_Print_Clock wcss_phy1_20_clk
    gosub Find_Print_Clock wcss_phy1_30_clk
    gosub Find_Print_Clock wcss_phy1_320_clk
    gosub Find_Print_Clock wcss_phy1_40_clk
    gosub Find_Print_Clock wcss_phy1_80_clk
    gosub Find_Print_Clock wcss_phy1_bw_clk
    gosub Find_Print_Clock wcss_phy1_bwx2_clk
    gosub Find_Print_Clock wcss_phy1_clk
    gosub Find_Print_Clock wcss_phy1_dfs_clk
    gosub Find_Print_Clock wcss_phy1_t240_clk
    gosub Find_Print_Clock wcss_phy1_tadc_clk
    gosub Find_Print_Clock wcss_phy1_tdac_clk
    gosub Find_Print_Clock wcss_phy1_x2_clk
    gosub Find_Print_Clock wcss_rfactrl_phy1_80_clk
    gosub Find_Print_Clock phy1_11ac_radio_adc_0_clk
    gosub Find_Print_Clock wcss_rfactrl_phy1_11ac_radio_adc_0_clk
    gosub Find_Print_Clock wcss_css_phy1_t240_clk
    gosub Find_Print_Clock wcss_phy1_160_clk
    gosub Find_Print_Clock wcss_phy1_20_clk
    gosub Find_Print_Clock wcss_phy1_30_clk
    gosub Find_Print_Clock wcss_phy1_320_clk
    gosub Find_Print_Clock wcss_phy1_40_clk
    gosub Find_Print_Clock wcss_phy1_80_clk
    gosub Find_Print_Clock wcss_phy1_bw_clk
    gosub Find_Print_Clock wcss_phy1_bwx2_clk
    gosub Find_Print_Clock wcss_phy1_clk
    gosub Find_Print_Clock wcss_phy1_dfs_clk
    gosub Find_Print_Clock wcss_phy1_t240_clk
    gosub Find_Print_Clock wcss_phy1_tadc_clk
    gosub Find_Print_Clock wcss_phy1_tdac_clk
    gosub Find_Print_Clock wcss_phy1_x2_clk
    gosub Find_Print_Clock wcss_rfactrl_phy1_80_clk
    gosub Find_Print_Clock phy1_gfmux_clk_src
    gosub Find_Print_Clock wcss_css_phy2_t240_clk
    gosub Find_Print_Clock wcss_phy2_160_clk
    gosub Find_Print_Clock wcss_phy2_20_clk
    gosub Find_Print_Clock wcss_phy2_30_clk
    gosub Find_Print_Clock wcss_phy2_320_clk
    gosub Find_Print_Clock wcss_phy2_40_clk
    gosub Find_Print_Clock wcss_phy2_80_clk
    gosub Find_Print_Clock wcss_phy2_bw_clk
    gosub Find_Print_Clock wcss_phy2_bwx2_clk
    gosub Find_Print_Clock wcss_phy2_clk
    gosub Find_Print_Clock wcss_phy2_dfs_clk
    gosub Find_Print_Clock wcss_phy2_t240_clk
    gosub Find_Print_Clock wcss_phy2_tadc_clk
    gosub Find_Print_Clock wcss_phy2_tdac_clk
    gosub Find_Print_Clock wcss_phy2_x2_clk
    gosub Find_Print_Clock wcss_rfactrl_phy2_80_clk
    gosub Find_Print_Clock phy2_11ac_radio_adc_0_clk
    gosub Find_Print_Clock wcss_css_phy2_t240_clk
    gosub Find_Print_Clock wcss_phy2_160_clk
    gosub Find_Print_Clock wcss_phy2_20_clk
    gosub Find_Print_Clock wcss_phy2_30_clk
    gosub Find_Print_Clock wcss_phy2_320_clk
    gosub Find_Print_Clock wcss_phy2_40_clk
    gosub Find_Print_Clock wcss_phy2_80_clk
    gosub Find_Print_Clock wcss_phy2_bw_clk
    gosub Find_Print_Clock wcss_phy2_bwx2_clk
    gosub Find_Print_Clock wcss_phy2_clk
    gosub Find_Print_Clock wcss_phy2_dfs_clk
    gosub Find_Print_Clock wcss_phy2_t240_clk
    gosub Find_Print_Clock wcss_phy2_tadc_clk
    gosub Find_Print_Clock wcss_phy2_tdac_clk
    gosub Find_Print_Clock wcss_phy2_x2_clk
    gosub Find_Print_Clock wcss_rfactrl_phy2_80_clk
    gosub Find_Print_Clock phy2_gfmux_clk_src
    gosub Find_Print_Clock phy1_11ac_radio_adc_1_clk
    gosub Find_Print_Clock wcss_rfactrl_phy1_11ac_radio_adc_1_clk
    gosub Find_Print_Clock phy2_11ac_radio_adc_1_clk
    gosub Find_Print_Clock wcss_dac_sm_clk
    gosub Find_Print_Clock wcss_top_ref_clk
    gosub Find_Print_Clock wcss_rfactrl_clk
    gosub Find_Print_Clock wcss_top_slp_clk
    gosub Find_Print_Clock wcss_debug_clkout_cbc_out
    gosub Find_Print_Clock wcss_cc_debug_prediv_clk_src
    gosub Find_Print_Clock wcss_noc_gfmux_clk_src
    gosub Find_Print_Clock wcss_wmac1_css_mac_clk
    gosub Find_Print_Clock wcss_wmac1_mac_clk
    gosub Find_Print_Clock wcss_wmac2_css_mac_clk
    gosub Find_Print_Clock wcss_wmac2_mac_clk
    gosub Find_Print_Clock wcss_css_wsi_clk
    return 1.
  )

  return 0.
)


;-----------------------------------------------------------------------------
; Find clocks that match what the user entered and print their information 
;-----------------------------------------------------------------------------

Find_Print_Clock:

ENTRY &clk

&clk_test=0
&clk_reg=0
&clk_reg_name=""

  &match=0
  &wild_head=0
  &wild_tail=0
  &clk_input_length=STRING.LENGTH("&clk")
  &clk_itr_length=STRING.LENGTH("gcc_sec_ctrl_acc_clk")

  if (STRING.SCAN("&clk", "*", 0)==0)
  (
    &wild_head=1
  )
  if (STRING.SCAN("&clk", "*", 1)==(STRING.LENGTH("&clk")-1))
  (
    &wild_tail=1
  )

  if ((&wild_head==1)&&(&wild_tail==1))
  (
    if (STRING.SCAN("gcc_sec_ctrl_acc_clk", STRING.MID("&clk", 1, &clk_input_length-2), 0)!=-1)
    ( 
      &match=1
    )
  )
  else if (&wild_head==1)
  (
    if (STRING.MID("gcc_sec_ctrl_acc_clk", &clk_itr_length-&clk_input_length+1, &clk_input_length-1)==STRING.CUT("&clk", 1))
    ( 
      &match=1
    )
  )
  else if (&wild_tail==1)
  (
    if (STRING.MID("gcc_sec_ctrl_acc_clk", 0, &clk_input_length-1)==STRING.CUT("&clk", -1))
    ( 
      &match=1
    )
  )
  else if ("gcc_sec_ctrl_acc_clk"=="&clk")
  (
    &match=1
  )
  
  if (&match==1)
  (
    &clk_test=&CLK_TEST_GCC_SEC_CTRL_ACC_CLK
    &clk_reg=&HWIO_GCC_SEC_CTRL_ACC_CBCR_ADDR
    &clk_reg_name="GCC_SEC_CTRL_ACC_CBCR"
    &clk_name="gcc_sec_ctrl_acc_clk"
    &clk_reg_cbcr_type="sm_pscbc"
    &clk_vote_bit=-1.
    &clk_multiplier=4.

    gosub Print_Clk_Info_Line
  )

  &match=0
  &wild_head=0
  &wild_tail=0
  &clk_input_length=STRING.LENGTH("&clk")
  &clk_itr_length=STRING.LENGTH("gcc_apc0_vs_clk")

  if (STRING.SCAN("&clk", "*", 0)==0)
  (
    &wild_head=1
  )
  if (STRING.SCAN("&clk", "*", 1)==(STRING.LENGTH("&clk")-1))
  (
    &wild_tail=1
  )

  if ((&wild_head==1)&&(&wild_tail==1))
  (
    if (STRING.SCAN("gcc_apc0_vs_clk", STRING.MID("&clk", 1, &clk_input_length-2), 0)!=-1)
    ( 
      &match=1
    )
  )
  else if (&wild_head==1)
  (
    if (STRING.MID("gcc_apc0_vs_clk", &clk_itr_length-&clk_input_length+1, &clk_input_length-1)==STRING.CUT("&clk", 1))
    ( 
      &match=1
    )
  )
  else if (&wild_tail==1)
  (
    if (STRING.MID("gcc_apc0_vs_clk", 0, &clk_input_length-1)==STRING.CUT("&clk", -1))
    ( 
      &match=1
    )
  )
  else if ("gcc_apc0_vs_clk"=="&clk")
  (
    &match=1
  )
  
  if (&match==1)
  (
    &clk_test=&CLK_TEST_GCC_APC0_VS_CLK
    &clk_reg=&HWIO_GCC_APC0_VS_CBCR_ADDR
    &clk_reg_name="GCC_APC0_VS_CBCR"
    &clk_name="gcc_apc0_vs_clk"
    &clk_reg_cbcr_type="sm_cbc"
    &clk_vote_bit=-1.
    &clk_multiplier=4.

    gosub Print_Clk_Info_Line
  )

  &match=0
  &wild_head=0
  &wild_tail=0
  &clk_input_length=STRING.LENGTH("&clk")
  &clk_itr_length=STRING.LENGTH("gcc_apc1_vs_clk")

  if (STRING.SCAN("&clk", "*", 0)==0)
  (
    &wild_head=1
  )
  if (STRING.SCAN("&clk", "*", 1)==(STRING.LENGTH("&clk")-1))
  (
    &wild_tail=1
  )

  if ((&wild_head==1)&&(&wild_tail==1))
  (
    if (STRING.SCAN("gcc_apc1_vs_clk", STRING.MID("&clk", 1, &clk_input_length-2), 0)!=-1)
    ( 
      &match=1
    )
  )
  else if (&wild_head==1)
  (
    if (STRING.MID("gcc_apc1_vs_clk", &clk_itr_length-&clk_input_length+1, &clk_input_length-1)==STRING.CUT("&clk", 1))
    ( 
      &match=1
    )
  )
  else if (&wild_tail==1)
  (
    if (STRING.MID("gcc_apc1_vs_clk", 0, &clk_input_length-1)==STRING.CUT("&clk", -1))
    ( 
      &match=1
    )
  )
  else if ("gcc_apc1_vs_clk"=="&clk")
  (
    &match=1
  )
  
  if (&match==1)
  (
    &clk_test=&CLK_TEST_GCC_APC1_VS_CLK
    &clk_reg=&HWIO_GCC_APC1_VS_CBCR_ADDR
    &clk_reg_name="GCC_APC1_VS_CBCR"
    &clk_name="gcc_apc1_vs_clk"
    &clk_reg_cbcr_type="sm_cbc"
    &clk_vote_bit=-1.
    &clk_multiplier=4.

    gosub Print_Clk_Info_Line
  )

  &match=0
  &wild_head=0
  &wild_tail=0
  &clk_input_length=STRING.LENGTH("&clk")
  &clk_itr_length=STRING.LENGTH("gcc_bimc_clk")

  if (STRING.SCAN("&clk", "*", 0)==0)
  (
    &wild_head=1
  )
  if (STRING.SCAN("&clk", "*", 1)==(STRING.LENGTH("&clk")-1))
  (
    &wild_tail=1
  )

  if ((&wild_head==1)&&(&wild_tail==1))
  (
    if (STRING.SCAN("gcc_bimc_clk", STRING.MID("&clk", 1, &clk_input_length-2), 0)!=-1)
    ( 
      &match=1
    )
  )
  else if (&wild_head==1)
  (
    if (STRING.MID("gcc_bimc_clk", &clk_itr_length-&clk_input_length+1, &clk_input_length-1)==STRING.CUT("&clk", 1))
    ( 
      &match=1
    )
  )
  else if (&wild_tail==1)
  (
    if (STRING.MID("gcc_bimc_clk", 0, &clk_input_length-1)==STRING.CUT("&clk", -1))
    ( 
      &match=1
    )
  )
  else if ("gcc_bimc_clk"=="&clk")
  (
    &match=1
  )
  
  if (&match==1)
  (
    &clk_test=&CLK_TEST_GCC_BIMC_CLK
    &clk_reg=&HWIO_GCC_BIMC_CBCR_ADDR
    &clk_reg_name="GCC_BIMC_CBCR"
    &clk_name="gcc_bimc_clk"
    &clk_reg_cbcr_type="sm_cbc"
    &clk_vote_bit=-1.
    &clk_multiplier=4.

    gosub Print_Clk_Info_Line
  )

  &match=0
  &wild_head=0
  &wild_tail=0
  &clk_input_length=STRING.LENGTH("&clk")
  &clk_itr_length=STRING.LENGTH("gcc_spdm_bimc_cy_clk")

  if (STRING.SCAN("&clk", "*", 0)==0)
  (
    &wild_head=1
  )
  if (STRING.SCAN("&clk", "*", 1)==(STRING.LENGTH("&clk")-1))
  (
    &wild_tail=1
  )

  if ((&wild_head==1)&&(&wild_tail==1))
  (
    if (STRING.SCAN("gcc_spdm_bimc_cy_clk", STRING.MID("&clk", 1, &clk_input_length-2), 0)!=-1)
    ( 
      &match=1
    )
  )
  else if (&wild_head==1)
  (
    if (STRING.MID("gcc_spdm_bimc_cy_clk", &clk_itr_length-&clk_input_length+1, &clk_input_length-1)==STRING.CUT("&clk", 1))
    ( 
      &match=1
    )
  )
  else if (&wild_tail==1)
  (
    if (STRING.MID("gcc_spdm_bimc_cy_clk", 0, &clk_input_length-1)==STRING.CUT("&clk", -1))
    ( 
      &match=1
    )
  )
  else if ("gcc_spdm_bimc_cy_clk"=="&clk")
  (
    &match=1
  )
  
  if (&match==1)
  (
    &clk_test=&CLK_TEST_GCC_SPDM_BIMC_CY_CLK
    &clk_reg=&HWIO_GCC_SPDM_BIMC_CY_CBCR_ADDR
    &clk_reg_name="GCC_SPDM_BIMC_CY_CBCR"
    &clk_name="gcc_spdm_bimc_cy_clk"
    &clk_reg_cbcr_type="sm_cbc"
    &clk_vote_bit=-1.
    &clk_multiplier=4.

    gosub Print_Clk_Info_Line
  )

  &match=0
  &wild_head=0
  &wild_tail=0
  &clk_input_length=STRING.LENGTH("&clk")
  &clk_itr_length=STRING.LENGTH("gcc_bimc_ddr_cpll0_clk")

  if (STRING.SCAN("&clk", "*", 0)==0)
  (
    &wild_head=1
  )
  if (STRING.SCAN("&clk", "*", 1)==(STRING.LENGTH("&clk")-1))
  (
    &wild_tail=1
  )

  if ((&wild_head==1)&&(&wild_tail==1))
  (
    if (STRING.SCAN("gcc_bimc_ddr_cpll0_clk", STRING.MID("&clk", 1, &clk_input_length-2), 0)!=-1)
    ( 
      &match=1
    )
  )
  else if (&wild_head==1)
  (
    if (STRING.MID("gcc_bimc_ddr_cpll0_clk", &clk_itr_length-&clk_input_length+1, &clk_input_length-1)==STRING.CUT("&clk", 1))
    ( 
      &match=1
    )
  )
  else if (&wild_tail==1)
  (
    if (STRING.MID("gcc_bimc_ddr_cpll0_clk", 0, &clk_input_length-1)==STRING.CUT("&clk", -1))
    ( 
      &match=1
    )
  )
  else if ("gcc_bimc_ddr_cpll0_clk"=="&clk")
  (
    &match=1
  )
  
  if (&match==1)
  (
    &clk_test=&CLK_TEST_GCC_BIMC_DDR_CPLL0_CLK
    &clk_reg=&HWIO_GCC_BIMC_DDR_CPLL0_CBCR_ADDR
    &clk_reg_name="GCC_BIMC_DDR_CPLL0_CBCR"
    &clk_name="gcc_bimc_ddr_cpll0_clk"
    &clk_reg_cbcr_type="sm_cbc"
    &clk_vote_bit=-1.
    &clk_multiplier=4.

    gosub Print_Clk_Info_Line
  )

  &match=0
  &wild_head=0
  &wild_tail=0
  &clk_input_length=STRING.LENGTH("&clk")
  &clk_itr_length=STRING.LENGTH("gcc_bimc_ddr_cpll1_clk")

  if (STRING.SCAN("&clk", "*", 0)==0)
  (
    &wild_head=1
  )
  if (STRING.SCAN("&clk", "*", 1)==(STRING.LENGTH("&clk")-1))
  (
    &wild_tail=1
  )

  if ((&wild_head==1)&&(&wild_tail==1))
  (
    if (STRING.SCAN("gcc_bimc_ddr_cpll1_clk", STRING.MID("&clk", 1, &clk_input_length-2), 0)!=-1)
    ( 
      &match=1
    )
  )
  else if (&wild_head==1)
  (
    if (STRING.MID("gcc_bimc_ddr_cpll1_clk", &clk_itr_length-&clk_input_length+1, &clk_input_length-1)==STRING.CUT("&clk", 1))
    ( 
      &match=1
    )
  )
  else if (&wild_tail==1)
  (
    if (STRING.MID("gcc_bimc_ddr_cpll1_clk", 0, &clk_input_length-1)==STRING.CUT("&clk", -1))
    ( 
      &match=1
    )
  )
  else if ("gcc_bimc_ddr_cpll1_clk"=="&clk")
  (
    &match=1
  )
  
  if (&match==1)
  (
    &clk_test=&CLK_TEST_GCC_BIMC_DDR_CPLL1_CLK
    &clk_reg=&HWIO_GCC_BIMC_DDR_CPLL1_CBCR_ADDR
    &clk_reg_name="GCC_BIMC_DDR_CPLL1_CBCR"
    &clk_name="gcc_bimc_ddr_cpll1_clk"
    &clk_reg_cbcr_type="sm_cbc"
    &clk_vote_bit=-1.
    &clk_multiplier=4.

    gosub Print_Clk_Info_Line
  )

  &match=0
  &wild_head=0
  &wild_tail=0
  &clk_input_length=STRING.LENGTH("&clk")
  &clk_itr_length=STRING.LENGTH("gcc_bimc_dtts_xo_clk")

  if (STRING.SCAN("&clk", "*", 0)==0)
  (
    &wild_head=1
  )
  if (STRING.SCAN("&clk", "*", 1)==(STRING.LENGTH("&clk")-1))
  (
    &wild_tail=1
  )

  if ((&wild_head==1)&&(&wild_tail==1))
  (
    if (STRING.SCAN("gcc_bimc_dtts_xo_clk", STRING.MID("&clk", 1, &clk_input_length-2), 0)!=-1)
    ( 
      &match=1
    )
  )
  else if (&wild_head==1)
  (
    if (STRING.MID("gcc_bimc_dtts_xo_clk", &clk_itr_length-&clk_input_length+1, &clk_input_length-1)==STRING.CUT("&clk", 1))
    ( 
      &match=1
    )
  )
  else if (&wild_tail==1)
  (
    if (STRING.MID("gcc_bimc_dtts_xo_clk", 0, &clk_input_length-1)==STRING.CUT("&clk", -1))
    ( 
      &match=1
    )
  )
  else if ("gcc_bimc_dtts_xo_clk"=="&clk")
  (
    &match=1
  )
  
  if (&match==1)
  (
    &clk_test=&CLK_TEST_GCC_BIMC_DTTS_XO_CLK
    &clk_reg=&HWIO_GCC_BIMC_DTTS_XO_CBCR_ADDR
    &clk_reg_name="GCC_BIMC_DTTS_XO_CBCR"
    &clk_name="gcc_bimc_dtts_xo_clk"
    &clk_reg_cbcr_type="sm_cbc"
    &clk_vote_bit=-1.
    &clk_multiplier=4.

    gosub Print_Clk_Info_Line
  )

  &match=0
  &wild_head=0
  &wild_tail=0
  &clk_input_length=STRING.LENGTH("&clk")
  &clk_itr_length=STRING.LENGTH("gcc_bimc_xo_clk")

  if (STRING.SCAN("&clk", "*", 0)==0)
  (
    &wild_head=1
  )
  if (STRING.SCAN("&clk", "*", 1)==(STRING.LENGTH("&clk")-1))
  (
    &wild_tail=1
  )

  if ((&wild_head==1)&&(&wild_tail==1))
  (
    if (STRING.SCAN("gcc_bimc_xo_clk", STRING.MID("&clk", 1, &clk_input_length-2), 0)!=-1)
    ( 
      &match=1
    )
  )
  else if (&wild_head==1)
  (
    if (STRING.MID("gcc_bimc_xo_clk", &clk_itr_length-&clk_input_length+1, &clk_input_length-1)==STRING.CUT("&clk", 1))
    ( 
      &match=1
    )
  )
  else if (&wild_tail==1)
  (
    if (STRING.MID("gcc_bimc_xo_clk", 0, &clk_input_length-1)==STRING.CUT("&clk", -1))
    ( 
      &match=1
    )
  )
  else if ("gcc_bimc_xo_clk"=="&clk")
  (
    &match=1
  )
  
  if (&match==1)
  (
    &clk_test=&CLK_TEST_GCC_BIMC_XO_CLK
    &clk_reg=&HWIO_GCC_BIMC_XO_CBCR_ADDR
    &clk_reg_name="GCC_BIMC_XO_CBCR"
    &clk_name="gcc_bimc_xo_clk"
    &clk_reg_cbcr_type="sm_cbc"
    &clk_vote_bit=-1.
    &clk_multiplier=4.

    gosub Print_Clk_Info_Line
  )

  &match=0
  &wild_head=0
  &wild_tail=0
  &clk_input_length=STRING.LENGTH("&clk")
  &clk_itr_length=STRING.LENGTH("gcc_cfg_noc_ddr_cfg_clk")

  if (STRING.SCAN("&clk", "*", 0)==0)
  (
    &wild_head=1
  )
  if (STRING.SCAN("&clk", "*", 1)==(STRING.LENGTH("&clk")-1))
  (
    &wild_tail=1
  )

  if ((&wild_head==1)&&(&wild_tail==1))
  (
    if (STRING.SCAN("gcc_cfg_noc_ddr_cfg_clk", STRING.MID("&clk", 1, &clk_input_length-2), 0)!=-1)
    ( 
      &match=1
    )
  )
  else if (&wild_head==1)
  (
    if (STRING.MID("gcc_cfg_noc_ddr_cfg_clk", &clk_itr_length-&clk_input_length+1, &clk_input_length-1)==STRING.CUT("&clk", 1))
    ( 
      &match=1
    )
  )
  else if (&wild_tail==1)
  (
    if (STRING.MID("gcc_cfg_noc_ddr_cfg_clk", 0, &clk_input_length-1)==STRING.CUT("&clk", -1))
    ( 
      &match=1
    )
  )
  else if ("gcc_cfg_noc_ddr_cfg_clk"=="&clk")
  (
    &match=1
  )
  
  if (&match==1)
  (
    &clk_test=&CLK_TEST_GCC_CFG_NOC_DDR_CFG_CLK
    &clk_reg=&HWIO_GCC_CFG_NOC_DDR_CFG_CBCR_ADDR
    &clk_reg_name="GCC_CFG_NOC_DDR_CFG_CBCR"
    &clk_name="gcc_cfg_noc_ddr_cfg_clk"
    &clk_reg_cbcr_type="sm_cbc"
    &clk_vote_bit=-1.
    &clk_multiplier=4.

    gosub Print_Clk_Info_Line
  )

  &match=0
  &wild_head=0
  &wild_tail=0
  &clk_input_length=STRING.LENGTH("&clk")
  &clk_itr_length=STRING.LENGTH("gcc_cnoc_bus_timeout5_ahb_clk")

  if (STRING.SCAN("&clk", "*", 0)==0)
  (
    &wild_head=1
  )
  if (STRING.SCAN("&clk", "*", 1)==(STRING.LENGTH("&clk")-1))
  (
    &wild_tail=1
  )

  if ((&wild_head==1)&&(&wild_tail==1))
  (
    if (STRING.SCAN("gcc_cnoc_bus_timeout5_ahb_clk", STRING.MID("&clk", 1, &clk_input_length-2), 0)!=-1)
    ( 
      &match=1
    )
  )
  else if (&wild_head==1)
  (
    if (STRING.MID("gcc_cnoc_bus_timeout5_ahb_clk", &clk_itr_length-&clk_input_length+1, &clk_input_length-1)==STRING.CUT("&clk", 1))
    ( 
      &match=1
    )
  )
  else if (&wild_tail==1)
  (
    if (STRING.MID("gcc_cnoc_bus_timeout5_ahb_clk", 0, &clk_input_length-1)==STRING.CUT("&clk", -1))
    ( 
      &match=1
    )
  )
  else if ("gcc_cnoc_bus_timeout5_ahb_clk"=="&clk")
  (
    &match=1
  )
  
  if (&match==1)
  (
    &clk_test=&CLK_TEST_GCC_CNOC_BUS_TIMEOUT5_AHB_CLK
    &clk_reg=&HWIO_GCC_CNOC_BUS_TIMEOUT5_AHB_CBCR_ADDR
    &clk_reg_name="GCC_CNOC_BUS_TIMEOUT5_AHB_CBCR"
    &clk_name="gcc_cnoc_bus_timeout5_ahb_clk"
    &clk_reg_cbcr_type="sm_cbc"
    &clk_vote_bit=-1.
    &clk_multiplier=4.

    gosub Print_Clk_Info_Line
  )

  &match=0
  &wild_head=0
  &wild_tail=0
  &clk_input_length=STRING.LENGTH("&clk")
  &clk_itr_length=STRING.LENGTH("gcc_ddr_dim_cfg_clk")

  if (STRING.SCAN("&clk", "*", 0)==0)
  (
    &wild_head=1
  )
  if (STRING.SCAN("&clk", "*", 1)==(STRING.LENGTH("&clk")-1))
  (
    &wild_tail=1
  )

  if ((&wild_head==1)&&(&wild_tail==1))
  (
    if (STRING.SCAN("gcc_ddr_dim_cfg_clk", STRING.MID("&clk", 1, &clk_input_length-2), 0)!=-1)
    ( 
      &match=1
    )
  )
  else if (&wild_head==1)
  (
    if (STRING.MID("gcc_ddr_dim_cfg_clk", &clk_itr_length-&clk_input_length+1, &clk_input_length-1)==STRING.CUT("&clk", 1))
    ( 
      &match=1
    )
  )
  else if (&wild_tail==1)
  (
    if (STRING.MID("gcc_ddr_dim_cfg_clk", 0, &clk_input_length-1)==STRING.CUT("&clk", -1))
    ( 
      &match=1
    )
  )
  else if ("gcc_ddr_dim_cfg_clk"=="&clk")
  (
    &match=1
  )
  
  if (&match==1)
  (
    &clk_test=&CLK_TEST_GCC_DDR_DIM_CFG_CLK
    &clk_reg=&HWIO_GCC_DDR_DIM_CFG_CBCR_ADDR
    &clk_reg_name="GCC_DDR_DIM_CFG_CBCR"
    &clk_name="gcc_ddr_dim_cfg_clk"
    &clk_reg_cbcr_type="sm_cbc"
    &clk_vote_bit=-1.
    &clk_multiplier=4.

    gosub Print_Clk_Info_Line
  )

  &match=0
  &wild_head=0
  &wild_tail=0
  &clk_input_length=STRING.LENGTH("&clk")
  &clk_itr_length=STRING.LENGTH("gcc_bimc_hmss_axi_clk")

  if (STRING.SCAN("&clk", "*", 0)==0)
  (
    &wild_head=1
  )
  if (STRING.SCAN("&clk", "*", 1)==(STRING.LENGTH("&clk")-1))
  (
    &wild_tail=1
  )

  if ((&wild_head==1)&&(&wild_tail==1))
  (
    if (STRING.SCAN("gcc_bimc_hmss_axi_clk", STRING.MID("&clk", 1, &clk_input_length-2), 0)!=-1)
    ( 
      &match=1
    )
  )
  else if (&wild_head==1)
  (
    if (STRING.MID("gcc_bimc_hmss_axi_clk", &clk_itr_length-&clk_input_length+1, &clk_input_length-1)==STRING.CUT("&clk", 1))
    ( 
      &match=1
    )
  )
  else if (&wild_tail==1)
  (
    if (STRING.MID("gcc_bimc_hmss_axi_clk", 0, &clk_input_length-1)==STRING.CUT("&clk", -1))
    ( 
      &match=1
    )
  )
  else if ("gcc_bimc_hmss_axi_clk"=="&clk")
  (
    &match=1
  )
  
  if (&match==1)
  (
    &clk_test=&CLK_TEST_GCC_BIMC_HMSS_AXI_CLK
    &clk_reg=&HWIO_GCC_BIMC_HMSS_AXI_CBCR_ADDR
    &clk_reg_name="GCC_BIMC_HMSS_AXI_CBCR"
    &clk_name="gcc_bimc_hmss_axi_clk"
    &clk_reg_cbcr_type="sm_cbc"
    &clk_vote_bit=22.
    &clk_multiplier=4.

    gosub Print_Clk_Info_Line
  )

  &match=0
  &wild_head=0
  &wild_tail=0
  &clk_input_length=STRING.LENGTH("&clk")
  &clk_itr_length=STRING.LENGTH("gcc_blsp1_qup1_i2c_apps_clk")

  if (STRING.SCAN("&clk", "*", 0)==0)
  (
    &wild_head=1
  )
  if (STRING.SCAN("&clk", "*", 1)==(STRING.LENGTH("&clk")-1))
  (
    &wild_tail=1
  )

  if ((&wild_head==1)&&(&wild_tail==1))
  (
    if (STRING.SCAN("gcc_blsp1_qup1_i2c_apps_clk", STRING.MID("&clk", 1, &clk_input_length-2), 0)!=-1)
    ( 
      &match=1
    )
  )
  else if (&wild_head==1)
  (
    if (STRING.MID("gcc_blsp1_qup1_i2c_apps_clk", &clk_itr_length-&clk_input_length+1, &clk_input_length-1)==STRING.CUT("&clk", 1))
    ( 
      &match=1
    )
  )
  else if (&wild_tail==1)
  (
    if (STRING.MID("gcc_blsp1_qup1_i2c_apps_clk", 0, &clk_input_length-1)==STRING.CUT("&clk", -1))
    ( 
      &match=1
    )
  )
  else if ("gcc_blsp1_qup1_i2c_apps_clk"=="&clk")
  (
    &match=1
  )
  
  if (&match==1)
  (
    &clk_test=&CLK_TEST_GCC_BLSP1_QUP1_I2C_APPS_CLK
    &clk_reg=&HWIO_GCC_BLSP1_QUP1_I2C_APPS_CBCR_ADDR
    &clk_reg_name="GCC_BLSP1_QUP1_I2C_APPS_CBCR"
    &clk_name="gcc_blsp1_qup1_i2c_apps_clk"
    &clk_reg_cbcr_type="sm_cbc"
    &clk_vote_bit=-1.
    &clk_multiplier=4.

    gosub Print_Clk_Info_Line
  )

  &match=0
  &wild_head=0
  &wild_tail=0
  &clk_input_length=STRING.LENGTH("&clk")
  &clk_itr_length=STRING.LENGTH("gcc_blsp1_qup1_spi_apps_clk")

  if (STRING.SCAN("&clk", "*", 0)==0)
  (
    &wild_head=1
  )
  if (STRING.SCAN("&clk", "*", 1)==(STRING.LENGTH("&clk")-1))
  (
    &wild_tail=1
  )

  if ((&wild_head==1)&&(&wild_tail==1))
  (
    if (STRING.SCAN("gcc_blsp1_qup1_spi_apps_clk", STRING.MID("&clk", 1, &clk_input_length-2), 0)!=-1)
    ( 
      &match=1
    )
  )
  else if (&wild_head==1)
  (
    if (STRING.MID("gcc_blsp1_qup1_spi_apps_clk", &clk_itr_length-&clk_input_length+1, &clk_input_length-1)==STRING.CUT("&clk", 1))
    ( 
      &match=1
    )
  )
  else if (&wild_tail==1)
  (
    if (STRING.MID("gcc_blsp1_qup1_spi_apps_clk", 0, &clk_input_length-1)==STRING.CUT("&clk", -1))
    ( 
      &match=1
    )
  )
  else if ("gcc_blsp1_qup1_spi_apps_clk"=="&clk")
  (
    &match=1
  )
  
  if (&match==1)
  (
    &clk_test=&CLK_TEST_GCC_BLSP1_QUP1_SPI_APPS_CLK
    &clk_reg=&HWIO_GCC_BLSP1_QUP1_SPI_APPS_CBCR_ADDR
    &clk_reg_name="GCC_BLSP1_QUP1_SPI_APPS_CBCR"
    &clk_name="gcc_blsp1_qup1_spi_apps_clk"
    &clk_reg_cbcr_type="sm_cbc"
    &clk_vote_bit=-1.
    &clk_multiplier=4.

    gosub Print_Clk_Info_Line
  )

  &match=0
  &wild_head=0
  &wild_tail=0
  &clk_input_length=STRING.LENGTH("&clk")
  &clk_itr_length=STRING.LENGTH("gcc_blsp1_qup2_i2c_apps_clk")

  if (STRING.SCAN("&clk", "*", 0)==0)
  (
    &wild_head=1
  )
  if (STRING.SCAN("&clk", "*", 1)==(STRING.LENGTH("&clk")-1))
  (
    &wild_tail=1
  )

  if ((&wild_head==1)&&(&wild_tail==1))
  (
    if (STRING.SCAN("gcc_blsp1_qup2_i2c_apps_clk", STRING.MID("&clk", 1, &clk_input_length-2), 0)!=-1)
    ( 
      &match=1
    )
  )
  else if (&wild_head==1)
  (
    if (STRING.MID("gcc_blsp1_qup2_i2c_apps_clk", &clk_itr_length-&clk_input_length+1, &clk_input_length-1)==STRING.CUT("&clk", 1))
    ( 
      &match=1
    )
  )
  else if (&wild_tail==1)
  (
    if (STRING.MID("gcc_blsp1_qup2_i2c_apps_clk", 0, &clk_input_length-1)==STRING.CUT("&clk", -1))
    ( 
      &match=1
    )
  )
  else if ("gcc_blsp1_qup2_i2c_apps_clk"=="&clk")
  (
    &match=1
  )
  
  if (&match==1)
  (
    &clk_test=&CLK_TEST_GCC_BLSP1_QUP2_I2C_APPS_CLK
    &clk_reg=&HWIO_GCC_BLSP1_QUP2_I2C_APPS_CBCR_ADDR
    &clk_reg_name="GCC_BLSP1_QUP2_I2C_APPS_CBCR"
    &clk_name="gcc_blsp1_qup2_i2c_apps_clk"
    &clk_reg_cbcr_type="sm_cbc"
    &clk_vote_bit=-1.
    &clk_multiplier=4.

    gosub Print_Clk_Info_Line
  )

  &match=0
  &wild_head=0
  &wild_tail=0
  &clk_input_length=STRING.LENGTH("&clk")
  &clk_itr_length=STRING.LENGTH("gcc_blsp1_qup2_spi_apps_clk")

  if (STRING.SCAN("&clk", "*", 0)==0)
  (
    &wild_head=1
  )
  if (STRING.SCAN("&clk", "*", 1)==(STRING.LENGTH("&clk")-1))
  (
    &wild_tail=1
  )

  if ((&wild_head==1)&&(&wild_tail==1))
  (
    if (STRING.SCAN("gcc_blsp1_qup2_spi_apps_clk", STRING.MID("&clk", 1, &clk_input_length-2), 0)!=-1)
    ( 
      &match=1
    )
  )
  else if (&wild_head==1)
  (
    if (STRING.MID("gcc_blsp1_qup2_spi_apps_clk", &clk_itr_length-&clk_input_length+1, &clk_input_length-1)==STRING.CUT("&clk", 1))
    ( 
      &match=1
    )
  )
  else if (&wild_tail==1)
  (
    if (STRING.MID("gcc_blsp1_qup2_spi_apps_clk", 0, &clk_input_length-1)==STRING.CUT("&clk", -1))
    ( 
      &match=1
    )
  )
  else if ("gcc_blsp1_qup2_spi_apps_clk"=="&clk")
  (
    &match=1
  )
  
  if (&match==1)
  (
    &clk_test=&CLK_TEST_GCC_BLSP1_QUP2_SPI_APPS_CLK
    &clk_reg=&HWIO_GCC_BLSP1_QUP2_SPI_APPS_CBCR_ADDR
    &clk_reg_name="GCC_BLSP1_QUP2_SPI_APPS_CBCR"
    &clk_name="gcc_blsp1_qup2_spi_apps_clk"
    &clk_reg_cbcr_type="sm_cbc"
    &clk_vote_bit=-1.
    &clk_multiplier=4.

    gosub Print_Clk_Info_Line
  )

  &match=0
  &wild_head=0
  &wild_tail=0
  &clk_input_length=STRING.LENGTH("&clk")
  &clk_itr_length=STRING.LENGTH("gcc_blsp1_qup3_i2c_apps_clk")

  if (STRING.SCAN("&clk", "*", 0)==0)
  (
    &wild_head=1
  )
  if (STRING.SCAN("&clk", "*", 1)==(STRING.LENGTH("&clk")-1))
  (
    &wild_tail=1
  )

  if ((&wild_head==1)&&(&wild_tail==1))
  (
    if (STRING.SCAN("gcc_blsp1_qup3_i2c_apps_clk", STRING.MID("&clk", 1, &clk_input_length-2), 0)!=-1)
    ( 
      &match=1
    )
  )
  else if (&wild_head==1)
  (
    if (STRING.MID("gcc_blsp1_qup3_i2c_apps_clk", &clk_itr_length-&clk_input_length+1, &clk_input_length-1)==STRING.CUT("&clk", 1))
    ( 
      &match=1
    )
  )
  else if (&wild_tail==1)
  (
    if (STRING.MID("gcc_blsp1_qup3_i2c_apps_clk", 0, &clk_input_length-1)==STRING.CUT("&clk", -1))
    ( 
      &match=1
    )
  )
  else if ("gcc_blsp1_qup3_i2c_apps_clk"=="&clk")
  (
    &match=1
  )
  
  if (&match==1)
  (
    &clk_test=&CLK_TEST_GCC_BLSP1_QUP3_I2C_APPS_CLK
    &clk_reg=&HWIO_GCC_BLSP1_QUP3_I2C_APPS_CBCR_ADDR
    &clk_reg_name="GCC_BLSP1_QUP3_I2C_APPS_CBCR"
    &clk_name="gcc_blsp1_qup3_i2c_apps_clk"
    &clk_reg_cbcr_type="sm_cbc"
    &clk_vote_bit=-1.
    &clk_multiplier=4.

    gosub Print_Clk_Info_Line
  )

  &match=0
  &wild_head=0
  &wild_tail=0
  &clk_input_length=STRING.LENGTH("&clk")
  &clk_itr_length=STRING.LENGTH("gcc_blsp1_qup3_spi_apps_clk")

  if (STRING.SCAN("&clk", "*", 0)==0)
  (
    &wild_head=1
  )
  if (STRING.SCAN("&clk", "*", 1)==(STRING.LENGTH("&clk")-1))
  (
    &wild_tail=1
  )

  if ((&wild_head==1)&&(&wild_tail==1))
  (
    if (STRING.SCAN("gcc_blsp1_qup3_spi_apps_clk", STRING.MID("&clk", 1, &clk_input_length-2), 0)!=-1)
    ( 
      &match=1
    )
  )
  else if (&wild_head==1)
  (
    if (STRING.MID("gcc_blsp1_qup3_spi_apps_clk", &clk_itr_length-&clk_input_length+1, &clk_input_length-1)==STRING.CUT("&clk", 1))
    ( 
      &match=1
    )
  )
  else if (&wild_tail==1)
  (
    if (STRING.MID("gcc_blsp1_qup3_spi_apps_clk", 0, &clk_input_length-1)==STRING.CUT("&clk", -1))
    ( 
      &match=1
    )
  )
  else if ("gcc_blsp1_qup3_spi_apps_clk"=="&clk")
  (
    &match=1
  )
  
  if (&match==1)
  (
    &clk_test=&CLK_TEST_GCC_BLSP1_QUP3_SPI_APPS_CLK
    &clk_reg=&HWIO_GCC_BLSP1_QUP3_SPI_APPS_CBCR_ADDR
    &clk_reg_name="GCC_BLSP1_QUP3_SPI_APPS_CBCR"
    &clk_name="gcc_blsp1_qup3_spi_apps_clk"
    &clk_reg_cbcr_type="sm_cbc"
    &clk_vote_bit=-1.
    &clk_multiplier=4.

    gosub Print_Clk_Info_Line
  )

  &match=0
  &wild_head=0
  &wild_tail=0
  &clk_input_length=STRING.LENGTH("&clk")
  &clk_itr_length=STRING.LENGTH("gcc_blsp1_qup4_i2c_apps_clk")

  if (STRING.SCAN("&clk", "*", 0)==0)
  (
    &wild_head=1
  )
  if (STRING.SCAN("&clk", "*", 1)==(STRING.LENGTH("&clk")-1))
  (
    &wild_tail=1
  )

  if ((&wild_head==1)&&(&wild_tail==1))
  (
    if (STRING.SCAN("gcc_blsp1_qup4_i2c_apps_clk", STRING.MID("&clk", 1, &clk_input_length-2), 0)!=-1)
    ( 
      &match=1
    )
  )
  else if (&wild_head==1)
  (
    if (STRING.MID("gcc_blsp1_qup4_i2c_apps_clk", &clk_itr_length-&clk_input_length+1, &clk_input_length-1)==STRING.CUT("&clk", 1))
    ( 
      &match=1
    )
  )
  else if (&wild_tail==1)
  (
    if (STRING.MID("gcc_blsp1_qup4_i2c_apps_clk", 0, &clk_input_length-1)==STRING.CUT("&clk", -1))
    ( 
      &match=1
    )
  )
  else if ("gcc_blsp1_qup4_i2c_apps_clk"=="&clk")
  (
    &match=1
  )
  
  if (&match==1)
  (
    &clk_test=&CLK_TEST_GCC_BLSP1_QUP4_I2C_APPS_CLK
    &clk_reg=&HWIO_GCC_BLSP1_QUP4_I2C_APPS_CBCR_ADDR
    &clk_reg_name="GCC_BLSP1_QUP4_I2C_APPS_CBCR"
    &clk_name="gcc_blsp1_qup4_i2c_apps_clk"
    &clk_reg_cbcr_type="sm_cbc"
    &clk_vote_bit=-1.
    &clk_multiplier=4.

    gosub Print_Clk_Info_Line
  )

  &match=0
  &wild_head=0
  &wild_tail=0
  &clk_input_length=STRING.LENGTH("&clk")
  &clk_itr_length=STRING.LENGTH("gcc_blsp1_qup4_spi_apps_clk")

  if (STRING.SCAN("&clk", "*", 0)==0)
  (
    &wild_head=1
  )
  if (STRING.SCAN("&clk", "*", 1)==(STRING.LENGTH("&clk")-1))
  (
    &wild_tail=1
  )

  if ((&wild_head==1)&&(&wild_tail==1))
  (
    if (STRING.SCAN("gcc_blsp1_qup4_spi_apps_clk", STRING.MID("&clk", 1, &clk_input_length-2), 0)!=-1)
    ( 
      &match=1
    )
  )
  else if (&wild_head==1)
  (
    if (STRING.MID("gcc_blsp1_qup4_spi_apps_clk", &clk_itr_length-&clk_input_length+1, &clk_input_length-1)==STRING.CUT("&clk", 1))
    ( 
      &match=1
    )
  )
  else if (&wild_tail==1)
  (
    if (STRING.MID("gcc_blsp1_qup4_spi_apps_clk", 0, &clk_input_length-1)==STRING.CUT("&clk", -1))
    ( 
      &match=1
    )
  )
  else if ("gcc_blsp1_qup4_spi_apps_clk"=="&clk")
  (
    &match=1
  )
  
  if (&match==1)
  (
    &clk_test=&CLK_TEST_GCC_BLSP1_QUP4_SPI_APPS_CLK
    &clk_reg=&HWIO_GCC_BLSP1_QUP4_SPI_APPS_CBCR_ADDR
    &clk_reg_name="GCC_BLSP1_QUP4_SPI_APPS_CBCR"
    &clk_name="gcc_blsp1_qup4_spi_apps_clk"
    &clk_reg_cbcr_type="sm_cbc"
    &clk_vote_bit=-1.
    &clk_multiplier=4.

    gosub Print_Clk_Info_Line
  )

  &match=0
  &wild_head=0
  &wild_tail=0
  &clk_input_length=STRING.LENGTH("&clk")
  &clk_itr_length=STRING.LENGTH("gcc_blsp1_qup5_i2c_apps_clk")

  if (STRING.SCAN("&clk", "*", 0)==0)
  (
    &wild_head=1
  )
  if (STRING.SCAN("&clk", "*", 1)==(STRING.LENGTH("&clk")-1))
  (
    &wild_tail=1
  )

  if ((&wild_head==1)&&(&wild_tail==1))
  (
    if (STRING.SCAN("gcc_blsp1_qup5_i2c_apps_clk", STRING.MID("&clk", 1, &clk_input_length-2), 0)!=-1)
    ( 
      &match=1
    )
  )
  else if (&wild_head==1)
  (
    if (STRING.MID("gcc_blsp1_qup5_i2c_apps_clk", &clk_itr_length-&clk_input_length+1, &clk_input_length-1)==STRING.CUT("&clk", 1))
    ( 
      &match=1
    )
  )
  else if (&wild_tail==1)
  (
    if (STRING.MID("gcc_blsp1_qup5_i2c_apps_clk", 0, &clk_input_length-1)==STRING.CUT("&clk", -1))
    ( 
      &match=1
    )
  )
  else if ("gcc_blsp1_qup5_i2c_apps_clk"=="&clk")
  (
    &match=1
  )
  
  if (&match==1)
  (
    &clk_test=&CLK_TEST_GCC_BLSP1_QUP5_I2C_APPS_CLK
    &clk_reg=&HWIO_GCC_BLSP1_QUP5_I2C_APPS_CBCR_ADDR
    &clk_reg_name="GCC_BLSP1_QUP5_I2C_APPS_CBCR"
    &clk_name="gcc_blsp1_qup5_i2c_apps_clk"
    &clk_reg_cbcr_type="sm_cbc"
    &clk_vote_bit=-1.
    &clk_multiplier=4.

    gosub Print_Clk_Info_Line
  )

  &match=0
  &wild_head=0
  &wild_tail=0
  &clk_input_length=STRING.LENGTH("&clk")
  &clk_itr_length=STRING.LENGTH("gcc_blsp1_qup5_spi_apps_clk")

  if (STRING.SCAN("&clk", "*", 0)==0)
  (
    &wild_head=1
  )
  if (STRING.SCAN("&clk", "*", 1)==(STRING.LENGTH("&clk")-1))
  (
    &wild_tail=1
  )

  if ((&wild_head==1)&&(&wild_tail==1))
  (
    if (STRING.SCAN("gcc_blsp1_qup5_spi_apps_clk", STRING.MID("&clk", 1, &clk_input_length-2), 0)!=-1)
    ( 
      &match=1
    )
  )
  else if (&wild_head==1)
  (
    if (STRING.MID("gcc_blsp1_qup5_spi_apps_clk", &clk_itr_length-&clk_input_length+1, &clk_input_length-1)==STRING.CUT("&clk", 1))
    ( 
      &match=1
    )
  )
  else if (&wild_tail==1)
  (
    if (STRING.MID("gcc_blsp1_qup5_spi_apps_clk", 0, &clk_input_length-1)==STRING.CUT("&clk", -1))
    ( 
      &match=1
    )
  )
  else if ("gcc_blsp1_qup5_spi_apps_clk"=="&clk")
  (
    &match=1
  )
  
  if (&match==1)
  (
    &clk_test=&CLK_TEST_GCC_BLSP1_QUP5_SPI_APPS_CLK
    &clk_reg=&HWIO_GCC_BLSP1_QUP5_SPI_APPS_CBCR_ADDR
    &clk_reg_name="GCC_BLSP1_QUP5_SPI_APPS_CBCR"
    &clk_name="gcc_blsp1_qup5_spi_apps_clk"
    &clk_reg_cbcr_type="sm_cbc"
    &clk_vote_bit=-1.
    &clk_multiplier=4.

    gosub Print_Clk_Info_Line
  )

  &match=0
  &wild_head=0
  &wild_tail=0
  &clk_input_length=STRING.LENGTH("&clk")
  &clk_itr_length=STRING.LENGTH("gcc_blsp1_qup6_i2c_apps_clk")

  if (STRING.SCAN("&clk", "*", 0)==0)
  (
    &wild_head=1
  )
  if (STRING.SCAN("&clk", "*", 1)==(STRING.LENGTH("&clk")-1))
  (
    &wild_tail=1
  )

  if ((&wild_head==1)&&(&wild_tail==1))
  (
    if (STRING.SCAN("gcc_blsp1_qup6_i2c_apps_clk", STRING.MID("&clk", 1, &clk_input_length-2), 0)!=-1)
    ( 
      &match=1
    )
  )
  else if (&wild_head==1)
  (
    if (STRING.MID("gcc_blsp1_qup6_i2c_apps_clk", &clk_itr_length-&clk_input_length+1, &clk_input_length-1)==STRING.CUT("&clk", 1))
    ( 
      &match=1
    )
  )
  else if (&wild_tail==1)
  (
    if (STRING.MID("gcc_blsp1_qup6_i2c_apps_clk", 0, &clk_input_length-1)==STRING.CUT("&clk", -1))
    ( 
      &match=1
    )
  )
  else if ("gcc_blsp1_qup6_i2c_apps_clk"=="&clk")
  (
    &match=1
  )
  
  if (&match==1)
  (
    &clk_test=&CLK_TEST_GCC_BLSP1_QUP6_I2C_APPS_CLK
    &clk_reg=&HWIO_GCC_BLSP1_QUP6_I2C_APPS_CBCR_ADDR
    &clk_reg_name="GCC_BLSP1_QUP6_I2C_APPS_CBCR"
    &clk_name="gcc_blsp1_qup6_i2c_apps_clk"
    &clk_reg_cbcr_type="sm_cbc"
    &clk_vote_bit=-1.
    &clk_multiplier=4.

    gosub Print_Clk_Info_Line
  )

  &match=0
  &wild_head=0
  &wild_tail=0
  &clk_input_length=STRING.LENGTH("&clk")
  &clk_itr_length=STRING.LENGTH("gcc_blsp1_qup6_spi_apps_clk")

  if (STRING.SCAN("&clk", "*", 0)==0)
  (
    &wild_head=1
  )
  if (STRING.SCAN("&clk", "*", 1)==(STRING.LENGTH("&clk")-1))
  (
    &wild_tail=1
  )

  if ((&wild_head==1)&&(&wild_tail==1))
  (
    if (STRING.SCAN("gcc_blsp1_qup6_spi_apps_clk", STRING.MID("&clk", 1, &clk_input_length-2), 0)!=-1)
    ( 
      &match=1
    )
  )
  else if (&wild_head==1)
  (
    if (STRING.MID("gcc_blsp1_qup6_spi_apps_clk", &clk_itr_length-&clk_input_length+1, &clk_input_length-1)==STRING.CUT("&clk", 1))
    ( 
      &match=1
    )
  )
  else if (&wild_tail==1)
  (
    if (STRING.MID("gcc_blsp1_qup6_spi_apps_clk", 0, &clk_input_length-1)==STRING.CUT("&clk", -1))
    ( 
      &match=1
    )
  )
  else if ("gcc_blsp1_qup6_spi_apps_clk"=="&clk")
  (
    &match=1
  )
  
  if (&match==1)
  (
    &clk_test=&CLK_TEST_GCC_BLSP1_QUP6_SPI_APPS_CLK
    &clk_reg=&HWIO_GCC_BLSP1_QUP6_SPI_APPS_CBCR_ADDR
    &clk_reg_name="GCC_BLSP1_QUP6_SPI_APPS_CBCR"
    &clk_name="gcc_blsp1_qup6_spi_apps_clk"
    &clk_reg_cbcr_type="sm_cbc"
    &clk_vote_bit=-1.
    &clk_multiplier=4.

    gosub Print_Clk_Info_Line
  )

  &match=0
  &wild_head=0
  &wild_tail=0
  &clk_input_length=STRING.LENGTH("&clk")
  &clk_itr_length=STRING.LENGTH("gcc_blsp1_uart1_apps_clk")

  if (STRING.SCAN("&clk", "*", 0)==0)
  (
    &wild_head=1
  )
  if (STRING.SCAN("&clk", "*", 1)==(STRING.LENGTH("&clk")-1))
  (
    &wild_tail=1
  )

  if ((&wild_head==1)&&(&wild_tail==1))
  (
    if (STRING.SCAN("gcc_blsp1_uart1_apps_clk", STRING.MID("&clk", 1, &clk_input_length-2), 0)!=-1)
    ( 
      &match=1
    )
  )
  else if (&wild_head==1)
  (
    if (STRING.MID("gcc_blsp1_uart1_apps_clk", &clk_itr_length-&clk_input_length+1, &clk_input_length-1)==STRING.CUT("&clk", 1))
    ( 
      &match=1
    )
  )
  else if (&wild_tail==1)
  (
    if (STRING.MID("gcc_blsp1_uart1_apps_clk", 0, &clk_input_length-1)==STRING.CUT("&clk", -1))
    ( 
      &match=1
    )
  )
  else if ("gcc_blsp1_uart1_apps_clk"=="&clk")
  (
    &match=1
  )
  
  if (&match==1)
  (
    &clk_test=&CLK_TEST_GCC_BLSP1_UART1_APPS_CLK
    &clk_reg=&HWIO_GCC_BLSP1_UART1_APPS_CBCR_ADDR
    &clk_reg_name="GCC_BLSP1_UART1_APPS_CBCR"
    &clk_name="gcc_blsp1_uart1_apps_clk"
    &clk_reg_cbcr_type="sm_cbc"
    &clk_vote_bit=-1.
    &clk_multiplier=4.

    gosub Print_Clk_Info_Line
  )

  &match=0
  &wild_head=0
  &wild_tail=0
  &clk_input_length=STRING.LENGTH("&clk")
  &clk_itr_length=STRING.LENGTH("gcc_blsp1_uart2_apps_clk")

  if (STRING.SCAN("&clk", "*", 0)==0)
  (
    &wild_head=1
  )
  if (STRING.SCAN("&clk", "*", 1)==(STRING.LENGTH("&clk")-1))
  (
    &wild_tail=1
  )

  if ((&wild_head==1)&&(&wild_tail==1))
  (
    if (STRING.SCAN("gcc_blsp1_uart2_apps_clk", STRING.MID("&clk", 1, &clk_input_length-2), 0)!=-1)
    ( 
      &match=1
    )
  )
  else if (&wild_head==1)
  (
    if (STRING.MID("gcc_blsp1_uart2_apps_clk", &clk_itr_length-&clk_input_length+1, &clk_input_length-1)==STRING.CUT("&clk", 1))
    ( 
      &match=1
    )
  )
  else if (&wild_tail==1)
  (
    if (STRING.MID("gcc_blsp1_uart2_apps_clk", 0, &clk_input_length-1)==STRING.CUT("&clk", -1))
    ( 
      &match=1
    )
  )
  else if ("gcc_blsp1_uart2_apps_clk"=="&clk")
  (
    &match=1
  )
  
  if (&match==1)
  (
    &clk_test=&CLK_TEST_GCC_BLSP1_UART2_APPS_CLK
    &clk_reg=&HWIO_GCC_BLSP1_UART2_APPS_CBCR_ADDR
    &clk_reg_name="GCC_BLSP1_UART2_APPS_CBCR"
    &clk_name="gcc_blsp1_uart2_apps_clk"
    &clk_reg_cbcr_type="sm_cbc"
    &clk_vote_bit=-1.
    &clk_multiplier=4.

    gosub Print_Clk_Info_Line
  )

  &match=0
  &wild_head=0
  &wild_tail=0
  &clk_input_length=STRING.LENGTH("&clk")
  &clk_itr_length=STRING.LENGTH("gcc_blsp1_uart3_apps_clk")

  if (STRING.SCAN("&clk", "*", 0)==0)
  (
    &wild_head=1
  )
  if (STRING.SCAN("&clk", "*", 1)==(STRING.LENGTH("&clk")-1))
  (
    &wild_tail=1
  )

  if ((&wild_head==1)&&(&wild_tail==1))
  (
    if (STRING.SCAN("gcc_blsp1_uart3_apps_clk", STRING.MID("&clk", 1, &clk_input_length-2), 0)!=-1)
    ( 
      &match=1
    )
  )
  else if (&wild_head==1)
  (
    if (STRING.MID("gcc_blsp1_uart3_apps_clk", &clk_itr_length-&clk_input_length+1, &clk_input_length-1)==STRING.CUT("&clk", 1))
    ( 
      &match=1
    )
  )
  else if (&wild_tail==1)
  (
    if (STRING.MID("gcc_blsp1_uart3_apps_clk", 0, &clk_input_length-1)==STRING.CUT("&clk", -1))
    ( 
      &match=1
    )
  )
  else if ("gcc_blsp1_uart3_apps_clk"=="&clk")
  (
    &match=1
  )
  
  if (&match==1)
  (
    &clk_test=&CLK_TEST_GCC_BLSP1_UART3_APPS_CLK
    &clk_reg=&HWIO_GCC_BLSP1_UART3_APPS_CBCR_ADDR
    &clk_reg_name="GCC_BLSP1_UART3_APPS_CBCR"
    &clk_name="gcc_blsp1_uart3_apps_clk"
    &clk_reg_cbcr_type="sm_cbc"
    &clk_vote_bit=-1.
    &clk_multiplier=4.

    gosub Print_Clk_Info_Line
  )

  &match=0
  &wild_head=0
  &wild_tail=0
  &clk_input_length=STRING.LENGTH("&clk")
  &clk_itr_length=STRING.LENGTH("gcc_blsp2_qup1_i2c_apps_clk")

  if (STRING.SCAN("&clk", "*", 0)==0)
  (
    &wild_head=1
  )
  if (STRING.SCAN("&clk", "*", 1)==(STRING.LENGTH("&clk")-1))
  (
    &wild_tail=1
  )

  if ((&wild_head==1)&&(&wild_tail==1))
  (
    if (STRING.SCAN("gcc_blsp2_qup1_i2c_apps_clk", STRING.MID("&clk", 1, &clk_input_length-2), 0)!=-1)
    ( 
      &match=1
    )
  )
  else if (&wild_head==1)
  (
    if (STRING.MID("gcc_blsp2_qup1_i2c_apps_clk", &clk_itr_length-&clk_input_length+1, &clk_input_length-1)==STRING.CUT("&clk", 1))
    ( 
      &match=1
    )
  )
  else if (&wild_tail==1)
  (
    if (STRING.MID("gcc_blsp2_qup1_i2c_apps_clk", 0, &clk_input_length-1)==STRING.CUT("&clk", -1))
    ( 
      &match=1
    )
  )
  else if ("gcc_blsp2_qup1_i2c_apps_clk"=="&clk")
  (
    &match=1
  )
  
  if (&match==1)
  (
    &clk_test=&CLK_TEST_GCC_BLSP2_QUP1_I2C_APPS_CLK
    &clk_reg=&HWIO_GCC_BLSP2_QUP1_I2C_APPS_CBCR_ADDR
    &clk_reg_name="GCC_BLSP2_QUP1_I2C_APPS_CBCR"
    &clk_name="gcc_blsp2_qup1_i2c_apps_clk"
    &clk_reg_cbcr_type="sm_cbc"
    &clk_vote_bit=-1.
    &clk_multiplier=4.

    gosub Print_Clk_Info_Line
  )

  &match=0
  &wild_head=0
  &wild_tail=0
  &clk_input_length=STRING.LENGTH("&clk")
  &clk_itr_length=STRING.LENGTH("gcc_blsp2_qup1_spi_apps_clk")

  if (STRING.SCAN("&clk", "*", 0)==0)
  (
    &wild_head=1
  )
  if (STRING.SCAN("&clk", "*", 1)==(STRING.LENGTH("&clk")-1))
  (
    &wild_tail=1
  )

  if ((&wild_head==1)&&(&wild_tail==1))
  (
    if (STRING.SCAN("gcc_blsp2_qup1_spi_apps_clk", STRING.MID("&clk", 1, &clk_input_length-2), 0)!=-1)
    ( 
      &match=1
    )
  )
  else if (&wild_head==1)
  (
    if (STRING.MID("gcc_blsp2_qup1_spi_apps_clk", &clk_itr_length-&clk_input_length+1, &clk_input_length-1)==STRING.CUT("&clk", 1))
    ( 
      &match=1
    )
  )
  else if (&wild_tail==1)
  (
    if (STRING.MID("gcc_blsp2_qup1_spi_apps_clk", 0, &clk_input_length-1)==STRING.CUT("&clk", -1))
    ( 
      &match=1
    )
  )
  else if ("gcc_blsp2_qup1_spi_apps_clk"=="&clk")
  (
    &match=1
  )
  
  if (&match==1)
  (
    &clk_test=&CLK_TEST_GCC_BLSP2_QUP1_SPI_APPS_CLK
    &clk_reg=&HWIO_GCC_BLSP2_QUP1_SPI_APPS_CBCR_ADDR
    &clk_reg_name="GCC_BLSP2_QUP1_SPI_APPS_CBCR"
    &clk_name="gcc_blsp2_qup1_spi_apps_clk"
    &clk_reg_cbcr_type="sm_cbc"
    &clk_vote_bit=-1.
    &clk_multiplier=4.

    gosub Print_Clk_Info_Line
  )

  &match=0
  &wild_head=0
  &wild_tail=0
  &clk_input_length=STRING.LENGTH("&clk")
  &clk_itr_length=STRING.LENGTH("gcc_blsp2_qup2_i2c_apps_clk")

  if (STRING.SCAN("&clk", "*", 0)==0)
  (
    &wild_head=1
  )
  if (STRING.SCAN("&clk", "*", 1)==(STRING.LENGTH("&clk")-1))
  (
    &wild_tail=1
  )

  if ((&wild_head==1)&&(&wild_tail==1))
  (
    if (STRING.SCAN("gcc_blsp2_qup2_i2c_apps_clk", STRING.MID("&clk", 1, &clk_input_length-2), 0)!=-1)
    ( 
      &match=1
    )
  )
  else if (&wild_head==1)
  (
    if (STRING.MID("gcc_blsp2_qup2_i2c_apps_clk", &clk_itr_length-&clk_input_length+1, &clk_input_length-1)==STRING.CUT("&clk", 1))
    ( 
      &match=1
    )
  )
  else if (&wild_tail==1)
  (
    if (STRING.MID("gcc_blsp2_qup2_i2c_apps_clk", 0, &clk_input_length-1)==STRING.CUT("&clk", -1))
    ( 
      &match=1
    )
  )
  else if ("gcc_blsp2_qup2_i2c_apps_clk"=="&clk")
  (
    &match=1
  )
  
  if (&match==1)
  (
    &clk_test=&CLK_TEST_GCC_BLSP2_QUP2_I2C_APPS_CLK
    &clk_reg=&HWIO_GCC_BLSP2_QUP2_I2C_APPS_CBCR_ADDR
    &clk_reg_name="GCC_BLSP2_QUP2_I2C_APPS_CBCR"
    &clk_name="gcc_blsp2_qup2_i2c_apps_clk"
    &clk_reg_cbcr_type="sm_cbc"
    &clk_vote_bit=-1.
    &clk_multiplier=4.

    gosub Print_Clk_Info_Line
  )

  &match=0
  &wild_head=0
  &wild_tail=0
  &clk_input_length=STRING.LENGTH("&clk")
  &clk_itr_length=STRING.LENGTH("gcc_blsp2_qup2_spi_apps_clk")

  if (STRING.SCAN("&clk", "*", 0)==0)
  (
    &wild_head=1
  )
  if (STRING.SCAN("&clk", "*", 1)==(STRING.LENGTH("&clk")-1))
  (
    &wild_tail=1
  )

  if ((&wild_head==1)&&(&wild_tail==1))
  (
    if (STRING.SCAN("gcc_blsp2_qup2_spi_apps_clk", STRING.MID("&clk", 1, &clk_input_length-2), 0)!=-1)
    ( 
      &match=1
    )
  )
  else if (&wild_head==1)
  (
    if (STRING.MID("gcc_blsp2_qup2_spi_apps_clk", &clk_itr_length-&clk_input_length+1, &clk_input_length-1)==STRING.CUT("&clk", 1))
    ( 
      &match=1
    )
  )
  else if (&wild_tail==1)
  (
    if (STRING.MID("gcc_blsp2_qup2_spi_apps_clk", 0, &clk_input_length-1)==STRING.CUT("&clk", -1))
    ( 
      &match=1
    )
  )
  else if ("gcc_blsp2_qup2_spi_apps_clk"=="&clk")
  (
    &match=1
  )
  
  if (&match==1)
  (
    &clk_test=&CLK_TEST_GCC_BLSP2_QUP2_SPI_APPS_CLK
    &clk_reg=&HWIO_GCC_BLSP2_QUP2_SPI_APPS_CBCR_ADDR
    &clk_reg_name="GCC_BLSP2_QUP2_SPI_APPS_CBCR"
    &clk_name="gcc_blsp2_qup2_spi_apps_clk"
    &clk_reg_cbcr_type="sm_cbc"
    &clk_vote_bit=-1.
    &clk_multiplier=4.

    gosub Print_Clk_Info_Line
  )

  &match=0
  &wild_head=0
  &wild_tail=0
  &clk_input_length=STRING.LENGTH("&clk")
  &clk_itr_length=STRING.LENGTH("gcc_blsp2_qup3_i2c_apps_clk")

  if (STRING.SCAN("&clk", "*", 0)==0)
  (
    &wild_head=1
  )
  if (STRING.SCAN("&clk", "*", 1)==(STRING.LENGTH("&clk")-1))
  (
    &wild_tail=1
  )

  if ((&wild_head==1)&&(&wild_tail==1))
  (
    if (STRING.SCAN("gcc_blsp2_qup3_i2c_apps_clk", STRING.MID("&clk", 1, &clk_input_length-2), 0)!=-1)
    ( 
      &match=1
    )
  )
  else if (&wild_head==1)
  (
    if (STRING.MID("gcc_blsp2_qup3_i2c_apps_clk", &clk_itr_length-&clk_input_length+1, &clk_input_length-1)==STRING.CUT("&clk", 1))
    ( 
      &match=1
    )
  )
  else if (&wild_tail==1)
  (
    if (STRING.MID("gcc_blsp2_qup3_i2c_apps_clk", 0, &clk_input_length-1)==STRING.CUT("&clk", -1))
    ( 
      &match=1
    )
  )
  else if ("gcc_blsp2_qup3_i2c_apps_clk"=="&clk")
  (
    &match=1
  )
  
  if (&match==1)
  (
    &clk_test=&CLK_TEST_GCC_BLSP2_QUP3_I2C_APPS_CLK
    &clk_reg=&HWIO_GCC_BLSP2_QUP3_I2C_APPS_CBCR_ADDR
    &clk_reg_name="GCC_BLSP2_QUP3_I2C_APPS_CBCR"
    &clk_name="gcc_blsp2_qup3_i2c_apps_clk"
    &clk_reg_cbcr_type="sm_cbc"
    &clk_vote_bit=-1.
    &clk_multiplier=4.

    gosub Print_Clk_Info_Line
  )

  &match=0
  &wild_head=0
  &wild_tail=0
  &clk_input_length=STRING.LENGTH("&clk")
  &clk_itr_length=STRING.LENGTH("gcc_blsp2_qup3_spi_apps_clk")

  if (STRING.SCAN("&clk", "*", 0)==0)
  (
    &wild_head=1
  )
  if (STRING.SCAN("&clk", "*", 1)==(STRING.LENGTH("&clk")-1))
  (
    &wild_tail=1
  )

  if ((&wild_head==1)&&(&wild_tail==1))
  (
    if (STRING.SCAN("gcc_blsp2_qup3_spi_apps_clk", STRING.MID("&clk", 1, &clk_input_length-2), 0)!=-1)
    ( 
      &match=1
    )
  )
  else if (&wild_head==1)
  (
    if (STRING.MID("gcc_blsp2_qup3_spi_apps_clk", &clk_itr_length-&clk_input_length+1, &clk_input_length-1)==STRING.CUT("&clk", 1))
    ( 
      &match=1
    )
  )
  else if (&wild_tail==1)
  (
    if (STRING.MID("gcc_blsp2_qup3_spi_apps_clk", 0, &clk_input_length-1)==STRING.CUT("&clk", -1))
    ( 
      &match=1
    )
  )
  else if ("gcc_blsp2_qup3_spi_apps_clk"=="&clk")
  (
    &match=1
  )
  
  if (&match==1)
  (
    &clk_test=&CLK_TEST_GCC_BLSP2_QUP3_SPI_APPS_CLK
    &clk_reg=&HWIO_GCC_BLSP2_QUP3_SPI_APPS_CBCR_ADDR
    &clk_reg_name="GCC_BLSP2_QUP3_SPI_APPS_CBCR"
    &clk_name="gcc_blsp2_qup3_spi_apps_clk"
    &clk_reg_cbcr_type="sm_cbc"
    &clk_vote_bit=-1.
    &clk_multiplier=4.

    gosub Print_Clk_Info_Line
  )

  &match=0
  &wild_head=0
  &wild_tail=0
  &clk_input_length=STRING.LENGTH("&clk")
  &clk_itr_length=STRING.LENGTH("gcc_blsp2_qup4_i2c_apps_clk")

  if (STRING.SCAN("&clk", "*", 0)==0)
  (
    &wild_head=1
  )
  if (STRING.SCAN("&clk", "*", 1)==(STRING.LENGTH("&clk")-1))
  (
    &wild_tail=1
  )

  if ((&wild_head==1)&&(&wild_tail==1))
  (
    if (STRING.SCAN("gcc_blsp2_qup4_i2c_apps_clk", STRING.MID("&clk", 1, &clk_input_length-2), 0)!=-1)
    ( 
      &match=1
    )
  )
  else if (&wild_head==1)
  (
    if (STRING.MID("gcc_blsp2_qup4_i2c_apps_clk", &clk_itr_length-&clk_input_length+1, &clk_input_length-1)==STRING.CUT("&clk", 1))
    ( 
      &match=1
    )
  )
  else if (&wild_tail==1)
  (
    if (STRING.MID("gcc_blsp2_qup4_i2c_apps_clk", 0, &clk_input_length-1)==STRING.CUT("&clk", -1))
    ( 
      &match=1
    )
  )
  else if ("gcc_blsp2_qup4_i2c_apps_clk"=="&clk")
  (
    &match=1
  )
  
  if (&match==1)
  (
    &clk_test=&CLK_TEST_GCC_BLSP2_QUP4_I2C_APPS_CLK
    &clk_reg=&HWIO_GCC_BLSP2_QUP4_I2C_APPS_CBCR_ADDR
    &clk_reg_name="GCC_BLSP2_QUP4_I2C_APPS_CBCR"
    &clk_name="gcc_blsp2_qup4_i2c_apps_clk"
    &clk_reg_cbcr_type="sm_cbc"
    &clk_vote_bit=-1.
    &clk_multiplier=4.

    gosub Print_Clk_Info_Line
  )

  &match=0
  &wild_head=0
  &wild_tail=0
  &clk_input_length=STRING.LENGTH("&clk")
  &clk_itr_length=STRING.LENGTH("gcc_blsp2_qup4_spi_apps_clk")

  if (STRING.SCAN("&clk", "*", 0)==0)
  (
    &wild_head=1
  )
  if (STRING.SCAN("&clk", "*", 1)==(STRING.LENGTH("&clk")-1))
  (
    &wild_tail=1
  )

  if ((&wild_head==1)&&(&wild_tail==1))
  (
    if (STRING.SCAN("gcc_blsp2_qup4_spi_apps_clk", STRING.MID("&clk", 1, &clk_input_length-2), 0)!=-1)
    ( 
      &match=1
    )
  )
  else if (&wild_head==1)
  (
    if (STRING.MID("gcc_blsp2_qup4_spi_apps_clk", &clk_itr_length-&clk_input_length+1, &clk_input_length-1)==STRING.CUT("&clk", 1))
    ( 
      &match=1
    )
  )
  else if (&wild_tail==1)
  (
    if (STRING.MID("gcc_blsp2_qup4_spi_apps_clk", 0, &clk_input_length-1)==STRING.CUT("&clk", -1))
    ( 
      &match=1
    )
  )
  else if ("gcc_blsp2_qup4_spi_apps_clk"=="&clk")
  (
    &match=1
  )
  
  if (&match==1)
  (
    &clk_test=&CLK_TEST_GCC_BLSP2_QUP4_SPI_APPS_CLK
    &clk_reg=&HWIO_GCC_BLSP2_QUP4_SPI_APPS_CBCR_ADDR
    &clk_reg_name="GCC_BLSP2_QUP4_SPI_APPS_CBCR"
    &clk_name="gcc_blsp2_qup4_spi_apps_clk"
    &clk_reg_cbcr_type="sm_cbc"
    &clk_vote_bit=-1.
    &clk_multiplier=4.

    gosub Print_Clk_Info_Line
  )

  &match=0
  &wild_head=0
  &wild_tail=0
  &clk_input_length=STRING.LENGTH("&clk")
  &clk_itr_length=STRING.LENGTH("gcc_blsp2_qup5_i2c_apps_clk")

  if (STRING.SCAN("&clk", "*", 0)==0)
  (
    &wild_head=1
  )
  if (STRING.SCAN("&clk", "*", 1)==(STRING.LENGTH("&clk")-1))
  (
    &wild_tail=1
  )

  if ((&wild_head==1)&&(&wild_tail==1))
  (
    if (STRING.SCAN("gcc_blsp2_qup5_i2c_apps_clk", STRING.MID("&clk", 1, &clk_input_length-2), 0)!=-1)
    ( 
      &match=1
    )
  )
  else if (&wild_head==1)
  (
    if (STRING.MID("gcc_blsp2_qup5_i2c_apps_clk", &clk_itr_length-&clk_input_length+1, &clk_input_length-1)==STRING.CUT("&clk", 1))
    ( 
      &match=1
    )
  )
  else if (&wild_tail==1)
  (
    if (STRING.MID("gcc_blsp2_qup5_i2c_apps_clk", 0, &clk_input_length-1)==STRING.CUT("&clk", -1))
    ( 
      &match=1
    )
  )
  else if ("gcc_blsp2_qup5_i2c_apps_clk"=="&clk")
  (
    &match=1
  )
  
  if (&match==1)
  (
    &clk_test=&CLK_TEST_GCC_BLSP2_QUP5_I2C_APPS_CLK
    &clk_reg=&HWIO_GCC_BLSP2_QUP5_I2C_APPS_CBCR_ADDR
    &clk_reg_name="GCC_BLSP2_QUP5_I2C_APPS_CBCR"
    &clk_name="gcc_blsp2_qup5_i2c_apps_clk"
    &clk_reg_cbcr_type="sm_cbc"
    &clk_vote_bit=-1.
    &clk_multiplier=4.

    gosub Print_Clk_Info_Line
  )

  &match=0
  &wild_head=0
  &wild_tail=0
  &clk_input_length=STRING.LENGTH("&clk")
  &clk_itr_length=STRING.LENGTH("gcc_blsp2_qup5_spi_apps_clk")

  if (STRING.SCAN("&clk", "*", 0)==0)
  (
    &wild_head=1
  )
  if (STRING.SCAN("&clk", "*", 1)==(STRING.LENGTH("&clk")-1))
  (
    &wild_tail=1
  )

  if ((&wild_head==1)&&(&wild_tail==1))
  (
    if (STRING.SCAN("gcc_blsp2_qup5_spi_apps_clk", STRING.MID("&clk", 1, &clk_input_length-2), 0)!=-1)
    ( 
      &match=1
    )
  )
  else if (&wild_head==1)
  (
    if (STRING.MID("gcc_blsp2_qup5_spi_apps_clk", &clk_itr_length-&clk_input_length+1, &clk_input_length-1)==STRING.CUT("&clk", 1))
    ( 
      &match=1
    )
  )
  else if (&wild_tail==1)
  (
    if (STRING.MID("gcc_blsp2_qup5_spi_apps_clk", 0, &clk_input_length-1)==STRING.CUT("&clk", -1))
    ( 
      &match=1
    )
  )
  else if ("gcc_blsp2_qup5_spi_apps_clk"=="&clk")
  (
    &match=1
  )
  
  if (&match==1)
  (
    &clk_test=&CLK_TEST_GCC_BLSP2_QUP5_SPI_APPS_CLK
    &clk_reg=&HWIO_GCC_BLSP2_QUP5_SPI_APPS_CBCR_ADDR
    &clk_reg_name="GCC_BLSP2_QUP5_SPI_APPS_CBCR"
    &clk_name="gcc_blsp2_qup5_spi_apps_clk"
    &clk_reg_cbcr_type="sm_cbc"
    &clk_vote_bit=-1.
    &clk_multiplier=4.

    gosub Print_Clk_Info_Line
  )

  &match=0
  &wild_head=0
  &wild_tail=0
  &clk_input_length=STRING.LENGTH("&clk")
  &clk_itr_length=STRING.LENGTH("gcc_blsp2_qup6_i2c_apps_clk")

  if (STRING.SCAN("&clk", "*", 0)==0)
  (
    &wild_head=1
  )
  if (STRING.SCAN("&clk", "*", 1)==(STRING.LENGTH("&clk")-1))
  (
    &wild_tail=1
  )

  if ((&wild_head==1)&&(&wild_tail==1))
  (
    if (STRING.SCAN("gcc_blsp2_qup6_i2c_apps_clk", STRING.MID("&clk", 1, &clk_input_length-2), 0)!=-1)
    ( 
      &match=1
    )
  )
  else if (&wild_head==1)
  (
    if (STRING.MID("gcc_blsp2_qup6_i2c_apps_clk", &clk_itr_length-&clk_input_length+1, &clk_input_length-1)==STRING.CUT("&clk", 1))
    ( 
      &match=1
    )
  )
  else if (&wild_tail==1)
  (
    if (STRING.MID("gcc_blsp2_qup6_i2c_apps_clk", 0, &clk_input_length-1)==STRING.CUT("&clk", -1))
    ( 
      &match=1
    )
  )
  else if ("gcc_blsp2_qup6_i2c_apps_clk"=="&clk")
  (
    &match=1
  )
  
  if (&match==1)
  (
    &clk_test=&CLK_TEST_GCC_BLSP2_QUP6_I2C_APPS_CLK
    &clk_reg=&HWIO_GCC_BLSP2_QUP6_I2C_APPS_CBCR_ADDR
    &clk_reg_name="GCC_BLSP2_QUP6_I2C_APPS_CBCR"
    &clk_name="gcc_blsp2_qup6_i2c_apps_clk"
    &clk_reg_cbcr_type="sm_cbc"
    &clk_vote_bit=-1.
    &clk_multiplier=4.

    gosub Print_Clk_Info_Line
  )

  &match=0
  &wild_head=0
  &wild_tail=0
  &clk_input_length=STRING.LENGTH("&clk")
  &clk_itr_length=STRING.LENGTH("gcc_blsp2_qup6_spi_apps_clk")

  if (STRING.SCAN("&clk", "*", 0)==0)
  (
    &wild_head=1
  )
  if (STRING.SCAN("&clk", "*", 1)==(STRING.LENGTH("&clk")-1))
  (
    &wild_tail=1
  )

  if ((&wild_head==1)&&(&wild_tail==1))
  (
    if (STRING.SCAN("gcc_blsp2_qup6_spi_apps_clk", STRING.MID("&clk", 1, &clk_input_length-2), 0)!=-1)
    ( 
      &match=1
    )
  )
  else if (&wild_head==1)
  (
    if (STRING.MID("gcc_blsp2_qup6_spi_apps_clk", &clk_itr_length-&clk_input_length+1, &clk_input_length-1)==STRING.CUT("&clk", 1))
    ( 
      &match=1
    )
  )
  else if (&wild_tail==1)
  (
    if (STRING.MID("gcc_blsp2_qup6_spi_apps_clk", 0, &clk_input_length-1)==STRING.CUT("&clk", -1))
    ( 
      &match=1
    )
  )
  else if ("gcc_blsp2_qup6_spi_apps_clk"=="&clk")
  (
    &match=1
  )
  
  if (&match==1)
  (
    &clk_test=&CLK_TEST_GCC_BLSP2_QUP6_SPI_APPS_CLK
    &clk_reg=&HWIO_GCC_BLSP2_QUP6_SPI_APPS_CBCR_ADDR
    &clk_reg_name="GCC_BLSP2_QUP6_SPI_APPS_CBCR"
    &clk_name="gcc_blsp2_qup6_spi_apps_clk"
    &clk_reg_cbcr_type="sm_cbc"
    &clk_vote_bit=-1.
    &clk_multiplier=4.

    gosub Print_Clk_Info_Line
  )

  &match=0
  &wild_head=0
  &wild_tail=0
  &clk_input_length=STRING.LENGTH("&clk")
  &clk_itr_length=STRING.LENGTH("gcc_blsp2_uart1_apps_clk")

  if (STRING.SCAN("&clk", "*", 0)==0)
  (
    &wild_head=1
  )
  if (STRING.SCAN("&clk", "*", 1)==(STRING.LENGTH("&clk")-1))
  (
    &wild_tail=1
  )

  if ((&wild_head==1)&&(&wild_tail==1))
  (
    if (STRING.SCAN("gcc_blsp2_uart1_apps_clk", STRING.MID("&clk", 1, &clk_input_length-2), 0)!=-1)
    ( 
      &match=1
    )
  )
  else if (&wild_head==1)
  (
    if (STRING.MID("gcc_blsp2_uart1_apps_clk", &clk_itr_length-&clk_input_length+1, &clk_input_length-1)==STRING.CUT("&clk", 1))
    ( 
      &match=1
    )
  )
  else if (&wild_tail==1)
  (
    if (STRING.MID("gcc_blsp2_uart1_apps_clk", 0, &clk_input_length-1)==STRING.CUT("&clk", -1))
    ( 
      &match=1
    )
  )
  else if ("gcc_blsp2_uart1_apps_clk"=="&clk")
  (
    &match=1
  )
  
  if (&match==1)
  (
    &clk_test=&CLK_TEST_GCC_BLSP2_UART1_APPS_CLK
    &clk_reg=&HWIO_GCC_BLSP2_UART1_APPS_CBCR_ADDR
    &clk_reg_name="GCC_BLSP2_UART1_APPS_CBCR"
    &clk_name="gcc_blsp2_uart1_apps_clk"
    &clk_reg_cbcr_type="sm_cbc"
    &clk_vote_bit=-1.
    &clk_multiplier=4.

    gosub Print_Clk_Info_Line
  )

  &match=0
  &wild_head=0
  &wild_tail=0
  &clk_input_length=STRING.LENGTH("&clk")
  &clk_itr_length=STRING.LENGTH("gcc_blsp2_uart2_apps_clk")

  if (STRING.SCAN("&clk", "*", 0)==0)
  (
    &wild_head=1
  )
  if (STRING.SCAN("&clk", "*", 1)==(STRING.LENGTH("&clk")-1))
  (
    &wild_tail=1
  )

  if ((&wild_head==1)&&(&wild_tail==1))
  (
    if (STRING.SCAN("gcc_blsp2_uart2_apps_clk", STRING.MID("&clk", 1, &clk_input_length-2), 0)!=-1)
    ( 
      &match=1
    )
  )
  else if (&wild_head==1)
  (
    if (STRING.MID("gcc_blsp2_uart2_apps_clk", &clk_itr_length-&clk_input_length+1, &clk_input_length-1)==STRING.CUT("&clk", 1))
    ( 
      &match=1
    )
  )
  else if (&wild_tail==1)
  (
    if (STRING.MID("gcc_blsp2_uart2_apps_clk", 0, &clk_input_length-1)==STRING.CUT("&clk", -1))
    ( 
      &match=1
    )
  )
  else if ("gcc_blsp2_uart2_apps_clk"=="&clk")
  (
    &match=1
  )
  
  if (&match==1)
  (
    &clk_test=&CLK_TEST_GCC_BLSP2_UART2_APPS_CLK
    &clk_reg=&HWIO_GCC_BLSP2_UART2_APPS_CBCR_ADDR
    &clk_reg_name="GCC_BLSP2_UART2_APPS_CBCR"
    &clk_name="gcc_blsp2_uart2_apps_clk"
    &clk_reg_cbcr_type="sm_cbc"
    &clk_vote_bit=-1.
    &clk_multiplier=4.

    gosub Print_Clk_Info_Line
  )

  &match=0
  &wild_head=0
  &wild_tail=0
  &clk_input_length=STRING.LENGTH("&clk")
  &clk_itr_length=STRING.LENGTH("gcc_blsp2_uart3_apps_clk")

  if (STRING.SCAN("&clk", "*", 0)==0)
  (
    &wild_head=1
  )
  if (STRING.SCAN("&clk", "*", 1)==(STRING.LENGTH("&clk")-1))
  (
    &wild_tail=1
  )

  if ((&wild_head==1)&&(&wild_tail==1))
  (
    if (STRING.SCAN("gcc_blsp2_uart3_apps_clk", STRING.MID("&clk", 1, &clk_input_length-2), 0)!=-1)
    ( 
      &match=1
    )
  )
  else if (&wild_head==1)
  (
    if (STRING.MID("gcc_blsp2_uart3_apps_clk", &clk_itr_length-&clk_input_length+1, &clk_input_length-1)==STRING.CUT("&clk", 1))
    ( 
      &match=1
    )
  )
  else if (&wild_tail==1)
  (
    if (STRING.MID("gcc_blsp2_uart3_apps_clk", 0, &clk_input_length-1)==STRING.CUT("&clk", -1))
    ( 
      &match=1
    )
  )
  else if ("gcc_blsp2_uart3_apps_clk"=="&clk")
  (
    &match=1
  )
  
  if (&match==1)
  (
    &clk_test=&CLK_TEST_GCC_BLSP2_UART3_APPS_CLK
    &clk_reg=&HWIO_GCC_BLSP2_UART3_APPS_CBCR_ADDR
    &clk_reg_name="GCC_BLSP2_UART3_APPS_CBCR"
    &clk_name="gcc_blsp2_uart3_apps_clk"
    &clk_reg_cbcr_type="sm_cbc"
    &clk_vote_bit=-1.
    &clk_multiplier=4.

    gosub Print_Clk_Info_Line
  )

  &match=0
  &wild_head=0
  &wild_tail=0
  &clk_input_length=STRING.LENGTH("&clk")
  &clk_itr_length=STRING.LENGTH("gcc_blsp1_uart1_sim_clk")

  if (STRING.SCAN("&clk", "*", 0)==0)
  (
    &wild_head=1
  )
  if (STRING.SCAN("&clk", "*", 1)==(STRING.LENGTH("&clk")-1))
  (
    &wild_tail=1
  )

  if ((&wild_head==1)&&(&wild_tail==1))
  (
    if (STRING.SCAN("gcc_blsp1_uart1_sim_clk", STRING.MID("&clk", 1, &clk_input_length-2), 0)!=-1)
    ( 
      &match=1
    )
  )
  else if (&wild_head==1)
  (
    if (STRING.MID("gcc_blsp1_uart1_sim_clk", &clk_itr_length-&clk_input_length+1, &clk_input_length-1)==STRING.CUT("&clk", 1))
    ( 
      &match=1
    )
  )
  else if (&wild_tail==1)
  (
    if (STRING.MID("gcc_blsp1_uart1_sim_clk", 0, &clk_input_length-1)==STRING.CUT("&clk", -1))
    ( 
      &match=1
    )
  )
  else if ("gcc_blsp1_uart1_sim_clk"=="&clk")
  (
    &match=1
  )
  
  if (&match==1)
  (
    &clk_test=&CLK_TEST_GCC_BLSP1_UART1_SIM_CLK
    &clk_reg=&HWIO_GCC_BLSP1_UART1_SIM_CBCR_ADDR
    &clk_reg_name="GCC_BLSP1_UART1_SIM_CBCR"
    &clk_name="gcc_blsp1_uart1_sim_clk"
    &clk_reg_cbcr_type="sm_cbc"
    &clk_vote_bit=-1.
    &clk_multiplier=4.

    gosub Print_Clk_Info_Line
  )

  &match=0
  &wild_head=0
  &wild_tail=0
  &clk_input_length=STRING.LENGTH("&clk")
  &clk_itr_length=STRING.LENGTH("gcc_blsp1_uart2_sim_clk")

  if (STRING.SCAN("&clk", "*", 0)==0)
  (
    &wild_head=1
  )
  if (STRING.SCAN("&clk", "*", 1)==(STRING.LENGTH("&clk")-1))
  (
    &wild_tail=1
  )

  if ((&wild_head==1)&&(&wild_tail==1))
  (
    if (STRING.SCAN("gcc_blsp1_uart2_sim_clk", STRING.MID("&clk", 1, &clk_input_length-2), 0)!=-1)
    ( 
      &match=1
    )
  )
  else if (&wild_head==1)
  (
    if (STRING.MID("gcc_blsp1_uart2_sim_clk", &clk_itr_length-&clk_input_length+1, &clk_input_length-1)==STRING.CUT("&clk", 1))
    ( 
      &match=1
    )
  )
  else if (&wild_tail==1)
  (
    if (STRING.MID("gcc_blsp1_uart2_sim_clk", 0, &clk_input_length-1)==STRING.CUT("&clk", -1))
    ( 
      &match=1
    )
  )
  else if ("gcc_blsp1_uart2_sim_clk"=="&clk")
  (
    &match=1
  )
  
  if (&match==1)
  (
    &clk_test=&CLK_TEST_GCC_BLSP1_UART2_SIM_CLK
    &clk_reg=&HWIO_GCC_BLSP1_UART2_SIM_CBCR_ADDR
    &clk_reg_name="GCC_BLSP1_UART2_SIM_CBCR"
    &clk_name="gcc_blsp1_uart2_sim_clk"
    &clk_reg_cbcr_type="sm_cbc"
    &clk_vote_bit=-1.
    &clk_multiplier=4.

    gosub Print_Clk_Info_Line
  )

  &match=0
  &wild_head=0
  &wild_tail=0
  &clk_input_length=STRING.LENGTH("&clk")
  &clk_itr_length=STRING.LENGTH("gcc_blsp1_uart3_sim_clk")

  if (STRING.SCAN("&clk", "*", 0)==0)
  (
    &wild_head=1
  )
  if (STRING.SCAN("&clk", "*", 1)==(STRING.LENGTH("&clk")-1))
  (
    &wild_tail=1
  )

  if ((&wild_head==1)&&(&wild_tail==1))
  (
    if (STRING.SCAN("gcc_blsp1_uart3_sim_clk", STRING.MID("&clk", 1, &clk_input_length-2), 0)!=-1)
    ( 
      &match=1
    )
  )
  else if (&wild_head==1)
  (
    if (STRING.MID("gcc_blsp1_uart3_sim_clk", &clk_itr_length-&clk_input_length+1, &clk_input_length-1)==STRING.CUT("&clk", 1))
    ( 
      &match=1
    )
  )
  else if (&wild_tail==1)
  (
    if (STRING.MID("gcc_blsp1_uart3_sim_clk", 0, &clk_input_length-1)==STRING.CUT("&clk", -1))
    ( 
      &match=1
    )
  )
  else if ("gcc_blsp1_uart3_sim_clk"=="&clk")
  (
    &match=1
  )
  
  if (&match==1)
  (
    &clk_test=&CLK_TEST_GCC_BLSP1_UART3_SIM_CLK
    &clk_reg=&HWIO_GCC_BLSP1_UART3_SIM_CBCR_ADDR
    &clk_reg_name="GCC_BLSP1_UART3_SIM_CBCR"
    &clk_name="gcc_blsp1_uart3_sim_clk"
    &clk_reg_cbcr_type="sm_cbc"
    &clk_vote_bit=-1.
    &clk_multiplier=4.

    gosub Print_Clk_Info_Line
  )

  &match=0
  &wild_head=0
  &wild_tail=0
  &clk_input_length=STRING.LENGTH("&clk")
  &clk_itr_length=STRING.LENGTH("gcc_blsp2_uart1_sim_clk")

  if (STRING.SCAN("&clk", "*", 0)==0)
  (
    &wild_head=1
  )
  if (STRING.SCAN("&clk", "*", 1)==(STRING.LENGTH("&clk")-1))
  (
    &wild_tail=1
  )

  if ((&wild_head==1)&&(&wild_tail==1))
  (
    if (STRING.SCAN("gcc_blsp2_uart1_sim_clk", STRING.MID("&clk", 1, &clk_input_length-2), 0)!=-1)
    ( 
      &match=1
    )
  )
  else if (&wild_head==1)
  (
    if (STRING.MID("gcc_blsp2_uart1_sim_clk", &clk_itr_length-&clk_input_length+1, &clk_input_length-1)==STRING.CUT("&clk", 1))
    ( 
      &match=1
    )
  )
  else if (&wild_tail==1)
  (
    if (STRING.MID("gcc_blsp2_uart1_sim_clk", 0, &clk_input_length-1)==STRING.CUT("&clk", -1))
    ( 
      &match=1
    )
  )
  else if ("gcc_blsp2_uart1_sim_clk"=="&clk")
  (
    &match=1
  )
  
  if (&match==1)
  (
    &clk_test=&CLK_TEST_GCC_BLSP2_UART1_SIM_CLK
    &clk_reg=&HWIO_GCC_BLSP2_UART1_SIM_CBCR_ADDR
    &clk_reg_name="GCC_BLSP2_UART1_SIM_CBCR"
    &clk_name="gcc_blsp2_uart1_sim_clk"
    &clk_reg_cbcr_type="sm_cbc"
    &clk_vote_bit=-1.
    &clk_multiplier=4.

    gosub Print_Clk_Info_Line
  )

  &match=0
  &wild_head=0
  &wild_tail=0
  &clk_input_length=STRING.LENGTH("&clk")
  &clk_itr_length=STRING.LENGTH("gcc_blsp2_uart2_sim_clk")

  if (STRING.SCAN("&clk", "*", 0)==0)
  (
    &wild_head=1
  )
  if (STRING.SCAN("&clk", "*", 1)==(STRING.LENGTH("&clk")-1))
  (
    &wild_tail=1
  )

  if ((&wild_head==1)&&(&wild_tail==1))
  (
    if (STRING.SCAN("gcc_blsp2_uart2_sim_clk", STRING.MID("&clk", 1, &clk_input_length-2), 0)!=-1)
    ( 
      &match=1
    )
  )
  else if (&wild_head==1)
  (
    if (STRING.MID("gcc_blsp2_uart2_sim_clk", &clk_itr_length-&clk_input_length+1, &clk_input_length-1)==STRING.CUT("&clk", 1))
    ( 
      &match=1
    )
  )
  else if (&wild_tail==1)
  (
    if (STRING.MID("gcc_blsp2_uart2_sim_clk", 0, &clk_input_length-1)==STRING.CUT("&clk", -1))
    ( 
      &match=1
    )
  )
  else if ("gcc_blsp2_uart2_sim_clk"=="&clk")
  (
    &match=1
  )
  
  if (&match==1)
  (
    &clk_test=&CLK_TEST_GCC_BLSP2_UART2_SIM_CLK
    &clk_reg=&HWIO_GCC_BLSP2_UART2_SIM_CBCR_ADDR
    &clk_reg_name="GCC_BLSP2_UART2_SIM_CBCR"
    &clk_name="gcc_blsp2_uart2_sim_clk"
    &clk_reg_cbcr_type="sm_cbc"
    &clk_vote_bit=-1.
    &clk_multiplier=4.

    gosub Print_Clk_Info_Line
  )

  &match=0
  &wild_head=0
  &wild_tail=0
  &clk_input_length=STRING.LENGTH("&clk")
  &clk_itr_length=STRING.LENGTH("gcc_blsp2_uart3_sim_clk")

  if (STRING.SCAN("&clk", "*", 0)==0)
  (
    &wild_head=1
  )
  if (STRING.SCAN("&clk", "*", 1)==(STRING.LENGTH("&clk")-1))
  (
    &wild_tail=1
  )

  if ((&wild_head==1)&&(&wild_tail==1))
  (
    if (STRING.SCAN("gcc_blsp2_uart3_sim_clk", STRING.MID("&clk", 1, &clk_input_length-2), 0)!=-1)
    ( 
      &match=1
    )
  )
  else if (&wild_head==1)
  (
    if (STRING.MID("gcc_blsp2_uart3_sim_clk", &clk_itr_length-&clk_input_length+1, &clk_input_length-1)==STRING.CUT("&clk", 1))
    ( 
      &match=1
    )
  )
  else if (&wild_tail==1)
  (
    if (STRING.MID("gcc_blsp2_uart3_sim_clk", 0, &clk_input_length-1)==STRING.CUT("&clk", -1))
    ( 
      &match=1
    )
  )
  else if ("gcc_blsp2_uart3_sim_clk"=="&clk")
  (
    &match=1
  )
  
  if (&match==1)
  (
    &clk_test=&CLK_TEST_GCC_BLSP2_UART3_SIM_CLK
    &clk_reg=&HWIO_GCC_BLSP2_UART3_SIM_CBCR_ADDR
    &clk_reg_name="GCC_BLSP2_UART3_SIM_CBCR"
    &clk_name="gcc_blsp2_uart3_sim_clk"
    &clk_reg_cbcr_type="sm_cbc"
    &clk_vote_bit=-1.
    &clk_multiplier=4.

    gosub Print_Clk_Info_Line
  )

  &match=0
  &wild_head=0
  &wild_tail=0
  &clk_input_length=STRING.LENGTH("&clk")
  &clk_itr_length=STRING.LENGTH("gcc_ce1_clk")

  if (STRING.SCAN("&clk", "*", 0)==0)
  (
    &wild_head=1
  )
  if (STRING.SCAN("&clk", "*", 1)==(STRING.LENGTH("&clk")-1))
  (
    &wild_tail=1
  )

  if ((&wild_head==1)&&(&wild_tail==1))
  (
    if (STRING.SCAN("gcc_ce1_clk", STRING.MID("&clk", 1, &clk_input_length-2), 0)!=-1)
    ( 
      &match=1
    )
  )
  else if (&wild_head==1)
  (
    if (STRING.MID("gcc_ce1_clk", &clk_itr_length-&clk_input_length+1, &clk_input_length-1)==STRING.CUT("&clk", 1))
    ( 
      &match=1
    )
  )
  else if (&wild_tail==1)
  (
    if (STRING.MID("gcc_ce1_clk", 0, &clk_input_length-1)==STRING.CUT("&clk", -1))
    ( 
      &match=1
    )
  )
  else if ("gcc_ce1_clk"=="&clk")
  (
    &match=1
  )
  
  if (&match==1)
  (
    &clk_test=&CLK_TEST_GCC_CE1_CLK
    &clk_reg=&HWIO_GCC_CE1_CBCR_ADDR
    &clk_reg_name="GCC_CE1_CBCR"
    &clk_name="gcc_ce1_clk"
    &clk_reg_cbcr_type="sm_pscbc"
    &clk_vote_bit=5.
    &clk_multiplier=4.

    gosub Print_Clk_Info_Line
  )

  &match=0
  &wild_head=0
  &wild_tail=0
  &clk_input_length=STRING.LENGTH("&clk")
  &clk_itr_length=STRING.LENGTH("gcc_aggre1_cnoc_periph_ahb_clk")

  if (STRING.SCAN("&clk", "*", 0)==0)
  (
    &wild_head=1
  )
  if (STRING.SCAN("&clk", "*", 1)==(STRING.LENGTH("&clk")-1))
  (
    &wild_tail=1
  )

  if ((&wild_head==1)&&(&wild_tail==1))
  (
    if (STRING.SCAN("gcc_aggre1_cnoc_periph_ahb_clk", STRING.MID("&clk", 1, &clk_input_length-2), 0)!=-1)
    ( 
      &match=1
    )
  )
  else if (&wild_head==1)
  (
    if (STRING.MID("gcc_aggre1_cnoc_periph_ahb_clk", &clk_itr_length-&clk_input_length+1, &clk_input_length-1)==STRING.CUT("&clk", 1))
    ( 
      &match=1
    )
  )
  else if (&wild_tail==1)
  (
    if (STRING.MID("gcc_aggre1_cnoc_periph_ahb_clk", 0, &clk_input_length-1)==STRING.CUT("&clk", -1))
    ( 
      &match=1
    )
  )
  else if ("gcc_aggre1_cnoc_periph_ahb_clk"=="&clk")
  (
    &match=1
  )
  
  if (&match==1)
  (
    &clk_test=&CLK_TEST_GCC_AGGRE1_CNOC_PERIPH_AHB_CLK
    &clk_reg=&HWIO_GCC_AGGRE1_CNOC_PERIPH_AHB_CBCR_ADDR
    &clk_reg_name="GCC_AGGRE1_CNOC_PERIPH_AHB_CBCR"
    &clk_name="gcc_aggre1_cnoc_periph_ahb_clk"
    &clk_reg_cbcr_type="sm_cbc"
    &clk_vote_bit=-1.
    &clk_multiplier=4.

    gosub Print_Clk_Info_Line
  )

  &match=0
  &wild_head=0
  &wild_tail=0
  &clk_input_length=STRING.LENGTH("&clk")
  &clk_itr_length=STRING.LENGTH("gcc_aggre2_cnoc_periph_ahb_clk")

  if (STRING.SCAN("&clk", "*", 0)==0)
  (
    &wild_head=1
  )
  if (STRING.SCAN("&clk", "*", 1)==(STRING.LENGTH("&clk")-1))
  (
    &wild_tail=1
  )

  if ((&wild_head==1)&&(&wild_tail==1))
  (
    if (STRING.SCAN("gcc_aggre2_cnoc_periph_ahb_clk", STRING.MID("&clk", 1, &clk_input_length-2), 0)!=-1)
    ( 
      &match=1
    )
  )
  else if (&wild_head==1)
  (
    if (STRING.MID("gcc_aggre2_cnoc_periph_ahb_clk", &clk_itr_length-&clk_input_length+1, &clk_input_length-1)==STRING.CUT("&clk", 1))
    ( 
      &match=1
    )
  )
  else if (&wild_tail==1)
  (
    if (STRING.MID("gcc_aggre2_cnoc_periph_ahb_clk", 0, &clk_input_length-1)==STRING.CUT("&clk", -1))
    ( 
      &match=1
    )
  )
  else if ("gcc_aggre2_cnoc_periph_ahb_clk"=="&clk")
  (
    &match=1
  )
  
  if (&match==1)
  (
    &clk_test=&CLK_TEST_GCC_AGGRE2_CNOC_PERIPH_AHB_CLK
    &clk_reg=&HWIO_GCC_AGGRE2_CNOC_PERIPH_AHB_CBCR_ADDR
    &clk_reg_name="GCC_AGGRE2_CNOC_PERIPH_AHB_CBCR"
    &clk_name="gcc_aggre2_cnoc_periph_ahb_clk"
    &clk_reg_cbcr_type="sm_cbc"
    &clk_vote_bit=-1.
    &clk_multiplier=4.

    gosub Print_Clk_Info_Line
  )

  &match=0
  &wild_head=0
  &wild_tail=0
  &clk_input_length=STRING.LENGTH("&clk")
  &clk_itr_length=STRING.LENGTH("gcc_blsp1_ahb_clk")

  if (STRING.SCAN("&clk", "*", 0)==0)
  (
    &wild_head=1
  )
  if (STRING.SCAN("&clk", "*", 1)==(STRING.LENGTH("&clk")-1))
  (
    &wild_tail=1
  )

  if ((&wild_head==1)&&(&wild_tail==1))
  (
    if (STRING.SCAN("gcc_blsp1_ahb_clk", STRING.MID("&clk", 1, &clk_input_length-2), 0)!=-1)
    ( 
      &match=1
    )
  )
  else if (&wild_head==1)
  (
    if (STRING.MID("gcc_blsp1_ahb_clk", &clk_itr_length-&clk_input_length+1, &clk_input_length-1)==STRING.CUT("&clk", 1))
    ( 
      &match=1
    )
  )
  else if (&wild_tail==1)
  (
    if (STRING.MID("gcc_blsp1_ahb_clk", 0, &clk_input_length-1)==STRING.CUT("&clk", -1))
    ( 
      &match=1
    )
  )
  else if ("gcc_blsp1_ahb_clk"=="&clk")
  (
    &match=1
  )
  
  if (&match==1)
  (
    &clk_test=&CLK_TEST_GCC_BLSP1_AHB_CLK
    &clk_reg=&HWIO_GCC_BLSP1_AHB_CBCR_ADDR
    &clk_reg_name="GCC_BLSP1_AHB_CBCR"
    &clk_name="gcc_blsp1_ahb_clk"
    &clk_reg_cbcr_type="sm_pscbc"
    &clk_vote_bit=17.
    &clk_multiplier=4.

    gosub Print_Clk_Info_Line
  )

  &match=0
  &wild_head=0
  &wild_tail=0
  &clk_input_length=STRING.LENGTH("&clk")
  &clk_itr_length=STRING.LENGTH("gcc_blsp2_ahb_clk")

  if (STRING.SCAN("&clk", "*", 0)==0)
  (
    &wild_head=1
  )
  if (STRING.SCAN("&clk", "*", 1)==(STRING.LENGTH("&clk")-1))
  (
    &wild_tail=1
  )

  if ((&wild_head==1)&&(&wild_tail==1))
  (
    if (STRING.SCAN("gcc_blsp2_ahb_clk", STRING.MID("&clk", 1, &clk_input_length-2), 0)!=-1)
    ( 
      &match=1
    )
  )
  else if (&wild_head==1)
  (
    if (STRING.MID("gcc_blsp2_ahb_clk", &clk_itr_length-&clk_input_length+1, &clk_input_length-1)==STRING.CUT("&clk", 1))
    ( 
      &match=1
    )
  )
  else if (&wild_tail==1)
  (
    if (STRING.MID("gcc_blsp2_ahb_clk", 0, &clk_input_length-1)==STRING.CUT("&clk", -1))
    ( 
      &match=1
    )
  )
  else if ("gcc_blsp2_ahb_clk"=="&clk")
  (
    &match=1
  )
  
  if (&match==1)
  (
    &clk_test=&CLK_TEST_GCC_BLSP2_AHB_CLK
    &clk_reg=&HWIO_GCC_BLSP2_AHB_CBCR_ADDR
    &clk_reg_name="GCC_BLSP2_AHB_CBCR"
    &clk_name="gcc_blsp2_ahb_clk"
    &clk_reg_cbcr_type="sm_pscbc"
    &clk_vote_bit=15.
    &clk_multiplier=4.

    gosub Print_Clk_Info_Line
  )

  &match=0
  &wild_head=0
  &wild_tail=0
  &clk_input_length=STRING.LENGTH("&clk")
  &clk_itr_length=STRING.LENGTH("gcc_cnoc_periph_bus_timeout1_ahb_clk")

  if (STRING.SCAN("&clk", "*", 0)==0)
  (
    &wild_head=1
  )
  if (STRING.SCAN("&clk", "*", 1)==(STRING.LENGTH("&clk")-1))
  (
    &wild_tail=1
  )

  if ((&wild_head==1)&&(&wild_tail==1))
  (
    if (STRING.SCAN("gcc_cnoc_periph_bus_timeout1_ahb_clk", STRING.MID("&clk", 1, &clk_input_length-2), 0)!=-1)
    ( 
      &match=1
    )
  )
  else if (&wild_head==1)
  (
    if (STRING.MID("gcc_cnoc_periph_bus_timeout1_ahb_clk", &clk_itr_length-&clk_input_length+1, &clk_input_length-1)==STRING.CUT("&clk", 1))
    ( 
      &match=1
    )
  )
  else if (&wild_tail==1)
  (
    if (STRING.MID("gcc_cnoc_periph_bus_timeout1_ahb_clk", 0, &clk_input_length-1)==STRING.CUT("&clk", -1))
    ( 
      &match=1
    )
  )
  else if ("gcc_cnoc_periph_bus_timeout1_ahb_clk"=="&clk")
  (
    &match=1
  )
  
  if (&match==1)
  (
    &clk_test=&CLK_TEST_GCC_CNOC_PERIPH_BUS_TIMEOUT1_AHB_CLK
    &clk_reg=&HWIO_GCC_CNOC_PERIPH_BUS_TIMEOUT1_AHB_CBCR_ADDR
    &clk_reg_name="GCC_CNOC_PERIPH_BUS_TIMEOUT1_AHB_CBCR"
    &clk_name="gcc_cnoc_periph_bus_timeout1_ahb_clk"
    &clk_reg_cbcr_type="sm_cbc"
    &clk_vote_bit=-1.
    &clk_multiplier=4.

    gosub Print_Clk_Info_Line
  )

  &match=0
  &wild_head=0
  &wild_tail=0
  &clk_input_length=STRING.LENGTH("&clk")
  &clk_itr_length=STRING.LENGTH("gcc_cnoc_periph_bus_timeout2_ahb_clk")

  if (STRING.SCAN("&clk", "*", 0)==0)
  (
    &wild_head=1
  )
  if (STRING.SCAN("&clk", "*", 1)==(STRING.LENGTH("&clk")-1))
  (
    &wild_tail=1
  )

  if ((&wild_head==1)&&(&wild_tail==1))
  (
    if (STRING.SCAN("gcc_cnoc_periph_bus_timeout2_ahb_clk", STRING.MID("&clk", 1, &clk_input_length-2), 0)!=-1)
    ( 
      &match=1
    )
  )
  else if (&wild_head==1)
  (
    if (STRING.MID("gcc_cnoc_periph_bus_timeout2_ahb_clk", &clk_itr_length-&clk_input_length+1, &clk_input_length-1)==STRING.CUT("&clk", 1))
    ( 
      &match=1
    )
  )
  else if (&wild_tail==1)
  (
    if (STRING.MID("gcc_cnoc_periph_bus_timeout2_ahb_clk", 0, &clk_input_length-1)==STRING.CUT("&clk", -1))
    ( 
      &match=1
    )
  )
  else if ("gcc_cnoc_periph_bus_timeout2_ahb_clk"=="&clk")
  (
    &match=1
  )
  
  if (&match==1)
  (
    &clk_test=&CLK_TEST_GCC_CNOC_PERIPH_BUS_TIMEOUT2_AHB_CLK
    &clk_reg=&HWIO_GCC_CNOC_PERIPH_BUS_TIMEOUT2_AHB_CBCR_ADDR
    &clk_reg_name="GCC_CNOC_PERIPH_BUS_TIMEOUT2_AHB_CBCR"
    &clk_name="gcc_cnoc_periph_bus_timeout2_ahb_clk"
    &clk_reg_cbcr_type="sm_cbc"
    &clk_vote_bit=-1.
    &clk_multiplier=4.

    gosub Print_Clk_Info_Line
  )

  &match=0
  &wild_head=0
  &wild_tail=0
  &clk_input_length=STRING.LENGTH("&clk")
  &clk_itr_length=STRING.LENGTH("gcc_cnoc_periph_east_ahb_clk")

  if (STRING.SCAN("&clk", "*", 0)==0)
  (
    &wild_head=1
  )
  if (STRING.SCAN("&clk", "*", 1)==(STRING.LENGTH("&clk")-1))
  (
    &wild_tail=1
  )

  if ((&wild_head==1)&&(&wild_tail==1))
  (
    if (STRING.SCAN("gcc_cnoc_periph_east_ahb_clk", STRING.MID("&clk", 1, &clk_input_length-2), 0)!=-1)
    ( 
      &match=1
    )
  )
  else if (&wild_head==1)
  (
    if (STRING.MID("gcc_cnoc_periph_east_ahb_clk", &clk_itr_length-&clk_input_length+1, &clk_input_length-1)==STRING.CUT("&clk", 1))
    ( 
      &match=1
    )
  )
  else if (&wild_tail==1)
  (
    if (STRING.MID("gcc_cnoc_periph_east_ahb_clk", 0, &clk_input_length-1)==STRING.CUT("&clk", -1))
    ( 
      &match=1
    )
  )
  else if ("gcc_cnoc_periph_east_ahb_clk"=="&clk")
  (
    &match=1
  )
  
  if (&match==1)
  (
    &clk_test=&CLK_TEST_GCC_CNOC_PERIPH_EAST_AHB_CLK
    &clk_reg=&HWIO_GCC_CNOC_PERIPH_EAST_AHB_CBCR_ADDR
    &clk_reg_name="GCC_CNOC_PERIPH_EAST_AHB_CBCR"
    &clk_name="gcc_cnoc_periph_east_ahb_clk"
    &clk_reg_cbcr_type="sm_cbc"
    &clk_vote_bit=-1.
    &clk_multiplier=4.

    gosub Print_Clk_Info_Line
  )

  &match=0
  &wild_head=0
  &wild_tail=0
  &clk_input_length=STRING.LENGTH("&clk")
  &clk_itr_length=STRING.LENGTH("gcc_cnoc_periph_west_ahb_clk")

  if (STRING.SCAN("&clk", "*", 0)==0)
  (
    &wild_head=1
  )
  if (STRING.SCAN("&clk", "*", 1)==(STRING.LENGTH("&clk")-1))
  (
    &wild_tail=1
  )

  if ((&wild_head==1)&&(&wild_tail==1))
  (
    if (STRING.SCAN("gcc_cnoc_periph_west_ahb_clk", STRING.MID("&clk", 1, &clk_input_length-2), 0)!=-1)
    ( 
      &match=1
    )
  )
  else if (&wild_head==1)
  (
    if (STRING.MID("gcc_cnoc_periph_west_ahb_clk", &clk_itr_length-&clk_input_length+1, &clk_input_length-1)==STRING.CUT("&clk", 1))
    ( 
      &match=1
    )
  )
  else if (&wild_tail==1)
  (
    if (STRING.MID("gcc_cnoc_periph_west_ahb_clk", 0, &clk_input_length-1)==STRING.CUT("&clk", -1))
    ( 
      &match=1
    )
  )
  else if ("gcc_cnoc_periph_west_ahb_clk"=="&clk")
  (
    &match=1
  )
  
  if (&match==1)
  (
    &clk_test=&CLK_TEST_GCC_CNOC_PERIPH_WEST_AHB_CLK
    &clk_reg=&HWIO_GCC_CNOC_PERIPH_WEST_AHB_CBCR_ADDR
    &clk_reg_name="GCC_CNOC_PERIPH_WEST_AHB_CBCR"
    &clk_name="gcc_cnoc_periph_west_ahb_clk"
    &clk_reg_cbcr_type="sm_cbc"
    &clk_vote_bit=-1.
    &clk_multiplier=4.

    gosub Print_Clk_Info_Line
  )

  &match=0
  &wild_head=0
  &wild_tail=0
  &clk_input_length=STRING.LENGTH("&clk")
  &clk_itr_length=STRING.LENGTH("gcc_pdm_ahb_clk")

  if (STRING.SCAN("&clk", "*", 0)==0)
  (
    &wild_head=1
  )
  if (STRING.SCAN("&clk", "*", 1)==(STRING.LENGTH("&clk")-1))
  (
    &wild_tail=1
  )

  if ((&wild_head==1)&&(&wild_tail==1))
  (
    if (STRING.SCAN("gcc_pdm_ahb_clk", STRING.MID("&clk", 1, &clk_input_length-2), 0)!=-1)
    ( 
      &match=1
    )
  )
  else if (&wild_head==1)
  (
    if (STRING.MID("gcc_pdm_ahb_clk", &clk_itr_length-&clk_input_length+1, &clk_input_length-1)==STRING.CUT("&clk", 1))
    ( 
      &match=1
    )
  )
  else if (&wild_tail==1)
  (
    if (STRING.MID("gcc_pdm_ahb_clk", 0, &clk_input_length-1)==STRING.CUT("&clk", -1))
    ( 
      &match=1
    )
  )
  else if ("gcc_pdm_ahb_clk"=="&clk")
  (
    &match=1
  )
  
  if (&match==1)
  (
    &clk_test=&CLK_TEST_GCC_PDM_AHB_CLK
    &clk_reg=&HWIO_GCC_PDM_AHB_CBCR_ADDR
    &clk_reg_name="GCC_PDM_AHB_CBCR"
    &clk_name="gcc_pdm_ahb_clk"
    &clk_reg_cbcr_type="sm_cbc"
    &clk_vote_bit=-1.
    &clk_multiplier=4.

    gosub Print_Clk_Info_Line
  )

  &match=0
  &wild_head=0
  &wild_tail=0
  &clk_input_length=STRING.LENGTH("&clk")
  &clk_itr_length=STRING.LENGTH("gcc_sdcc2_ahb_clk")

  if (STRING.SCAN("&clk", "*", 0)==0)
  (
    &wild_head=1
  )
  if (STRING.SCAN("&clk", "*", 1)==(STRING.LENGTH("&clk")-1))
  (
    &wild_tail=1
  )

  if ((&wild_head==1)&&(&wild_tail==1))
  (
    if (STRING.SCAN("gcc_sdcc2_ahb_clk", STRING.MID("&clk", 1, &clk_input_length-2), 0)!=-1)
    ( 
      &match=1
    )
  )
  else if (&wild_head==1)
  (
    if (STRING.MID("gcc_sdcc2_ahb_clk", &clk_itr_length-&clk_input_length+1, &clk_input_length-1)==STRING.CUT("&clk", 1))
    ( 
      &match=1
    )
  )
  else if (&wild_tail==1)
  (
    if (STRING.MID("gcc_sdcc2_ahb_clk", 0, &clk_input_length-1)==STRING.CUT("&clk", -1))
    ( 
      &match=1
    )
  )
  else if ("gcc_sdcc2_ahb_clk"=="&clk")
  (
    &match=1
  )
  
  if (&match==1)
  (
    &clk_test=&CLK_TEST_GCC_SDCC2_AHB_CLK
    &clk_reg=&HWIO_GCC_SDCC2_AHB_CBCR_ADDR
    &clk_reg_name="GCC_SDCC2_AHB_CBCR"
    &clk_name="gcc_sdcc2_ahb_clk"
    &clk_reg_cbcr_type="sm_cbc"
    &clk_vote_bit=-1.
    &clk_multiplier=4.

    gosub Print_Clk_Info_Line
  )

  &match=0
  &wild_head=0
  &wild_tail=0
  &clk_input_length=STRING.LENGTH("&clk")
  &clk_itr_length=STRING.LENGTH("gcc_sdcc4_ahb_clk")

  if (STRING.SCAN("&clk", "*", 0)==0)
  (
    &wild_head=1
  )
  if (STRING.SCAN("&clk", "*", 1)==(STRING.LENGTH("&clk")-1))
  (
    &wild_tail=1
  )

  if ((&wild_head==1)&&(&wild_tail==1))
  (
    if (STRING.SCAN("gcc_sdcc4_ahb_clk", STRING.MID("&clk", 1, &clk_input_length-2), 0)!=-1)
    ( 
      &match=1
    )
  )
  else if (&wild_head==1)
  (
    if (STRING.MID("gcc_sdcc4_ahb_clk", &clk_itr_length-&clk_input_length+1, &clk_input_length-1)==STRING.CUT("&clk", 1))
    ( 
      &match=1
    )
  )
  else if (&wild_tail==1)
  (
    if (STRING.MID("gcc_sdcc4_ahb_clk", 0, &clk_input_length-1)==STRING.CUT("&clk", -1))
    ( 
      &match=1
    )
  )
  else if ("gcc_sdcc4_ahb_clk"=="&clk")
  (
    &match=1
  )
  
  if (&match==1)
  (
    &clk_test=&CLK_TEST_GCC_SDCC4_AHB_CLK
    &clk_reg=&HWIO_GCC_SDCC4_AHB_CBCR_ADDR
    &clk_reg_name="GCC_SDCC4_AHB_CBCR"
    &clk_name="gcc_sdcc4_ahb_clk"
    &clk_reg_cbcr_type="sm_cbc"
    &clk_vote_bit=-1.
    &clk_multiplier=4.

    gosub Print_Clk_Info_Line
  )

  &match=0
  &wild_head=0
  &wild_tail=0
  &clk_input_length=STRING.LENGTH("&clk")
  &clk_itr_length=STRING.LENGTH("gcc_spdm_pnoc_cy_clk")

  if (STRING.SCAN("&clk", "*", 0)==0)
  (
    &wild_head=1
  )
  if (STRING.SCAN("&clk", "*", 1)==(STRING.LENGTH("&clk")-1))
  (
    &wild_tail=1
  )

  if ((&wild_head==1)&&(&wild_tail==1))
  (
    if (STRING.SCAN("gcc_spdm_pnoc_cy_clk", STRING.MID("&clk", 1, &clk_input_length-2), 0)!=-1)
    ( 
      &match=1
    )
  )
  else if (&wild_head==1)
  (
    if (STRING.MID("gcc_spdm_pnoc_cy_clk", &clk_itr_length-&clk_input_length+1, &clk_input_length-1)==STRING.CUT("&clk", 1))
    ( 
      &match=1
    )
  )
  else if (&wild_tail==1)
  (
    if (STRING.MID("gcc_spdm_pnoc_cy_clk", 0, &clk_input_length-1)==STRING.CUT("&clk", -1))
    ( 
      &match=1
    )
  )
  else if ("gcc_spdm_pnoc_cy_clk"=="&clk")
  (
    &match=1
  )
  
  if (&match==1)
  (
    &clk_test=&CLK_TEST_GCC_SPDM_PNOC_CY_CLK
    &clk_reg=&HWIO_GCC_SPDM_PNOC_CY_CBCR_ADDR
    &clk_reg_name="GCC_SPDM_PNOC_CY_CBCR"
    &clk_name="gcc_spdm_pnoc_cy_clk"
    &clk_reg_cbcr_type="sm_cbc"
    &clk_vote_bit=-1.
    &clk_multiplier=4.

    gosub Print_Clk_Info_Line
  )

  &match=0
  &wild_head=0
  &wild_tail=0
  &clk_input_length=STRING.LENGTH("&clk")
  &clk_itr_length=STRING.LENGTH("gcc_tsif_ahb_clk")

  if (STRING.SCAN("&clk", "*", 0)==0)
  (
    &wild_head=1
  )
  if (STRING.SCAN("&clk", "*", 1)==(STRING.LENGTH("&clk")-1))
  (
    &wild_tail=1
  )

  if ((&wild_head==1)&&(&wild_tail==1))
  (
    if (STRING.SCAN("gcc_tsif_ahb_clk", STRING.MID("&clk", 1, &clk_input_length-2), 0)!=-1)
    ( 
      &match=1
    )
  )
  else if (&wild_head==1)
  (
    if (STRING.MID("gcc_tsif_ahb_clk", &clk_itr_length-&clk_input_length+1, &clk_input_length-1)==STRING.CUT("&clk", 1))
    ( 
      &match=1
    )
  )
  else if (&wild_tail==1)
  (
    if (STRING.MID("gcc_tsif_ahb_clk", 0, &clk_input_length-1)==STRING.CUT("&clk", -1))
    ( 
      &match=1
    )
  )
  else if ("gcc_tsif_ahb_clk"=="&clk")
  (
    &match=1
  )
  
  if (&match==1)
  (
    &clk_test=&CLK_TEST_GCC_TSIF_AHB_CLK
    &clk_reg=&HWIO_GCC_TSIF_AHB_CBCR_ADDR
    &clk_reg_name="GCC_TSIF_AHB_CBCR"
    &clk_name="gcc_tsif_ahb_clk"
    &clk_reg_cbcr_type="sm_pscbc"
    &clk_vote_bit=-1.
    &clk_multiplier=4.

    gosub Print_Clk_Info_Line
  )

  &match=0
  &wild_head=0
  &wild_tail=0
  &clk_input_length=STRING.LENGTH("&clk")
  &clk_itr_length=STRING.LENGTH("gcc_usb_phy_cfg_ahb2phy_clk")

  if (STRING.SCAN("&clk", "*", 0)==0)
  (
    &wild_head=1
  )
  if (STRING.SCAN("&clk", "*", 1)==(STRING.LENGTH("&clk")-1))
  (
    &wild_tail=1
  )

  if ((&wild_head==1)&&(&wild_tail==1))
  (
    if (STRING.SCAN("gcc_usb_phy_cfg_ahb2phy_clk", STRING.MID("&clk", 1, &clk_input_length-2), 0)!=-1)
    ( 
      &match=1
    )
  )
  else if (&wild_head==1)
  (
    if (STRING.MID("gcc_usb_phy_cfg_ahb2phy_clk", &clk_itr_length-&clk_input_length+1, &clk_input_length-1)==STRING.CUT("&clk", 1))
    ( 
      &match=1
    )
  )
  else if (&wild_tail==1)
  (
    if (STRING.MID("gcc_usb_phy_cfg_ahb2phy_clk", 0, &clk_input_length-1)==STRING.CUT("&clk", -1))
    ( 
      &match=1
    )
  )
  else if ("gcc_usb_phy_cfg_ahb2phy_clk"=="&clk")
  (
    &match=1
  )
  
  if (&match==1)
  (
    &clk_test=&CLK_TEST_GCC_USB_PHY_CFG_AHB2PHY_CLK
    &clk_reg=&HWIO_GCC_USB_PHY_CFG_AHB2PHY_CBCR_ADDR
    &clk_reg_name="GCC_USB_PHY_CFG_AHB2PHY_CBCR"
    &clk_name="gcc_usb_phy_cfg_ahb2phy_clk"
    &clk_reg_cbcr_type="sm_cbc"
    &clk_vote_bit=-1.
    &clk_multiplier=4.

    gosub Print_Clk_Info_Line
  )

  &match=0
  &wild_head=0
  &wild_tail=0
  &clk_input_length=STRING.LENGTH("&clk")
  &clk_itr_length=STRING.LENGTH("gcc_aggre1_cnoc_ahb_clk")

  if (STRING.SCAN("&clk", "*", 0)==0)
  (
    &wild_head=1
  )
  if (STRING.SCAN("&clk", "*", 1)==(STRING.LENGTH("&clk")-1))
  (
    &wild_tail=1
  )

  if ((&wild_head==1)&&(&wild_tail==1))
  (
    if (STRING.SCAN("gcc_aggre1_cnoc_ahb_clk", STRING.MID("&clk", 1, &clk_input_length-2), 0)!=-1)
    ( 
      &match=1
    )
  )
  else if (&wild_head==1)
  (
    if (STRING.MID("gcc_aggre1_cnoc_ahb_clk", &clk_itr_length-&clk_input_length+1, &clk_input_length-1)==STRING.CUT("&clk", 1))
    ( 
      &match=1
    )
  )
  else if (&wild_tail==1)
  (
    if (STRING.MID("gcc_aggre1_cnoc_ahb_clk", 0, &clk_input_length-1)==STRING.CUT("&clk", -1))
    ( 
      &match=1
    )
  )
  else if ("gcc_aggre1_cnoc_ahb_clk"=="&clk")
  (
    &match=1
  )
  
  if (&match==1)
  (
    &clk_test=&CLK_TEST_GCC_AGGRE1_CNOC_AHB_CLK
    &clk_reg=&HWIO_GCC_AGGRE1_CNOC_AHB_CBCR_ADDR
    &clk_reg_name="GCC_AGGRE1_CNOC_AHB_CBCR"
    &clk_name="gcc_aggre1_cnoc_ahb_clk"
    &clk_reg_cbcr_type="sm_cbc"
    &clk_vote_bit=-1.
    &clk_multiplier=4.

    gosub Print_Clk_Info_Line
  )

  &match=0
  &wild_head=0
  &wild_tail=0
  &clk_input_length=STRING.LENGTH("&clk")
  &clk_itr_length=STRING.LENGTH("gcc_aggre1_noc_msmpu_cfg_ahb_clk")

  if (STRING.SCAN("&clk", "*", 0)==0)
  (
    &wild_head=1
  )
  if (STRING.SCAN("&clk", "*", 1)==(STRING.LENGTH("&clk")-1))
  (
    &wild_tail=1
  )

  if ((&wild_head==1)&&(&wild_tail==1))
  (
    if (STRING.SCAN("gcc_aggre1_noc_msmpu_cfg_ahb_clk", STRING.MID("&clk", 1, &clk_input_length-2), 0)!=-1)
    ( 
      &match=1
    )
  )
  else if (&wild_head==1)
  (
    if (STRING.MID("gcc_aggre1_noc_msmpu_cfg_ahb_clk", &clk_itr_length-&clk_input_length+1, &clk_input_length-1)==STRING.CUT("&clk", 1))
    ( 
      &match=1
    )
  )
  else if (&wild_tail==1)
  (
    if (STRING.MID("gcc_aggre1_noc_msmpu_cfg_ahb_clk", 0, &clk_input_length-1)==STRING.CUT("&clk", -1))
    ( 
      &match=1
    )
  )
  else if ("gcc_aggre1_noc_msmpu_cfg_ahb_clk"=="&clk")
  (
    &match=1
  )
  
  if (&match==1)
  (
    &clk_test=&CLK_TEST_GCC_AGGRE1_NOC_MSMPU_CFG_AHB_CLK
    &clk_reg=&HWIO_GCC_AGGRE1_NOC_MSMPU_CFG_AHB_CBCR_ADDR
    &clk_reg_name="GCC_AGGRE1_NOC_MSMPU_CFG_AHB_CBCR"
    &clk_name="gcc_aggre1_noc_msmpu_cfg_ahb_clk"
    &clk_reg_cbcr_type="sm_cbc"
    &clk_vote_bit=-1.
    &clk_multiplier=4.

    gosub Print_Clk_Info_Line
  )

  &match=0
  &wild_head=0
  &wild_tail=0
  &clk_input_length=STRING.LENGTH("&clk")
  &clk_itr_length=STRING.LENGTH("gcc_aggre2_cnoc_ahb_clk")

  if (STRING.SCAN("&clk", "*", 0)==0)
  (
    &wild_head=1
  )
  if (STRING.SCAN("&clk", "*", 1)==(STRING.LENGTH("&clk")-1))
  (
    &wild_tail=1
  )

  if ((&wild_head==1)&&(&wild_tail==1))
  (
    if (STRING.SCAN("gcc_aggre2_cnoc_ahb_clk", STRING.MID("&clk", 1, &clk_input_length-2), 0)!=-1)
    ( 
      &match=1
    )
  )
  else if (&wild_head==1)
  (
    if (STRING.MID("gcc_aggre2_cnoc_ahb_clk", &clk_itr_length-&clk_input_length+1, &clk_input_length-1)==STRING.CUT("&clk", 1))
    ( 
      &match=1
    )
  )
  else if (&wild_tail==1)
  (
    if (STRING.MID("gcc_aggre2_cnoc_ahb_clk", 0, &clk_input_length-1)==STRING.CUT("&clk", -1))
    ( 
      &match=1
    )
  )
  else if ("gcc_aggre2_cnoc_ahb_clk"=="&clk")
  (
    &match=1
  )
  
  if (&match==1)
  (
    &clk_test=&CLK_TEST_GCC_AGGRE2_CNOC_AHB_CLK
    &clk_reg=&HWIO_GCC_AGGRE2_CNOC_AHB_CBCR_ADDR
    &clk_reg_name="GCC_AGGRE2_CNOC_AHB_CBCR"
    &clk_name="gcc_aggre2_cnoc_ahb_clk"
    &clk_reg_cbcr_type="sm_cbc"
    &clk_vote_bit=-1.
    &clk_multiplier=4.

    gosub Print_Clk_Info_Line
  )

  &match=0
  &wild_head=0
  &wild_tail=0
  &clk_input_length=STRING.LENGTH("&clk")
  &clk_itr_length=STRING.LENGTH("gcc_aggre2_noc_msmpu_cfg_ahb_clk")

  if (STRING.SCAN("&clk", "*", 0)==0)
  (
    &wild_head=1
  )
  if (STRING.SCAN("&clk", "*", 1)==(STRING.LENGTH("&clk")-1))
  (
    &wild_tail=1
  )

  if ((&wild_head==1)&&(&wild_tail==1))
  (
    if (STRING.SCAN("gcc_aggre2_noc_msmpu_cfg_ahb_clk", STRING.MID("&clk", 1, &clk_input_length-2), 0)!=-1)
    ( 
      &match=1
    )
  )
  else if (&wild_head==1)
  (
    if (STRING.MID("gcc_aggre2_noc_msmpu_cfg_ahb_clk", &clk_itr_length-&clk_input_length+1, &clk_input_length-1)==STRING.CUT("&clk", 1))
    ( 
      &match=1
    )
  )
  else if (&wild_tail==1)
  (
    if (STRING.MID("gcc_aggre2_noc_msmpu_cfg_ahb_clk", 0, &clk_input_length-1)==STRING.CUT("&clk", -1))
    ( 
      &match=1
    )
  )
  else if ("gcc_aggre2_noc_msmpu_cfg_ahb_clk"=="&clk")
  (
    &match=1
  )
  
  if (&match==1)
  (
    &clk_test=&CLK_TEST_GCC_AGGRE2_NOC_MSMPU_CFG_AHB_CLK
    &clk_reg=&HWIO_GCC_AGGRE2_NOC_MSMPU_CFG_AHB_CBCR_ADDR
    &clk_reg_name="GCC_AGGRE2_NOC_MSMPU_CFG_AHB_CBCR"
    &clk_name="gcc_aggre2_noc_msmpu_cfg_ahb_clk"
    &clk_reg_cbcr_type="sm_cbc"
    &clk_vote_bit=-1.
    &clk_multiplier=4.

    gosub Print_Clk_Info_Line
  )

  &match=0
  &wild_head=0
  &wild_tail=0
  &clk_input_length=STRING.LENGTH("&clk")
  &clk_itr_length=STRING.LENGTH("gcc_ahb_clk")

  if (STRING.SCAN("&clk", "*", 0)==0)
  (
    &wild_head=1
  )
  if (STRING.SCAN("&clk", "*", 1)==(STRING.LENGTH("&clk")-1))
  (
    &wild_tail=1
  )

  if ((&wild_head==1)&&(&wild_tail==1))
  (
    if (STRING.SCAN("gcc_ahb_clk", STRING.MID("&clk", 1, &clk_input_length-2), 0)!=-1)
    ( 
      &match=1
    )
  )
  else if (&wild_head==1)
  (
    if (STRING.MID("gcc_ahb_clk", &clk_itr_length-&clk_input_length+1, &clk_input_length-1)==STRING.CUT("&clk", 1))
    ( 
      &match=1
    )
  )
  else if (&wild_tail==1)
  (
    if (STRING.MID("gcc_ahb_clk", 0, &clk_input_length-1)==STRING.CUT("&clk", -1))
    ( 
      &match=1
    )
  )
  else if ("gcc_ahb_clk"=="&clk")
  (
    &match=1
  )
  
  if (&match==1)
  (
    &clk_test=&CLK_TEST_GCC_AHB_CLK
    &clk_reg=&HWIO_GCC_GCC_AHB_CBCR_ADDR
    &clk_reg_name="GCC_GCC_AHB_CBCR"
    &clk_name="gcc_ahb_clk"
    &clk_reg_cbcr_type="sm_cbc"
    &clk_vote_bit=-1.
    &clk_multiplier=4.

    gosub Print_Clk_Info_Line
  )

  &match=0
  &wild_head=0
  &wild_tail=0
  &clk_input_length=STRING.LENGTH("&clk")
  &clk_itr_length=STRING.LENGTH("gcc_bimc_cfg_ahb_clk")

  if (STRING.SCAN("&clk", "*", 0)==0)
  (
    &wild_head=1
  )
  if (STRING.SCAN("&clk", "*", 1)==(STRING.LENGTH("&clk")-1))
  (
    &wild_tail=1
  )

  if ((&wild_head==1)&&(&wild_tail==1))
  (
    if (STRING.SCAN("gcc_bimc_cfg_ahb_clk", STRING.MID("&clk", 1, &clk_input_length-2), 0)!=-1)
    ( 
      &match=1
    )
  )
  else if (&wild_head==1)
  (
    if (STRING.MID("gcc_bimc_cfg_ahb_clk", &clk_itr_length-&clk_input_length+1, &clk_input_length-1)==STRING.CUT("&clk", 1))
    ( 
      &match=1
    )
  )
  else if (&wild_tail==1)
  (
    if (STRING.MID("gcc_bimc_cfg_ahb_clk", 0, &clk_input_length-1)==STRING.CUT("&clk", -1))
    ( 
      &match=1
    )
  )
  else if ("gcc_bimc_cfg_ahb_clk"=="&clk")
  (
    &match=1
  )
  
  if (&match==1)
  (
    &clk_test=&CLK_TEST_GCC_BIMC_CFG_AHB_CLK
    &clk_reg=&HWIO_GCC_BIMC_CFG_AHB_CBCR_ADDR
    &clk_reg_name="GCC_BIMC_CFG_AHB_CBCR"
    &clk_name="gcc_bimc_cfg_ahb_clk"
    &clk_reg_cbcr_type="sm_cbc"
    &clk_vote_bit=-1.
    &clk_multiplier=4.

    gosub Print_Clk_Info_Line
  )

  &match=0
  &wild_head=0
  &wild_tail=0
  &clk_input_length=STRING.LENGTH("&clk")
  &clk_itr_length=STRING.LENGTH("gcc_bimc_nius_cfg_ahb_clk")

  if (STRING.SCAN("&clk", "*", 0)==0)
  (
    &wild_head=1
  )
  if (STRING.SCAN("&clk", "*", 1)==(STRING.LENGTH("&clk")-1))
  (
    &wild_tail=1
  )

  if ((&wild_head==1)&&(&wild_tail==1))
  (
    if (STRING.SCAN("gcc_bimc_nius_cfg_ahb_clk", STRING.MID("&clk", 1, &clk_input_length-2), 0)!=-1)
    ( 
      &match=1
    )
  )
  else if (&wild_head==1)
  (
    if (STRING.MID("gcc_bimc_nius_cfg_ahb_clk", &clk_itr_length-&clk_input_length+1, &clk_input_length-1)==STRING.CUT("&clk", 1))
    ( 
      &match=1
    )
  )
  else if (&wild_tail==1)
  (
    if (STRING.MID("gcc_bimc_nius_cfg_ahb_clk", 0, &clk_input_length-1)==STRING.CUT("&clk", -1))
    ( 
      &match=1
    )
  )
  else if ("gcc_bimc_nius_cfg_ahb_clk"=="&clk")
  (
    &match=1
  )
  
  if (&match==1)
  (
    &clk_test=&CLK_TEST_GCC_BIMC_NIUS_CFG_AHB_CLK
    &clk_reg=&HWIO_GCC_BIMC_NIUS_CFG_AHB_CBCR_ADDR
    &clk_reg_name="GCC_BIMC_NIUS_CFG_AHB_CBCR"
    &clk_name="gcc_bimc_nius_cfg_ahb_clk"
    &clk_reg_cbcr_type="sm_cbc"
    &clk_vote_bit=-1.
    &clk_multiplier=4.

    gosub Print_Clk_Info_Line
  )

  &match=0
  &wild_head=0
  &wild_tail=0
  &clk_input_length=STRING.LENGTH("&clk")
  &clk_itr_length=STRING.LENGTH("gcc_boot_rom_ahb_clk")

  if (STRING.SCAN("&clk", "*", 0)==0)
  (
    &wild_head=1
  )
  if (STRING.SCAN("&clk", "*", 1)==(STRING.LENGTH("&clk")-1))
  (
    &wild_tail=1
  )

  if ((&wild_head==1)&&(&wild_tail==1))
  (
    if (STRING.SCAN("gcc_boot_rom_ahb_clk", STRING.MID("&clk", 1, &clk_input_length-2), 0)!=-1)
    ( 
      &match=1
    )
  )
  else if (&wild_head==1)
  (
    if (STRING.MID("gcc_boot_rom_ahb_clk", &clk_itr_length-&clk_input_length+1, &clk_input_length-1)==STRING.CUT("&clk", 1))
    ( 
      &match=1
    )
  )
  else if (&wild_tail==1)
  (
    if (STRING.MID("gcc_boot_rom_ahb_clk", 0, &clk_input_length-1)==STRING.CUT("&clk", -1))
    ( 
      &match=1
    )
  )
  else if ("gcc_boot_rom_ahb_clk"=="&clk")
  (
    &match=1
  )
  
  if (&match==1)
  (
    &clk_test=&CLK_TEST_GCC_BOOT_ROM_AHB_CLK
    &clk_reg=&HWIO_GCC_BOOT_ROM_AHB_CBCR_ADDR
    &clk_reg_name="GCC_BOOT_ROM_AHB_CBCR"
    &clk_name="gcc_boot_rom_ahb_clk"
    &clk_reg_cbcr_type="sm_pscbc"
    &clk_vote_bit=10.
    &clk_multiplier=4.

    gosub Print_Clk_Info_Line
  )

  &match=0
  &wild_head=0
  &wild_tail=0
  &clk_input_length=STRING.LENGTH("&clk")
  &clk_itr_length=STRING.LENGTH("gcc_ce1_ahb_clk")

  if (STRING.SCAN("&clk", "*", 0)==0)
  (
    &wild_head=1
  )
  if (STRING.SCAN("&clk", "*", 1)==(STRING.LENGTH("&clk")-1))
  (
    &wild_tail=1
  )

  if ((&wild_head==1)&&(&wild_tail==1))
  (
    if (STRING.SCAN("gcc_ce1_ahb_clk", STRING.MID("&clk", 1, &clk_input_length-2), 0)!=-1)
    ( 
      &match=1
    )
  )
  else if (&wild_head==1)
  (
    if (STRING.MID("gcc_ce1_ahb_clk", &clk_itr_length-&clk_input_length+1, &clk_input_length-1)==STRING.CUT("&clk", 1))
    ( 
      &match=1
    )
  )
  else if (&wild_tail==1)
  (
    if (STRING.MID("gcc_ce1_ahb_clk", 0, &clk_input_length-1)==STRING.CUT("&clk", -1))
    ( 
      &match=1
    )
  )
  else if ("gcc_ce1_ahb_clk"=="&clk")
  (
    &match=1
  )
  
  if (&match==1)
  (
    &clk_test=&CLK_TEST_GCC_CE1_AHB_CLK
    &clk_reg=&HWIO_GCC_CE1_AHB_CBCR_ADDR
    &clk_reg_name="GCC_CE1_AHB_CBCR"
    &clk_name="gcc_ce1_ahb_clk"
    &clk_reg_cbcr_type="sm_cbc"
    &clk_vote_bit=3.
    &clk_multiplier=4.

    gosub Print_Clk_Info_Line
  )

  &match=0
  &wild_head=0
  &wild_tail=0
  &clk_input_length=STRING.LENGTH("&clk")
  &clk_itr_length=STRING.LENGTH("gcc_cfg_noc_ahb_clk")

  if (STRING.SCAN("&clk", "*", 0)==0)
  (
    &wild_head=1
  )
  if (STRING.SCAN("&clk", "*", 1)==(STRING.LENGTH("&clk")-1))
  (
    &wild_tail=1
  )

  if ((&wild_head==1)&&(&wild_tail==1))
  (
    if (STRING.SCAN("gcc_cfg_noc_ahb_clk", STRING.MID("&clk", 1, &clk_input_length-2), 0)!=-1)
    ( 
      &match=1
    )
  )
  else if (&wild_head==1)
  (
    if (STRING.MID("gcc_cfg_noc_ahb_clk", &clk_itr_length-&clk_input_length+1, &clk_input_length-1)==STRING.CUT("&clk", 1))
    ( 
      &match=1
    )
  )
  else if (&wild_tail==1)
  (
    if (STRING.MID("gcc_cfg_noc_ahb_clk", 0, &clk_input_length-1)==STRING.CUT("&clk", -1))
    ( 
      &match=1
    )
  )
  else if ("gcc_cfg_noc_ahb_clk"=="&clk")
  (
    &match=1
  )
  
  if (&match==1)
  (
    &clk_test=&CLK_TEST_GCC_CFG_NOC_AHB_CLK
    &clk_reg=&HWIO_GCC_CFG_NOC_AHB_CBCR_ADDR
    &clk_reg_name="GCC_CFG_NOC_AHB_CBCR"
    &clk_name="gcc_cfg_noc_ahb_clk"
    &clk_reg_cbcr_type="sm_cbc"
    &clk_vote_bit=-1.
    &clk_multiplier=4.

    gosub Print_Clk_Info_Line
  )

  &match=0
  &wild_head=0
  &wild_tail=0
  &clk_input_length=STRING.LENGTH("&clk")
  &clk_itr_length=STRING.LENGTH("gcc_cfg_noc_east_ahb_clk")

  if (STRING.SCAN("&clk", "*", 0)==0)
  (
    &wild_head=1
  )
  if (STRING.SCAN("&clk", "*", 1)==(STRING.LENGTH("&clk")-1))
  (
    &wild_tail=1
  )

  if ((&wild_head==1)&&(&wild_tail==1))
  (
    if (STRING.SCAN("gcc_cfg_noc_east_ahb_clk", STRING.MID("&clk", 1, &clk_input_length-2), 0)!=-1)
    ( 
      &match=1
    )
  )
  else if (&wild_head==1)
  (
    if (STRING.MID("gcc_cfg_noc_east_ahb_clk", &clk_itr_length-&clk_input_length+1, &clk_input_length-1)==STRING.CUT("&clk", 1))
    ( 
      &match=1
    )
  )
  else if (&wild_tail==1)
  (
    if (STRING.MID("gcc_cfg_noc_east_ahb_clk", 0, &clk_input_length-1)==STRING.CUT("&clk", -1))
    ( 
      &match=1
    )
  )
  else if ("gcc_cfg_noc_east_ahb_clk"=="&clk")
  (
    &match=1
  )
  
  if (&match==1)
  (
    &clk_test=&CLK_TEST_GCC_CFG_NOC_EAST_AHB_CLK
    &clk_reg=&HWIO_GCC_CFG_NOC_EAST_AHB_CBCR_ADDR
    &clk_reg_name="GCC_CFG_NOC_EAST_AHB_CBCR"
    &clk_name="gcc_cfg_noc_east_ahb_clk"
    &clk_reg_cbcr_type="sm_cbc"
    &clk_vote_bit=-1.
    &clk_multiplier=4.

    gosub Print_Clk_Info_Line
  )

  &match=0
  &wild_head=0
  &wild_tail=0
  &clk_input_length=STRING.LENGTH("&clk")
  &clk_itr_length=STRING.LENGTH("gcc_cfg_noc_north_ahb_clk")

  if (STRING.SCAN("&clk", "*", 0)==0)
  (
    &wild_head=1
  )
  if (STRING.SCAN("&clk", "*", 1)==(STRING.LENGTH("&clk")-1))
  (
    &wild_tail=1
  )

  if ((&wild_head==1)&&(&wild_tail==1))
  (
    if (STRING.SCAN("gcc_cfg_noc_north_ahb_clk", STRING.MID("&clk", 1, &clk_input_length-2), 0)!=-1)
    ( 
      &match=1
    )
  )
  else if (&wild_head==1)
  (
    if (STRING.MID("gcc_cfg_noc_north_ahb_clk", &clk_itr_length-&clk_input_length+1, &clk_input_length-1)==STRING.CUT("&clk", 1))
    ( 
      &match=1
    )
  )
  else if (&wild_tail==1)
  (
    if (STRING.MID("gcc_cfg_noc_north_ahb_clk", 0, &clk_input_length-1)==STRING.CUT("&clk", -1))
    ( 
      &match=1
    )
  )
  else if ("gcc_cfg_noc_north_ahb_clk"=="&clk")
  (
    &match=1
  )
  
  if (&match==1)
  (
    &clk_test=&CLK_TEST_GCC_CFG_NOC_NORTH_AHB_CLK
    &clk_reg=&HWIO_GCC_CFG_NOC_NORTH_AHB_CBCR_ADDR
    &clk_reg_name="GCC_CFG_NOC_NORTH_AHB_CBCR"
    &clk_name="gcc_cfg_noc_north_ahb_clk"
    &clk_reg_cbcr_type="sm_cbc"
    &clk_vote_bit=-1.
    &clk_multiplier=4.

    gosub Print_Clk_Info_Line
  )

  &match=0
  &wild_head=0
  &wild_tail=0
  &clk_input_length=STRING.LENGTH("&clk")
  &clk_itr_length=STRING.LENGTH("gcc_cfg_noc_west_ahb_clk")

  if (STRING.SCAN("&clk", "*", 0)==0)
  (
    &wild_head=1
  )
  if (STRING.SCAN("&clk", "*", 1)==(STRING.LENGTH("&clk")-1))
  (
    &wild_tail=1
  )

  if ((&wild_head==1)&&(&wild_tail==1))
  (
    if (STRING.SCAN("gcc_cfg_noc_west_ahb_clk", STRING.MID("&clk", 1, &clk_input_length-2), 0)!=-1)
    ( 
      &match=1
    )
  )
  else if (&wild_head==1)
  (
    if (STRING.MID("gcc_cfg_noc_west_ahb_clk", &clk_itr_length-&clk_input_length+1, &clk_input_length-1)==STRING.CUT("&clk", 1))
    ( 
      &match=1
    )
  )
  else if (&wild_tail==1)
  (
    if (STRING.MID("gcc_cfg_noc_west_ahb_clk", 0, &clk_input_length-1)==STRING.CUT("&clk", -1))
    ( 
      &match=1
    )
  )
  else if ("gcc_cfg_noc_west_ahb_clk"=="&clk")
  (
    &match=1
  )
  
  if (&match==1)
  (
    &clk_test=&CLK_TEST_GCC_CFG_NOC_WEST_AHB_CLK
    &clk_reg=&HWIO_GCC_CFG_NOC_WEST_AHB_CBCR_ADDR
    &clk_reg_name="GCC_CFG_NOC_WEST_AHB_CBCR"
    &clk_name="gcc_cfg_noc_west_ahb_clk"
    &clk_reg_cbcr_type="sm_cbc"
    &clk_vote_bit=-1.
    &clk_multiplier=4.

    gosub Print_Clk_Info_Line
  )

  &match=0
  &wild_head=0
  &wild_tail=0
  &clk_input_length=STRING.LENGTH("&clk")
  &clk_itr_length=STRING.LENGTH("gcc_cnoc_bus_timeout0_ahb_clk")

  if (STRING.SCAN("&clk", "*", 0)==0)
  (
    &wild_head=1
  )
  if (STRING.SCAN("&clk", "*", 1)==(STRING.LENGTH("&clk")-1))
  (
    &wild_tail=1
  )

  if ((&wild_head==1)&&(&wild_tail==1))
  (
    if (STRING.SCAN("gcc_cnoc_bus_timeout0_ahb_clk", STRING.MID("&clk", 1, &clk_input_length-2), 0)!=-1)
    ( 
      &match=1
    )
  )
  else if (&wild_head==1)
  (
    if (STRING.MID("gcc_cnoc_bus_timeout0_ahb_clk", &clk_itr_length-&clk_input_length+1, &clk_input_length-1)==STRING.CUT("&clk", 1))
    ( 
      &match=1
    )
  )
  else if (&wild_tail==1)
  (
    if (STRING.MID("gcc_cnoc_bus_timeout0_ahb_clk", 0, &clk_input_length-1)==STRING.CUT("&clk", -1))
    ( 
      &match=1
    )
  )
  else if ("gcc_cnoc_bus_timeout0_ahb_clk"=="&clk")
  (
    &match=1
  )
  
  if (&match==1)
  (
    &clk_test=&CLK_TEST_GCC_CNOC_BUS_TIMEOUT0_AHB_CLK
    &clk_reg=&HWIO_GCC_CNOC_BUS_TIMEOUT0_AHB_CBCR_ADDR
    &clk_reg_name="GCC_CNOC_BUS_TIMEOUT0_AHB_CBCR"
    &clk_name="gcc_cnoc_bus_timeout0_ahb_clk"
    &clk_reg_cbcr_type="sm_cbc"
    &clk_vote_bit=-1.
    &clk_multiplier=4.

    gosub Print_Clk_Info_Line
  )

  &match=0
  &wild_head=0
  &wild_tail=0
  &clk_input_length=STRING.LENGTH("&clk")
  &clk_itr_length=STRING.LENGTH("gcc_cnoc_bus_timeout10_ahb_clk")

  if (STRING.SCAN("&clk", "*", 0)==0)
  (
    &wild_head=1
  )
  if (STRING.SCAN("&clk", "*", 1)==(STRING.LENGTH("&clk")-1))
  (
    &wild_tail=1
  )

  if ((&wild_head==1)&&(&wild_tail==1))
  (
    if (STRING.SCAN("gcc_cnoc_bus_timeout10_ahb_clk", STRING.MID("&clk", 1, &clk_input_length-2), 0)!=-1)
    ( 
      &match=1
    )
  )
  else if (&wild_head==1)
  (
    if (STRING.MID("gcc_cnoc_bus_timeout10_ahb_clk", &clk_itr_length-&clk_input_length+1, &clk_input_length-1)==STRING.CUT("&clk", 1))
    ( 
      &match=1
    )
  )
  else if (&wild_tail==1)
  (
    if (STRING.MID("gcc_cnoc_bus_timeout10_ahb_clk", 0, &clk_input_length-1)==STRING.CUT("&clk", -1))
    ( 
      &match=1
    )
  )
  else if ("gcc_cnoc_bus_timeout10_ahb_clk"=="&clk")
  (
    &match=1
  )
  
  if (&match==1)
  (
    &clk_test=&CLK_TEST_GCC_CNOC_BUS_TIMEOUT10_AHB_CLK
    &clk_reg=&HWIO_GCC_CNOC_BUS_TIMEOUT10_AHB_CBCR_ADDR
    &clk_reg_name="GCC_CNOC_BUS_TIMEOUT10_AHB_CBCR"
    &clk_name="gcc_cnoc_bus_timeout10_ahb_clk"
    &clk_reg_cbcr_type="sm_cbc"
    &clk_vote_bit=-1.
    &clk_multiplier=4.

    gosub Print_Clk_Info_Line
  )

  &match=0
  &wild_head=0
  &wild_tail=0
  &clk_input_length=STRING.LENGTH("&clk")
  &clk_itr_length=STRING.LENGTH("gcc_cnoc_bus_timeout11_ahb_clk")

  if (STRING.SCAN("&clk", "*", 0)==0)
  (
    &wild_head=1
  )
  if (STRING.SCAN("&clk", "*", 1)==(STRING.LENGTH("&clk")-1))
  (
    &wild_tail=1
  )

  if ((&wild_head==1)&&(&wild_tail==1))
  (
    if (STRING.SCAN("gcc_cnoc_bus_timeout11_ahb_clk", STRING.MID("&clk", 1, &clk_input_length-2), 0)!=-1)
    ( 
      &match=1
    )
  )
  else if (&wild_head==1)
  (
    if (STRING.MID("gcc_cnoc_bus_timeout11_ahb_clk", &clk_itr_length-&clk_input_length+1, &clk_input_length-1)==STRING.CUT("&clk", 1))
    ( 
      &match=1
    )
  )
  else if (&wild_tail==1)
  (
    if (STRING.MID("gcc_cnoc_bus_timeout11_ahb_clk", 0, &clk_input_length-1)==STRING.CUT("&clk", -1))
    ( 
      &match=1
    )
  )
  else if ("gcc_cnoc_bus_timeout11_ahb_clk"=="&clk")
  (
    &match=1
  )
  
  if (&match==1)
  (
    &clk_test=&CLK_TEST_GCC_CNOC_BUS_TIMEOUT11_AHB_CLK
    &clk_reg=&HWIO_GCC_CNOC_BUS_TIMEOUT11_AHB_CBCR_ADDR
    &clk_reg_name="GCC_CNOC_BUS_TIMEOUT11_AHB_CBCR"
    &clk_name="gcc_cnoc_bus_timeout11_ahb_clk"
    &clk_reg_cbcr_type="sm_cbc"
    &clk_vote_bit=-1.
    &clk_multiplier=4.

    gosub Print_Clk_Info_Line
  )

  &match=0
  &wild_head=0
  &wild_tail=0
  &clk_input_length=STRING.LENGTH("&clk")
  &clk_itr_length=STRING.LENGTH("gcc_cnoc_bus_timeout12_ahb_clk")

  if (STRING.SCAN("&clk", "*", 0)==0)
  (
    &wild_head=1
  )
  if (STRING.SCAN("&clk", "*", 1)==(STRING.LENGTH("&clk")-1))
  (
    &wild_tail=1
  )

  if ((&wild_head==1)&&(&wild_tail==1))
  (
    if (STRING.SCAN("gcc_cnoc_bus_timeout12_ahb_clk", STRING.MID("&clk", 1, &clk_input_length-2), 0)!=-1)
    ( 
      &match=1
    )
  )
  else if (&wild_head==1)
  (
    if (STRING.MID("gcc_cnoc_bus_timeout12_ahb_clk", &clk_itr_length-&clk_input_length+1, &clk_input_length-1)==STRING.CUT("&clk", 1))
    ( 
      &match=1
    )
  )
  else if (&wild_tail==1)
  (
    if (STRING.MID("gcc_cnoc_bus_timeout12_ahb_clk", 0, &clk_input_length-1)==STRING.CUT("&clk", -1))
    ( 
      &match=1
    )
  )
  else if ("gcc_cnoc_bus_timeout12_ahb_clk"=="&clk")
  (
    &match=1
  )
  
  if (&match==1)
  (
    &clk_test=&CLK_TEST_GCC_CNOC_BUS_TIMEOUT12_AHB_CLK
    &clk_reg=&HWIO_GCC_CNOC_BUS_TIMEOUT12_AHB_CBCR_ADDR
    &clk_reg_name="GCC_CNOC_BUS_TIMEOUT12_AHB_CBCR"
    &clk_name="gcc_cnoc_bus_timeout12_ahb_clk"
    &clk_reg_cbcr_type="sm_cbc"
    &clk_vote_bit=-1.
    &clk_multiplier=4.

    gosub Print_Clk_Info_Line
  )

  &match=0
  &wild_head=0
  &wild_tail=0
  &clk_input_length=STRING.LENGTH("&clk")
  &clk_itr_length=STRING.LENGTH("gcc_cnoc_bus_timeout1_ahb_clk")

  if (STRING.SCAN("&clk", "*", 0)==0)
  (
    &wild_head=1
  )
  if (STRING.SCAN("&clk", "*", 1)==(STRING.LENGTH("&clk")-1))
  (
    &wild_tail=1
  )

  if ((&wild_head==1)&&(&wild_tail==1))
  (
    if (STRING.SCAN("gcc_cnoc_bus_timeout1_ahb_clk", STRING.MID("&clk", 1, &clk_input_length-2), 0)!=-1)
    ( 
      &match=1
    )
  )
  else if (&wild_head==1)
  (
    if (STRING.MID("gcc_cnoc_bus_timeout1_ahb_clk", &clk_itr_length-&clk_input_length+1, &clk_input_length-1)==STRING.CUT("&clk", 1))
    ( 
      &match=1
    )
  )
  else if (&wild_tail==1)
  (
    if (STRING.MID("gcc_cnoc_bus_timeout1_ahb_clk", 0, &clk_input_length-1)==STRING.CUT("&clk", -1))
    ( 
      &match=1
    )
  )
  else if ("gcc_cnoc_bus_timeout1_ahb_clk"=="&clk")
  (
    &match=1
  )
  
  if (&match==1)
  (
    &clk_test=&CLK_TEST_GCC_CNOC_BUS_TIMEOUT1_AHB_CLK
    &clk_reg=&HWIO_GCC_CNOC_BUS_TIMEOUT1_AHB_CBCR_ADDR
    &clk_reg_name="GCC_CNOC_BUS_TIMEOUT1_AHB_CBCR"
    &clk_name="gcc_cnoc_bus_timeout1_ahb_clk"
    &clk_reg_cbcr_type="sm_cbc"
    &clk_vote_bit=-1.
    &clk_multiplier=4.

    gosub Print_Clk_Info_Line
  )

  &match=0
  &wild_head=0
  &wild_tail=0
  &clk_input_length=STRING.LENGTH("&clk")
  &clk_itr_length=STRING.LENGTH("gcc_cnoc_bus_timeout2_ahb_clk")

  if (STRING.SCAN("&clk", "*", 0)==0)
  (
    &wild_head=1
  )
  if (STRING.SCAN("&clk", "*", 1)==(STRING.LENGTH("&clk")-1))
  (
    &wild_tail=1
  )

  if ((&wild_head==1)&&(&wild_tail==1))
  (
    if (STRING.SCAN("gcc_cnoc_bus_timeout2_ahb_clk", STRING.MID("&clk", 1, &clk_input_length-2), 0)!=-1)
    ( 
      &match=1
    )
  )
  else if (&wild_head==1)
  (
    if (STRING.MID("gcc_cnoc_bus_timeout2_ahb_clk", &clk_itr_length-&clk_input_length+1, &clk_input_length-1)==STRING.CUT("&clk", 1))
    ( 
      &match=1
    )
  )
  else if (&wild_tail==1)
  (
    if (STRING.MID("gcc_cnoc_bus_timeout2_ahb_clk", 0, &clk_input_length-1)==STRING.CUT("&clk", -1))
    ( 
      &match=1
    )
  )
  else if ("gcc_cnoc_bus_timeout2_ahb_clk"=="&clk")
  (
    &match=1
  )
  
  if (&match==1)
  (
    &clk_test=&CLK_TEST_GCC_CNOC_BUS_TIMEOUT2_AHB_CLK
    &clk_reg=&HWIO_GCC_CNOC_BUS_TIMEOUT2_AHB_CBCR_ADDR
    &clk_reg_name="GCC_CNOC_BUS_TIMEOUT2_AHB_CBCR"
    &clk_name="gcc_cnoc_bus_timeout2_ahb_clk"
    &clk_reg_cbcr_type="sm_cbc"
    &clk_vote_bit=-1.
    &clk_multiplier=4.

    gosub Print_Clk_Info_Line
  )

  &match=0
  &wild_head=0
  &wild_tail=0
  &clk_input_length=STRING.LENGTH("&clk")
  &clk_itr_length=STRING.LENGTH("gcc_cnoc_bus_timeout3_ahb_clk")

  if (STRING.SCAN("&clk", "*", 0)==0)
  (
    &wild_head=1
  )
  if (STRING.SCAN("&clk", "*", 1)==(STRING.LENGTH("&clk")-1))
  (
    &wild_tail=1
  )

  if ((&wild_head==1)&&(&wild_tail==1))
  (
    if (STRING.SCAN("gcc_cnoc_bus_timeout3_ahb_clk", STRING.MID("&clk", 1, &clk_input_length-2), 0)!=-1)
    ( 
      &match=1
    )
  )
  else if (&wild_head==1)
  (
    if (STRING.MID("gcc_cnoc_bus_timeout3_ahb_clk", &clk_itr_length-&clk_input_length+1, &clk_input_length-1)==STRING.CUT("&clk", 1))
    ( 
      &match=1
    )
  )
  else if (&wild_tail==1)
  (
    if (STRING.MID("gcc_cnoc_bus_timeout3_ahb_clk", 0, &clk_input_length-1)==STRING.CUT("&clk", -1))
    ( 
      &match=1
    )
  )
  else if ("gcc_cnoc_bus_timeout3_ahb_clk"=="&clk")
  (
    &match=1
  )
  
  if (&match==1)
  (
    &clk_test=&CLK_TEST_GCC_CNOC_BUS_TIMEOUT3_AHB_CLK
    &clk_reg=&HWIO_GCC_CNOC_BUS_TIMEOUT3_AHB_CBCR_ADDR
    &clk_reg_name="GCC_CNOC_BUS_TIMEOUT3_AHB_CBCR"
    &clk_name="gcc_cnoc_bus_timeout3_ahb_clk"
    &clk_reg_cbcr_type="sm_cbc"
    &clk_vote_bit=-1.
    &clk_multiplier=4.

    gosub Print_Clk_Info_Line
  )

  &match=0
  &wild_head=0
  &wild_tail=0
  &clk_input_length=STRING.LENGTH("&clk")
  &clk_itr_length=STRING.LENGTH("gcc_cnoc_bus_timeout4_ahb_clk")

  if (STRING.SCAN("&clk", "*", 0)==0)
  (
    &wild_head=1
  )
  if (STRING.SCAN("&clk", "*", 1)==(STRING.LENGTH("&clk")-1))
  (
    &wild_tail=1
  )

  if ((&wild_head==1)&&(&wild_tail==1))
  (
    if (STRING.SCAN("gcc_cnoc_bus_timeout4_ahb_clk", STRING.MID("&clk", 1, &clk_input_length-2), 0)!=-1)
    ( 
      &match=1
    )
  )
  else if (&wild_head==1)
  (
    if (STRING.MID("gcc_cnoc_bus_timeout4_ahb_clk", &clk_itr_length-&clk_input_length+1, &clk_input_length-1)==STRING.CUT("&clk", 1))
    ( 
      &match=1
    )
  )
  else if (&wild_tail==1)
  (
    if (STRING.MID("gcc_cnoc_bus_timeout4_ahb_clk", 0, &clk_input_length-1)==STRING.CUT("&clk", -1))
    ( 
      &match=1
    )
  )
  else if ("gcc_cnoc_bus_timeout4_ahb_clk"=="&clk")
  (
    &match=1
  )
  
  if (&match==1)
  (
    &clk_test=&CLK_TEST_GCC_CNOC_BUS_TIMEOUT4_AHB_CLK
    &clk_reg=&HWIO_GCC_CNOC_BUS_TIMEOUT4_AHB_CBCR_ADDR
    &clk_reg_name="GCC_CNOC_BUS_TIMEOUT4_AHB_CBCR"
    &clk_name="gcc_cnoc_bus_timeout4_ahb_clk"
    &clk_reg_cbcr_type="sm_cbc"
    &clk_vote_bit=-1.
    &clk_multiplier=4.

    gosub Print_Clk_Info_Line
  )

  &match=0
  &wild_head=0
  &wild_tail=0
  &clk_input_length=STRING.LENGTH("&clk")
  &clk_itr_length=STRING.LENGTH("gcc_cnoc_bus_timeout6_ahb_clk")

  if (STRING.SCAN("&clk", "*", 0)==0)
  (
    &wild_head=1
  )
  if (STRING.SCAN("&clk", "*", 1)==(STRING.LENGTH("&clk")-1))
  (
    &wild_tail=1
  )

  if ((&wild_head==1)&&(&wild_tail==1))
  (
    if (STRING.SCAN("gcc_cnoc_bus_timeout6_ahb_clk", STRING.MID("&clk", 1, &clk_input_length-2), 0)!=-1)
    ( 
      &match=1
    )
  )
  else if (&wild_head==1)
  (
    if (STRING.MID("gcc_cnoc_bus_timeout6_ahb_clk", &clk_itr_length-&clk_input_length+1, &clk_input_length-1)==STRING.CUT("&clk", 1))
    ( 
      &match=1
    )
  )
  else if (&wild_tail==1)
  (
    if (STRING.MID("gcc_cnoc_bus_timeout6_ahb_clk", 0, &clk_input_length-1)==STRING.CUT("&clk", -1))
    ( 
      &match=1
    )
  )
  else if ("gcc_cnoc_bus_timeout6_ahb_clk"=="&clk")
  (
    &match=1
  )
  
  if (&match==1)
  (
    &clk_test=&CLK_TEST_GCC_CNOC_BUS_TIMEOUT6_AHB_CLK
    &clk_reg=&HWIO_GCC_CNOC_BUS_TIMEOUT6_AHB_CBCR_ADDR
    &clk_reg_name="GCC_CNOC_BUS_TIMEOUT6_AHB_CBCR"
    &clk_name="gcc_cnoc_bus_timeout6_ahb_clk"
    &clk_reg_cbcr_type="sm_cbc"
    &clk_vote_bit=-1.
    &clk_multiplier=4.

    gosub Print_Clk_Info_Line
  )

  &match=0
  &wild_head=0
  &wild_tail=0
  &clk_input_length=STRING.LENGTH("&clk")
  &clk_itr_length=STRING.LENGTH("gcc_cnoc_bus_timeout7_ahb_clk")

  if (STRING.SCAN("&clk", "*", 0)==0)
  (
    &wild_head=1
  )
  if (STRING.SCAN("&clk", "*", 1)==(STRING.LENGTH("&clk")-1))
  (
    &wild_tail=1
  )

  if ((&wild_head==1)&&(&wild_tail==1))
  (
    if (STRING.SCAN("gcc_cnoc_bus_timeout7_ahb_clk", STRING.MID("&clk", 1, &clk_input_length-2), 0)!=-1)
    ( 
      &match=1
    )
  )
  else if (&wild_head==1)
  (
    if (STRING.MID("gcc_cnoc_bus_timeout7_ahb_clk", &clk_itr_length-&clk_input_length+1, &clk_input_length-1)==STRING.CUT("&clk", 1))
    ( 
      &match=1
    )
  )
  else if (&wild_tail==1)
  (
    if (STRING.MID("gcc_cnoc_bus_timeout7_ahb_clk", 0, &clk_input_length-1)==STRING.CUT("&clk", -1))
    ( 
      &match=1
    )
  )
  else if ("gcc_cnoc_bus_timeout7_ahb_clk"=="&clk")
  (
    &match=1
  )
  
  if (&match==1)
  (
    &clk_test=&CLK_TEST_GCC_CNOC_BUS_TIMEOUT7_AHB_CLK
    &clk_reg=&HWIO_GCC_CNOC_BUS_TIMEOUT7_AHB_CBCR_ADDR
    &clk_reg_name="GCC_CNOC_BUS_TIMEOUT7_AHB_CBCR"
    &clk_name="gcc_cnoc_bus_timeout7_ahb_clk"
    &clk_reg_cbcr_type="sm_cbc"
    &clk_vote_bit=-1.
    &clk_multiplier=4.

    gosub Print_Clk_Info_Line
  )

  &match=0
  &wild_head=0
  &wild_tail=0
  &clk_input_length=STRING.LENGTH("&clk")
  &clk_itr_length=STRING.LENGTH("gcc_cnoc_bus_timeout8_ahb_clk")

  if (STRING.SCAN("&clk", "*", 0)==0)
  (
    &wild_head=1
  )
  if (STRING.SCAN("&clk", "*", 1)==(STRING.LENGTH("&clk")-1))
  (
    &wild_tail=1
  )

  if ((&wild_head==1)&&(&wild_tail==1))
  (
    if (STRING.SCAN("gcc_cnoc_bus_timeout8_ahb_clk", STRING.MID("&clk", 1, &clk_input_length-2), 0)!=-1)
    ( 
      &match=1
    )
  )
  else if (&wild_head==1)
  (
    if (STRING.MID("gcc_cnoc_bus_timeout8_ahb_clk", &clk_itr_length-&clk_input_length+1, &clk_input_length-1)==STRING.CUT("&clk", 1))
    ( 
      &match=1
    )
  )
  else if (&wild_tail==1)
  (
    if (STRING.MID("gcc_cnoc_bus_timeout8_ahb_clk", 0, &clk_input_length-1)==STRING.CUT("&clk", -1))
    ( 
      &match=1
    )
  )
  else if ("gcc_cnoc_bus_timeout8_ahb_clk"=="&clk")
  (
    &match=1
  )
  
  if (&match==1)
  (
    &clk_test=&CLK_TEST_GCC_CNOC_BUS_TIMEOUT8_AHB_CLK
    &clk_reg=&HWIO_GCC_CNOC_BUS_TIMEOUT8_AHB_CBCR_ADDR
    &clk_reg_name="GCC_CNOC_BUS_TIMEOUT8_AHB_CBCR"
    &clk_name="gcc_cnoc_bus_timeout8_ahb_clk"
    &clk_reg_cbcr_type="sm_cbc"
    &clk_vote_bit=-1.
    &clk_multiplier=4.

    gosub Print_Clk_Info_Line
  )

  &match=0
  &wild_head=0
  &wild_tail=0
  &clk_input_length=STRING.LENGTH("&clk")
  &clk_itr_length=STRING.LENGTH("gcc_cnoc_bus_timeout9_ahb_clk")

  if (STRING.SCAN("&clk", "*", 0)==0)
  (
    &wild_head=1
  )
  if (STRING.SCAN("&clk", "*", 1)==(STRING.LENGTH("&clk")-1))
  (
    &wild_tail=1
  )

  if ((&wild_head==1)&&(&wild_tail==1))
  (
    if (STRING.SCAN("gcc_cnoc_bus_timeout9_ahb_clk", STRING.MID("&clk", 1, &clk_input_length-2), 0)!=-1)
    ( 
      &match=1
    )
  )
  else if (&wild_head==1)
  (
    if (STRING.MID("gcc_cnoc_bus_timeout9_ahb_clk", &clk_itr_length-&clk_input_length+1, &clk_input_length-1)==STRING.CUT("&clk", 1))
    ( 
      &match=1
    )
  )
  else if (&wild_tail==1)
  (
    if (STRING.MID("gcc_cnoc_bus_timeout9_ahb_clk", 0, &clk_input_length-1)==STRING.CUT("&clk", -1))
    ( 
      &match=1
    )
  )
  else if ("gcc_cnoc_bus_timeout9_ahb_clk"=="&clk")
  (
    &match=1
  )
  
  if (&match==1)
  (
    &clk_test=&CLK_TEST_GCC_CNOC_BUS_TIMEOUT9_AHB_CLK
    &clk_reg=&HWIO_GCC_CNOC_BUS_TIMEOUT9_AHB_CBCR_ADDR
    &clk_reg_name="GCC_CNOC_BUS_TIMEOUT9_AHB_CBCR"
    &clk_name="gcc_cnoc_bus_timeout9_ahb_clk"
    &clk_reg_cbcr_type="sm_cbc"
    &clk_vote_bit=-1.
    &clk_multiplier=4.

    gosub Print_Clk_Info_Line
  )

  &match=0
  &wild_head=0
  &wild_tail=0
  &clk_input_length=STRING.LENGTH("&clk")
  &clk_itr_length=STRING.LENGTH("gcc_cnoc_mst_rpm_ahb_clk")

  if (STRING.SCAN("&clk", "*", 0)==0)
  (
    &wild_head=1
  )
  if (STRING.SCAN("&clk", "*", 1)==(STRING.LENGTH("&clk")-1))
  (
    &wild_tail=1
  )

  if ((&wild_head==1)&&(&wild_tail==1))
  (
    if (STRING.SCAN("gcc_cnoc_mst_rpm_ahb_clk", STRING.MID("&clk", 1, &clk_input_length-2), 0)!=-1)
    ( 
      &match=1
    )
  )
  else if (&wild_head==1)
  (
    if (STRING.MID("gcc_cnoc_mst_rpm_ahb_clk", &clk_itr_length-&clk_input_length+1, &clk_input_length-1)==STRING.CUT("&clk", 1))
    ( 
      &match=1
    )
  )
  else if (&wild_tail==1)
  (
    if (STRING.MID("gcc_cnoc_mst_rpm_ahb_clk", 0, &clk_input_length-1)==STRING.CUT("&clk", -1))
    ( 
      &match=1
    )
  )
  else if ("gcc_cnoc_mst_rpm_ahb_clk"=="&clk")
  (
    &match=1
  )
  
  if (&match==1)
  (
    &clk_test=&CLK_TEST_GCC_CNOC_MST_RPM_AHB_CLK
    &clk_reg=&HWIO_GCC_CNOC_MST_RPM_AHB_CBCR_ADDR
    &clk_reg_name="GCC_CNOC_MST_RPM_AHB_CBCR"
    &clk_name="gcc_cnoc_mst_rpm_ahb_clk"
    &clk_reg_cbcr_type="sm_cbc"
    &clk_vote_bit=-1.
    &clk_multiplier=4.

    gosub Print_Clk_Info_Line
  )

  &match=0
  &wild_head=0
  &wild_tail=0
  &clk_input_length=STRING.LENGTH("&clk")
  &clk_itr_length=STRING.LENGTH("gcc_dcc_ahb_clk")

  if (STRING.SCAN("&clk", "*", 0)==0)
  (
    &wild_head=1
  )
  if (STRING.SCAN("&clk", "*", 1)==(STRING.LENGTH("&clk")-1))
  (
    &wild_tail=1
  )

  if ((&wild_head==1)&&(&wild_tail==1))
  (
    if (STRING.SCAN("gcc_dcc_ahb_clk", STRING.MID("&clk", 1, &clk_input_length-2), 0)!=-1)
    ( 
      &match=1
    )
  )
  else if (&wild_head==1)
  (
    if (STRING.MID("gcc_dcc_ahb_clk", &clk_itr_length-&clk_input_length+1, &clk_input_length-1)==STRING.CUT("&clk", 1))
    ( 
      &match=1
    )
  )
  else if (&wild_tail==1)
  (
    if (STRING.MID("gcc_dcc_ahb_clk", 0, &clk_input_length-1)==STRING.CUT("&clk", -1))
    ( 
      &match=1
    )
  )
  else if ("gcc_dcc_ahb_clk"=="&clk")
  (
    &match=1
  )
  
  if (&match==1)
  (
    &clk_test=&CLK_TEST_GCC_DCC_AHB_CLK
    &clk_reg=&HWIO_GCC_DCC_AHB_CBCR_ADDR
    &clk_reg_name="GCC_DCC_AHB_CBCR"
    &clk_name="gcc_dcc_ahb_clk"
    &clk_reg_cbcr_type="sm_pscbc"
    &clk_vote_bit=-1.
    &clk_multiplier=4.

    gosub Print_Clk_Info_Line
  )

  &match=0
  &wild_head=0
  &wild_tail=0
  &clk_input_length=STRING.LENGTH("&clk")
  &clk_itr_length=STRING.LENGTH("gcc_glm_ahb_clk")

  if (STRING.SCAN("&clk", "*", 0)==0)
  (
    &wild_head=1
  )
  if (STRING.SCAN("&clk", "*", 1)==(STRING.LENGTH("&clk")-1))
  (
    &wild_tail=1
  )

  if ((&wild_head==1)&&(&wild_tail==1))
  (
    if (STRING.SCAN("gcc_glm_ahb_clk", STRING.MID("&clk", 1, &clk_input_length-2), 0)!=-1)
    ( 
      &match=1
    )
  )
  else if (&wild_head==1)
  (
    if (STRING.MID("gcc_glm_ahb_clk", &clk_itr_length-&clk_input_length+1, &clk_input_length-1)==STRING.CUT("&clk", 1))
    ( 
      &match=1
    )
  )
  else if (&wild_tail==1)
  (
    if (STRING.MID("gcc_glm_ahb_clk", 0, &clk_input_length-1)==STRING.CUT("&clk", -1))
    ( 
      &match=1
    )
  )
  else if ("gcc_glm_ahb_clk"=="&clk")
  (
    &match=1
  )
  
  if (&match==1)
  (
    &clk_test=&CLK_TEST_GCC_GLM_AHB_CLK
    &clk_reg=&HWIO_GCC_GLM_AHB_CBCR_ADDR
    &clk_reg_name="GCC_GLM_AHB_CBCR"
    &clk_name="gcc_glm_ahb_clk"
    &clk_reg_cbcr_type="sm_cbc"
    &clk_vote_bit=-1.
    &clk_multiplier=4.

    gosub Print_Clk_Info_Line
  )

  &match=0
  &wild_head=0
  &wild_tail=0
  &clk_input_length=STRING.LENGTH("&clk")
  &clk_itr_length=STRING.LENGTH("gcc_gpu_cfg_ahb_clk")

  if (STRING.SCAN("&clk", "*", 0)==0)
  (
    &wild_head=1
  )
  if (STRING.SCAN("&clk", "*", 1)==(STRING.LENGTH("&clk")-1))
  (
    &wild_tail=1
  )

  if ((&wild_head==1)&&(&wild_tail==1))
  (
    if (STRING.SCAN("gcc_gpu_cfg_ahb_clk", STRING.MID("&clk", 1, &clk_input_length-2), 0)!=-1)
    ( 
      &match=1
    )
  )
  else if (&wild_head==1)
  (
    if (STRING.MID("gcc_gpu_cfg_ahb_clk", &clk_itr_length-&clk_input_length+1, &clk_input_length-1)==STRING.CUT("&clk", 1))
    ( 
      &match=1
    )
  )
  else if (&wild_tail==1)
  (
    if (STRING.MID("gcc_gpu_cfg_ahb_clk", 0, &clk_input_length-1)==STRING.CUT("&clk", -1))
    ( 
      &match=1
    )
  )
  else if ("gcc_gpu_cfg_ahb_clk"=="&clk")
  (
    &match=1
  )
  
  if (&match==1)
  (
    &clk_test=&CLK_TEST_GCC_GPU_CFG_AHB_CLK
    &clk_reg=&HWIO_GCC_GPU_CFG_AHB_CBCR_ADDR
    &clk_reg_name="GCC_GPU_CFG_AHB_CBCR"
    &clk_name="gcc_gpu_cfg_ahb_clk"
    &clk_reg_cbcr_type="sm_cbc"
    &clk_vote_bit=-1.
    &clk_multiplier=4.

    gosub Print_Clk_Info_Line
  )

  &match=0
  &wild_head=0
  &wild_tail=0
  &clk_input_length=STRING.LENGTH("&clk")
  &clk_itr_length=STRING.LENGTH("gcc_imem_cfg_ahb_clk")

  if (STRING.SCAN("&clk", "*", 0)==0)
  (
    &wild_head=1
  )
  if (STRING.SCAN("&clk", "*", 1)==(STRING.LENGTH("&clk")-1))
  (
    &wild_tail=1
  )

  if ((&wild_head==1)&&(&wild_tail==1))
  (
    if (STRING.SCAN("gcc_imem_cfg_ahb_clk", STRING.MID("&clk", 1, &clk_input_length-2), 0)!=-1)
    ( 
      &match=1
    )
  )
  else if (&wild_head==1)
  (
    if (STRING.MID("gcc_imem_cfg_ahb_clk", &clk_itr_length-&clk_input_length+1, &clk_input_length-1)==STRING.CUT("&clk", 1))
    ( 
      &match=1
    )
  )
  else if (&wild_tail==1)
  (
    if (STRING.MID("gcc_imem_cfg_ahb_clk", 0, &clk_input_length-1)==STRING.CUT("&clk", -1))
    ( 
      &match=1
    )
  )
  else if ("gcc_imem_cfg_ahb_clk"=="&clk")
  (
    &match=1
  )
  
  if (&match==1)
  (
    &clk_test=&CLK_TEST_GCC_IMEM_CFG_AHB_CLK
    &clk_reg=&HWIO_GCC_IMEM_CFG_AHB_CBCR_ADDR
    &clk_reg_name="GCC_IMEM_CFG_AHB_CBCR"
    &clk_name="gcc_imem_cfg_ahb_clk"
    &clk_reg_cbcr_type="sm_cbc"
    &clk_vote_bit=-1.
    &clk_multiplier=4.

    gosub Print_Clk_Info_Line
  )

  &match=0
  &wild_head=0
  &wild_tail=0
  &clk_input_length=STRING.LENGTH("&clk")
  &clk_itr_length=STRING.LENGTH("gcc_ipa_ahb_clk")

  if (STRING.SCAN("&clk", "*", 0)==0)
  (
    &wild_head=1
  )
  if (STRING.SCAN("&clk", "*", 1)==(STRING.LENGTH("&clk")-1))
  (
    &wild_tail=1
  )

  if ((&wild_head==1)&&(&wild_tail==1))
  (
    if (STRING.SCAN("gcc_ipa_ahb_clk", STRING.MID("&clk", 1, &clk_input_length-2), 0)!=-1)
    ( 
      &match=1
    )
  )
  else if (&wild_head==1)
  (
    if (STRING.MID("gcc_ipa_ahb_clk", &clk_itr_length-&clk_input_length+1, &clk_input_length-1)==STRING.CUT("&clk", 1))
    ( 
      &match=1
    )
  )
  else if (&wild_tail==1)
  (
    if (STRING.MID("gcc_ipa_ahb_clk", 0, &clk_input_length-1)==STRING.CUT("&clk", -1))
    ( 
      &match=1
    )
  )
  else if ("gcc_ipa_ahb_clk"=="&clk")
  (
    &match=1
  )
  
  if (&match==1)
  (
    &clk_test=&CLK_TEST_GCC_IPA_AHB_CLK
    &clk_reg=&HWIO_GCC_IPA_AHB_CBCR_ADDR
    &clk_reg_name="GCC_IPA_AHB_CBCR"
    &clk_name="gcc_ipa_ahb_clk"
    &clk_reg_cbcr_type="sm_cbc"
    &clk_vote_bit=-1.
    &clk_multiplier=4.

    gosub Print_Clk_Info_Line
  )

  &match=0
  &wild_head=0
  &wild_tail=0
  &clk_input_length=STRING.LENGTH("&clk")
  &clk_itr_length=STRING.LENGTH("gcc_lpass_core_smmu_ahb_clk")

  if (STRING.SCAN("&clk", "*", 0)==0)
  (
    &wild_head=1
  )
  if (STRING.SCAN("&clk", "*", 1)==(STRING.LENGTH("&clk")-1))
  (
    &wild_tail=1
  )

  if ((&wild_head==1)&&(&wild_tail==1))
  (
    if (STRING.SCAN("gcc_lpass_core_smmu_ahb_clk", STRING.MID("&clk", 1, &clk_input_length-2), 0)!=-1)
    ( 
      &match=1
    )
  )
  else if (&wild_head==1)
  (
    if (STRING.MID("gcc_lpass_core_smmu_ahb_clk", &clk_itr_length-&clk_input_length+1, &clk_input_length-1)==STRING.CUT("&clk", 1))
    ( 
      &match=1
    )
  )
  else if (&wild_tail==1)
  (
    if (STRING.MID("gcc_lpass_core_smmu_ahb_clk", 0, &clk_input_length-1)==STRING.CUT("&clk", -1))
    ( 
      &match=1
    )
  )
  else if ("gcc_lpass_core_smmu_ahb_clk"=="&clk")
  (
    &match=1
  )
  
  if (&match==1)
  (
    &clk_test=&CLK_TEST_GCC_LPASS_CORE_SMMU_AHB_CLK
    &clk_reg=&HWIO_GCC_LPASS_CORE_SMMU_AHB_CBCR_ADDR
    &clk_reg_name="GCC_LPASS_CORE_SMMU_AHB_CBCR"
    &clk_name="gcc_lpass_core_smmu_ahb_clk"
    &clk_reg_cbcr_type="sm_cbc"
    &clk_vote_bit=-1.
    &clk_multiplier=4.

    gosub Print_Clk_Info_Line
  )

  &match=0
  &wild_head=0
  &wild_tail=0
  &clk_input_length=STRING.LENGTH("&clk")
  &clk_itr_length=STRING.LENGTH("gcc_lpass_q6_smmu_ahb_clk")

  if (STRING.SCAN("&clk", "*", 0)==0)
  (
    &wild_head=1
  )
  if (STRING.SCAN("&clk", "*", 1)==(STRING.LENGTH("&clk")-1))
  (
    &wild_tail=1
  )

  if ((&wild_head==1)&&(&wild_tail==1))
  (
    if (STRING.SCAN("gcc_lpass_q6_smmu_ahb_clk", STRING.MID("&clk", 1, &clk_input_length-2), 0)!=-1)
    ( 
      &match=1
    )
  )
  else if (&wild_head==1)
  (
    if (STRING.MID("gcc_lpass_q6_smmu_ahb_clk", &clk_itr_length-&clk_input_length+1, &clk_input_length-1)==STRING.CUT("&clk", 1))
    ( 
      &match=1
    )
  )
  else if (&wild_tail==1)
  (
    if (STRING.MID("gcc_lpass_q6_smmu_ahb_clk", 0, &clk_input_length-1)==STRING.CUT("&clk", -1))
    ( 
      &match=1
    )
  )
  else if ("gcc_lpass_q6_smmu_ahb_clk"=="&clk")
  (
    &match=1
  )
  
  if (&match==1)
  (
    &clk_test=&CLK_TEST_GCC_LPASS_Q6_SMMU_AHB_CLK
    &clk_reg=&HWIO_GCC_LPASS_Q6_SMMU_AHB_CBCR_ADDR
    &clk_reg_name="GCC_LPASS_Q6_SMMU_AHB_CBCR"
    &clk_name="gcc_lpass_q6_smmu_ahb_clk"
    &clk_reg_cbcr_type="sm_cbc"
    &clk_vote_bit=-1.
    &clk_multiplier=4.

    gosub Print_Clk_Info_Line
  )

  &match=0
  &wild_head=0
  &wild_tail=0
  &clk_input_length=STRING.LENGTH("&clk")
  &clk_itr_length=STRING.LENGTH("gcc_lpass_smmu_aon_ahb_clk")

  if (STRING.SCAN("&clk", "*", 0)==0)
  (
    &wild_head=1
  )
  if (STRING.SCAN("&clk", "*", 1)==(STRING.LENGTH("&clk")-1))
  (
    &wild_tail=1
  )

  if ((&wild_head==1)&&(&wild_tail==1))
  (
    if (STRING.SCAN("gcc_lpass_smmu_aon_ahb_clk", STRING.MID("&clk", 1, &clk_input_length-2), 0)!=-1)
    ( 
      &match=1
    )
  )
  else if (&wild_head==1)
  (
    if (STRING.MID("gcc_lpass_smmu_aon_ahb_clk", &clk_itr_length-&clk_input_length+1, &clk_input_length-1)==STRING.CUT("&clk", 1))
    ( 
      &match=1
    )
  )
  else if (&wild_tail==1)
  (
    if (STRING.MID("gcc_lpass_smmu_aon_ahb_clk", 0, &clk_input_length-1)==STRING.CUT("&clk", -1))
    ( 
      &match=1
    )
  )
  else if ("gcc_lpass_smmu_aon_ahb_clk"=="&clk")
  (
    &match=1
  )
  
  if (&match==1)
  (
    &clk_test=&CLK_TEST_GCC_LPASS_SMMU_AON_AHB_CLK
    &clk_reg=&HWIO_GCC_LPASS_SMMU_AON_AHB_CBCR_ADDR
    &clk_reg_name="GCC_LPASS_SMMU_AON_AHB_CBCR"
    &clk_name="gcc_lpass_smmu_aon_ahb_clk"
    &clk_reg_cbcr_type="sm_cbc"
    &clk_vote_bit=-1.
    &clk_multiplier=4.

    gosub Print_Clk_Info_Line
  )

  &match=0
  &wild_head=0
  &wild_tail=0
  &clk_input_length=STRING.LENGTH("&clk")
  &clk_itr_length=STRING.LENGTH("gcc_mccc_cfg_ahb_clk")

  if (STRING.SCAN("&clk", "*", 0)==0)
  (
    &wild_head=1
  )
  if (STRING.SCAN("&clk", "*", 1)==(STRING.LENGTH("&clk")-1))
  (
    &wild_tail=1
  )

  if ((&wild_head==1)&&(&wild_tail==1))
  (
    if (STRING.SCAN("gcc_mccc_cfg_ahb_clk", STRING.MID("&clk", 1, &clk_input_length-2), 0)!=-1)
    ( 
      &match=1
    )
  )
  else if (&wild_head==1)
  (
    if (STRING.MID("gcc_mccc_cfg_ahb_clk", &clk_itr_length-&clk_input_length+1, &clk_input_length-1)==STRING.CUT("&clk", 1))
    ( 
      &match=1
    )
  )
  else if (&wild_tail==1)
  (
    if (STRING.MID("gcc_mccc_cfg_ahb_clk", 0, &clk_input_length-1)==STRING.CUT("&clk", -1))
    ( 
      &match=1
    )
  )
  else if ("gcc_mccc_cfg_ahb_clk"=="&clk")
  (
    &match=1
  )
  
  if (&match==1)
  (
    &clk_test=&CLK_TEST_GCC_MCCC_CFG_AHB_CLK
    &clk_reg=&HWIO_GCC_MCCC_CFG_AHB_CBCR_ADDR
    &clk_reg_name="GCC_MCCC_CFG_AHB_CBCR"
    &clk_name="gcc_mccc_cfg_ahb_clk"
    &clk_reg_cbcr_type="sm_cbc"
    &clk_vote_bit=-1.
    &clk_multiplier=4.

    gosub Print_Clk_Info_Line
  )

  &match=0
  &wild_head=0
  &wild_tail=0
  &clk_input_length=STRING.LENGTH("&clk")
  &clk_itr_length=STRING.LENGTH("gcc_mmss_noc_cfg_ahb_clk")

  if (STRING.SCAN("&clk", "*", 0)==0)
  (
    &wild_head=1
  )
  if (STRING.SCAN("&clk", "*", 1)==(STRING.LENGTH("&clk")-1))
  (
    &wild_tail=1
  )

  if ((&wild_head==1)&&(&wild_tail==1))
  (
    if (STRING.SCAN("gcc_mmss_noc_cfg_ahb_clk", STRING.MID("&clk", 1, &clk_input_length-2), 0)!=-1)
    ( 
      &match=1
    )
  )
  else if (&wild_head==1)
  (
    if (STRING.MID("gcc_mmss_noc_cfg_ahb_clk", &clk_itr_length-&clk_input_length+1, &clk_input_length-1)==STRING.CUT("&clk", 1))
    ( 
      &match=1
    )
  )
  else if (&wild_tail==1)
  (
    if (STRING.MID("gcc_mmss_noc_cfg_ahb_clk", 0, &clk_input_length-1)==STRING.CUT("&clk", -1))
    ( 
      &match=1
    )
  )
  else if ("gcc_mmss_noc_cfg_ahb_clk"=="&clk")
  (
    &match=1
  )
  
  if (&match==1)
  (
    &clk_test=&CLK_TEST_GCC_MMSS_NOC_CFG_AHB_CLK
    &clk_reg=&HWIO_GCC_MMSS_NOC_CFG_AHB_CBCR_ADDR
    &clk_reg_name="GCC_MMSS_NOC_CFG_AHB_CBCR"
    &clk_name="gcc_mmss_noc_cfg_ahb_clk"
    &clk_reg_cbcr_type="sm_cbc"
    &clk_vote_bit=-1.
    &clk_multiplier=4.

    gosub Print_Clk_Info_Line
  )

  &match=0
  &wild_head=0
  &wild_tail=0
  &clk_input_length=STRING.LENGTH("&clk")
  &clk_itr_length=STRING.LENGTH("gcc_mmss_qm_ahb_clk")

  if (STRING.SCAN("&clk", "*", 0)==0)
  (
    &wild_head=1
  )
  if (STRING.SCAN("&clk", "*", 1)==(STRING.LENGTH("&clk")-1))
  (
    &wild_tail=1
  )

  if ((&wild_head==1)&&(&wild_tail==1))
  (
    if (STRING.SCAN("gcc_mmss_qm_ahb_clk", STRING.MID("&clk", 1, &clk_input_length-2), 0)!=-1)
    ( 
      &match=1
    )
  )
  else if (&wild_head==1)
  (
    if (STRING.MID("gcc_mmss_qm_ahb_clk", &clk_itr_length-&clk_input_length+1, &clk_input_length-1)==STRING.CUT("&clk", 1))
    ( 
      &match=1
    )
  )
  else if (&wild_tail==1)
  (
    if (STRING.MID("gcc_mmss_qm_ahb_clk", 0, &clk_input_length-1)==STRING.CUT("&clk", -1))
    ( 
      &match=1
    )
  )
  else if ("gcc_mmss_qm_ahb_clk"=="&clk")
  (
    &match=1
  )
  
  if (&match==1)
  (
    &clk_test=&CLK_TEST_GCC_MMSS_QM_AHB_CLK
    &clk_reg=&HWIO_GCC_MMSS_QM_AHB_CBCR_ADDR
    &clk_reg_name="GCC_MMSS_QM_AHB_CBCR"
    &clk_name="gcc_mmss_qm_ahb_clk"
    &clk_reg_cbcr_type="sm_cbc"
    &clk_vote_bit=-1.
    &clk_multiplier=4.

    gosub Print_Clk_Info_Line
  )

  &match=0
  &wild_head=0
  &wild_tail=0
  &clk_input_length=STRING.LENGTH("&clk")
  &clk_itr_length=STRING.LENGTH("gcc_mpm_ahb_clk")

  if (STRING.SCAN("&clk", "*", 0)==0)
  (
    &wild_head=1
  )
  if (STRING.SCAN("&clk", "*", 1)==(STRING.LENGTH("&clk")-1))
  (
    &wild_tail=1
  )

  if ((&wild_head==1)&&(&wild_tail==1))
  (
    if (STRING.SCAN("gcc_mpm_ahb_clk", STRING.MID("&clk", 1, &clk_input_length-2), 0)!=-1)
    ( 
      &match=1
    )
  )
  else if (&wild_head==1)
  (
    if (STRING.MID("gcc_mpm_ahb_clk", &clk_itr_length-&clk_input_length+1, &clk_input_length-1)==STRING.CUT("&clk", 1))
    ( 
      &match=1
    )
  )
  else if (&wild_tail==1)
  (
    if (STRING.MID("gcc_mpm_ahb_clk", 0, &clk_input_length-1)==STRING.CUT("&clk", -1))
    ( 
      &match=1
    )
  )
  else if ("gcc_mpm_ahb_clk"=="&clk")
  (
    &match=1
  )
  
  if (&match==1)
  (
    &clk_test=&CLK_TEST_GCC_MPM_AHB_CLK
    &clk_reg=&HWIO_GCC_MPM_AHB_CBCR_ADDR
    &clk_reg_name="GCC_MPM_AHB_CBCR"
    &clk_name="gcc_mpm_ahb_clk"
    &clk_reg_cbcr_type="sm_cbc"
    &clk_vote_bit=19.
    &clk_multiplier=4.

    gosub Print_Clk_Info_Line
  )

  &match=0
  &wild_head=0
  &wild_tail=0
  &clk_input_length=STRING.LENGTH("&clk")
  &clk_itr_length=STRING.LENGTH("gcc_msg_ram_ahb_clk")

  if (STRING.SCAN("&clk", "*", 0)==0)
  (
    &wild_head=1
  )
  if (STRING.SCAN("&clk", "*", 1)==(STRING.LENGTH("&clk")-1))
  (
    &wild_tail=1
  )

  if ((&wild_head==1)&&(&wild_tail==1))
  (
    if (STRING.SCAN("gcc_msg_ram_ahb_clk", STRING.MID("&clk", 1, &clk_input_length-2), 0)!=-1)
    ( 
      &match=1
    )
  )
  else if (&wild_head==1)
  (
    if (STRING.MID("gcc_msg_ram_ahb_clk", &clk_itr_length-&clk_input_length+1, &clk_input_length-1)==STRING.CUT("&clk", 1))
    ( 
      &match=1
    )
  )
  else if (&wild_tail==1)
  (
    if (STRING.MID("gcc_msg_ram_ahb_clk", 0, &clk_input_length-1)==STRING.CUT("&clk", -1))
    ( 
      &match=1
    )
  )
  else if ("gcc_msg_ram_ahb_clk"=="&clk")
  (
    &match=1
  )
  
  if (&match==1)
  (
    &clk_test=&CLK_TEST_GCC_MSG_RAM_AHB_CLK
    &clk_reg=&HWIO_GCC_MSG_RAM_AHB_CBCR_ADDR
    &clk_reg_name="GCC_MSG_RAM_AHB_CBCR"
    &clk_name="gcc_msg_ram_ahb_clk"
    &clk_reg_cbcr_type="sm_pscbc"
    &clk_vote_bit=9.
    &clk_multiplier=4.

    gosub Print_Clk_Info_Line
  )

  &match=0
  &wild_head=0
  &wild_tail=0
  &clk_input_length=STRING.LENGTH("&clk")
  &clk_itr_length=STRING.LENGTH("gcc_mss_cfg_ahb_clk")

  if (STRING.SCAN("&clk", "*", 0)==0)
  (
    &wild_head=1
  )
  if (STRING.SCAN("&clk", "*", 1)==(STRING.LENGTH("&clk")-1))
  (
    &wild_tail=1
  )

  if ((&wild_head==1)&&(&wild_tail==1))
  (
    if (STRING.SCAN("gcc_mss_cfg_ahb_clk", STRING.MID("&clk", 1, &clk_input_length-2), 0)!=-1)
    ( 
      &match=1
    )
  )
  else if (&wild_head==1)
  (
    if (STRING.MID("gcc_mss_cfg_ahb_clk", &clk_itr_length-&clk_input_length+1, &clk_input_length-1)==STRING.CUT("&clk", 1))
    ( 
      &match=1
    )
  )
  else if (&wild_tail==1)
  (
    if (STRING.MID("gcc_mss_cfg_ahb_clk", 0, &clk_input_length-1)==STRING.CUT("&clk", -1))
    ( 
      &match=1
    )
  )
  else if ("gcc_mss_cfg_ahb_clk"=="&clk")
  (
    &match=1
  )
  
  if (&match==1)
  (
    &clk_test=&CLK_TEST_GCC_MSS_CFG_AHB_CLK
    &clk_reg=&HWIO_GCC_MSS_CFG_AHB_CBCR_ADDR
    &clk_reg_name="GCC_MSS_CFG_AHB_CBCR"
    &clk_name="gcc_mss_cfg_ahb_clk"
    &clk_reg_cbcr_type="sm_cbc"
    &clk_vote_bit=-1.
    &clk_multiplier=4.

    gosub Print_Clk_Info_Line
  )

  &match=0
  &wild_head=0
  &wild_tail=0
  &clk_input_length=STRING.LENGTH("&clk")
  &clk_itr_length=STRING.LENGTH("gcc_mss_msmpu_cfg_ahb_clk")

  if (STRING.SCAN("&clk", "*", 0)==0)
  (
    &wild_head=1
  )
  if (STRING.SCAN("&clk", "*", 1)==(STRING.LENGTH("&clk")-1))
  (
    &wild_tail=1
  )

  if ((&wild_head==1)&&(&wild_tail==1))
  (
    if (STRING.SCAN("gcc_mss_msmpu_cfg_ahb_clk", STRING.MID("&clk", 1, &clk_input_length-2), 0)!=-1)
    ( 
      &match=1
    )
  )
  else if (&wild_head==1)
  (
    if (STRING.MID("gcc_mss_msmpu_cfg_ahb_clk", &clk_itr_length-&clk_input_length+1, &clk_input_length-1)==STRING.CUT("&clk", 1))
    ( 
      &match=1
    )
  )
  else if (&wild_tail==1)
  (
    if (STRING.MID("gcc_mss_msmpu_cfg_ahb_clk", 0, &clk_input_length-1)==STRING.CUT("&clk", -1))
    ( 
      &match=1
    )
  )
  else if ("gcc_mss_msmpu_cfg_ahb_clk"=="&clk")
  (
    &match=1
  )
  
  if (&match==1)
  (
    &clk_test=&CLK_TEST_GCC_MSS_MSMPU_CFG_AHB_CLK
    &clk_reg=&HWIO_GCC_MSS_MSMPU_CFG_AHB_CBCR_ADDR
    &clk_reg_name="GCC_MSS_MSMPU_CFG_AHB_CBCR"
    &clk_name="gcc_mss_msmpu_cfg_ahb_clk"
    &clk_reg_cbcr_type="sm_cbc"
    &clk_vote_bit=-1.
    &clk_multiplier=4.

    gosub Print_Clk_Info_Line
  )

  &match=0
  &wild_head=0
  &wild_tail=0
  &clk_input_length=STRING.LENGTH("&clk")
  &clk_itr_length=STRING.LENGTH("gcc_mss_q6_msmpu_cfg_ahb_clk")

  if (STRING.SCAN("&clk", "*", 0)==0)
  (
    &wild_head=1
  )
  if (STRING.SCAN("&clk", "*", 1)==(STRING.LENGTH("&clk")-1))
  (
    &wild_tail=1
  )

  if ((&wild_head==1)&&(&wild_tail==1))
  (
    if (STRING.SCAN("gcc_mss_q6_msmpu_cfg_ahb_clk", STRING.MID("&clk", 1, &clk_input_length-2), 0)!=-1)
    ( 
      &match=1
    )
  )
  else if (&wild_head==1)
  (
    if (STRING.MID("gcc_mss_q6_msmpu_cfg_ahb_clk", &clk_itr_length-&clk_input_length+1, &clk_input_length-1)==STRING.CUT("&clk", 1))
    ( 
      &match=1
    )
  )
  else if (&wild_tail==1)
  (
    if (STRING.MID("gcc_mss_q6_msmpu_cfg_ahb_clk", 0, &clk_input_length-1)==STRING.CUT("&clk", -1))
    ( 
      &match=1
    )
  )
  else if ("gcc_mss_q6_msmpu_cfg_ahb_clk"=="&clk")
  (
    &match=1
  )
  
  if (&match==1)
  (
    &clk_test=&CLK_TEST_GCC_MSS_Q6_MSMPU_CFG_AHB_CLK
    &clk_reg=&HWIO_GCC_MSS_Q6_MSMPU_CFG_AHB_CBCR_ADDR
    &clk_reg_name="GCC_MSS_Q6_MSMPU_CFG_AHB_CBCR"
    &clk_name="gcc_mss_q6_msmpu_cfg_ahb_clk"
    &clk_reg_cbcr_type="sm_cbc"
    &clk_vote_bit=-1.
    &clk_multiplier=4.

    gosub Print_Clk_Info_Line
  )

  &match=0
  &wild_head=0
  &wild_tail=0
  &clk_input_length=STRING.LENGTH("&clk")
  &clk_itr_length=STRING.LENGTH("gcc_pcie_0_cfg_ahb_clk")

  if (STRING.SCAN("&clk", "*", 0)==0)
  (
    &wild_head=1
  )
  if (STRING.SCAN("&clk", "*", 1)==(STRING.LENGTH("&clk")-1))
  (
    &wild_tail=1
  )

  if ((&wild_head==1)&&(&wild_tail==1))
  (
    if (STRING.SCAN("gcc_pcie_0_cfg_ahb_clk", STRING.MID("&clk", 1, &clk_input_length-2), 0)!=-1)
    ( 
      &match=1
    )
  )
  else if (&wild_head==1)
  (
    if (STRING.MID("gcc_pcie_0_cfg_ahb_clk", &clk_itr_length-&clk_input_length+1, &clk_input_length-1)==STRING.CUT("&clk", 1))
    ( 
      &match=1
    )
  )
  else if (&wild_tail==1)
  (
    if (STRING.MID("gcc_pcie_0_cfg_ahb_clk", 0, &clk_input_length-1)==STRING.CUT("&clk", -1))
    ( 
      &match=1
    )
  )
  else if ("gcc_pcie_0_cfg_ahb_clk"=="&clk")
  (
    &match=1
  )
  
  if (&match==1)
  (
    &clk_test=&CLK_TEST_GCC_PCIE_0_CFG_AHB_CLK
    &clk_reg=&HWIO_GCC_PCIE_0_CFG_AHB_CBCR_ADDR
    &clk_reg_name="GCC_PCIE_0_CFG_AHB_CBCR"
    &clk_name="gcc_pcie_0_cfg_ahb_clk"
    &clk_reg_cbcr_type="sm_cbc"
    &clk_vote_bit=-1.
    &clk_multiplier=4.

    gosub Print_Clk_Info_Line
  )

  &match=0
  &wild_head=0
  &wild_tail=0
  &clk_input_length=STRING.LENGTH("&clk")
  &clk_itr_length=STRING.LENGTH("gcc_pimem_ahb_clk")

  if (STRING.SCAN("&clk", "*", 0)==0)
  (
    &wild_head=1
  )
  if (STRING.SCAN("&clk", "*", 1)==(STRING.LENGTH("&clk")-1))
  (
    &wild_tail=1
  )

  if ((&wild_head==1)&&(&wild_tail==1))
  (
    if (STRING.SCAN("gcc_pimem_ahb_clk", STRING.MID("&clk", 1, &clk_input_length-2), 0)!=-1)
    ( 
      &match=1
    )
  )
  else if (&wild_head==1)
  (
    if (STRING.MID("gcc_pimem_ahb_clk", &clk_itr_length-&clk_input_length+1, &clk_input_length-1)==STRING.CUT("&clk", 1))
    ( 
      &match=1
    )
  )
  else if (&wild_tail==1)
  (
    if (STRING.MID("gcc_pimem_ahb_clk", 0, &clk_input_length-1)==STRING.CUT("&clk", -1))
    ( 
      &match=1
    )
  )
  else if ("gcc_pimem_ahb_clk"=="&clk")
  (
    &match=1
  )
  
  if (&match==1)
  (
    &clk_test=&CLK_TEST_GCC_PIMEM_AHB_CLK
    &clk_reg=&HWIO_GCC_PIMEM_AHB_CBCR_ADDR
    &clk_reg_name="GCC_PIMEM_AHB_CBCR"
    &clk_name="gcc_pimem_ahb_clk"
    &clk_reg_cbcr_type="sm_cbc"
    &clk_vote_bit=-1.
    &clk_multiplier=4.

    gosub Print_Clk_Info_Line
  )

  &match=0
  &wild_head=0
  &wild_tail=0
  &clk_input_length=STRING.LENGTH("&clk")
  &clk_itr_length=STRING.LENGTH("gcc_prng_ahb_clk")

  if (STRING.SCAN("&clk", "*", 0)==0)
  (
    &wild_head=1
  )
  if (STRING.SCAN("&clk", "*", 1)==(STRING.LENGTH("&clk")-1))
  (
    &wild_tail=1
  )

  if ((&wild_head==1)&&(&wild_tail==1))
  (
    if (STRING.SCAN("gcc_prng_ahb_clk", STRING.MID("&clk", 1, &clk_input_length-2), 0)!=-1)
    ( 
      &match=1
    )
  )
  else if (&wild_head==1)
  (
    if (STRING.MID("gcc_prng_ahb_clk", &clk_itr_length-&clk_input_length+1, &clk_input_length-1)==STRING.CUT("&clk", 1))
    ( 
      &match=1
    )
  )
  else if (&wild_tail==1)
  (
    if (STRING.MID("gcc_prng_ahb_clk", 0, &clk_input_length-1)==STRING.CUT("&clk", -1))
    ( 
      &match=1
    )
  )
  else if ("gcc_prng_ahb_clk"=="&clk")
  (
    &match=1
  )
  
  if (&match==1)
  (
    &clk_test=&CLK_TEST_GCC_PRNG_AHB_CLK
    &clk_reg=&HWIO_GCC_PRNG_AHB_CBCR_ADDR
    &clk_reg_name="GCC_PRNG_AHB_CBCR"
    &clk_name="gcc_prng_ahb_clk"
    &clk_reg_cbcr_type="sm_cbc"
    &clk_vote_bit=13.
    &clk_multiplier=4.

    gosub Print_Clk_Info_Line
  )

  &match=0
  &wild_head=0
  &wild_tail=0
  &clk_input_length=STRING.LENGTH("&clk")
  &clk_itr_length=STRING.LENGTH("gcc_qdss_cfg_ahb_clk")

  if (STRING.SCAN("&clk", "*", 0)==0)
  (
    &wild_head=1
  )
  if (STRING.SCAN("&clk", "*", 1)==(STRING.LENGTH("&clk")-1))
  (
    &wild_tail=1
  )

  if ((&wild_head==1)&&(&wild_tail==1))
  (
    if (STRING.SCAN("gcc_qdss_cfg_ahb_clk", STRING.MID("&clk", 1, &clk_input_length-2), 0)!=-1)
    ( 
      &match=1
    )
  )
  else if (&wild_head==1)
  (
    if (STRING.MID("gcc_qdss_cfg_ahb_clk", &clk_itr_length-&clk_input_length+1, &clk_input_length-1)==STRING.CUT("&clk", 1))
    ( 
      &match=1
    )
  )
  else if (&wild_tail==1)
  (
    if (STRING.MID("gcc_qdss_cfg_ahb_clk", 0, &clk_input_length-1)==STRING.CUT("&clk", -1))
    ( 
      &match=1
    )
  )
  else if ("gcc_qdss_cfg_ahb_clk"=="&clk")
  (
    &match=1
  )
  
  if (&match==1)
  (
    &clk_test=&CLK_TEST_GCC_QDSS_CFG_AHB_CLK
    &clk_reg=&HWIO_GCC_QDSS_CFG_AHB_CBCR_ADDR
    &clk_reg_name="GCC_QDSS_CFG_AHB_CBCR"
    &clk_name="gcc_qdss_cfg_ahb_clk"
    &clk_reg_cbcr_type="sm_cbc"
    &clk_vote_bit=37.
    &clk_multiplier=4.

    gosub Print_Clk_Info_Line
  )

  &match=0
  &wild_head=0
  &wild_tail=0
  &clk_input_length=STRING.LENGTH("&clk")
  &clk_itr_length=STRING.LENGTH("gcc_qdss_dap_ahb_clk")

  if (STRING.SCAN("&clk", "*", 0)==0)
  (
    &wild_head=1
  )
  if (STRING.SCAN("&clk", "*", 1)==(STRING.LENGTH("&clk")-1))
  (
    &wild_tail=1
  )

  if ((&wild_head==1)&&(&wild_tail==1))
  (
    if (STRING.SCAN("gcc_qdss_dap_ahb_clk", STRING.MID("&clk", 1, &clk_input_length-2), 0)!=-1)
    ( 
      &match=1
    )
  )
  else if (&wild_head==1)
  (
    if (STRING.MID("gcc_qdss_dap_ahb_clk", &clk_itr_length-&clk_input_length+1, &clk_input_length-1)==STRING.CUT("&clk", 1))
    ( 
      &match=1
    )
  )
  else if (&wild_tail==1)
  (
    if (STRING.MID("gcc_qdss_dap_ahb_clk", 0, &clk_input_length-1)==STRING.CUT("&clk", -1))
    ( 
      &match=1
    )
  )
  else if ("gcc_qdss_dap_ahb_clk"=="&clk")
  (
    &match=1
  )
  
  if (&match==1)
  (
    &clk_test=&CLK_TEST_GCC_QDSS_DAP_AHB_CLK
    &clk_reg=&HWIO_GCC_QDSS_DAP_AHB_CBCR_ADDR
    &clk_reg_name="GCC_QDSS_DAP_AHB_CBCR"
    &clk_name="gcc_qdss_dap_ahb_clk"
    &clk_reg_cbcr_type="sm_cbc"
    &clk_vote_bit=-1.
    &clk_multiplier=4.

    gosub Print_Clk_Info_Line
  )

  &match=0
  &wild_head=0
  &wild_tail=0
  &clk_input_length=STRING.LENGTH("&clk")
  &clk_itr_length=STRING.LENGTH("gcc_rbcpr_cx_ahb_clk")

  if (STRING.SCAN("&clk", "*", 0)==0)
  (
    &wild_head=1
  )
  if (STRING.SCAN("&clk", "*", 1)==(STRING.LENGTH("&clk")-1))
  (
    &wild_tail=1
  )

  if ((&wild_head==1)&&(&wild_tail==1))
  (
    if (STRING.SCAN("gcc_rbcpr_cx_ahb_clk", STRING.MID("&clk", 1, &clk_input_length-2), 0)!=-1)
    ( 
      &match=1
    )
  )
  else if (&wild_head==1)
  (
    if (STRING.MID("gcc_rbcpr_cx_ahb_clk", &clk_itr_length-&clk_input_length+1, &clk_input_length-1)==STRING.CUT("&clk", 1))
    ( 
      &match=1
    )
  )
  else if (&wild_tail==1)
  (
    if (STRING.MID("gcc_rbcpr_cx_ahb_clk", 0, &clk_input_length-1)==STRING.CUT("&clk", -1))
    ( 
      &match=1
    )
  )
  else if ("gcc_rbcpr_cx_ahb_clk"=="&clk")
  (
    &match=1
  )
  
  if (&match==1)
  (
    &clk_test=&CLK_TEST_GCC_RBCPR_CX_AHB_CLK
    &clk_reg=&HWIO_GCC_RBCPR_CX_AHB_CBCR_ADDR
    &clk_reg_name="GCC_RBCPR_CX_AHB_CBCR"
    &clk_name="gcc_rbcpr_cx_ahb_clk"
    &clk_reg_cbcr_type="sm_cbc"
    &clk_vote_bit=-1.
    &clk_multiplier=4.

    gosub Print_Clk_Info_Line
  )

  &match=0
  &wild_head=0
  &wild_tail=0
  &clk_input_length=STRING.LENGTH("&clk")
  &clk_itr_length=STRING.LENGTH("gcc_rbcpr_mx_ahb_clk")

  if (STRING.SCAN("&clk", "*", 0)==0)
  (
    &wild_head=1
  )
  if (STRING.SCAN("&clk", "*", 1)==(STRING.LENGTH("&clk")-1))
  (
    &wild_tail=1
  )

  if ((&wild_head==1)&&(&wild_tail==1))
  (
    if (STRING.SCAN("gcc_rbcpr_mx_ahb_clk", STRING.MID("&clk", 1, &clk_input_length-2), 0)!=-1)
    ( 
      &match=1
    )
  )
  else if (&wild_head==1)
  (
    if (STRING.MID("gcc_rbcpr_mx_ahb_clk", &clk_itr_length-&clk_input_length+1, &clk_input_length-1)==STRING.CUT("&clk", 1))
    ( 
      &match=1
    )
  )
  else if (&wild_tail==1)
  (
    if (STRING.MID("gcc_rbcpr_mx_ahb_clk", 0, &clk_input_length-1)==STRING.CUT("&clk", -1))
    ( 
      &match=1
    )
  )
  else if ("gcc_rbcpr_mx_ahb_clk"=="&clk")
  (
    &match=1
  )
  
  if (&match==1)
  (
    &clk_test=&CLK_TEST_GCC_RBCPR_MX_AHB_CLK
    &clk_reg=&HWIO_GCC_RBCPR_MX_AHB_CBCR_ADDR
    &clk_reg_name="GCC_RBCPR_MX_AHB_CBCR"
    &clk_name="gcc_rbcpr_mx_ahb_clk"
    &clk_reg_cbcr_type="sm_cbc"
    &clk_vote_bit=-1.
    &clk_multiplier=4.

    gosub Print_Clk_Info_Line
  )

  &match=0
  &wild_head=0
  &wild_tail=0
  &clk_input_length=STRING.LENGTH("&clk")
  &clk_itr_length=STRING.LENGTH("gcc_rpm_mst_m2_cnoc_ahb_clk")

  if (STRING.SCAN("&clk", "*", 0)==0)
  (
    &wild_head=1
  )
  if (STRING.SCAN("&clk", "*", 1)==(STRING.LENGTH("&clk")-1))
  (
    &wild_tail=1
  )

  if ((&wild_head==1)&&(&wild_tail==1))
  (
    if (STRING.SCAN("gcc_rpm_mst_m2_cnoc_ahb_clk", STRING.MID("&clk", 1, &clk_input_length-2), 0)!=-1)
    ( 
      &match=1
    )
  )
  else if (&wild_head==1)
  (
    if (STRING.MID("gcc_rpm_mst_m2_cnoc_ahb_clk", &clk_itr_length-&clk_input_length+1, &clk_input_length-1)==STRING.CUT("&clk", 1))
    ( 
      &match=1
    )
  )
  else if (&wild_tail==1)
  (
    if (STRING.MID("gcc_rpm_mst_m2_cnoc_ahb_clk", 0, &clk_input_length-1)==STRING.CUT("&clk", -1))
    ( 
      &match=1
    )
  )
  else if ("gcc_rpm_mst_m2_cnoc_ahb_clk"=="&clk")
  (
    &match=1
  )
  
  if (&match==1)
  (
    &clk_test=&CLK_TEST_GCC_RPM_MST_M2_CNOC_AHB_CLK
    &clk_reg=&HWIO_GCC_RPM_MST_M2_CNOC_AHB_CBCR_ADDR
    &clk_reg_name="GCC_RPM_MST_M2_CNOC_AHB_CBCR"
    &clk_name="gcc_rpm_mst_m2_cnoc_ahb_clk"
    &clk_reg_cbcr_type="sm_cbc"
    &clk_vote_bit=-1.
    &clk_multiplier=4.

    gosub Print_Clk_Info_Line
  )

  &match=0
  &wild_head=0
  &wild_tail=0
  &clk_input_length=STRING.LENGTH("&clk")
  &clk_itr_length=STRING.LENGTH("gcc_sec_ctrl_ahb_clk")

  if (STRING.SCAN("&clk", "*", 0)==0)
  (
    &wild_head=1
  )
  if (STRING.SCAN("&clk", "*", 1)==(STRING.LENGTH("&clk")-1))
  (
    &wild_tail=1
  )

  if ((&wild_head==1)&&(&wild_tail==1))
  (
    if (STRING.SCAN("gcc_sec_ctrl_ahb_clk", STRING.MID("&clk", 1, &clk_input_length-2), 0)!=-1)
    ( 
      &match=1
    )
  )
  else if (&wild_head==1)
  (
    if (STRING.MID("gcc_sec_ctrl_ahb_clk", &clk_itr_length-&clk_input_length+1, &clk_input_length-1)==STRING.CUT("&clk", 1))
    ( 
      &match=1
    )
  )
  else if (&wild_tail==1)
  (
    if (STRING.MID("gcc_sec_ctrl_ahb_clk", 0, &clk_input_length-1)==STRING.CUT("&clk", -1))
    ( 
      &match=1
    )
  )
  else if ("gcc_sec_ctrl_ahb_clk"=="&clk")
  (
    &match=1
  )
  
  if (&match==1)
  (
    &clk_test=&CLK_TEST_GCC_SEC_CTRL_AHB_CLK
    &clk_reg=&HWIO_GCC_SEC_CTRL_AHB_CBCR_ADDR
    &clk_reg_name="GCC_SEC_CTRL_AHB_CBCR"
    &clk_name="gcc_sec_ctrl_ahb_clk"
    &clk_reg_cbcr_type="sm_cbc"
    &clk_vote_bit=-1.
    &clk_multiplier=4.

    gosub Print_Clk_Info_Line
  )

  &match=0
  &wild_head=0
  &wild_tail=0
  &clk_input_length=STRING.LENGTH("&clk")
  &clk_itr_length=STRING.LENGTH("gcc_sec_ctrl_boot_rom_patch_clk")

  if (STRING.SCAN("&clk", "*", 0)==0)
  (
    &wild_head=1
  )
  if (STRING.SCAN("&clk", "*", 1)==(STRING.LENGTH("&clk")-1))
  (
    &wild_tail=1
  )

  if ((&wild_head==1)&&(&wild_tail==1))
  (
    if (STRING.SCAN("gcc_sec_ctrl_boot_rom_patch_clk", STRING.MID("&clk", 1, &clk_input_length-2), 0)!=-1)
    ( 
      &match=1
    )
  )
  else if (&wild_head==1)
  (
    if (STRING.MID("gcc_sec_ctrl_boot_rom_patch_clk", &clk_itr_length-&clk_input_length+1, &clk_input_length-1)==STRING.CUT("&clk", 1))
    ( 
      &match=1
    )
  )
  else if (&wild_tail==1)
  (
    if (STRING.MID("gcc_sec_ctrl_boot_rom_patch_clk", 0, &clk_input_length-1)==STRING.CUT("&clk", -1))
    ( 
      &match=1
    )
  )
  else if ("gcc_sec_ctrl_boot_rom_patch_clk"=="&clk")
  (
    &match=1
  )
  
  if (&match==1)
  (
    &clk_test=&CLK_TEST_GCC_SEC_CTRL_BOOT_ROM_PATCH_CLK
    &clk_reg=&HWIO_GCC_SEC_CTRL_BOOT_ROM_PATCH_CBCR_ADDR
    &clk_reg_name="GCC_SEC_CTRL_BOOT_ROM_PATCH_CBCR"
    &clk_name="gcc_sec_ctrl_boot_rom_patch_clk"
    &clk_reg_cbcr_type="sm_cbc"
    &clk_vote_bit=-1.
    &clk_multiplier=4.

    gosub Print_Clk_Info_Line
  )

  &match=0
  &wild_head=0
  &wild_tail=0
  &clk_input_length=STRING.LENGTH("&clk")
  &clk_itr_length=STRING.LENGTH("gcc_skl_ahb_clk")

  if (STRING.SCAN("&clk", "*", 0)==0)
  (
    &wild_head=1
  )
  if (STRING.SCAN("&clk", "*", 1)==(STRING.LENGTH("&clk")-1))
  (
    &wild_tail=1
  )

  if ((&wild_head==1)&&(&wild_tail==1))
  (
    if (STRING.SCAN("gcc_skl_ahb_clk", STRING.MID("&clk", 1, &clk_input_length-2), 0)!=-1)
    ( 
      &match=1
    )
  )
  else if (&wild_head==1)
  (
    if (STRING.MID("gcc_skl_ahb_clk", &clk_itr_length-&clk_input_length+1, &clk_input_length-1)==STRING.CUT("&clk", 1))
    ( 
      &match=1
    )
  )
  else if (&wild_tail==1)
  (
    if (STRING.MID("gcc_skl_ahb_clk", 0, &clk_input_length-1)==STRING.CUT("&clk", -1))
    ( 
      &match=1
    )
  )
  else if ("gcc_skl_ahb_clk"=="&clk")
  (
    &match=1
  )
  
  if (&match==1)
  (
    &clk_test=&CLK_TEST_GCC_SKL_AHB_CLK
    &clk_reg=&HWIO_GCC_SKL_AHB_CBCR_ADDR
    &clk_reg_name="GCC_SKL_AHB_CBCR"
    &clk_name="gcc_skl_ahb_clk"
    &clk_reg_cbcr_type="sm_cbc"
    &clk_vote_bit=-1.
    &clk_multiplier=4.

    gosub Print_Clk_Info_Line
  )

  &match=0
  &wild_head=0
  &wild_tail=0
  &clk_input_length=STRING.LENGTH("&clk")
  &clk_itr_length=STRING.LENGTH("gcc_smmu_aggre1_ahb_clk")

  if (STRING.SCAN("&clk", "*", 0)==0)
  (
    &wild_head=1
  )
  if (STRING.SCAN("&clk", "*", 1)==(STRING.LENGTH("&clk")-1))
  (
    &wild_tail=1
  )

  if ((&wild_head==1)&&(&wild_tail==1))
  (
    if (STRING.SCAN("gcc_smmu_aggre1_ahb_clk", STRING.MID("&clk", 1, &clk_input_length-2), 0)!=-1)
    ( 
      &match=1
    )
  )
  else if (&wild_head==1)
  (
    if (STRING.MID("gcc_smmu_aggre1_ahb_clk", &clk_itr_length-&clk_input_length+1, &clk_input_length-1)==STRING.CUT("&clk", 1))
    ( 
      &match=1
    )
  )
  else if (&wild_tail==1)
  (
    if (STRING.MID("gcc_smmu_aggre1_ahb_clk", 0, &clk_input_length-1)==STRING.CUT("&clk", -1))
    ( 
      &match=1
    )
  )
  else if ("gcc_smmu_aggre1_ahb_clk"=="&clk")
  (
    &match=1
  )
  
  if (&match==1)
  (
    &clk_test=&CLK_TEST_GCC_SMMU_AGGRE1_AHB_CLK
    &clk_reg=&HWIO_GCC_SMMU_AGGRE1_AHB_CBCR_ADDR
    &clk_reg_name="GCC_SMMU_AGGRE1_AHB_CBCR"
    &clk_name="gcc_smmu_aggre1_ahb_clk"
    &clk_reg_cbcr_type="sm_cbc"
    &clk_vote_bit=-1.
    &clk_multiplier=4.

    gosub Print_Clk_Info_Line
  )

  &match=0
  &wild_head=0
  &wild_tail=0
  &clk_input_length=STRING.LENGTH("&clk")
  &clk_itr_length=STRING.LENGTH("gcc_smmu_aggre2_ahb_clk")

  if (STRING.SCAN("&clk", "*", 0)==0)
  (
    &wild_head=1
  )
  if (STRING.SCAN("&clk", "*", 1)==(STRING.LENGTH("&clk")-1))
  (
    &wild_tail=1
  )

  if ((&wild_head==1)&&(&wild_tail==1))
  (
    if (STRING.SCAN("gcc_smmu_aggre2_ahb_clk", STRING.MID("&clk", 1, &clk_input_length-2), 0)!=-1)
    ( 
      &match=1
    )
  )
  else if (&wild_head==1)
  (
    if (STRING.MID("gcc_smmu_aggre2_ahb_clk", &clk_itr_length-&clk_input_length+1, &clk_input_length-1)==STRING.CUT("&clk", 1))
    ( 
      &match=1
    )
  )
  else if (&wild_tail==1)
  (
    if (STRING.MID("gcc_smmu_aggre2_ahb_clk", 0, &clk_input_length-1)==STRING.CUT("&clk", -1))
    ( 
      &match=1
    )
  )
  else if ("gcc_smmu_aggre2_ahb_clk"=="&clk")
  (
    &match=1
  )
  
  if (&match==1)
  (
    &clk_test=&CLK_TEST_GCC_SMMU_AGGRE2_AHB_CLK
    &clk_reg=&HWIO_GCC_SMMU_AGGRE2_AHB_CBCR_ADDR
    &clk_reg_name="GCC_SMMU_AGGRE2_AHB_CBCR"
    &clk_name="gcc_smmu_aggre2_ahb_clk"
    &clk_reg_cbcr_type="sm_cbc"
    &clk_vote_bit=-1.
    &clk_multiplier=4.

    gosub Print_Clk_Info_Line
  )

  &match=0
  &wild_head=0
  &wild_tail=0
  &clk_input_length=STRING.LENGTH("&clk")
  &clk_itr_length=STRING.LENGTH("gcc_snoc_cnoc_ahb_clk")

  if (STRING.SCAN("&clk", "*", 0)==0)
  (
    &wild_head=1
  )
  if (STRING.SCAN("&clk", "*", 1)==(STRING.LENGTH("&clk")-1))
  (
    &wild_tail=1
  )

  if ((&wild_head==1)&&(&wild_tail==1))
  (
    if (STRING.SCAN("gcc_snoc_cnoc_ahb_clk", STRING.MID("&clk", 1, &clk_input_length-2), 0)!=-1)
    ( 
      &match=1
    )
  )
  else if (&wild_head==1)
  (
    if (STRING.MID("gcc_snoc_cnoc_ahb_clk", &clk_itr_length-&clk_input_length+1, &clk_input_length-1)==STRING.CUT("&clk", 1))
    ( 
      &match=1
    )
  )
  else if (&wild_tail==1)
  (
    if (STRING.MID("gcc_snoc_cnoc_ahb_clk", 0, &clk_input_length-1)==STRING.CUT("&clk", -1))
    ( 
      &match=1
    )
  )
  else if ("gcc_snoc_cnoc_ahb_clk"=="&clk")
  (
    &match=1
  )
  
  if (&match==1)
  (
    &clk_test=&CLK_TEST_GCC_SNOC_CNOC_AHB_CLK
    &clk_reg=&HWIO_GCC_SNOC_CNOC_AHB_CBCR_ADDR
    &clk_reg_name="GCC_SNOC_CNOC_AHB_CBCR"
    &clk_name="gcc_snoc_cnoc_ahb_clk"
    &clk_reg_cbcr_type="sm_cbc"
    &clk_vote_bit=-1.
    &clk_multiplier=4.

    gosub Print_Clk_Info_Line
  )

  &match=0
  &wild_head=0
  &wild_tail=0
  &clk_input_length=STRING.LENGTH("&clk")
  &clk_itr_length=STRING.LENGTH("gcc_spdm_cfg_ahb_clk")

  if (STRING.SCAN("&clk", "*", 0)==0)
  (
    &wild_head=1
  )
  if (STRING.SCAN("&clk", "*", 1)==(STRING.LENGTH("&clk")-1))
  (
    &wild_tail=1
  )

  if ((&wild_head==1)&&(&wild_tail==1))
  (
    if (STRING.SCAN("gcc_spdm_cfg_ahb_clk", STRING.MID("&clk", 1, &clk_input_length-2), 0)!=-1)
    ( 
      &match=1
    )
  )
  else if (&wild_head==1)
  (
    if (STRING.MID("gcc_spdm_cfg_ahb_clk", &clk_itr_length-&clk_input_length+1, &clk_input_length-1)==STRING.CUT("&clk", 1))
    ( 
      &match=1
    )
  )
  else if (&wild_tail==1)
  (
    if (STRING.MID("gcc_spdm_cfg_ahb_clk", 0, &clk_input_length-1)==STRING.CUT("&clk", -1))
    ( 
      &match=1
    )
  )
  else if ("gcc_spdm_cfg_ahb_clk"=="&clk")
  (
    &match=1
  )
  
  if (&match==1)
  (
    &clk_test=&CLK_TEST_GCC_SPDM_CFG_AHB_CLK
    &clk_reg=&HWIO_GCC_SPDM_CFG_AHB_CBCR_ADDR
    &clk_reg_name="GCC_SPDM_CFG_AHB_CBCR"
    &clk_name="gcc_spdm_cfg_ahb_clk"
    &clk_reg_cbcr_type="sm_cbc"
    &clk_vote_bit=-1.
    &clk_multiplier=4.

    gosub Print_Clk_Info_Line
  )

  &match=0
  &wild_head=0
  &wild_tail=0
  &clk_input_length=STRING.LENGTH("&clk")
  &clk_itr_length=STRING.LENGTH("gcc_spdm_mstr_ahb_clk")

  if (STRING.SCAN("&clk", "*", 0)==0)
  (
    &wild_head=1
  )
  if (STRING.SCAN("&clk", "*", 1)==(STRING.LENGTH("&clk")-1))
  (
    &wild_tail=1
  )

  if ((&wild_head==1)&&(&wild_tail==1))
  (
    if (STRING.SCAN("gcc_spdm_mstr_ahb_clk", STRING.MID("&clk", 1, &clk_input_length-2), 0)!=-1)
    ( 
      &match=1
    )
  )
  else if (&wild_head==1)
  (
    if (STRING.MID("gcc_spdm_mstr_ahb_clk", &clk_itr_length-&clk_input_length+1, &clk_input_length-1)==STRING.CUT("&clk", 1))
    ( 
      &match=1
    )
  )
  else if (&wild_tail==1)
  (
    if (STRING.MID("gcc_spdm_mstr_ahb_clk", 0, &clk_input_length-1)==STRING.CUT("&clk", -1))
    ( 
      &match=1
    )
  )
  else if ("gcc_spdm_mstr_ahb_clk"=="&clk")
  (
    &match=1
  )
  
  if (&match==1)
  (
    &clk_test=&CLK_TEST_GCC_SPDM_MSTR_AHB_CLK
    &clk_reg=&HWIO_GCC_SPDM_MSTR_AHB_CBCR_ADDR
    &clk_reg_name="GCC_SPDM_MSTR_AHB_CBCR"
    &clk_name="gcc_spdm_mstr_ahb_clk"
    &clk_reg_cbcr_type="sm_cbc"
    &clk_vote_bit=-1.
    &clk_multiplier=4.

    gosub Print_Clk_Info_Line
  )

  &match=0
  &wild_head=0
  &wild_tail=0
  &clk_input_length=STRING.LENGTH("&clk")
  &clk_itr_length=STRING.LENGTH("gcc_spmi_cnoc_ahb_clk")

  if (STRING.SCAN("&clk", "*", 0)==0)
  (
    &wild_head=1
  )
  if (STRING.SCAN("&clk", "*", 1)==(STRING.LENGTH("&clk")-1))
  (
    &wild_tail=1
  )

  if ((&wild_head==1)&&(&wild_tail==1))
  (
    if (STRING.SCAN("gcc_spmi_cnoc_ahb_clk", STRING.MID("&clk", 1, &clk_input_length-2), 0)!=-1)
    ( 
      &match=1
    )
  )
  else if (&wild_head==1)
  (
    if (STRING.MID("gcc_spmi_cnoc_ahb_clk", &clk_itr_length-&clk_input_length+1, &clk_input_length-1)==STRING.CUT("&clk", 1))
    ( 
      &match=1
    )
  )
  else if (&wild_tail==1)
  (
    if (STRING.MID("gcc_spmi_cnoc_ahb_clk", 0, &clk_input_length-1)==STRING.CUT("&clk", -1))
    ( 
      &match=1
    )
  )
  else if ("gcc_spmi_cnoc_ahb_clk"=="&clk")
  (
    &match=1
  )
  
  if (&match==1)
  (
    &clk_test=&CLK_TEST_GCC_SPMI_CNOC_AHB_CLK
    &clk_reg=&HWIO_GCC_SPMI_CNOC_AHB_CBCR_ADDR
    &clk_reg_name="GCC_SPMI_CNOC_AHB_CBCR"
    &clk_name="gcc_spmi_cnoc_ahb_clk"
    &clk_reg_cbcr_type="sm_cbc"
    &clk_vote_bit=6.
    &clk_multiplier=4.

    gosub Print_Clk_Info_Line
  )

  &match=0
  &wild_head=0
  &wild_tail=0
  &clk_input_length=STRING.LENGTH("&clk")
  &clk_itr_length=STRING.LENGTH("gcc_spss_cfg_ahb_clk")

  if (STRING.SCAN("&clk", "*", 0)==0)
  (
    &wild_head=1
  )
  if (STRING.SCAN("&clk", "*", 1)==(STRING.LENGTH("&clk")-1))
  (
    &wild_tail=1
  )

  if ((&wild_head==1)&&(&wild_tail==1))
  (
    if (STRING.SCAN("gcc_spss_cfg_ahb_clk", STRING.MID("&clk", 1, &clk_input_length-2), 0)!=-1)
    ( 
      &match=1
    )
  )
  else if (&wild_head==1)
  (
    if (STRING.MID("gcc_spss_cfg_ahb_clk", &clk_itr_length-&clk_input_length+1, &clk_input_length-1)==STRING.CUT("&clk", 1))
    ( 
      &match=1
    )
  )
  else if (&wild_tail==1)
  (
    if (STRING.MID("gcc_spss_cfg_ahb_clk", 0, &clk_input_length-1)==STRING.CUT("&clk", -1))
    ( 
      &match=1
    )
  )
  else if ("gcc_spss_cfg_ahb_clk"=="&clk")
  (
    &match=1
  )
  
  if (&match==1)
  (
    &clk_test=&CLK_TEST_GCC_SPSS_CFG_AHB_CLK
    &clk_reg=&HWIO_GCC_SPSS_CFG_AHB_CBCR_ADDR
    &clk_reg_name="GCC_SPSS_CFG_AHB_CBCR"
    &clk_name="gcc_spss_cfg_ahb_clk"
    &clk_reg_cbcr_type="sm_cbc"
    &clk_vote_bit=-1.
    &clk_multiplier=4.

    gosub Print_Clk_Info_Line
  )

  &match=0
  &wild_head=0
  &wild_tail=0
  &clk_input_length=STRING.LENGTH("&clk")
  &clk_itr_length=STRING.LENGTH("gcc_spss_scsr_clk")

  if (STRING.SCAN("&clk", "*", 0)==0)
  (
    &wild_head=1
  )
  if (STRING.SCAN("&clk", "*", 1)==(STRING.LENGTH("&clk")-1))
  (
    &wild_tail=1
  )

  if ((&wild_head==1)&&(&wild_tail==1))
  (
    if (STRING.SCAN("gcc_spss_scsr_clk", STRING.MID("&clk", 1, &clk_input_length-2), 0)!=-1)
    ( 
      &match=1
    )
  )
  else if (&wild_head==1)
  (
    if (STRING.MID("gcc_spss_scsr_clk", &clk_itr_length-&clk_input_length+1, &clk_input_length-1)==STRING.CUT("&clk", 1))
    ( 
      &match=1
    )
  )
  else if (&wild_tail==1)
  (
    if (STRING.MID("gcc_spss_scsr_clk", 0, &clk_input_length-1)==STRING.CUT("&clk", -1))
    ( 
      &match=1
    )
  )
  else if ("gcc_spss_scsr_clk"=="&clk")
  (
    &match=1
  )
  
  if (&match==1)
  (
    &clk_test=&CLK_TEST_GCC_SPSS_SCSR_CLK
    &clk_reg=&HWIO_GCC_SPSS_SCSR_CBCR_ADDR
    &clk_reg_name="GCC_SPSS_SCSR_CBCR"
    &clk_name="gcc_spss_scsr_clk"
    &clk_reg_cbcr_type="sm_cbc"
    &clk_vote_bit=-1.
    &clk_multiplier=4.

    gosub Print_Clk_Info_Line
  )

  &match=0
  &wild_head=0
  &wild_tail=0
  &clk_input_length=STRING.LENGTH("&clk")
  &clk_itr_length=STRING.LENGTH("gcc_ssc_cnoc_ahbs_clk")

  if (STRING.SCAN("&clk", "*", 0)==0)
  (
    &wild_head=1
  )
  if (STRING.SCAN("&clk", "*", 1)==(STRING.LENGTH("&clk")-1))
  (
    &wild_tail=1
  )

  if ((&wild_head==1)&&(&wild_tail==1))
  (
    if (STRING.SCAN("gcc_ssc_cnoc_ahbs_clk", STRING.MID("&clk", 1, &clk_input_length-2), 0)!=-1)
    ( 
      &match=1
    )
  )
  else if (&wild_head==1)
  (
    if (STRING.MID("gcc_ssc_cnoc_ahbs_clk", &clk_itr_length-&clk_input_length+1, &clk_input_length-1)==STRING.CUT("&clk", 1))
    ( 
      &match=1
    )
  )
  else if (&wild_tail==1)
  (
    if (STRING.MID("gcc_ssc_cnoc_ahbs_clk", 0, &clk_input_length-1)==STRING.CUT("&clk", -1))
    ( 
      &match=1
    )
  )
  else if ("gcc_ssc_cnoc_ahbs_clk"=="&clk")
  (
    &match=1
  )
  
  if (&match==1)
  (
    &clk_test=&CLK_TEST_GCC_SSC_CNOC_AHBS_CLK
    &clk_reg=&HWIO_GCC_SSC_CNOC_AHBS_CBCR_ADDR
    &clk_reg_name="GCC_SSC_CNOC_AHBS_CBCR"
    &clk_name="gcc_ssc_cnoc_ahbs_clk"
    &clk_reg_cbcr_type="sm_cbc"
    &clk_vote_bit=-1.
    &clk_multiplier=4.

    gosub Print_Clk_Info_Line
  )

  &match=0
  &wild_head=0
  &wild_tail=0
  &clk_input_length=STRING.LENGTH("&clk")
  &clk_itr_length=STRING.LENGTH("gcc_ssc_cnoc_mpu_clk")

  if (STRING.SCAN("&clk", "*", 0)==0)
  (
    &wild_head=1
  )
  if (STRING.SCAN("&clk", "*", 1)==(STRING.LENGTH("&clk")-1))
  (
    &wild_tail=1
  )

  if ((&wild_head==1)&&(&wild_tail==1))
  (
    if (STRING.SCAN("gcc_ssc_cnoc_mpu_clk", STRING.MID("&clk", 1, &clk_input_length-2), 0)!=-1)
    ( 
      &match=1
    )
  )
  else if (&wild_head==1)
  (
    if (STRING.MID("gcc_ssc_cnoc_mpu_clk", &clk_itr_length-&clk_input_length+1, &clk_input_length-1)==STRING.CUT("&clk", 1))
    ( 
      &match=1
    )
  )
  else if (&wild_tail==1)
  (
    if (STRING.MID("gcc_ssc_cnoc_mpu_clk", 0, &clk_input_length-1)==STRING.CUT("&clk", -1))
    ( 
      &match=1
    )
  )
  else if ("gcc_ssc_cnoc_mpu_clk"=="&clk")
  (
    &match=1
  )
  
  if (&match==1)
  (
    &clk_test=&CLK_TEST_GCC_SSC_CNOC_MPU_CLK
    &clk_reg=&HWIO_GCC_SSC_CNOC_MPU_CBCR_ADDR
    &clk_reg_name="GCC_SSC_CNOC_MPU_CBCR"
    &clk_name="gcc_ssc_cnoc_mpu_clk"
    &clk_reg_cbcr_type="sm_cbc"
    &clk_vote_bit=-1.
    &clk_multiplier=4.

    gosub Print_Clk_Info_Line
  )

  &match=0
  &wild_head=0
  &wild_tail=0
  &clk_input_length=STRING.LENGTH("&clk")
  &clk_itr_length=STRING.LENGTH("gcc_tcsr_ahb_clk")

  if (STRING.SCAN("&clk", "*", 0)==0)
  (
    &wild_head=1
  )
  if (STRING.SCAN("&clk", "*", 1)==(STRING.LENGTH("&clk")-1))
  (
    &wild_tail=1
  )

  if ((&wild_head==1)&&(&wild_tail==1))
  (
    if (STRING.SCAN("gcc_tcsr_ahb_clk", STRING.MID("&clk", 1, &clk_input_length-2), 0)!=-1)
    ( 
      &match=1
    )
  )
  else if (&wild_head==1)
  (
    if (STRING.MID("gcc_tcsr_ahb_clk", &clk_itr_length-&clk_input_length+1, &clk_input_length-1)==STRING.CUT("&clk", 1))
    ( 
      &match=1
    )
  )
  else if (&wild_tail==1)
  (
    if (STRING.MID("gcc_tcsr_ahb_clk", 0, &clk_input_length-1)==STRING.CUT("&clk", -1))
    ( 
      &match=1
    )
  )
  else if ("gcc_tcsr_ahb_clk"=="&clk")
  (
    &match=1
  )
  
  if (&match==1)
  (
    &clk_test=&CLK_TEST_GCC_TCSR_AHB_CLK
    &clk_reg=&HWIO_GCC_TCSR_AHB_CBCR_ADDR
    &clk_reg_name="GCC_TCSR_AHB_CBCR"
    &clk_name="gcc_tcsr_ahb_clk"
    &clk_reg_cbcr_type="sm_cbc"
    &clk_vote_bit=31.
    &clk_multiplier=4.

    gosub Print_Clk_Info_Line
  )

  &match=0
  &wild_head=0
  &wild_tail=0
  &clk_input_length=STRING.LENGTH("&clk")
  &clk_itr_length=STRING.LENGTH("gcc_tic_cfg_ahb_clk")

  if (STRING.SCAN("&clk", "*", 0)==0)
  (
    &wild_head=1
  )
  if (STRING.SCAN("&clk", "*", 1)==(STRING.LENGTH("&clk")-1))
  (
    &wild_tail=1
  )

  if ((&wild_head==1)&&(&wild_tail==1))
  (
    if (STRING.SCAN("gcc_tic_cfg_ahb_clk", STRING.MID("&clk", 1, &clk_input_length-2), 0)!=-1)
    ( 
      &match=1
    )
  )
  else if (&wild_head==1)
  (
    if (STRING.MID("gcc_tic_cfg_ahb_clk", &clk_itr_length-&clk_input_length+1, &clk_input_length-1)==STRING.CUT("&clk", 1))
    ( 
      &match=1
    )
  )
  else if (&wild_tail==1)
  (
    if (STRING.MID("gcc_tic_cfg_ahb_clk", 0, &clk_input_length-1)==STRING.CUT("&clk", -1))
    ( 
      &match=1
    )
  )
  else if ("gcc_tic_cfg_ahb_clk"=="&clk")
  (
    &match=1
  )
  
  if (&match==1)
  (
    &clk_test=&CLK_TEST_GCC_TIC_CFG_AHB_CLK
    &clk_reg=&HWIO_GCC_TIC_CFG_AHB_CBCR_ADDR
    &clk_reg_name="GCC_TIC_CFG_AHB_CBCR"
    &clk_name="gcc_tic_cfg_ahb_clk"
    &clk_reg_cbcr_type="sm_pscbc"
    &clk_vote_bit=-1.
    &clk_multiplier=4.

    gosub Print_Clk_Info_Line
  )

  &match=0
  &wild_head=0
  &wild_tail=0
  &clk_input_length=STRING.LENGTH("&clk")
  &clk_itr_length=STRING.LENGTH("gcc_tlmm_clk")

  if (STRING.SCAN("&clk", "*", 0)==0)
  (
    &wild_head=1
  )
  if (STRING.SCAN("&clk", "*", 1)==(STRING.LENGTH("&clk")-1))
  (
    &wild_tail=1
  )

  if ((&wild_head==1)&&(&wild_tail==1))
  (
    if (STRING.SCAN("gcc_tlmm_clk", STRING.MID("&clk", 1, &clk_input_length-2), 0)!=-1)
    ( 
      &match=1
    )
  )
  else if (&wild_head==1)
  (
    if (STRING.MID("gcc_tlmm_clk", &clk_itr_length-&clk_input_length+1, &clk_input_length-1)==STRING.CUT("&clk", 1))
    ( 
      &match=1
    )
  )
  else if (&wild_tail==1)
  (
    if (STRING.MID("gcc_tlmm_clk", 0, &clk_input_length-1)==STRING.CUT("&clk", -1))
    ( 
      &match=1
    )
  )
  else if ("gcc_tlmm_clk"=="&clk")
  (
    &match=1
  )
  
  if (&match==1)
  (
    &clk_test=&CLK_TEST_GCC_TLMM_CLK
    &clk_reg=&HWIO_GCC_TLMM_CBCR_ADDR
    &clk_reg_name="GCC_TLMM_CBCR"
    &clk_name="gcc_tlmm_clk"
    &clk_reg_cbcr_type="sm_cbc"
    &clk_vote_bit=7.
    &clk_multiplier=4.

    gosub Print_Clk_Info_Line
  )

  &match=0
  &wild_head=0
  &wild_tail=0
  &clk_input_length=STRING.LENGTH("&clk")
  &clk_itr_length=STRING.LENGTH("gcc_tlmm_east_ahb_clk")

  if (STRING.SCAN("&clk", "*", 0)==0)
  (
    &wild_head=1
  )
  if (STRING.SCAN("&clk", "*", 1)==(STRING.LENGTH("&clk")-1))
  (
    &wild_tail=1
  )

  if ((&wild_head==1)&&(&wild_tail==1))
  (
    if (STRING.SCAN("gcc_tlmm_east_ahb_clk", STRING.MID("&clk", 1, &clk_input_length-2), 0)!=-1)
    ( 
      &match=1
    )
  )
  else if (&wild_head==1)
  (
    if (STRING.MID("gcc_tlmm_east_ahb_clk", &clk_itr_length-&clk_input_length+1, &clk_input_length-1)==STRING.CUT("&clk", 1))
    ( 
      &match=1
    )
  )
  else if (&wild_tail==1)
  (
    if (STRING.MID("gcc_tlmm_east_ahb_clk", 0, &clk_input_length-1)==STRING.CUT("&clk", -1))
    ( 
      &match=1
    )
  )
  else if ("gcc_tlmm_east_ahb_clk"=="&clk")
  (
    &match=1
  )
  
  if (&match==1)
  (
    &clk_test=&CLK_TEST_GCC_TLMM_EAST_AHB_CLK
    &clk_reg=&HWIO_GCC_TLMM_EAST_AHB_CBCR_ADDR
    &clk_reg_name="GCC_TLMM_EAST_AHB_CBCR"
    &clk_name="gcc_tlmm_east_ahb_clk"
    &clk_reg_cbcr_type="sm_cbc"
    &clk_vote_bit=12.
    &clk_multiplier=4.

    gosub Print_Clk_Info_Line
  )

  &match=0
  &wild_head=0
  &wild_tail=0
  &clk_input_length=STRING.LENGTH("&clk")
  &clk_itr_length=STRING.LENGTH("gcc_tlmm_north_ahb_clk")

  if (STRING.SCAN("&clk", "*", 0)==0)
  (
    &wild_head=1
  )
  if (STRING.SCAN("&clk", "*", 1)==(STRING.LENGTH("&clk")-1))
  (
    &wild_tail=1
  )

  if ((&wild_head==1)&&(&wild_tail==1))
  (
    if (STRING.SCAN("gcc_tlmm_north_ahb_clk", STRING.MID("&clk", 1, &clk_input_length-2), 0)!=-1)
    ( 
      &match=1
    )
  )
  else if (&wild_head==1)
  (
    if (STRING.MID("gcc_tlmm_north_ahb_clk", &clk_itr_length-&clk_input_length+1, &clk_input_length-1)==STRING.CUT("&clk", 1))
    ( 
      &match=1
    )
  )
  else if (&wild_tail==1)
  (
    if (STRING.MID("gcc_tlmm_north_ahb_clk", 0, &clk_input_length-1)==STRING.CUT("&clk", -1))
    ( 
      &match=1
    )
  )
  else if ("gcc_tlmm_north_ahb_clk"=="&clk")
  (
    &match=1
  )
  
  if (&match==1)
  (
    &clk_test=&CLK_TEST_GCC_TLMM_NORTH_AHB_CLK
    &clk_reg=&HWIO_GCC_TLMM_NORTH_AHB_CBCR_ADDR
    &clk_reg_name="GCC_TLMM_NORTH_AHB_CBCR"
    &clk_name="gcc_tlmm_north_ahb_clk"
    &clk_reg_cbcr_type="sm_cbc"
    &clk_vote_bit=8.
    &clk_multiplier=4.

    gosub Print_Clk_Info_Line
  )

  &match=0
  &wild_head=0
  &wild_tail=0
  &clk_input_length=STRING.LENGTH("&clk")
  &clk_itr_length=STRING.LENGTH("gcc_tlmm_west_ahb_clk")

  if (STRING.SCAN("&clk", "*", 0)==0)
  (
    &wild_head=1
  )
  if (STRING.SCAN("&clk", "*", 1)==(STRING.LENGTH("&clk")-1))
  (
    &wild_tail=1
  )

  if ((&wild_head==1)&&(&wild_tail==1))
  (
    if (STRING.SCAN("gcc_tlmm_west_ahb_clk", STRING.MID("&clk", 1, &clk_input_length-2), 0)!=-1)
    ( 
      &match=1
    )
  )
  else if (&wild_head==1)
  (
    if (STRING.MID("gcc_tlmm_west_ahb_clk", &clk_itr_length-&clk_input_length+1, &clk_input_length-1)==STRING.CUT("&clk", 1))
    ( 
      &match=1
    )
  )
  else if (&wild_tail==1)
  (
    if (STRING.MID("gcc_tlmm_west_ahb_clk", 0, &clk_input_length-1)==STRING.CUT("&clk", -1))
    ( 
      &match=1
    )
  )
  else if ("gcc_tlmm_west_ahb_clk"=="&clk")
  (
    &match=1
  )
  
  if (&match==1)
  (
    &clk_test=&CLK_TEST_GCC_TLMM_WEST_AHB_CLK
    &clk_reg=&HWIO_GCC_TLMM_WEST_AHB_CBCR_ADDR
    &clk_reg_name="GCC_TLMM_WEST_AHB_CBCR"
    &clk_name="gcc_tlmm_west_ahb_clk"
    &clk_reg_cbcr_type="sm_cbc"
    &clk_vote_bit=11.
    &clk_multiplier=4.

    gosub Print_Clk_Info_Line
  )

  &match=0
  &wild_head=0
  &wild_tail=0
  &clk_input_length=STRING.LENGTH("&clk")
  &clk_itr_length=STRING.LENGTH("gcc_ufs_ahb_clk")

  if (STRING.SCAN("&clk", "*", 0)==0)
  (
    &wild_head=1
  )
  if (STRING.SCAN("&clk", "*", 1)==(STRING.LENGTH("&clk")-1))
  (
    &wild_tail=1
  )

  if ((&wild_head==1)&&(&wild_tail==1))
  (
    if (STRING.SCAN("gcc_ufs_ahb_clk", STRING.MID("&clk", 1, &clk_input_length-2), 0)!=-1)
    ( 
      &match=1
    )
  )
  else if (&wild_head==1)
  (
    if (STRING.MID("gcc_ufs_ahb_clk", &clk_itr_length-&clk_input_length+1, &clk_input_length-1)==STRING.CUT("&clk", 1))
    ( 
      &match=1
    )
  )
  else if (&wild_tail==1)
  (
    if (STRING.MID("gcc_ufs_ahb_clk", 0, &clk_input_length-1)==STRING.CUT("&clk", -1))
    ( 
      &match=1
    )
  )
  else if ("gcc_ufs_ahb_clk"=="&clk")
  (
    &match=1
  )
  
  if (&match==1)
  (
    &clk_test=&CLK_TEST_GCC_UFS_AHB_CLK
    &clk_reg=&HWIO_GCC_UFS_AHB_CBCR_ADDR
    &clk_reg_name="GCC_UFS_AHB_CBCR"
    &clk_name="gcc_ufs_ahb_clk"
    &clk_reg_cbcr_type="sm_cbc"
    &clk_vote_bit=-1.
    &clk_multiplier=4.

    gosub Print_Clk_Info_Line
  )

  &match=0
  &wild_head=0
  &wild_tail=0
  &clk_input_length=STRING.LENGTH("&clk")
  &clk_itr_length=STRING.LENGTH("gcc_spdm_debug_cy_clk")

  if (STRING.SCAN("&clk", "*", 0)==0)
  (
    &wild_head=1
  )
  if (STRING.SCAN("&clk", "*", 1)==(STRING.LENGTH("&clk")-1))
  (
    &wild_tail=1
  )

  if ((&wild_head==1)&&(&wild_tail==1))
  (
    if (STRING.SCAN("gcc_spdm_debug_cy_clk", STRING.MID("&clk", 1, &clk_input_length-2), 0)!=-1)
    ( 
      &match=1
    )
  )
  else if (&wild_head==1)
  (
    if (STRING.MID("gcc_spdm_debug_cy_clk", &clk_itr_length-&clk_input_length+1, &clk_input_length-1)==STRING.CUT("&clk", 1))
    ( 
      &match=1
    )
  )
  else if (&wild_tail==1)
  (
    if (STRING.MID("gcc_spdm_debug_cy_clk", 0, &clk_input_length-1)==STRING.CUT("&clk", -1))
    ( 
      &match=1
    )
  )
  else if ("gcc_spdm_debug_cy_clk"=="&clk")
  (
    &match=1
  )
  
  if (&match==1)
  (
    &clk_test=0
    &clk_reg=&HWIO_GCC_SPDM_DEBUG_CY_CBCR_ADDR
    &clk_reg_name="GCC_SPDM_DEBUG_CY_CBCR"
    &clk_name="gcc_spdm_debug_cy_clk"
    &clk_reg_cbcr_type="sm_cbc"
    &clk_vote_bit=-1.
    &clk_multiplier=4.

    gosub Print_Clk_Info_Line
  )

  &match=0
  &wild_head=0
  &wild_tail=0
  &clk_input_length=STRING.LENGTH("&clk")
  &clk_itr_length=STRING.LENGTH("gcc_bimc_sleep_clk")

  if (STRING.SCAN("&clk", "*", 0)==0)
  (
    &wild_head=1
  )
  if (STRING.SCAN("&clk", "*", 1)==(STRING.LENGTH("&clk")-1))
  (
    &wild_tail=1
  )

  if ((&wild_head==1)&&(&wild_tail==1))
  (
    if (STRING.SCAN("gcc_bimc_sleep_clk", STRING.MID("&clk", 1, &clk_input_length-2), 0)!=-1)
    ( 
      &match=1
    )
  )
  else if (&wild_head==1)
  (
    if (STRING.MID("gcc_bimc_sleep_clk", &clk_itr_length-&clk_input_length+1, &clk_input_length-1)==STRING.CUT("&clk", 1))
    ( 
      &match=1
    )
  )
  else if (&wild_tail==1)
  (
    if (STRING.MID("gcc_bimc_sleep_clk", 0, &clk_input_length-1)==STRING.CUT("&clk", -1))
    ( 
      &match=1
    )
  )
  else if ("gcc_bimc_sleep_clk"=="&clk")
  (
    &match=1
  )
  
  if (&match==1)
  (
    &clk_test=&CLK_TEST_GCC_BIMC_SLEEP_CLK
    &clk_reg=&HWIO_GCC_BIMC_SLEEP_CBCR_ADDR
    &clk_reg_name="GCC_BIMC_SLEEP_CBCR"
    &clk_name="gcc_bimc_sleep_clk"
    &clk_reg_cbcr_type="sm_cbc"
    &clk_vote_bit=-1.
    &clk_multiplier=4.

    gosub Print_Clk_Info_Line
  )

  &match=0
  &wild_head=0
  &wild_tail=0
  &clk_input_length=STRING.LENGTH("&clk")
  &clk_itr_length=STRING.LENGTH("gcc_blsp1_sleep_clk")

  if (STRING.SCAN("&clk", "*", 0)==0)
  (
    &wild_head=1
  )
  if (STRING.SCAN("&clk", "*", 1)==(STRING.LENGTH("&clk")-1))
  (
    &wild_tail=1
  )

  if ((&wild_head==1)&&(&wild_tail==1))
  (
    if (STRING.SCAN("gcc_blsp1_sleep_clk", STRING.MID("&clk", 1, &clk_input_length-2), 0)!=-1)
    ( 
      &match=1
    )
  )
  else if (&wild_head==1)
  (
    if (STRING.MID("gcc_blsp1_sleep_clk", &clk_itr_length-&clk_input_length+1, &clk_input_length-1)==STRING.CUT("&clk", 1))
    ( 
      &match=1
    )
  )
  else if (&wild_tail==1)
  (
    if (STRING.MID("gcc_blsp1_sleep_clk", 0, &clk_input_length-1)==STRING.CUT("&clk", -1))
    ( 
      &match=1
    )
  )
  else if ("gcc_blsp1_sleep_clk"=="&clk")
  (
    &match=1
  )
  
  if (&match==1)
  (
    &clk_test=&CLK_TEST_GCC_BLSP1_SLEEP_CLK
    &clk_reg=&HWIO_GCC_BLSP1_SLEEP_CBCR_ADDR
    &clk_reg_name="GCC_BLSP1_SLEEP_CBCR"
    &clk_name="gcc_blsp1_sleep_clk"
    &clk_reg_cbcr_type="sm_cbc"
    &clk_vote_bit=16.
    &clk_multiplier=4.

    gosub Print_Clk_Info_Line
  )

  &match=0
  &wild_head=0
  &wild_tail=0
  &clk_input_length=STRING.LENGTH("&clk")
  &clk_itr_length=STRING.LENGTH("gcc_blsp2_sleep_clk")

  if (STRING.SCAN("&clk", "*", 0)==0)
  (
    &wild_head=1
  )
  if (STRING.SCAN("&clk", "*", 1)==(STRING.LENGTH("&clk")-1))
  (
    &wild_tail=1
  )

  if ((&wild_head==1)&&(&wild_tail==1))
  (
    if (STRING.SCAN("gcc_blsp2_sleep_clk", STRING.MID("&clk", 1, &clk_input_length-2), 0)!=-1)
    ( 
      &match=1
    )
  )
  else if (&wild_head==1)
  (
    if (STRING.MID("gcc_blsp2_sleep_clk", &clk_itr_length-&clk_input_length+1, &clk_input_length-1)==STRING.CUT("&clk", 1))
    ( 
      &match=1
    )
  )
  else if (&wild_tail==1)
  (
    if (STRING.MID("gcc_blsp2_sleep_clk", 0, &clk_input_length-1)==STRING.CUT("&clk", -1))
    ( 
      &match=1
    )
  )
  else if ("gcc_blsp2_sleep_clk"=="&clk")
  (
    &match=1
  )
  
  if (&match==1)
  (
    &clk_test=&CLK_TEST_GCC_BLSP2_SLEEP_CLK
    &clk_reg=&HWIO_GCC_BLSP2_SLEEP_CBCR_ADDR
    &clk_reg_name="GCC_BLSP2_SLEEP_CBCR"
    &clk_name="gcc_blsp2_sleep_clk"
    &clk_reg_cbcr_type="sm_cbc"
    &clk_vote_bit=14.
    &clk_multiplier=4.

    gosub Print_Clk_Info_Line
  )

  &match=0
  &wild_head=0
  &wild_tail=0
  &clk_input_length=STRING.LENGTH("&clk")
  &clk_itr_length=STRING.LENGTH("gcc_ddr_dim_sleep_clk")

  if (STRING.SCAN("&clk", "*", 0)==0)
  (
    &wild_head=1
  )
  if (STRING.SCAN("&clk", "*", 1)==(STRING.LENGTH("&clk")-1))
  (
    &wild_tail=1
  )

  if ((&wild_head==1)&&(&wild_tail==1))
  (
    if (STRING.SCAN("gcc_ddr_dim_sleep_clk", STRING.MID("&clk", 1, &clk_input_length-2), 0)!=-1)
    ( 
      &match=1
    )
  )
  else if (&wild_head==1)
  (
    if (STRING.MID("gcc_ddr_dim_sleep_clk", &clk_itr_length-&clk_input_length+1, &clk_input_length-1)==STRING.CUT("&clk", 1))
    ( 
      &match=1
    )
  )
  else if (&wild_tail==1)
  (
    if (STRING.MID("gcc_ddr_dim_sleep_clk", 0, &clk_input_length-1)==STRING.CUT("&clk", -1))
    ( 
      &match=1
    )
  )
  else if ("gcc_ddr_dim_sleep_clk"=="&clk")
  (
    &match=1
  )
  
  if (&match==1)
  (
    &clk_test=&CLK_TEST_GCC_DDR_DIM_SLEEP_CLK
    &clk_reg=&HWIO_GCC_DDR_DIM_SLEEP_CBCR_ADDR
    &clk_reg_name="GCC_DDR_DIM_SLEEP_CBCR"
    &clk_name="gcc_ddr_dim_sleep_clk"
    &clk_reg_cbcr_type="sm_cbc"
    &clk_vote_bit=-1.
    &clk_multiplier=4.

    gosub Print_Clk_Info_Line
  )

  &match=0
  &wild_head=0
  &wild_tail=0
  &clk_input_length=STRING.LENGTH("&clk")
  &clk_itr_length=STRING.LENGTH("gcc_im_sleep_clk")

  if (STRING.SCAN("&clk", "*", 0)==0)
  (
    &wild_head=1
  )
  if (STRING.SCAN("&clk", "*", 1)==(STRING.LENGTH("&clk")-1))
  (
    &wild_tail=1
  )

  if ((&wild_head==1)&&(&wild_tail==1))
  (
    if (STRING.SCAN("gcc_im_sleep_clk", STRING.MID("&clk", 1, &clk_input_length-2), 0)!=-1)
    ( 
      &match=1
    )
  )
  else if (&wild_head==1)
  (
    if (STRING.MID("gcc_im_sleep_clk", &clk_itr_length-&clk_input_length+1, &clk_input_length-1)==STRING.CUT("&clk", 1))
    ( 
      &match=1
    )
  )
  else if (&wild_tail==1)
  (
    if (STRING.MID("gcc_im_sleep_clk", 0, &clk_input_length-1)==STRING.CUT("&clk", -1))
    ( 
      &match=1
    )
  )
  else if ("gcc_im_sleep_clk"=="&clk")
  (
    &match=1
  )
  
  if (&match==1)
  (
    &clk_test=&CLK_TEST_GCC_IM_SLEEP_CLK
    &clk_reg=&HWIO_GCC_GCC_IM_SLEEP_CBCR_ADDR
    &clk_reg_name="GCC_GCC_IM_SLEEP_CBCR"
    &clk_name="gcc_im_sleep_clk"
    &clk_reg_cbcr_type="sm_cbc"
    &clk_vote_bit=-1.
    &clk_multiplier=4.

    gosub Print_Clk_Info_Line
  )

  &match=0
  &wild_head=0
  &wild_tail=0
  &clk_input_length=STRING.LENGTH("&clk")
  &clk_itr_length=STRING.LENGTH("gcc_ipa_sleep_clk")

  if (STRING.SCAN("&clk", "*", 0)==0)
  (
    &wild_head=1
  )
  if (STRING.SCAN("&clk", "*", 1)==(STRING.LENGTH("&clk")-1))
  (
    &wild_tail=1
  )

  if ((&wild_head==1)&&(&wild_tail==1))
  (
    if (STRING.SCAN("gcc_ipa_sleep_clk", STRING.MID("&clk", 1, &clk_input_length-2), 0)!=-1)
    ( 
      &match=1
    )
  )
  else if (&wild_head==1)
  (
    if (STRING.MID("gcc_ipa_sleep_clk", &clk_itr_length-&clk_input_length+1, &clk_input_length-1)==STRING.CUT("&clk", 1))
    ( 
      &match=1
    )
  )
  else if (&wild_tail==1)
  (
    if (STRING.MID("gcc_ipa_sleep_clk", 0, &clk_input_length-1)==STRING.CUT("&clk", -1))
    ( 
      &match=1
    )
  )
  else if ("gcc_ipa_sleep_clk"=="&clk")
  (
    &match=1
  )
  
  if (&match==1)
  (
    &clk_test=&CLK_TEST_GCC_IPA_SLEEP_CLK
    &clk_reg=&HWIO_GCC_IPA_SLEEP_CBCR_ADDR
    &clk_reg_name="GCC_IPA_SLEEP_CBCR"
    &clk_name="gcc_ipa_sleep_clk"
    &clk_reg_cbcr_type="sm_cbc"
    &clk_vote_bit=-1.
    &clk_multiplier=4.

    gosub Print_Clk_Info_Line
  )

  &match=0
  &wild_head=0
  &wild_tail=0
  &clk_input_length=STRING.LENGTH("&clk")
  &clk_itr_length=STRING.LENGTH("gcc_rpm_sleep_clk")

  if (STRING.SCAN("&clk", "*", 0)==0)
  (
    &wild_head=1
  )
  if (STRING.SCAN("&clk", "*", 1)==(STRING.LENGTH("&clk")-1))
  (
    &wild_tail=1
  )

  if ((&wild_head==1)&&(&wild_tail==1))
  (
    if (STRING.SCAN("gcc_rpm_sleep_clk", STRING.MID("&clk", 1, &clk_input_length-2), 0)!=-1)
    ( 
      &match=1
    )
  )
  else if (&wild_head==1)
  (
    if (STRING.MID("gcc_rpm_sleep_clk", &clk_itr_length-&clk_input_length+1, &clk_input_length-1)==STRING.CUT("&clk", 1))
    ( 
      &match=1
    )
  )
  else if (&wild_tail==1)
  (
    if (STRING.MID("gcc_rpm_sleep_clk", 0, &clk_input_length-1)==STRING.CUT("&clk", -1))
    ( 
      &match=1
    )
  )
  else if ("gcc_rpm_sleep_clk"=="&clk")
  (
    &match=1
  )
  
  if (&match==1)
  (
    &clk_test=&CLK_TEST_GCC_RPM_SLEEP_CLK
    &clk_reg=&HWIO_GCC_RPM_SLEEP_CBCR_ADDR
    &clk_reg_name="GCC_RPM_SLEEP_CBCR"
    &clk_name="gcc_rpm_sleep_clk"
    &clk_reg_cbcr_type="sm_cbc"
    &clk_vote_bit=-1.
    &clk_multiplier=4.

    gosub Print_Clk_Info_Line
  )

  &match=0
  &wild_head=0
  &wild_tail=0
  &clk_input_length=STRING.LENGTH("&clk")
  &clk_itr_length=STRING.LENGTH("gcc_tsif_inactivity_timers_clk")

  if (STRING.SCAN("&clk", "*", 0)==0)
  (
    &wild_head=1
  )
  if (STRING.SCAN("&clk", "*", 1)==(STRING.LENGTH("&clk")-1))
  (
    &wild_tail=1
  )

  if ((&wild_head==1)&&(&wild_tail==1))
  (
    if (STRING.SCAN("gcc_tsif_inactivity_timers_clk", STRING.MID("&clk", 1, &clk_input_length-2), 0)!=-1)
    ( 
      &match=1
    )
  )
  else if (&wild_head==1)
  (
    if (STRING.MID("gcc_tsif_inactivity_timers_clk", &clk_itr_length-&clk_input_length+1, &clk_input_length-1)==STRING.CUT("&clk", 1))
    ( 
      &match=1
    )
  )
  else if (&wild_tail==1)
  (
    if (STRING.MID("gcc_tsif_inactivity_timers_clk", 0, &clk_input_length-1)==STRING.CUT("&clk", -1))
    ( 
      &match=1
    )
  )
  else if ("gcc_tsif_inactivity_timers_clk"=="&clk")
  (
    &match=1
  )
  
  if (&match==1)
  (
    &clk_test=&CLK_TEST_GCC_TSIF_INACTIVITY_TIMERS_CLK
    &clk_reg=&HWIO_GCC_TSIF_INACTIVITY_TIMERS_CBCR_ADDR
    &clk_reg_name="GCC_TSIF_INACTIVITY_TIMERS_CBCR"
    &clk_name="gcc_tsif_inactivity_timers_clk"
    &clk_reg_cbcr_type="sm_cbc"
    &clk_vote_bit=-1.
    &clk_multiplier=4.

    gosub Print_Clk_Info_Line
  )

  &match=0
  &wild_head=0
  &wild_tail=0
  &clk_input_length=STRING.LENGTH("&clk")
  &clk_itr_length=STRING.LENGTH("gcc_usb30_sleep_clk")

  if (STRING.SCAN("&clk", "*", 0)==0)
  (
    &wild_head=1
  )
  if (STRING.SCAN("&clk", "*", 1)==(STRING.LENGTH("&clk")-1))
  (
    &wild_tail=1
  )

  if ((&wild_head==1)&&(&wild_tail==1))
  (
    if (STRING.SCAN("gcc_usb30_sleep_clk", STRING.MID("&clk", 1, &clk_input_length-2), 0)!=-1)
    ( 
      &match=1
    )
  )
  else if (&wild_head==1)
  (
    if (STRING.MID("gcc_usb30_sleep_clk", &clk_itr_length-&clk_input_length+1, &clk_input_length-1)==STRING.CUT("&clk", 1))
    ( 
      &match=1
    )
  )
  else if (&wild_tail==1)
  (
    if (STRING.MID("gcc_usb30_sleep_clk", 0, &clk_input_length-1)==STRING.CUT("&clk", -1))
    ( 
      &match=1
    )
  )
  else if ("gcc_usb30_sleep_clk"=="&clk")
  (
    &match=1
  )
  
  if (&match==1)
  (
    &clk_test=&CLK_TEST_GCC_USB30_SLEEP_CLK
    &clk_reg=&HWIO_GCC_USB30_SLEEP_CBCR_ADDR
    &clk_reg_name="GCC_USB30_SLEEP_CBCR"
    &clk_name="gcc_usb30_sleep_clk"
    &clk_reg_cbcr_type="sm_cbc"
    &clk_vote_bit=-1.
    &clk_multiplier=4.

    gosub Print_Clk_Info_Line
  )

  &match=0
  &wild_head=0
  &wild_tail=0
  &clk_input_length=STRING.LENGTH("&clk")
  &clk_itr_length=STRING.LENGTH("gcc_aggre1_noc_xo_clk")

  if (STRING.SCAN("&clk", "*", 0)==0)
  (
    &wild_head=1
  )
  if (STRING.SCAN("&clk", "*", 1)==(STRING.LENGTH("&clk")-1))
  (
    &wild_tail=1
  )

  if ((&wild_head==1)&&(&wild_tail==1))
  (
    if (STRING.SCAN("gcc_aggre1_noc_xo_clk", STRING.MID("&clk", 1, &clk_input_length-2), 0)!=-1)
    ( 
      &match=1
    )
  )
  else if (&wild_head==1)
  (
    if (STRING.MID("gcc_aggre1_noc_xo_clk", &clk_itr_length-&clk_input_length+1, &clk_input_length-1)==STRING.CUT("&clk", 1))
    ( 
      &match=1
    )
  )
  else if (&wild_tail==1)
  (
    if (STRING.MID("gcc_aggre1_noc_xo_clk", 0, &clk_input_length-1)==STRING.CUT("&clk", -1))
    ( 
      &match=1
    )
  )
  else if ("gcc_aggre1_noc_xo_clk"=="&clk")
  (
    &match=1
  )
  
  if (&match==1)
  (
    &clk_test=&CLK_TEST_GCC_AGGRE1_NOC_XO_CLK
    &clk_reg=&HWIO_GCC_AGGRE1_NOC_XO_CBCR_ADDR
    &clk_reg_name="GCC_AGGRE1_NOC_XO_CBCR"
    &clk_name="gcc_aggre1_noc_xo_clk"
    &clk_reg_cbcr_type="sm_cbc"
    &clk_vote_bit=-1.
    &clk_multiplier=4.

    gosub Print_Clk_Info_Line
  )

  &match=0
  &wild_head=0
  &wild_tail=0
  &clk_input_length=STRING.LENGTH("&clk")
  &clk_itr_length=STRING.LENGTH("gcc_ahb2phy_east_clk")

  if (STRING.SCAN("&clk", "*", 0)==0)
  (
    &wild_head=1
  )
  if (STRING.SCAN("&clk", "*", 1)==(STRING.LENGTH("&clk")-1))
  (
    &wild_tail=1
  )

  if ((&wild_head==1)&&(&wild_tail==1))
  (
    if (STRING.SCAN("gcc_ahb2phy_east_clk", STRING.MID("&clk", 1, &clk_input_length-2), 0)!=-1)
    ( 
      &match=1
    )
  )
  else if (&wild_head==1)
  (
    if (STRING.MID("gcc_ahb2phy_east_clk", &clk_itr_length-&clk_input_length+1, &clk_input_length-1)==STRING.CUT("&clk", 1))
    ( 
      &match=1
    )
  )
  else if (&wild_tail==1)
  (
    if (STRING.MID("gcc_ahb2phy_east_clk", 0, &clk_input_length-1)==STRING.CUT("&clk", -1))
    ( 
      &match=1
    )
  )
  else if ("gcc_ahb2phy_east_clk"=="&clk")
  (
    &match=1
  )
  
  if (&match==1)
  (
    &clk_test=&CLK_TEST_GCC_AHB2PHY_EAST_CLK
    &clk_reg=&HWIO_GCC_AHB2PHY_EAST_CBCR_ADDR
    &clk_reg_name="GCC_AHB2PHY_EAST_CBCR"
    &clk_name="gcc_ahb2phy_east_clk"
    &clk_reg_cbcr_type="sm_cbc"
    &clk_vote_bit=-1.
    &clk_multiplier=4.

    gosub Print_Clk_Info_Line
  )

  &match=0
  &wild_head=0
  &wild_tail=0
  &clk_input_length=STRING.LENGTH("&clk")
  &clk_itr_length=STRING.LENGTH("gcc_cfg_noc_ah2phy_xo_clk")

  if (STRING.SCAN("&clk", "*", 0)==0)
  (
    &wild_head=1
  )
  if (STRING.SCAN("&clk", "*", 1)==(STRING.LENGTH("&clk")-1))
  (
    &wild_tail=1
  )

  if ((&wild_head==1)&&(&wild_tail==1))
  (
    if (STRING.SCAN("gcc_cfg_noc_ah2phy_xo_clk", STRING.MID("&clk", 1, &clk_input_length-2), 0)!=-1)
    ( 
      &match=1
    )
  )
  else if (&wild_head==1)
  (
    if (STRING.MID("gcc_cfg_noc_ah2phy_xo_clk", &clk_itr_length-&clk_input_length+1, &clk_input_length-1)==STRING.CUT("&clk", 1))
    ( 
      &match=1
    )
  )
  else if (&wild_tail==1)
  (
    if (STRING.MID("gcc_cfg_noc_ah2phy_xo_clk", 0, &clk_input_length-1)==STRING.CUT("&clk", -1))
    ( 
      &match=1
    )
  )
  else if ("gcc_cfg_noc_ah2phy_xo_clk"=="&clk")
  (
    &match=1
  )
  
  if (&match==1)
  (
    &clk_test=&CLK_TEST_GCC_CFG_NOC_AH2PHY_XO_CLK
    &clk_reg=&HWIO_GCC_CFG_NOC_AH2PHY_XO_CBCR_ADDR
    &clk_reg_name="GCC_CFG_NOC_AH2PHY_XO_CBCR"
    &clk_name="gcc_cfg_noc_ah2phy_xo_clk"
    &clk_reg_cbcr_type="sm_cbc"
    &clk_vote_bit=-1.
    &clk_multiplier=4.

    gosub Print_Clk_Info_Line
  )

  &match=0
  &wild_head=0
  &wild_tail=0
  &clk_input_length=STRING.LENGTH("&clk")
  &clk_itr_length=STRING.LENGTH("gcc_cfg_noc_dcd_xo_clk")

  if (STRING.SCAN("&clk", "*", 0)==0)
  (
    &wild_head=1
  )
  if (STRING.SCAN("&clk", "*", 1)==(STRING.LENGTH("&clk")-1))
  (
    &wild_tail=1
  )

  if ((&wild_head==1)&&(&wild_tail==1))
  (
    if (STRING.SCAN("gcc_cfg_noc_dcd_xo_clk", STRING.MID("&clk", 1, &clk_input_length-2), 0)!=-1)
    ( 
      &match=1
    )
  )
  else if (&wild_head==1)
  (
    if (STRING.MID("gcc_cfg_noc_dcd_xo_clk", &clk_itr_length-&clk_input_length+1, &clk_input_length-1)==STRING.CUT("&clk", 1))
    ( 
      &match=1
    )
  )
  else if (&wild_tail==1)
  (
    if (STRING.MID("gcc_cfg_noc_dcd_xo_clk", 0, &clk_input_length-1)==STRING.CUT("&clk", -1))
    ( 
      &match=1
    )
  )
  else if ("gcc_cfg_noc_dcd_xo_clk"=="&clk")
  (
    &match=1
  )
  
  if (&match==1)
  (
    &clk_test=&CLK_TEST_GCC_CFG_NOC_DCD_XO_CLK
    &clk_reg=&HWIO_GCC_CFG_NOC_DCD_XO_CBCR_ADDR
    &clk_reg_name="GCC_CFG_NOC_DCD_XO_CBCR"
    &clk_name="gcc_cfg_noc_dcd_xo_clk"
    &clk_reg_cbcr_type="sm_cbc"
    &clk_vote_bit=-1.
    &clk_multiplier=4.

    gosub Print_Clk_Info_Line
  )

  &match=0
  &wild_head=0
  &wild_tail=0
  &clk_input_length=STRING.LENGTH("&clk")
  &clk_itr_length=STRING.LENGTH("gcc_cfg_noc_east_dcd_xo_clk")

  if (STRING.SCAN("&clk", "*", 0)==0)
  (
    &wild_head=1
  )
  if (STRING.SCAN("&clk", "*", 1)==(STRING.LENGTH("&clk")-1))
  (
    &wild_tail=1
  )

  if ((&wild_head==1)&&(&wild_tail==1))
  (
    if (STRING.SCAN("gcc_cfg_noc_east_dcd_xo_clk", STRING.MID("&clk", 1, &clk_input_length-2), 0)!=-1)
    ( 
      &match=1
    )
  )
  else if (&wild_head==1)
  (
    if (STRING.MID("gcc_cfg_noc_east_dcd_xo_clk", &clk_itr_length-&clk_input_length+1, &clk_input_length-1)==STRING.CUT("&clk", 1))
    ( 
      &match=1
    )
  )
  else if (&wild_tail==1)
  (
    if (STRING.MID("gcc_cfg_noc_east_dcd_xo_clk", 0, &clk_input_length-1)==STRING.CUT("&clk", -1))
    ( 
      &match=1
    )
  )
  else if ("gcc_cfg_noc_east_dcd_xo_clk"=="&clk")
  (
    &match=1
  )
  
  if (&match==1)
  (
    &clk_test=&CLK_TEST_GCC_CFG_NOC_EAST_DCD_XO_CLK
    &clk_reg=&HWIO_GCC_CFG_NOC_EAST_DCD_XO_CBCR_ADDR
    &clk_reg_name="GCC_CFG_NOC_EAST_DCD_XO_CBCR"
    &clk_name="gcc_cfg_noc_east_dcd_xo_clk"
    &clk_reg_cbcr_type="sm_cbc"
    &clk_vote_bit=-1.
    &clk_multiplier=4.

    gosub Print_Clk_Info_Line
  )

  &match=0
  &wild_head=0
  &wild_tail=0
  &clk_input_length=STRING.LENGTH("&clk")
  &clk_itr_length=STRING.LENGTH("gcc_cfg_noc_north_dcd_xo_clk")

  if (STRING.SCAN("&clk", "*", 0)==0)
  (
    &wild_head=1
  )
  if (STRING.SCAN("&clk", "*", 1)==(STRING.LENGTH("&clk")-1))
  (
    &wild_tail=1
  )

  if ((&wild_head==1)&&(&wild_tail==1))
  (
    if (STRING.SCAN("gcc_cfg_noc_north_dcd_xo_clk", STRING.MID("&clk", 1, &clk_input_length-2), 0)!=-1)
    ( 
      &match=1
    )
  )
  else if (&wild_head==1)
  (
    if (STRING.MID("gcc_cfg_noc_north_dcd_xo_clk", &clk_itr_length-&clk_input_length+1, &clk_input_length-1)==STRING.CUT("&clk", 1))
    ( 
      &match=1
    )
  )
  else if (&wild_tail==1)
  (
    if (STRING.MID("gcc_cfg_noc_north_dcd_xo_clk", 0, &clk_input_length-1)==STRING.CUT("&clk", -1))
    ( 
      &match=1
    )
  )
  else if ("gcc_cfg_noc_north_dcd_xo_clk"=="&clk")
  (
    &match=1
  )
  
  if (&match==1)
  (
    &clk_test=&CLK_TEST_GCC_CFG_NOC_NORTH_DCD_XO_CLK
    &clk_reg=&HWIO_GCC_CFG_NOC_NORTH_DCD_XO_CBCR_ADDR
    &clk_reg_name="GCC_CFG_NOC_NORTH_DCD_XO_CBCR"
    &clk_name="gcc_cfg_noc_north_dcd_xo_clk"
    &clk_reg_cbcr_type="sm_cbc"
    &clk_vote_bit=-1.
    &clk_multiplier=4.

    gosub Print_Clk_Info_Line
  )

  &match=0
  &wild_head=0
  &wild_tail=0
  &clk_input_length=STRING.LENGTH("&clk")
  &clk_itr_length=STRING.LENGTH("gcc_cfg_noc_west_dcd_xo_clk")

  if (STRING.SCAN("&clk", "*", 0)==0)
  (
    &wild_head=1
  )
  if (STRING.SCAN("&clk", "*", 1)==(STRING.LENGTH("&clk")-1))
  (
    &wild_tail=1
  )

  if ((&wild_head==1)&&(&wild_tail==1))
  (
    if (STRING.SCAN("gcc_cfg_noc_west_dcd_xo_clk", STRING.MID("&clk", 1, &clk_input_length-2), 0)!=-1)
    ( 
      &match=1
    )
  )
  else if (&wild_head==1)
  (
    if (STRING.MID("gcc_cfg_noc_west_dcd_xo_clk", &clk_itr_length-&clk_input_length+1, &clk_input_length-1)==STRING.CUT("&clk", 1))
    ( 
      &match=1
    )
  )
  else if (&wild_tail==1)
  (
    if (STRING.MID("gcc_cfg_noc_west_dcd_xo_clk", 0, &clk_input_length-1)==STRING.CUT("&clk", -1))
    ( 
      &match=1
    )
  )
  else if ("gcc_cfg_noc_west_dcd_xo_clk"=="&clk")
  (
    &match=1
  )
  
  if (&match==1)
  (
    &clk_test=&CLK_TEST_GCC_CFG_NOC_WEST_DCD_XO_CLK
    &clk_reg=&HWIO_GCC_CFG_NOC_WEST_DCD_XO_CBCR_ADDR
    &clk_reg_name="GCC_CFG_NOC_WEST_DCD_XO_CBCR"
    &clk_name="gcc_cfg_noc_west_dcd_xo_clk"
    &clk_reg_cbcr_type="sm_cbc"
    &clk_vote_bit=-1.
    &clk_multiplier=4.

    gosub Print_Clk_Info_Line
  )

  &match=0
  &wild_head=0
  &wild_tail=0
  &clk_input_length=STRING.LENGTH("&clk")
  &clk_itr_length=STRING.LENGTH("gcc_cm_phy_refgen1_clk")

  if (STRING.SCAN("&clk", "*", 0)==0)
  (
    &wild_head=1
  )
  if (STRING.SCAN("&clk", "*", 1)==(STRING.LENGTH("&clk")-1))
  (
    &wild_tail=1
  )

  if ((&wild_head==1)&&(&wild_tail==1))
  (
    if (STRING.SCAN("gcc_cm_phy_refgen1_clk", STRING.MID("&clk", 1, &clk_input_length-2), 0)!=-1)
    ( 
      &match=1
    )
  )
  else if (&wild_head==1)
  (
    if (STRING.MID("gcc_cm_phy_refgen1_clk", &clk_itr_length-&clk_input_length+1, &clk_input_length-1)==STRING.CUT("&clk", 1))
    ( 
      &match=1
    )
  )
  else if (&wild_tail==1)
  (
    if (STRING.MID("gcc_cm_phy_refgen1_clk", 0, &clk_input_length-1)==STRING.CUT("&clk", -1))
    ( 
      &match=1
    )
  )
  else if ("gcc_cm_phy_refgen1_clk"=="&clk")
  (
    &match=1
  )
  
  if (&match==1)
  (
    &clk_test=&CLK_TEST_GCC_CM_PHY_REFGEN1_CLK
    &clk_reg=&HWIO_GCC_CM_PHY_REFGEN1_CBCR_ADDR
    &clk_reg_name="GCC_CM_PHY_REFGEN1_CBCR"
    &clk_name="gcc_cm_phy_refgen1_clk"
    &clk_reg_cbcr_type="sm_cbc"
    &clk_vote_bit=-1.
    &clk_multiplier=4.

    gosub Print_Clk_Info_Line
  )

  &match=0
  &wild_head=0
  &wild_tail=0
  &clk_input_length=STRING.LENGTH("&clk")
  &clk_itr_length=STRING.LENGTH("gcc_cm_phy_refgen2_clk")

  if (STRING.SCAN("&clk", "*", 0)==0)
  (
    &wild_head=1
  )
  if (STRING.SCAN("&clk", "*", 1)==(STRING.LENGTH("&clk")-1))
  (
    &wild_tail=1
  )

  if ((&wild_head==1)&&(&wild_tail==1))
  (
    if (STRING.SCAN("gcc_cm_phy_refgen2_clk", STRING.MID("&clk", 1, &clk_input_length-2), 0)!=-1)
    ( 
      &match=1
    )
  )
  else if (&wild_head==1)
  (
    if (STRING.MID("gcc_cm_phy_refgen2_clk", &clk_itr_length-&clk_input_length+1, &clk_input_length-1)==STRING.CUT("&clk", 1))
    ( 
      &match=1
    )
  )
  else if (&wild_tail==1)
  (
    if (STRING.MID("gcc_cm_phy_refgen2_clk", 0, &clk_input_length-1)==STRING.CUT("&clk", -1))
    ( 
      &match=1
    )
  )
  else if ("gcc_cm_phy_refgen2_clk"=="&clk")
  (
    &match=1
  )
  
  if (&match==1)
  (
    &clk_test=&CLK_TEST_GCC_CM_PHY_REFGEN2_CLK
    &clk_reg=&HWIO_GCC_CM_PHY_REFGEN2_CBCR_ADDR
    &clk_reg_name="GCC_CM_PHY_REFGEN2_CBCR"
    &clk_name="gcc_cm_phy_refgen2_clk"
    &clk_reg_cbcr_type="sm_cbc"
    &clk_vote_bit=-1.
    &clk_multiplier=4.

    gosub Print_Clk_Info_Line
  )

  &match=0
  &wild_head=0
  &wild_tail=0
  &clk_input_length=STRING.LENGTH("&clk")
  &clk_itr_length=STRING.LENGTH("gcc_cnoc_bus_timeout13_ahb_clk")

  if (STRING.SCAN("&clk", "*", 0)==0)
  (
    &wild_head=1
  )
  if (STRING.SCAN("&clk", "*", 1)==(STRING.LENGTH("&clk")-1))
  (
    &wild_tail=1
  )

  if ((&wild_head==1)&&(&wild_tail==1))
  (
    if (STRING.SCAN("gcc_cnoc_bus_timeout13_ahb_clk", STRING.MID("&clk", 1, &clk_input_length-2), 0)!=-1)
    ( 
      &match=1
    )
  )
  else if (&wild_head==1)
  (
    if (STRING.MID("gcc_cnoc_bus_timeout13_ahb_clk", &clk_itr_length-&clk_input_length+1, &clk_input_length-1)==STRING.CUT("&clk", 1))
    ( 
      &match=1
    )
  )
  else if (&wild_tail==1)
  (
    if (STRING.MID("gcc_cnoc_bus_timeout13_ahb_clk", 0, &clk_input_length-1)==STRING.CUT("&clk", -1))
    ( 
      &match=1
    )
  )
  else if ("gcc_cnoc_bus_timeout13_ahb_clk"=="&clk")
  (
    &match=1
  )
  
  if (&match==1)
  (
    &clk_test=&CLK_TEST_GCC_CNOC_BUS_TIMEOUT13_AHB_CLK
    &clk_reg=&HWIO_GCC_CNOC_BUS_TIMEOUT13_AHB_CBCR_ADDR
    &clk_reg_name="GCC_CNOC_BUS_TIMEOUT13_AHB_CBCR"
    &clk_name="gcc_cnoc_bus_timeout13_ahb_clk"
    &clk_reg_cbcr_type="sm_cbc"
    &clk_vote_bit=-1.
    &clk_multiplier=4.

    gosub Print_Clk_Info_Line
  )

  &match=0
  &wild_head=0
  &wild_tail=0
  &clk_input_length=STRING.LENGTH("&clk")
  &clk_itr_length=STRING.LENGTH("gcc_glm_xo_clk")

  if (STRING.SCAN("&clk", "*", 0)==0)
  (
    &wild_head=1
  )
  if (STRING.SCAN("&clk", "*", 1)==(STRING.LENGTH("&clk")-1))
  (
    &wild_tail=1
  )

  if ((&wild_head==1)&&(&wild_tail==1))
  (
    if (STRING.SCAN("gcc_glm_xo_clk", STRING.MID("&clk", 1, &clk_input_length-2), 0)!=-1)
    ( 
      &match=1
    )
  )
  else if (&wild_head==1)
  (
    if (STRING.MID("gcc_glm_xo_clk", &clk_itr_length-&clk_input_length+1, &clk_input_length-1)==STRING.CUT("&clk", 1))
    ( 
      &match=1
    )
  )
  else if (&wild_tail==1)
  (
    if (STRING.MID("gcc_glm_xo_clk", 0, &clk_input_length-1)==STRING.CUT("&clk", -1))
    ( 
      &match=1
    )
  )
  else if ("gcc_glm_xo_clk"=="&clk")
  (
    &match=1
  )
  
  if (&match==1)
  (
    &clk_test=&CLK_TEST_GCC_GLM_XO_CLK
    &clk_reg=&HWIO_GCC_GLM_XO_CBCR_ADDR
    &clk_reg_name="GCC_GLM_XO_CBCR"
    &clk_name="gcc_glm_xo_clk"
    &clk_reg_cbcr_type="sm_cbc"
    &clk_vote_bit=-1.
    &clk_multiplier=4.

    gosub Print_Clk_Info_Line
  )

  &match=0
  &wild_head=0
  &wild_tail=0
  &clk_input_length=STRING.LENGTH("&clk")
  &clk_itr_length=STRING.LENGTH("gcc_pdm_xo4_clk")

  if (STRING.SCAN("&clk", "*", 0)==0)
  (
    &wild_head=1
  )
  if (STRING.SCAN("&clk", "*", 1)==(STRING.LENGTH("&clk")-1))
  (
    &wild_tail=1
  )

  if ((&wild_head==1)&&(&wild_tail==1))
  (
    if (STRING.SCAN("gcc_pdm_xo4_clk", STRING.MID("&clk", 1, &clk_input_length-2), 0)!=-1)
    ( 
      &match=1
    )
  )
  else if (&wild_head==1)
  (
    if (STRING.MID("gcc_pdm_xo4_clk", &clk_itr_length-&clk_input_length+1, &clk_input_length-1)==STRING.CUT("&clk", 1))
    ( 
      &match=1
    )
  )
  else if (&wild_tail==1)
  (
    if (STRING.MID("gcc_pdm_xo4_clk", 0, &clk_input_length-1)==STRING.CUT("&clk", -1))
    ( 
      &match=1
    )
  )
  else if ("gcc_pdm_xo4_clk"=="&clk")
  (
    &match=1
  )
  
  if (&match==1)
  (
    &clk_test=&CLK_TEST_GCC_PDM_XO4_CLK
    &clk_reg=&HWIO_GCC_PDM_XO4_CBCR_ADDR
    &clk_reg_name="GCC_PDM_XO4_CBCR"
    &clk_name="gcc_pdm_xo4_clk"
    &clk_reg_cbcr_type="sm_cbc"
    &clk_vote_bit=-1.
    &clk_multiplier=4.

    gosub Print_Clk_Info_Line
  )

  &match=0
  &wild_head=0
  &wild_tail=0
  &clk_input_length=STRING.LENGTH("&clk")
  &clk_itr_length=STRING.LENGTH("gcc_qdss_xo_clk")

  if (STRING.SCAN("&clk", "*", 0)==0)
  (
    &wild_head=1
  )
  if (STRING.SCAN("&clk", "*", 1)==(STRING.LENGTH("&clk")-1))
  (
    &wild_tail=1
  )

  if ((&wild_head==1)&&(&wild_tail==1))
  (
    if (STRING.SCAN("gcc_qdss_xo_clk", STRING.MID("&clk", 1, &clk_input_length-2), 0)!=-1)
    ( 
      &match=1
    )
  )
  else if (&wild_head==1)
  (
    if (STRING.MID("gcc_qdss_xo_clk", &clk_itr_length-&clk_input_length+1, &clk_input_length-1)==STRING.CUT("&clk", 1))
    ( 
      &match=1
    )
  )
  else if (&wild_tail==1)
  (
    if (STRING.MID("gcc_qdss_xo_clk", 0, &clk_input_length-1)==STRING.CUT("&clk", -1))
    ( 
      &match=1
    )
  )
  else if ("gcc_qdss_xo_clk"=="&clk")
  (
    &match=1
  )
  
  if (&match==1)
  (
    &clk_test=&CLK_TEST_GCC_QDSS_XO_CLK
    &clk_reg=&HWIO_GCC_QDSS_XO_CBCR_ADDR
    &clk_reg_name="GCC_QDSS_XO_CBCR"
    &clk_name="gcc_qdss_xo_clk"
    &clk_reg_cbcr_type="sm_cbc"
    &clk_vote_bit=-1.
    &clk_multiplier=4.

    gosub Print_Clk_Info_Line
  )

  &match=0
  &wild_head=0
  &wild_tail=0
  &clk_input_length=STRING.LENGTH("&clk")
  &clk_itr_length=STRING.LENGTH("gcc_qrefs_vbg_cal_clk")

  if (STRING.SCAN("&clk", "*", 0)==0)
  (
    &wild_head=1
  )
  if (STRING.SCAN("&clk", "*", 1)==(STRING.LENGTH("&clk")-1))
  (
    &wild_tail=1
  )

  if ((&wild_head==1)&&(&wild_tail==1))
  (
    if (STRING.SCAN("gcc_qrefs_vbg_cal_clk", STRING.MID("&clk", 1, &clk_input_length-2), 0)!=-1)
    ( 
      &match=1
    )
  )
  else if (&wild_head==1)
  (
    if (STRING.MID("gcc_qrefs_vbg_cal_clk", &clk_itr_length-&clk_input_length+1, &clk_input_length-1)==STRING.CUT("&clk", 1))
    ( 
      &match=1
    )
  )
  else if (&wild_tail==1)
  (
    if (STRING.MID("gcc_qrefs_vbg_cal_clk", 0, &clk_input_length-1)==STRING.CUT("&clk", -1))
    ( 
      &match=1
    )
  )
  else if ("gcc_qrefs_vbg_cal_clk"=="&clk")
  (
    &match=1
  )
  
  if (&match==1)
  (
    &clk_test=&CLK_TEST_GCC_QREFS_VBG_CAL_CLK
    &clk_reg=&HWIO_GCC_QREFS_VBG_CAL_CBCR_ADDR
    &clk_reg_name="GCC_QREFS_VBG_CAL_CBCR"
    &clk_name="gcc_qrefs_vbg_cal_clk"
    &clk_reg_cbcr_type="sm_cbc"
    &clk_vote_bit=-1.
    &clk_multiplier=4.

    gosub Print_Clk_Info_Line
  )

  &match=0
  &wild_head=0
  &wild_tail=0
  &clk_input_length=STRING.LENGTH("&clk")
  &clk_itr_length=STRING.LENGTH("gcc_rpm_timer_clk")

  if (STRING.SCAN("&clk", "*", 0)==0)
  (
    &wild_head=1
  )
  if (STRING.SCAN("&clk", "*", 1)==(STRING.LENGTH("&clk")-1))
  (
    &wild_tail=1
  )

  if ((&wild_head==1)&&(&wild_tail==1))
  (
    if (STRING.SCAN("gcc_rpm_timer_clk", STRING.MID("&clk", 1, &clk_input_length-2), 0)!=-1)
    ( 
      &match=1
    )
  )
  else if (&wild_head==1)
  (
    if (STRING.MID("gcc_rpm_timer_clk", &clk_itr_length-&clk_input_length+1, &clk_input_length-1)==STRING.CUT("&clk", 1))
    ( 
      &match=1
    )
  )
  else if (&wild_tail==1)
  (
    if (STRING.MID("gcc_rpm_timer_clk", 0, &clk_input_length-1)==STRING.CUT("&clk", -1))
    ( 
      &match=1
    )
  )
  else if ("gcc_rpm_timer_clk"=="&clk")
  (
    &match=1
  )
  
  if (&match==1)
  (
    &clk_test=&CLK_TEST_GCC_RPM_TIMER_CLK
    &clk_reg=&HWIO_GCC_RPM_TIMER_CBCR_ADDR
    &clk_reg_name="GCC_RPM_TIMER_CBCR"
    &clk_name="gcc_rpm_timer_clk"
    &clk_reg_cbcr_type="sm_cbc"
    &clk_vote_bit=-1.
    &clk_multiplier=4.

    gosub Print_Clk_Info_Line
  )

  &match=0
  &wild_head=0
  &wild_tail=0
  &clk_input_length=STRING.LENGTH("&clk")
  &clk_itr_length=STRING.LENGTH("gcc_spdm_ff_clk")

  if (STRING.SCAN("&clk", "*", 0)==0)
  (
    &wild_head=1
  )
  if (STRING.SCAN("&clk", "*", 1)==(STRING.LENGTH("&clk")-1))
  (
    &wild_tail=1
  )

  if ((&wild_head==1)&&(&wild_tail==1))
  (
    if (STRING.SCAN("gcc_spdm_ff_clk", STRING.MID("&clk", 1, &clk_input_length-2), 0)!=-1)
    ( 
      &match=1
    )
  )
  else if (&wild_head==1)
  (
    if (STRING.MID("gcc_spdm_ff_clk", &clk_itr_length-&clk_input_length+1, &clk_input_length-1)==STRING.CUT("&clk", 1))
    ( 
      &match=1
    )
  )
  else if (&wild_tail==1)
  (
    if (STRING.MID("gcc_spdm_ff_clk", 0, &clk_input_length-1)==STRING.CUT("&clk", -1))
    ( 
      &match=1
    )
  )
  else if ("gcc_spdm_ff_clk"=="&clk")
  (
    &match=1
  )
  
  if (&match==1)
  (
    &clk_test=&CLK_TEST_GCC_SPDM_FF_CLK
    &clk_reg=&HWIO_GCC_SPDM_FF_CBCR_ADDR
    &clk_reg_name="GCC_SPDM_FF_CBCR"
    &clk_name="gcc_spdm_ff_clk"
    &clk_reg_cbcr_type="sm_cbc"
    &clk_vote_bit=-1.
    &clk_multiplier=4.

    gosub Print_Clk_Info_Line
  )

  &match=0
  &wild_head=0
  &wild_tail=0
  &clk_input_length=STRING.LENGTH("&clk")
  &clk_itr_length=STRING.LENGTH("gcc_spss_xo_clk")

  if (STRING.SCAN("&clk", "*", 0)==0)
  (
    &wild_head=1
  )
  if (STRING.SCAN("&clk", "*", 1)==(STRING.LENGTH("&clk")-1))
  (
    &wild_tail=1
  )

  if ((&wild_head==1)&&(&wild_tail==1))
  (
    if (STRING.SCAN("gcc_spss_xo_clk", STRING.MID("&clk", 1, &clk_input_length-2), 0)!=-1)
    ( 
      &match=1
    )
  )
  else if (&wild_head==1)
  (
    if (STRING.MID("gcc_spss_xo_clk", &clk_itr_length-&clk_input_length+1, &clk_input_length-1)==STRING.CUT("&clk", 1))
    ( 
      &match=1
    )
  )
  else if (&wild_tail==1)
  (
    if (STRING.MID("gcc_spss_xo_clk", 0, &clk_input_length-1)==STRING.CUT("&clk", -1))
    ( 
      &match=1
    )
  )
  else if ("gcc_spss_xo_clk"=="&clk")
  (
    &match=1
  )
  
  if (&match==1)
  (
    &clk_test=&CLK_TEST_GCC_SPSS_XO_CLK
    &clk_reg=&HWIO_GCC_SPSS_XO_CBCR_ADDR
    &clk_reg_name="GCC_SPSS_XO_CBCR"
    &clk_name="gcc_spss_xo_clk"
    &clk_reg_cbcr_type="sm_cbc"
    &clk_vote_bit=-1.
    &clk_multiplier=4.

    gosub Print_Clk_Info_Line
  )

  &match=0
  &wild_head=0
  &wild_tail=0
  &clk_input_length=STRING.LENGTH("&clk")
  &clk_itr_length=STRING.LENGTH("gcc_sram_sensor_xo_clk")

  if (STRING.SCAN("&clk", "*", 0)==0)
  (
    &wild_head=1
  )
  if (STRING.SCAN("&clk", "*", 1)==(STRING.LENGTH("&clk")-1))
  (
    &wild_tail=1
  )

  if ((&wild_head==1)&&(&wild_tail==1))
  (
    if (STRING.SCAN("gcc_sram_sensor_xo_clk", STRING.MID("&clk", 1, &clk_input_length-2), 0)!=-1)
    ( 
      &match=1
    )
  )
  else if (&wild_head==1)
  (
    if (STRING.MID("gcc_sram_sensor_xo_clk", &clk_itr_length-&clk_input_length+1, &clk_input_length-1)==STRING.CUT("&clk", 1))
    ( 
      &match=1
    )
  )
  else if (&wild_tail==1)
  (
    if (STRING.MID("gcc_sram_sensor_xo_clk", 0, &clk_input_length-1)==STRING.CUT("&clk", -1))
    ( 
      &match=1
    )
  )
  else if ("gcc_sram_sensor_xo_clk"=="&clk")
  (
    &match=1
  )
  
  if (&match==1)
  (
    &clk_test=&CLK_TEST_GCC_SRAM_SENSOR_XO_CLK
    &clk_reg=&HWIO_GCC_SRAM_SENSOR_XO_CBCR_ADDR
    &clk_reg_name="GCC_SRAM_SENSOR_XO_CBCR"
    &clk_name="gcc_sram_sensor_xo_clk"
    &clk_reg_cbcr_type="sm_pscbc"
    &clk_vote_bit=-1.
    &clk_multiplier=4.

    gosub Print_Clk_Info_Line
  )

  &match=0
  &wild_head=0
  &wild_tail=0
  &clk_input_length=STRING.LENGTH("&clk")
  &clk_itr_length=STRING.LENGTH("gcc_ssc_xo_clk")

  if (STRING.SCAN("&clk", "*", 0)==0)
  (
    &wild_head=1
  )
  if (STRING.SCAN("&clk", "*", 1)==(STRING.LENGTH("&clk")-1))
  (
    &wild_tail=1
  )

  if ((&wild_head==1)&&(&wild_tail==1))
  (
    if (STRING.SCAN("gcc_ssc_xo_clk", STRING.MID("&clk", 1, &clk_input_length-2), 0)!=-1)
    ( 
      &match=1
    )
  )
  else if (&wild_head==1)
  (
    if (STRING.MID("gcc_ssc_xo_clk", &clk_itr_length-&clk_input_length+1, &clk_input_length-1)==STRING.CUT("&clk", 1))
    ( 
      &match=1
    )
  )
  else if (&wild_tail==1)
  (
    if (STRING.MID("gcc_ssc_xo_clk", 0, &clk_input_length-1)==STRING.CUT("&clk", -1))
    ( 
      &match=1
    )
  )
  else if ("gcc_ssc_xo_clk"=="&clk")
  (
    &match=1
  )
  
  if (&match==1)
  (
    &clk_test=&CLK_TEST_GCC_SSC_XO_CLK
    &clk_reg=&HWIO_GCC_SSC_XO_CBCR_ADDR
    &clk_reg_name="GCC_SSC_XO_CBCR"
    &clk_name="gcc_ssc_xo_clk"
    &clk_reg_cbcr_type="sm_cbc"
    &clk_vote_bit=-1.
    &clk_multiplier=4.

    gosub Print_Clk_Info_Line
  )

  &match=0
  &wild_head=0
  &wild_tail=0
  &clk_input_length=STRING.LENGTH("&clk")
  &clk_itr_length=STRING.LENGTH("gcc_sys_noc_dcd_xo_clk")

  if (STRING.SCAN("&clk", "*", 0)==0)
  (
    &wild_head=1
  )
  if (STRING.SCAN("&clk", "*", 1)==(STRING.LENGTH("&clk")-1))
  (
    &wild_tail=1
  )

  if ((&wild_head==1)&&(&wild_tail==1))
  (
    if (STRING.SCAN("gcc_sys_noc_dcd_xo_clk", STRING.MID("&clk", 1, &clk_input_length-2), 0)!=-1)
    ( 
      &match=1
    )
  )
  else if (&wild_head==1)
  (
    if (STRING.MID("gcc_sys_noc_dcd_xo_clk", &clk_itr_length-&clk_input_length+1, &clk_input_length-1)==STRING.CUT("&clk", 1))
    ( 
      &match=1
    )
  )
  else if (&wild_tail==1)
  (
    if (STRING.MID("gcc_sys_noc_dcd_xo_clk", 0, &clk_input_length-1)==STRING.CUT("&clk", -1))
    ( 
      &match=1
    )
  )
  else if ("gcc_sys_noc_dcd_xo_clk"=="&clk")
  (
    &match=1
  )
  
  if (&match==1)
  (
    &clk_test=&CLK_TEST_GCC_SYS_NOC_DCD_XO_CLK
    &clk_reg=&HWIO_GCC_SYS_NOC_DCD_XO_CBCR_ADDR
    &clk_reg_name="GCC_SYS_NOC_DCD_XO_CBCR"
    &clk_name="gcc_sys_noc_dcd_xo_clk"
    &clk_reg_cbcr_type="sm_cbc"
    &clk_vote_bit=-1.
    &clk_multiplier=4.

    gosub Print_Clk_Info_Line
  )

  &match=0
  &wild_head=0
  &wild_tail=0
  &clk_input_length=STRING.LENGTH("&clk")
  &clk_itr_length=STRING.LENGTH("gcc_xo_clk")

  if (STRING.SCAN("&clk", "*", 0)==0)
  (
    &wild_head=1
  )
  if (STRING.SCAN("&clk", "*", 1)==(STRING.LENGTH("&clk")-1))
  (
    &wild_tail=1
  )

  if ((&wild_head==1)&&(&wild_tail==1))
  (
    if (STRING.SCAN("gcc_xo_clk", STRING.MID("&clk", 1, &clk_input_length-2), 0)!=-1)
    ( 
      &match=1
    )
  )
  else if (&wild_head==1)
  (
    if (STRING.MID("gcc_xo_clk", &clk_itr_length-&clk_input_length+1, &clk_input_length-1)==STRING.CUT("&clk", 1))
    ( 
      &match=1
    )
  )
  else if (&wild_tail==1)
  (
    if (STRING.MID("gcc_xo_clk", 0, &clk_input_length-1)==STRING.CUT("&clk", -1))
    ( 
      &match=1
    )
  )
  else if ("gcc_xo_clk"=="&clk")
  (
    &match=1
  )
  
  if (&match==1)
  (
    &clk_test=&CLK_TEST_GCC_XO_CLK
    &clk_reg=&HWIO_GCC_GCC_XO_CBCR_ADDR
    &clk_reg_name="GCC_GCC_XO_CBCR"
    &clk_name="gcc_xo_clk"
    &clk_reg_cbcr_type="sm_cbc"
    &clk_vote_bit=-1.
    &clk_multiplier=4.

    gosub Print_Clk_Info_Line
  )

  &match=0
  &wild_head=0
  &wild_tail=0
  &clk_input_length=STRING.LENGTH("&clk")
  &clk_itr_length=STRING.LENGTH("gcc_xo_div4_clk")

  if (STRING.SCAN("&clk", "*", 0)==0)
  (
    &wild_head=1
  )
  if (STRING.SCAN("&clk", "*", 1)==(STRING.LENGTH("&clk")-1))
  (
    &wild_tail=1
  )

  if ((&wild_head==1)&&(&wild_tail==1))
  (
    if (STRING.SCAN("gcc_xo_div4_clk", STRING.MID("&clk", 1, &clk_input_length-2), 0)!=-1)
    ( 
      &match=1
    )
  )
  else if (&wild_head==1)
  (
    if (STRING.MID("gcc_xo_div4_clk", &clk_itr_length-&clk_input_length+1, &clk_input_length-1)==STRING.CUT("&clk", 1))
    ( 
      &match=1
    )
  )
  else if (&wild_tail==1)
  (
    if (STRING.MID("gcc_xo_div4_clk", 0, &clk_input_length-1)==STRING.CUT("&clk", -1))
    ( 
      &match=1
    )
  )
  else if ("gcc_xo_div4_clk"=="&clk")
  (
    &match=1
  )
  
  if (&match==1)
  (
    &clk_test=&CLK_TEST_GCC_XO_DIV4_CLK
    &clk_reg=&HWIO_GCC_GCC_XO_DIV4_CBCR_ADDR
    &clk_reg_name="GCC_GCC_XO_DIV4_CBCR"
    &clk_name="gcc_xo_div4_clk"
    &clk_reg_cbcr_type="sm_cbc"
    &clk_vote_bit=-1.
    &clk_multiplier=4.

    gosub Print_Clk_Info_Line
  )

  &match=0
  &wild_head=0
  &wild_tail=0
  &clk_input_length=STRING.LENGTH("&clk")
  &clk_itr_length=STRING.LENGTH("gcc_glm_clk")

  if (STRING.SCAN("&clk", "*", 0)==0)
  (
    &wild_head=1
  )
  if (STRING.SCAN("&clk", "*", 1)==(STRING.LENGTH("&clk")-1))
  (
    &wild_tail=1
  )

  if ((&wild_head==1)&&(&wild_tail==1))
  (
    if (STRING.SCAN("gcc_glm_clk", STRING.MID("&clk", 1, &clk_input_length-2), 0)!=-1)
    ( 
      &match=1
    )
  )
  else if (&wild_head==1)
  (
    if (STRING.MID("gcc_glm_clk", &clk_itr_length-&clk_input_length+1, &clk_input_length-1)==STRING.CUT("&clk", 1))
    ( 
      &match=1
    )
  )
  else if (&wild_tail==1)
  (
    if (STRING.MID("gcc_glm_clk", 0, &clk_input_length-1)==STRING.CUT("&clk", -1))
    ( 
      &match=1
    )
  )
  else if ("gcc_glm_clk"=="&clk")
  (
    &match=1
  )
  
  if (&match==1)
  (
    &clk_test=&CLK_TEST_GCC_GLM_CLK
    &clk_reg=&HWIO_GCC_GLM_CBCR_ADDR
    &clk_reg_name="GCC_GLM_CBCR"
    &clk_name="gcc_glm_clk"
    &clk_reg_cbcr_type="sm_cbc"
    &clk_vote_bit=-1.
    &clk_multiplier=4.

    gosub Print_Clk_Info_Line
  )

  &match=0
  &wild_head=0
  &wild_tail=0
  &clk_input_length=STRING.LENGTH("&clk")
  &clk_itr_length=STRING.LENGTH("gcc_gp1_clk")

  if (STRING.SCAN("&clk", "*", 0)==0)
  (
    &wild_head=1
  )
  if (STRING.SCAN("&clk", "*", 1)==(STRING.LENGTH("&clk")-1))
  (
    &wild_tail=1
  )

  if ((&wild_head==1)&&(&wild_tail==1))
  (
    if (STRING.SCAN("gcc_gp1_clk", STRING.MID("&clk", 1, &clk_input_length-2), 0)!=-1)
    ( 
      &match=1
    )
  )
  else if (&wild_head==1)
  (
    if (STRING.MID("gcc_gp1_clk", &clk_itr_length-&clk_input_length+1, &clk_input_length-1)==STRING.CUT("&clk", 1))
    ( 
      &match=1
    )
  )
  else if (&wild_tail==1)
  (
    if (STRING.MID("gcc_gp1_clk", 0, &clk_input_length-1)==STRING.CUT("&clk", -1))
    ( 
      &match=1
    )
  )
  else if ("gcc_gp1_clk"=="&clk")
  (
    &match=1
  )
  
  if (&match==1)
  (
    &clk_test=&CLK_TEST_GCC_GP1_CLK
    &clk_reg=&HWIO_GCC_GP1_CBCR_ADDR
    &clk_reg_name="GCC_GP1_CBCR"
    &clk_name="gcc_gp1_clk"
    &clk_reg_cbcr_type="sm_cbc"
    &clk_vote_bit=-1.
    &clk_multiplier=4.

    gosub Print_Clk_Info_Line
  )

  &match=0
  &wild_head=0
  &wild_tail=0
  &clk_input_length=STRING.LENGTH("&clk")
  &clk_itr_length=STRING.LENGTH("gcc_gp2_clk")

  if (STRING.SCAN("&clk", "*", 0)==0)
  (
    &wild_head=1
  )
  if (STRING.SCAN("&clk", "*", 1)==(STRING.LENGTH("&clk")-1))
  (
    &wild_tail=1
  )

  if ((&wild_head==1)&&(&wild_tail==1))
  (
    if (STRING.SCAN("gcc_gp2_clk", STRING.MID("&clk", 1, &clk_input_length-2), 0)!=-1)
    ( 
      &match=1
    )
  )
  else if (&wild_head==1)
  (
    if (STRING.MID("gcc_gp2_clk", &clk_itr_length-&clk_input_length+1, &clk_input_length-1)==STRING.CUT("&clk", 1))
    ( 
      &match=1
    )
  )
  else if (&wild_tail==1)
  (
    if (STRING.MID("gcc_gp2_clk", 0, &clk_input_length-1)==STRING.CUT("&clk", -1))
    ( 
      &match=1
    )
  )
  else if ("gcc_gp2_clk"=="&clk")
  (
    &match=1
  )
  
  if (&match==1)
  (
    &clk_test=&CLK_TEST_GCC_GP2_CLK
    &clk_reg=&HWIO_GCC_GP2_CBCR_ADDR
    &clk_reg_name="GCC_GP2_CBCR"
    &clk_name="gcc_gp2_clk"
    &clk_reg_cbcr_type="sm_cbc"
    &clk_vote_bit=-1.
    &clk_multiplier=4.

    gosub Print_Clk_Info_Line
  )

  &match=0
  &wild_head=0
  &wild_tail=0
  &clk_input_length=STRING.LENGTH("&clk")
  &clk_itr_length=STRING.LENGTH("gcc_gp3_clk")

  if (STRING.SCAN("&clk", "*", 0)==0)
  (
    &wild_head=1
  )
  if (STRING.SCAN("&clk", "*", 1)==(STRING.LENGTH("&clk")-1))
  (
    &wild_tail=1
  )

  if ((&wild_head==1)&&(&wild_tail==1))
  (
    if (STRING.SCAN("gcc_gp3_clk", STRING.MID("&clk", 1, &clk_input_length-2), 0)!=-1)
    ( 
      &match=1
    )
  )
  else if (&wild_head==1)
  (
    if (STRING.MID("gcc_gp3_clk", &clk_itr_length-&clk_input_length+1, &clk_input_length-1)==STRING.CUT("&clk", 1))
    ( 
      &match=1
    )
  )
  else if (&wild_tail==1)
  (
    if (STRING.MID("gcc_gp3_clk", 0, &clk_input_length-1)==STRING.CUT("&clk", -1))
    ( 
      &match=1
    )
  )
  else if ("gcc_gp3_clk"=="&clk")
  (
    &match=1
  )
  
  if (&match==1)
  (
    &clk_test=&CLK_TEST_GCC_GP3_CLK
    &clk_reg=&HWIO_GCC_GP3_CBCR_ADDR
    &clk_reg_name="GCC_GP3_CBCR"
    &clk_name="gcc_gp3_clk"
    &clk_reg_cbcr_type="sm_cbc"
    &clk_vote_bit=-1.
    &clk_multiplier=4.

    gosub Print_Clk_Info_Line
  )

  &match=0
  &wild_head=0
  &wild_tail=0
  &clk_input_length=STRING.LENGTH("&clk")
  &clk_itr_length=STRING.LENGTH("gcc_bimc_gfx_clk")

  if (STRING.SCAN("&clk", "*", 0)==0)
  (
    &wild_head=1
  )
  if (STRING.SCAN("&clk", "*", 1)==(STRING.LENGTH("&clk")-1))
  (
    &wild_tail=1
  )

  if ((&wild_head==1)&&(&wild_tail==1))
  (
    if (STRING.SCAN("gcc_bimc_gfx_clk", STRING.MID("&clk", 1, &clk_input_length-2), 0)!=-1)
    ( 
      &match=1
    )
  )
  else if (&wild_head==1)
  (
    if (STRING.MID("gcc_bimc_gfx_clk", &clk_itr_length-&clk_input_length+1, &clk_input_length-1)==STRING.CUT("&clk", 1))
    ( 
      &match=1
    )
  )
  else if (&wild_tail==1)
  (
    if (STRING.MID("gcc_bimc_gfx_clk", 0, &clk_input_length-1)==STRING.CUT("&clk", -1))
    ( 
      &match=1
    )
  )
  else if ("gcc_bimc_gfx_clk"=="&clk")
  (
    &match=1
  )
  
  if (&match==1)
  (
    &clk_test=&CLK_TEST_GCC_BIMC_GFX_CLK
    &clk_reg=&HWIO_GCC_BIMC_GFX_CBCR_ADDR
    &clk_reg_name="GCC_BIMC_GFX_CBCR"
    &clk_name="gcc_bimc_gfx_clk"
    &clk_reg_cbcr_type="sm_cbc"
    &clk_vote_bit=-1.
    &clk_multiplier=4.

    gosub Print_Clk_Info_Line
  )

  &match=0
  &wild_head=0
  &wild_tail=0
  &clk_input_length=STRING.LENGTH("&clk")
  &clk_itr_length=STRING.LENGTH("gcc_gpu_bimc_gfx_clk")

  if (STRING.SCAN("&clk", "*", 0)==0)
  (
    &wild_head=1
  )
  if (STRING.SCAN("&clk", "*", 1)==(STRING.LENGTH("&clk")-1))
  (
    &wild_tail=1
  )

  if ((&wild_head==1)&&(&wild_tail==1))
  (
    if (STRING.SCAN("gcc_gpu_bimc_gfx_clk", STRING.MID("&clk", 1, &clk_input_length-2), 0)!=-1)
    ( 
      &match=1
    )
  )
  else if (&wild_head==1)
  (
    if (STRING.MID("gcc_gpu_bimc_gfx_clk", &clk_itr_length-&clk_input_length+1, &clk_input_length-1)==STRING.CUT("&clk", 1))
    ( 
      &match=1
    )
  )
  else if (&wild_tail==1)
  (
    if (STRING.MID("gcc_gpu_bimc_gfx_clk", 0, &clk_input_length-1)==STRING.CUT("&clk", -1))
    ( 
      &match=1
    )
  )
  else if ("gcc_gpu_bimc_gfx_clk"=="&clk")
  (
    &match=1
  )
  
  if (&match==1)
  (
    &clk_test=&CLK_TEST_GCC_GPU_BIMC_GFX_CLK
    &clk_reg=&HWIO_GCC_GPU_BIMC_GFX_CBCR_ADDR
    &clk_reg_name="GCC_GPU_BIMC_GFX_CBCR"
    &clk_name="gcc_gpu_bimc_gfx_clk"
    &clk_reg_cbcr_type="sm_cbc"
    &clk_vote_bit=-1.
    &clk_multiplier=4.

    gosub Print_Clk_Info_Line
  )

  &match=0
  &wild_head=0
  &wild_tail=0
  &clk_input_length=STRING.LENGTH("&clk")
  &clk_itr_length=STRING.LENGTH("gcc_gpu_bimc_gfx_src_clk")

  if (STRING.SCAN("&clk", "*", 0)==0)
  (
    &wild_head=1
  )
  if (STRING.SCAN("&clk", "*", 1)==(STRING.LENGTH("&clk")-1))
  (
    &wild_tail=1
  )

  if ((&wild_head==1)&&(&wild_tail==1))
  (
    if (STRING.SCAN("gcc_gpu_bimc_gfx_src_clk", STRING.MID("&clk", 1, &clk_input_length-2), 0)!=-1)
    ( 
      &match=1
    )
  )
  else if (&wild_head==1)
  (
    if (STRING.MID("gcc_gpu_bimc_gfx_src_clk", &clk_itr_length-&clk_input_length+1, &clk_input_length-1)==STRING.CUT("&clk", 1))
    ( 
      &match=1
    )
  )
  else if (&wild_tail==1)
  (
    if (STRING.MID("gcc_gpu_bimc_gfx_src_clk", 0, &clk_input_length-1)==STRING.CUT("&clk", -1))
    ( 
      &match=1
    )
  )
  else if ("gcc_gpu_bimc_gfx_src_clk"=="&clk")
  (
    &match=1
  )
  
  if (&match==1)
  (
    &clk_test=&CLK_TEST_GCC_GPU_BIMC_GFX_SRC_CLK
    &clk_reg=&HWIO_GCC_GPU_BIMC_GFX_SRC_CBCR_ADDR
    &clk_reg_name="GCC_GPU_BIMC_GFX_SRC_CBCR"
    &clk_name="gcc_gpu_bimc_gfx_src_clk"
    &clk_reg_cbcr_type="sm_pscbc"
    &clk_vote_bit=-1.
    &clk_multiplier=4.

    gosub Print_Clk_Info_Line
  )

  &match=0
  &wild_head=0
  &wild_tail=0
  &clk_input_length=STRING.LENGTH("&clk")
  &clk_itr_length=STRING.LENGTH("gcc_gpu_snoc_dvm_gfx_clk")

  if (STRING.SCAN("&clk", "*", 0)==0)
  (
    &wild_head=1
  )
  if (STRING.SCAN("&clk", "*", 1)==(STRING.LENGTH("&clk")-1))
  (
    &wild_tail=1
  )

  if ((&wild_head==1)&&(&wild_tail==1))
  (
    if (STRING.SCAN("gcc_gpu_snoc_dvm_gfx_clk", STRING.MID("&clk", 1, &clk_input_length-2), 0)!=-1)
    ( 
      &match=1
    )
  )
  else if (&wild_head==1)
  (
    if (STRING.MID("gcc_gpu_snoc_dvm_gfx_clk", &clk_itr_length-&clk_input_length+1, &clk_input_length-1)==STRING.CUT("&clk", 1))
    ( 
      &match=1
    )
  )
  else if (&wild_tail==1)
  (
    if (STRING.MID("gcc_gpu_snoc_dvm_gfx_clk", 0, &clk_input_length-1)==STRING.CUT("&clk", -1))
    ( 
      &match=1
    )
  )
  else if ("gcc_gpu_snoc_dvm_gfx_clk"=="&clk")
  (
    &match=1
  )
  
  if (&match==1)
  (
    &clk_test=&CLK_TEST_GCC_GPU_SNOC_DVM_GFX_CLK
    &clk_reg=&HWIO_GCC_GPU_SNOC_DVM_GFX_CBCR_ADDR
    &clk_reg_name="GCC_GPU_SNOC_DVM_GFX_CBCR"
    &clk_name="gcc_gpu_snoc_dvm_gfx_clk"
    &clk_reg_cbcr_type="sm_cbc"
    &clk_vote_bit=-1.
    &clk_multiplier=4.

    gosub Print_Clk_Info_Line
  )

  &match=0
  &wild_head=0
  &wild_tail=0
  &clk_input_length=STRING.LENGTH("&clk")
  &clk_itr_length=STRING.LENGTH("gcc_gpu_vs_clk")

  if (STRING.SCAN("&clk", "*", 0)==0)
  (
    &wild_head=1
  )
  if (STRING.SCAN("&clk", "*", 1)==(STRING.LENGTH("&clk")-1))
  (
    &wild_tail=1
  )

  if ((&wild_head==1)&&(&wild_tail==1))
  (
    if (STRING.SCAN("gcc_gpu_vs_clk", STRING.MID("&clk", 1, &clk_input_length-2), 0)!=-1)
    ( 
      &match=1
    )
  )
  else if (&wild_head==1)
  (
    if (STRING.MID("gcc_gpu_vs_clk", &clk_itr_length-&clk_input_length+1, &clk_input_length-1)==STRING.CUT("&clk", 1))
    ( 
      &match=1
    )
  )
  else if (&wild_tail==1)
  (
    if (STRING.MID("gcc_gpu_vs_clk", 0, &clk_input_length-1)==STRING.CUT("&clk", -1))
    ( 
      &match=1
    )
  )
  else if ("gcc_gpu_vs_clk"=="&clk")
  (
    &match=1
  )
  
  if (&match==1)
  (
    &clk_test=&CLK_TEST_GCC_GPU_VS_CLK
    &clk_reg=&HWIO_GCC_GPU_VS_CBCR_ADDR
    &clk_reg_name="GCC_GPU_VS_CBCR"
    &clk_name="gcc_gpu_vs_clk"
    &clk_reg_cbcr_type="sm_cbc"
    &clk_vote_bit=-1.
    &clk_multiplier=4.

    gosub Print_Clk_Info_Line
  )

  &match=0
  &wild_head=0
  &wild_tail=0
  &clk_input_length=STRING.LENGTH("&clk")
  &clk_itr_length=STRING.LENGTH("gcc_hmss_ahb_clk")

  if (STRING.SCAN("&clk", "*", 0)==0)
  (
    &wild_head=1
  )
  if (STRING.SCAN("&clk", "*", 1)==(STRING.LENGTH("&clk")-1))
  (
    &wild_tail=1
  )

  if ((&wild_head==1)&&(&wild_tail==1))
  (
    if (STRING.SCAN("gcc_hmss_ahb_clk", STRING.MID("&clk", 1, &clk_input_length-2), 0)!=-1)
    ( 
      &match=1
    )
  )
  else if (&wild_head==1)
  (
    if (STRING.MID("gcc_hmss_ahb_clk", &clk_itr_length-&clk_input_length+1, &clk_input_length-1)==STRING.CUT("&clk", 1))
    ( 
      &match=1
    )
  )
  else if (&wild_tail==1)
  (
    if (STRING.MID("gcc_hmss_ahb_clk", 0, &clk_input_length-1)==STRING.CUT("&clk", -1))
    ( 
      &match=1
    )
  )
  else if ("gcc_hmss_ahb_clk"=="&clk")
  (
    &match=1
  )
  
  if (&match==1)
  (
    &clk_test=&CLK_TEST_GCC_HMSS_AHB_CLK
    &clk_reg=&HWIO_GCC_HMSS_AHB_CBCR_ADDR
    &clk_reg_name="GCC_HMSS_AHB_CBCR"
    &clk_name="gcc_hmss_ahb_clk"
    &clk_reg_cbcr_type="sm_cbc"
    &clk_vote_bit=21.
    &clk_multiplier=4.

    gosub Print_Clk_Info_Line
  )

  &match=0
  &wild_head=0
  &wild_tail=0
  &clk_input_length=STRING.LENGTH("&clk")
  &clk_itr_length=STRING.LENGTH("gcc_snoc_bus_timeout0_ahb_clk")

  if (STRING.SCAN("&clk", "*", 0)==0)
  (
    &wild_head=1
  )
  if (STRING.SCAN("&clk", "*", 1)==(STRING.LENGTH("&clk")-1))
  (
    &wild_tail=1
  )

  if ((&wild_head==1)&&(&wild_tail==1))
  (
    if (STRING.SCAN("gcc_snoc_bus_timeout0_ahb_clk", STRING.MID("&clk", 1, &clk_input_length-2), 0)!=-1)
    ( 
      &match=1
    )
  )
  else if (&wild_head==1)
  (
    if (STRING.MID("gcc_snoc_bus_timeout0_ahb_clk", &clk_itr_length-&clk_input_length+1, &clk_input_length-1)==STRING.CUT("&clk", 1))
    ( 
      &match=1
    )
  )
  else if (&wild_tail==1)
  (
    if (STRING.MID("gcc_snoc_bus_timeout0_ahb_clk", 0, &clk_input_length-1)==STRING.CUT("&clk", -1))
    ( 
      &match=1
    )
  )
  else if ("gcc_snoc_bus_timeout0_ahb_clk"=="&clk")
  (
    &match=1
  )
  
  if (&match==1)
  (
    &clk_test=&CLK_TEST_GCC_SNOC_BUS_TIMEOUT0_AHB_CLK
    &clk_reg=&HWIO_GCC_SNOC_BUS_TIMEOUT0_AHB_CBCR_ADDR
    &clk_reg_name="GCC_SNOC_BUS_TIMEOUT0_AHB_CBCR"
    &clk_name="gcc_snoc_bus_timeout0_ahb_clk"
    &clk_reg_cbcr_type="sm_cbc"
    &clk_vote_bit=-1.
    &clk_multiplier=4.

    gosub Print_Clk_Info_Line
  )

  &match=0
  &wild_head=0
  &wild_tail=0
  &clk_input_length=STRING.LENGTH("&clk")
  &clk_itr_length=STRING.LENGTH("gcc_sys_noc_hmss_ahb_clk")

  if (STRING.SCAN("&clk", "*", 0)==0)
  (
    &wild_head=1
  )
  if (STRING.SCAN("&clk", "*", 1)==(STRING.LENGTH("&clk")-1))
  (
    &wild_tail=1
  )

  if ((&wild_head==1)&&(&wild_tail==1))
  (
    if (STRING.SCAN("gcc_sys_noc_hmss_ahb_clk", STRING.MID("&clk", 1, &clk_input_length-2), 0)!=-1)
    ( 
      &match=1
    )
  )
  else if (&wild_head==1)
  (
    if (STRING.MID("gcc_sys_noc_hmss_ahb_clk", &clk_itr_length-&clk_input_length+1, &clk_input_length-1)==STRING.CUT("&clk", 1))
    ( 
      &match=1
    )
  )
  else if (&wild_tail==1)
  (
    if (STRING.MID("gcc_sys_noc_hmss_ahb_clk", 0, &clk_input_length-1)==STRING.CUT("&clk", -1))
    ( 
      &match=1
    )
  )
  else if ("gcc_sys_noc_hmss_ahb_clk"=="&clk")
  (
    &match=1
  )
  
  if (&match==1)
  (
    &clk_test=&CLK_TEST_GCC_SYS_NOC_HMSS_AHB_CLK
    &clk_reg=&HWIO_GCC_SYS_NOC_HMSS_AHB_CBCR_ADDR
    &clk_reg_name="GCC_SYS_NOC_HMSS_AHB_CBCR"
    &clk_name="gcc_sys_noc_hmss_ahb_clk"
    &clk_reg_cbcr_type="sm_cbc"
    &clk_vote_bit=23.
    &clk_multiplier=4.

    gosub Print_Clk_Info_Line
  )

  &match=0
  &wild_head=0
  &wild_tail=0
  &clk_input_length=STRING.LENGTH("&clk")
  &clk_itr_length=STRING.LENGTH("gcc_hmss_rbcpr_clk")

  if (STRING.SCAN("&clk", "*", 0)==0)
  (
    &wild_head=1
  )
  if (STRING.SCAN("&clk", "*", 1)==(STRING.LENGTH("&clk")-1))
  (
    &wild_tail=1
  )

  if ((&wild_head==1)&&(&wild_tail==1))
  (
    if (STRING.SCAN("gcc_hmss_rbcpr_clk", STRING.MID("&clk", 1, &clk_input_length-2), 0)!=-1)
    ( 
      &match=1
    )
  )
  else if (&wild_head==1)
  (
    if (STRING.MID("gcc_hmss_rbcpr_clk", &clk_itr_length-&clk_input_length+1, &clk_input_length-1)==STRING.CUT("&clk", 1))
    ( 
      &match=1
    )
  )
  else if (&wild_tail==1)
  (
    if (STRING.MID("gcc_hmss_rbcpr_clk", 0, &clk_input_length-1)==STRING.CUT("&clk", -1))
    ( 
      &match=1
    )
  )
  else if ("gcc_hmss_rbcpr_clk"=="&clk")
  (
    &match=1
  )
  
  if (&match==1)
  (
    &clk_test=&CLK_TEST_GCC_HMSS_RBCPR_CLK
    &clk_reg=&HWIO_GCC_HMSS_RBCPR_CBCR_ADDR
    &clk_reg_name="GCC_HMSS_RBCPR_CBCR"
    &clk_name="gcc_hmss_rbcpr_clk"
    &clk_reg_cbcr_type="sm_cbc"
    &clk_vote_bit=-1.
    &clk_multiplier=4.

    gosub Print_Clk_Info_Line
  )

  &match=0
  &wild_head=0
  &wild_tail=0
  &clk_input_length=STRING.LENGTH("&clk")
  &clk_itr_length=STRING.LENGTH("gcc_aggre2_noc_ipa_clk")

  if (STRING.SCAN("&clk", "*", 0)==0)
  (
    &wild_head=1
  )
  if (STRING.SCAN("&clk", "*", 1)==(STRING.LENGTH("&clk")-1))
  (
    &wild_tail=1
  )

  if ((&wild_head==1)&&(&wild_tail==1))
  (
    if (STRING.SCAN("gcc_aggre2_noc_ipa_clk", STRING.MID("&clk", 1, &clk_input_length-2), 0)!=-1)
    ( 
      &match=1
    )
  )
  else if (&wild_head==1)
  (
    if (STRING.MID("gcc_aggre2_noc_ipa_clk", &clk_itr_length-&clk_input_length+1, &clk_input_length-1)==STRING.CUT("&clk", 1))
    ( 
      &match=1
    )
  )
  else if (&wild_tail==1)
  (
    if (STRING.MID("gcc_aggre2_noc_ipa_clk", 0, &clk_input_length-1)==STRING.CUT("&clk", -1))
    ( 
      &match=1
    )
  )
  else if ("gcc_aggre2_noc_ipa_clk"=="&clk")
  (
    &match=1
  )
  
  if (&match==1)
  (
    &clk_test=&CLK_TEST_GCC_AGGRE2_NOC_IPA_CLK
    &clk_reg=&HWIO_GCC_AGGRE2_NOC_IPA_CBCR_ADDR
    &clk_reg_name="GCC_AGGRE2_NOC_IPA_CBCR"
    &clk_name="gcc_aggre2_noc_ipa_clk"
    &clk_reg_cbcr_type="sm_cbc"
    &clk_vote_bit=-1.
    &clk_multiplier=4.

    gosub Print_Clk_Info_Line
  )

  &match=0
  &wild_head=0
  &wild_tail=0
  &clk_input_length=STRING.LENGTH("&clk")
  &clk_itr_length=STRING.LENGTH("gcc_ipa_2x_clk")

  if (STRING.SCAN("&clk", "*", 0)==0)
  (
    &wild_head=1
  )
  if (STRING.SCAN("&clk", "*", 1)==(STRING.LENGTH("&clk")-1))
  (
    &wild_tail=1
  )

  if ((&wild_head==1)&&(&wild_tail==1))
  (
    if (STRING.SCAN("gcc_ipa_2x_clk", STRING.MID("&clk", 1, &clk_input_length-2), 0)!=-1)
    ( 
      &match=1
    )
  )
  else if (&wild_head==1)
  (
    if (STRING.MID("gcc_ipa_2x_clk", &clk_itr_length-&clk_input_length+1, &clk_input_length-1)==STRING.CUT("&clk", 1))
    ( 
      &match=1
    )
  )
  else if (&wild_tail==1)
  (
    if (STRING.MID("gcc_ipa_2x_clk", 0, &clk_input_length-1)==STRING.CUT("&clk", -1))
    ( 
      &match=1
    )
  )
  else if ("gcc_ipa_2x_clk"=="&clk")
  (
    &match=1
  )
  
  if (&match==1)
  (
    &clk_test=&CLK_TEST_GCC_IPA_2X_CLK
    &clk_reg=&HWIO_GCC_IPA_2X_CBCR_ADDR
    &clk_reg_name="GCC_IPA_2X_CBCR"
    &clk_name="gcc_ipa_2x_clk"
    &clk_reg_cbcr_type="sm_pscbc"
    &clk_vote_bit=-1.
    &clk_multiplier=4.

    gosub Print_Clk_Info_Line
  )

  &match=0
  &wild_head=0
  &wild_tail=0
  &clk_input_length=STRING.LENGTH("&clk")
  &clk_itr_length=STRING.LENGTH("gcc_ipa_clk")

  if (STRING.SCAN("&clk", "*", 0)==0)
  (
    &wild_head=1
  )
  if (STRING.SCAN("&clk", "*", 1)==(STRING.LENGTH("&clk")-1))
  (
    &wild_tail=1
  )

  if ((&wild_head==1)&&(&wild_tail==1))
  (
    if (STRING.SCAN("gcc_ipa_clk", STRING.MID("&clk", 1, &clk_input_length-2), 0)!=-1)
    ( 
      &match=1
    )
  )
  else if (&wild_head==1)
  (
    if (STRING.MID("gcc_ipa_clk", &clk_itr_length-&clk_input_length+1, &clk_input_length-1)==STRING.CUT("&clk", 1))
    ( 
      &match=1
    )
  )
  else if (&wild_tail==1)
  (
    if (STRING.MID("gcc_ipa_clk", 0, &clk_input_length-1)==STRING.CUT("&clk", -1))
    ( 
      &match=1
    )
  )
  else if ("gcc_ipa_clk"=="&clk")
  (
    &match=1
  )
  
  if (&match==1)
  (
    &clk_test=&CLK_TEST_GCC_IPA_CLK
    &clk_reg=&HWIO_GCC_IPA_CBCR_ADDR
    &clk_reg_name="GCC_IPA_CBCR"
    &clk_name="gcc_ipa_clk"
    &clk_reg_cbcr_type="sm_pscbc"
    &clk_vote_bit=-1.
    &clk_multiplier=4.

    gosub Print_Clk_Info_Line
  )

  &match=0
  &wild_head=0
  &wild_tail=0
  &clk_input_length=STRING.LENGTH("&clk")
  &clk_itr_length=STRING.LENGTH("gcc_mmss_qm_core_clk")

  if (STRING.SCAN("&clk", "*", 0)==0)
  (
    &wild_head=1
  )
  if (STRING.SCAN("&clk", "*", 1)==(STRING.LENGTH("&clk")-1))
  (
    &wild_tail=1
  )

  if ((&wild_head==1)&&(&wild_tail==1))
  (
    if (STRING.SCAN("gcc_mmss_qm_core_clk", STRING.MID("&clk", 1, &clk_input_length-2), 0)!=-1)
    ( 
      &match=1
    )
  )
  else if (&wild_head==1)
  (
    if (STRING.MID("gcc_mmss_qm_core_clk", &clk_itr_length-&clk_input_length+1, &clk_input_length-1)==STRING.CUT("&clk", 1))
    ( 
      &match=1
    )
  )
  else if (&wild_tail==1)
  (
    if (STRING.MID("gcc_mmss_qm_core_clk", 0, &clk_input_length-1)==STRING.CUT("&clk", -1))
    ( 
      &match=1
    )
  )
  else if ("gcc_mmss_qm_core_clk"=="&clk")
  (
    &match=1
  )
  
  if (&match==1)
  (
    &clk_test=&CLK_TEST_GCC_MMSS_QM_CORE_CLK
    &clk_reg=&HWIO_GCC_MMSS_QM_CORE_CBCR_ADDR
    &clk_reg_name="GCC_MMSS_QM_CORE_CBCR"
    &clk_name="gcc_mmss_qm_core_clk"
    &clk_reg_cbcr_type="sm_cbc"
    &clk_vote_bit=-1.
    &clk_multiplier=4.

    gosub Print_Clk_Info_Line
  )

  &match=0
  &wild_head=0
  &wild_tail=0
  &clk_input_length=STRING.LENGTH("&clk")
  &clk_itr_length=STRING.LENGTH("gcc_bimc_mss_q6_axi_clk")

  if (STRING.SCAN("&clk", "*", 0)==0)
  (
    &wild_head=1
  )
  if (STRING.SCAN("&clk", "*", 1)==(STRING.LENGTH("&clk")-1))
  (
    &wild_tail=1
  )

  if ((&wild_head==1)&&(&wild_tail==1))
  (
    if (STRING.SCAN("gcc_bimc_mss_q6_axi_clk", STRING.MID("&clk", 1, &clk_input_length-2), 0)!=-1)
    ( 
      &match=1
    )
  )
  else if (&wild_head==1)
  (
    if (STRING.MID("gcc_bimc_mss_q6_axi_clk", &clk_itr_length-&clk_input_length+1, &clk_input_length-1)==STRING.CUT("&clk", 1))
    ( 
      &match=1
    )
  )
  else if (&wild_tail==1)
  (
    if (STRING.MID("gcc_bimc_mss_q6_axi_clk", 0, &clk_input_length-1)==STRING.CUT("&clk", -1))
    ( 
      &match=1
    )
  )
  else if ("gcc_bimc_mss_q6_axi_clk"=="&clk")
  (
    &match=1
  )
  
  if (&match==1)
  (
    &clk_test=&CLK_TEST_GCC_BIMC_MSS_Q6_AXI_CLK
    &clk_reg=&HWIO_GCC_BIMC_MSS_Q6_AXI_CBCR_ADDR
    &clk_reg_name="GCC_BIMC_MSS_Q6_AXI_CBCR"
    &clk_name="gcc_bimc_mss_q6_axi_clk"
    &clk_reg_cbcr_type="sm_cbc"
    &clk_vote_bit=-1.
    &clk_multiplier=4.

    gosub Print_Clk_Info_Line
  )

  &match=0
  &wild_head=0
  &wild_tail=0
  &clk_input_length=STRING.LENGTH("&clk")
  &clk_itr_length=STRING.LENGTH("gcc_mss_q6_bimc_axi_clk")

  if (STRING.SCAN("&clk", "*", 0)==0)
  (
    &wild_head=1
  )
  if (STRING.SCAN("&clk", "*", 1)==(STRING.LENGTH("&clk")-1))
  (
    &wild_tail=1
  )

  if ((&wild_head==1)&&(&wild_tail==1))
  (
    if (STRING.SCAN("gcc_mss_q6_bimc_axi_clk", STRING.MID("&clk", 1, &clk_input_length-2), 0)!=-1)
    ( 
      &match=1
    )
  )
  else if (&wild_head==1)
  (
    if (STRING.MID("gcc_mss_q6_bimc_axi_clk", &clk_itr_length-&clk_input_length+1, &clk_input_length-1)==STRING.CUT("&clk", 1))
    ( 
      &match=1
    )
  )
  else if (&wild_tail==1)
  (
    if (STRING.MID("gcc_mss_q6_bimc_axi_clk", 0, &clk_input_length-1)==STRING.CUT("&clk", -1))
    ( 
      &match=1
    )
  )
  else if ("gcc_mss_q6_bimc_axi_clk"=="&clk")
  (
    &match=1
  )
  
  if (&match==1)
  (
    &clk_test=&CLK_TEST_GCC_MSS_Q6_BIMC_AXI_CLK
    &clk_reg=&HWIO_GCC_MSS_Q6_BIMC_AXI_CBCR_ADDR
    &clk_reg_name="GCC_MSS_Q6_BIMC_AXI_CBCR"
    &clk_name="gcc_mss_q6_bimc_axi_clk"
    &clk_reg_cbcr_type="sm_cbc"
    &clk_vote_bit=-1.
    &clk_multiplier=4.

    gosub Print_Clk_Info_Line
  )

  &match=0
  &wild_head=0
  &wild_tail=0
  &clk_input_length=STRING.LENGTH("&clk")
  &clk_itr_length=STRING.LENGTH("gcc_mss_q6_msmpu_client_axi_clk")

  if (STRING.SCAN("&clk", "*", 0)==0)
  (
    &wild_head=1
  )
  if (STRING.SCAN("&clk", "*", 1)==(STRING.LENGTH("&clk")-1))
  (
    &wild_tail=1
  )

  if ((&wild_head==1)&&(&wild_tail==1))
  (
    if (STRING.SCAN("gcc_mss_q6_msmpu_client_axi_clk", STRING.MID("&clk", 1, &clk_input_length-2), 0)!=-1)
    ( 
      &match=1
    )
  )
  else if (&wild_head==1)
  (
    if (STRING.MID("gcc_mss_q6_msmpu_client_axi_clk", &clk_itr_length-&clk_input_length+1, &clk_input_length-1)==STRING.CUT("&clk", 1))
    ( 
      &match=1
    )
  )
  else if (&wild_tail==1)
  (
    if (STRING.MID("gcc_mss_q6_msmpu_client_axi_clk", 0, &clk_input_length-1)==STRING.CUT("&clk", -1))
    ( 
      &match=1
    )
  )
  else if ("gcc_mss_q6_msmpu_client_axi_clk"=="&clk")
  (
    &match=1
  )
  
  if (&match==1)
  (
    &clk_test=&CLK_TEST_GCC_MSS_Q6_MSMPU_CLIENT_AXI_CLK
    &clk_reg=&HWIO_GCC_MSS_Q6_MSMPU_CLIENT_AXI_CBCR_ADDR
    &clk_reg_name="GCC_MSS_Q6_MSMPU_CLIENT_AXI_CBCR"
    &clk_name="gcc_mss_q6_msmpu_client_axi_clk"
    &clk_reg_cbcr_type="sm_cbc"
    &clk_vote_bit=-1.
    &clk_multiplier=4.

    gosub Print_Clk_Info_Line
  )

  &match=0
  &wild_head=0
  &wild_tail=0
  &clk_input_length=STRING.LENGTH("&clk")
  &clk_itr_length=STRING.LENGTH("gcc_mss_vs_clk")

  if (STRING.SCAN("&clk", "*", 0)==0)
  (
    &wild_head=1
  )
  if (STRING.SCAN("&clk", "*", 1)==(STRING.LENGTH("&clk")-1))
  (
    &wild_tail=1
  )

  if ((&wild_head==1)&&(&wild_tail==1))
  (
    if (STRING.SCAN("gcc_mss_vs_clk", STRING.MID("&clk", 1, &clk_input_length-2), 0)!=-1)
    ( 
      &match=1
    )
  )
  else if (&wild_head==1)
  (
    if (STRING.MID("gcc_mss_vs_clk", &clk_itr_length-&clk_input_length+1, &clk_input_length-1)==STRING.CUT("&clk", 1))
    ( 
      &match=1
    )
  )
  else if (&wild_tail==1)
  (
    if (STRING.MID("gcc_mss_vs_clk", 0, &clk_input_length-1)==STRING.CUT("&clk", -1))
    ( 
      &match=1
    )
  )
  else if ("gcc_mss_vs_clk"=="&clk")
  (
    &match=1
  )
  
  if (&match==1)
  (
    &clk_test=&CLK_TEST_GCC_MSS_VS_CLK
    &clk_reg=&HWIO_GCC_MSS_VS_CBCR_ADDR
    &clk_reg_name="GCC_MSS_VS_CBCR"
    &clk_name="gcc_mss_vs_clk"
    &clk_reg_cbcr_type="sm_cbc"
    &clk_vote_bit=-1.
    &clk_multiplier=4.

    gosub Print_Clk_Info_Line
  )

  &match=0
  &wild_head=0
  &wild_tail=0
  &clk_input_length=STRING.LENGTH("&clk")
  &clk_itr_length=STRING.LENGTH("gcc_obt_odt_clk")

  if (STRING.SCAN("&clk", "*", 0)==0)
  (
    &wild_head=1
  )
  if (STRING.SCAN("&clk", "*", 1)==(STRING.LENGTH("&clk")-1))
  (
    &wild_tail=1
  )

  if ((&wild_head==1)&&(&wild_tail==1))
  (
    if (STRING.SCAN("gcc_obt_odt_clk", STRING.MID("&clk", 1, &clk_input_length-2), 0)!=-1)
    ( 
      &match=1
    )
  )
  else if (&wild_head==1)
  (
    if (STRING.MID("gcc_obt_odt_clk", &clk_itr_length-&clk_input_length+1, &clk_input_length-1)==STRING.CUT("&clk", 1))
    ( 
      &match=1
    )
  )
  else if (&wild_tail==1)
  (
    if (STRING.MID("gcc_obt_odt_clk", 0, &clk_input_length-1)==STRING.CUT("&clk", -1))
    ( 
      &match=1
    )
  )
  else if ("gcc_obt_odt_clk"=="&clk")
  (
    &match=1
  )
  
  if (&match==1)
  (
    &clk_test=&CLK_TEST_GCC_OBT_ODT_CLK
    &clk_reg=&HWIO_GCC_OBT_ODT_CBCR_ADDR
    &clk_reg_name="GCC_OBT_ODT_CBCR"
    &clk_name="gcc_obt_odt_clk"
    &clk_reg_cbcr_type="sm_cbc"
    &clk_vote_bit=-1.
    &clk_multiplier=4.

    gosub Print_Clk_Info_Line
  )

  &match=0
  &wild_head=0
  &wild_tail=0
  &clk_input_length=STRING.LENGTH("&clk")
  &clk_itr_length=STRING.LENGTH("gcc_pcie_0_pipe_clk")

  if (STRING.SCAN("&clk", "*", 0)==0)
  (
    &wild_head=1
  )
  if (STRING.SCAN("&clk", "*", 1)==(STRING.LENGTH("&clk")-1))
  (
    &wild_tail=1
  )

  if ((&wild_head==1)&&(&wild_tail==1))
  (
    if (STRING.SCAN("gcc_pcie_0_pipe_clk", STRING.MID("&clk", 1, &clk_input_length-2), 0)!=-1)
    ( 
      &match=1
    )
  )
  else if (&wild_head==1)
  (
    if (STRING.MID("gcc_pcie_0_pipe_clk", &clk_itr_length-&clk_input_length+1, &clk_input_length-1)==STRING.CUT("&clk", 1))
    ( 
      &match=1
    )
  )
  else if (&wild_tail==1)
  (
    if (STRING.MID("gcc_pcie_0_pipe_clk", 0, &clk_input_length-1)==STRING.CUT("&clk", -1))
    ( 
      &match=1
    )
  )
  else if ("gcc_pcie_0_pipe_clk"=="&clk")
  (
    &match=1
  )
  
  if (&match==1)
  (
    &clk_test=&CLK_TEST_GCC_PCIE_0_PIPE_CLK
    &clk_reg=&HWIO_GCC_PCIE_0_PIPE_CBCR_ADDR
    &clk_reg_name="GCC_PCIE_0_PIPE_CBCR"
    &clk_name="gcc_pcie_0_pipe_clk"
    &clk_reg_cbcr_type="sm_pscbc"
    &clk_vote_bit=-1.
    &clk_multiplier=4.

    gosub Print_Clk_Info_Line
  )

  &match=0
  &wild_head=0
  &wild_tail=0
  &clk_input_length=STRING.LENGTH("&clk")
  &clk_itr_length=STRING.LENGTH("gcc_pcie_0_aux_clk")

  if (STRING.SCAN("&clk", "*", 0)==0)
  (
    &wild_head=1
  )
  if (STRING.SCAN("&clk", "*", 1)==(STRING.LENGTH("&clk")-1))
  (
    &wild_tail=1
  )

  if ((&wild_head==1)&&(&wild_tail==1))
  (
    if (STRING.SCAN("gcc_pcie_0_aux_clk", STRING.MID("&clk", 1, &clk_input_length-2), 0)!=-1)
    ( 
      &match=1
    )
  )
  else if (&wild_head==1)
  (
    if (STRING.MID("gcc_pcie_0_aux_clk", &clk_itr_length-&clk_input_length+1, &clk_input_length-1)==STRING.CUT("&clk", 1))
    ( 
      &match=1
    )
  )
  else if (&wild_tail==1)
  (
    if (STRING.MID("gcc_pcie_0_aux_clk", 0, &clk_input_length-1)==STRING.CUT("&clk", -1))
    ( 
      &match=1
    )
  )
  else if ("gcc_pcie_0_aux_clk"=="&clk")
  (
    &match=1
  )
  
  if (&match==1)
  (
    &clk_test=&CLK_TEST_GCC_PCIE_0_AUX_CLK
    &clk_reg=&HWIO_GCC_PCIE_0_AUX_CBCR_ADDR
    &clk_reg_name="GCC_PCIE_0_AUX_CBCR"
    &clk_name="gcc_pcie_0_aux_clk"
    &clk_reg_cbcr_type="sm_cbc"
    &clk_vote_bit=-1.
    &clk_multiplier=4.

    gosub Print_Clk_Info_Line
  )

  &match=0
  &wild_head=0
  &wild_tail=0
  &clk_input_length=STRING.LENGTH("&clk")
  &clk_itr_length=STRING.LENGTH("gcc_pcie_phy_aux_clk")

  if (STRING.SCAN("&clk", "*", 0)==0)
  (
    &wild_head=1
  )
  if (STRING.SCAN("&clk", "*", 1)==(STRING.LENGTH("&clk")-1))
  (
    &wild_tail=1
  )

  if ((&wild_head==1)&&(&wild_tail==1))
  (
    if (STRING.SCAN("gcc_pcie_phy_aux_clk", STRING.MID("&clk", 1, &clk_input_length-2), 0)!=-1)
    ( 
      &match=1
    )
  )
  else if (&wild_head==1)
  (
    if (STRING.MID("gcc_pcie_phy_aux_clk", &clk_itr_length-&clk_input_length+1, &clk_input_length-1)==STRING.CUT("&clk", 1))
    ( 
      &match=1
    )
  )
  else if (&wild_tail==1)
  (
    if (STRING.MID("gcc_pcie_phy_aux_clk", 0, &clk_input_length-1)==STRING.CUT("&clk", -1))
    ( 
      &match=1
    )
  )
  else if ("gcc_pcie_phy_aux_clk"=="&clk")
  (
    &match=1
  )
  
  if (&match==1)
  (
    &clk_test=&CLK_TEST_GCC_PCIE_PHY_AUX_CLK
    &clk_reg=&HWIO_GCC_PCIE_PHY_AUX_CBCR_ADDR
    &clk_reg_name="GCC_PCIE_PHY_AUX_CBCR"
    &clk_name="gcc_pcie_phy_aux_clk"
    &clk_reg_cbcr_type="sm_cbc"
    &clk_vote_bit=-1.
    &clk_multiplier=4.

    gosub Print_Clk_Info_Line
  )

  &match=0
  &wild_head=0
  &wild_tail=0
  &clk_input_length=STRING.LENGTH("&clk")
  &clk_itr_length=STRING.LENGTH("gcc_pdm2_clk")

  if (STRING.SCAN("&clk", "*", 0)==0)
  (
    &wild_head=1
  )
  if (STRING.SCAN("&clk", "*", 1)==(STRING.LENGTH("&clk")-1))
  (
    &wild_tail=1
  )

  if ((&wild_head==1)&&(&wild_tail==1))
  (
    if (STRING.SCAN("gcc_pdm2_clk", STRING.MID("&clk", 1, &clk_input_length-2), 0)!=-1)
    ( 
      &match=1
    )
  )
  else if (&wild_head==1)
  (
    if (STRING.MID("gcc_pdm2_clk", &clk_itr_length-&clk_input_length+1, &clk_input_length-1)==STRING.CUT("&clk", 1))
    ( 
      &match=1
    )
  )
  else if (&wild_tail==1)
  (
    if (STRING.MID("gcc_pdm2_clk", 0, &clk_input_length-1)==STRING.CUT("&clk", -1))
    ( 
      &match=1
    )
  )
  else if ("gcc_pdm2_clk"=="&clk")
  (
    &match=1
  )
  
  if (&match==1)
  (
    &clk_test=&CLK_TEST_GCC_PDM2_CLK
    &clk_reg=&HWIO_GCC_PDM2_CBCR_ADDR
    &clk_reg_name="GCC_PDM2_CBCR"
    &clk_name="gcc_pdm2_clk"
    &clk_reg_cbcr_type="sm_cbc"
    &clk_vote_bit=-1.
    &clk_multiplier=4.

    gosub Print_Clk_Info_Line
  )

  &match=0
  &wild_head=0
  &wild_tail=0
  &clk_input_length=STRING.LENGTH("&clk")
  &clk_itr_length=STRING.LENGTH("gcc_bimc_pimem_axi_clk")

  if (STRING.SCAN("&clk", "*", 0)==0)
  (
    &wild_head=1
  )
  if (STRING.SCAN("&clk", "*", 1)==(STRING.LENGTH("&clk")-1))
  (
    &wild_tail=1
  )

  if ((&wild_head==1)&&(&wild_tail==1))
  (
    if (STRING.SCAN("gcc_bimc_pimem_axi_clk", STRING.MID("&clk", 1, &clk_input_length-2), 0)!=-1)
    ( 
      &match=1
    )
  )
  else if (&wild_head==1)
  (
    if (STRING.MID("gcc_bimc_pimem_axi_clk", &clk_itr_length-&clk_input_length+1, &clk_input_length-1)==STRING.CUT("&clk", 1))
    ( 
      &match=1
    )
  )
  else if (&wild_tail==1)
  (
    if (STRING.MID("gcc_bimc_pimem_axi_clk", 0, &clk_input_length-1)==STRING.CUT("&clk", -1))
    ( 
      &match=1
    )
  )
  else if ("gcc_bimc_pimem_axi_clk"=="&clk")
  (
    &match=1
  )
  
  if (&match==1)
  (
    &clk_test=&CLK_TEST_GCC_BIMC_PIMEM_AXI_CLK
    &clk_reg=&HWIO_GCC_BIMC_PIMEM_AXI_CBCR_ADDR
    &clk_reg_name="GCC_BIMC_PIMEM_AXI_CBCR"
    &clk_name="gcc_bimc_pimem_axi_clk"
    &clk_reg_cbcr_type="sm_cbc"
    &clk_vote_bit=-1.
    &clk_multiplier=4.

    gosub Print_Clk_Info_Line
  )

  &match=0
  &wild_head=0
  &wild_tail=0
  &clk_input_length=STRING.LENGTH("&clk")
  &clk_itr_length=STRING.LENGTH("gcc_pimem_axi_clk")

  if (STRING.SCAN("&clk", "*", 0)==0)
  (
    &wild_head=1
  )
  if (STRING.SCAN("&clk", "*", 1)==(STRING.LENGTH("&clk")-1))
  (
    &wild_tail=1
  )

  if ((&wild_head==1)&&(&wild_tail==1))
  (
    if (STRING.SCAN("gcc_pimem_axi_clk", STRING.MID("&clk", 1, &clk_input_length-2), 0)!=-1)
    ( 
      &match=1
    )
  )
  else if (&wild_head==1)
  (
    if (STRING.MID("gcc_pimem_axi_clk", &clk_itr_length-&clk_input_length+1, &clk_input_length-1)==STRING.CUT("&clk", 1))
    ( 
      &match=1
    )
  )
  else if (&wild_tail==1)
  (
    if (STRING.MID("gcc_pimem_axi_clk", 0, &clk_input_length-1)==STRING.CUT("&clk", -1))
    ( 
      &match=1
    )
  )
  else if ("gcc_pimem_axi_clk"=="&clk")
  (
    &match=1
  )
  
  if (&match==1)
  (
    &clk_test=&CLK_TEST_GCC_PIMEM_AXI_CLK
    &clk_reg=&HWIO_GCC_PIMEM_AXI_CBCR_ADDR
    &clk_reg_name="GCC_PIMEM_AXI_CBCR"
    &clk_name="gcc_pimem_axi_clk"
    &clk_reg_cbcr_type="sm_pscbc"
    &clk_vote_bit=-1.
    &clk_multiplier=4.

    gosub Print_Clk_Info_Line
  )

  &match=0
  &wild_head=0
  &wild_tail=0
  &clk_input_length=STRING.LENGTH("&clk")
  &clk_itr_length=STRING.LENGTH("gcc_sys_noc_pimem_axi_clk")

  if (STRING.SCAN("&clk", "*", 0)==0)
  (
    &wild_head=1
  )
  if (STRING.SCAN("&clk", "*", 1)==(STRING.LENGTH("&clk")-1))
  (
    &wild_tail=1
  )

  if ((&wild_head==1)&&(&wild_tail==1))
  (
    if (STRING.SCAN("gcc_sys_noc_pimem_axi_clk", STRING.MID("&clk", 1, &clk_input_length-2), 0)!=-1)
    ( 
      &match=1
    )
  )
  else if (&wild_head==1)
  (
    if (STRING.MID("gcc_sys_noc_pimem_axi_clk", &clk_itr_length-&clk_input_length+1, &clk_input_length-1)==STRING.CUT("&clk", 1))
    ( 
      &match=1
    )
  )
  else if (&wild_tail==1)
  (
    if (STRING.MID("gcc_sys_noc_pimem_axi_clk", 0, &clk_input_length-1)==STRING.CUT("&clk", -1))
    ( 
      &match=1
    )
  )
  else if ("gcc_sys_noc_pimem_axi_clk"=="&clk")
  (
    &match=1
  )
  
  if (&match==1)
  (
    &clk_test=&CLK_TEST_GCC_SYS_NOC_PIMEM_AXI_CLK
    &clk_reg=&HWIO_GCC_SYS_NOC_PIMEM_AXI_CBCR_ADDR
    &clk_reg_name="GCC_SYS_NOC_PIMEM_AXI_CBCR"
    &clk_name="gcc_sys_noc_pimem_axi_clk"
    &clk_reg_cbcr_type="sm_cbc"
    &clk_vote_bit=-1.
    &clk_multiplier=4.

    gosub Print_Clk_Info_Line
  )

  &match=0
  &wild_head=0
  &wild_tail=0
  &clk_input_length=STRING.LENGTH("&clk")
  &clk_itr_length=STRING.LENGTH("gcc_center_apb_clk")

  if (STRING.SCAN("&clk", "*", 0)==0)
  (
    &wild_head=1
  )
  if (STRING.SCAN("&clk", "*", 1)==(STRING.LENGTH("&clk")-1))
  (
    &wild_tail=1
  )

  if ((&wild_head==1)&&(&wild_tail==1))
  (
    if (STRING.SCAN("gcc_center_apb_clk", STRING.MID("&clk", 1, &clk_input_length-2), 0)!=-1)
    ( 
      &match=1
    )
  )
  else if (&wild_head==1)
  (
    if (STRING.MID("gcc_center_apb_clk", &clk_itr_length-&clk_input_length+1, &clk_input_length-1)==STRING.CUT("&clk", 1))
    ( 
      &match=1
    )
  )
  else if (&wild_tail==1)
  (
    if (STRING.MID("gcc_center_apb_clk", 0, &clk_input_length-1)==STRING.CUT("&clk", -1))
    ( 
      &match=1
    )
  )
  else if ("gcc_center_apb_clk"=="&clk")
  (
    &match=1
  )
  
  if (&match==1)
  (
    &clk_test=&CLK_TEST_GCC_CENTER_APB_CLK
    &clk_reg=&HWIO_GCC_CENTER_APB_CBCR_ADDR
    &clk_reg_name="GCC_CENTER_APB_CBCR"
    &clk_name="gcc_center_apb_clk"
    &clk_reg_cbcr_type="sm_cbc"
    &clk_vote_bit=-1.
    &clk_multiplier=4.

    gosub Print_Clk_Info_Line
  )

  &match=0
  &wild_head=0
  &wild_tail=0
  &clk_input_length=STRING.LENGTH("&clk")
  &clk_itr_length=STRING.LENGTH("gcc_east_apb_clk")

  if (STRING.SCAN("&clk", "*", 0)==0)
  (
    &wild_head=1
  )
  if (STRING.SCAN("&clk", "*", 1)==(STRING.LENGTH("&clk")-1))
  (
    &wild_tail=1
  )

  if ((&wild_head==1)&&(&wild_tail==1))
  (
    if (STRING.SCAN("gcc_east_apb_clk", STRING.MID("&clk", 1, &clk_input_length-2), 0)!=-1)
    ( 
      &match=1
    )
  )
  else if (&wild_head==1)
  (
    if (STRING.MID("gcc_east_apb_clk", &clk_itr_length-&clk_input_length+1, &clk_input_length-1)==STRING.CUT("&clk", 1))
    ( 
      &match=1
    )
  )
  else if (&wild_tail==1)
  (
    if (STRING.MID("gcc_east_apb_clk", 0, &clk_input_length-1)==STRING.CUT("&clk", -1))
    ( 
      &match=1
    )
  )
  else if ("gcc_east_apb_clk"=="&clk")
  (
    &match=1
  )
  
  if (&match==1)
  (
    &clk_test=&CLK_TEST_GCC_EAST_APB_CLK
    &clk_reg=&HWIO_GCC_EAST_APB_CBCR_ADDR
    &clk_reg_name="GCC_EAST_APB_CBCR"
    &clk_name="gcc_east_apb_clk"
    &clk_reg_cbcr_type="sm_cbc"
    &clk_vote_bit=-1.
    &clk_multiplier=4.

    gosub Print_Clk_Info_Line
  )

  &match=0
  &wild_head=0
  &wild_tail=0
  &clk_input_length=STRING.LENGTH("&clk")
  &clk_itr_length=STRING.LENGTH("gcc_gpu_trig_clk")

  if (STRING.SCAN("&clk", "*", 0)==0)
  (
    &wild_head=1
  )
  if (STRING.SCAN("&clk", "*", 1)==(STRING.LENGTH("&clk")-1))
  (
    &wild_tail=1
  )

  if ((&wild_head==1)&&(&wild_tail==1))
  (
    if (STRING.SCAN("gcc_gpu_trig_clk", STRING.MID("&clk", 1, &clk_input_length-2), 0)!=-1)
    ( 
      &match=1
    )
  )
  else if (&wild_head==1)
  (
    if (STRING.MID("gcc_gpu_trig_clk", &clk_itr_length-&clk_input_length+1, &clk_input_length-1)==STRING.CUT("&clk", 1))
    ( 
      &match=1
    )
  )
  else if (&wild_tail==1)
  (
    if (STRING.MID("gcc_gpu_trig_clk", 0, &clk_input_length-1)==STRING.CUT("&clk", -1))
    ( 
      &match=1
    )
  )
  else if ("gcc_gpu_trig_clk"=="&clk")
  (
    &match=1
  )
  
  if (&match==1)
  (
    &clk_test=&CLK_TEST_GCC_GPU_TRIG_CLK
    &clk_reg=&HWIO_GCC_GPU_TRIG_CBCR_ADDR
    &clk_reg_name="GCC_GPU_TRIG_CBCR"
    &clk_name="gcc_gpu_trig_clk"
    &clk_reg_cbcr_type="sm_cbc"
    &clk_vote_bit=-1.
    &clk_multiplier=4.

    gosub Print_Clk_Info_Line
  )

  &match=0
  &wild_head=0
  &wild_tail=0
  &clk_input_length=STRING.LENGTH("&clk")
  &clk_itr_length=STRING.LENGTH("gcc_hmss_trig_clk")

  if (STRING.SCAN("&clk", "*", 0)==0)
  (
    &wild_head=1
  )
  if (STRING.SCAN("&clk", "*", 1)==(STRING.LENGTH("&clk")-1))
  (
    &wild_tail=1
  )

  if ((&wild_head==1)&&(&wild_tail==1))
  (
    if (STRING.SCAN("gcc_hmss_trig_clk", STRING.MID("&clk", 1, &clk_input_length-2), 0)!=-1)
    ( 
      &match=1
    )
  )
  else if (&wild_head==1)
  (
    if (STRING.MID("gcc_hmss_trig_clk", &clk_itr_length-&clk_input_length+1, &clk_input_length-1)==STRING.CUT("&clk", 1))
    ( 
      &match=1
    )
  )
  else if (&wild_tail==1)
  (
    if (STRING.MID("gcc_hmss_trig_clk", 0, &clk_input_length-1)==STRING.CUT("&clk", -1))
    ( 
      &match=1
    )
  )
  else if ("gcc_hmss_trig_clk"=="&clk")
  (
    &match=1
  )
  
  if (&match==1)
  (
    &clk_test=&CLK_TEST_GCC_HMSS_TRIG_CLK
    &clk_reg=&HWIO_GCC_HMSS_TRIG_CBCR_ADDR
    &clk_reg_name="GCC_HMSS_TRIG_CBCR"
    &clk_name="gcc_hmss_trig_clk"
    &clk_reg_cbcr_type="sm_cbc"
    &clk_vote_bit=-1.
    &clk_multiplier=4.

    gosub Print_Clk_Info_Line
  )

  &match=0
  &wild_head=0
  &wild_tail=0
  &clk_input_length=STRING.LENGTH("&clk")
  &clk_itr_length=STRING.LENGTH("gcc_lpass_trig_clk")

  if (STRING.SCAN("&clk", "*", 0)==0)
  (
    &wild_head=1
  )
  if (STRING.SCAN("&clk", "*", 1)==(STRING.LENGTH("&clk")-1))
  (
    &wild_tail=1
  )

  if ((&wild_head==1)&&(&wild_tail==1))
  (
    if (STRING.SCAN("gcc_lpass_trig_clk", STRING.MID("&clk", 1, &clk_input_length-2), 0)!=-1)
    ( 
      &match=1
    )
  )
  else if (&wild_head==1)
  (
    if (STRING.MID("gcc_lpass_trig_clk", &clk_itr_length-&clk_input_length+1, &clk_input_length-1)==STRING.CUT("&clk", 1))
    ( 
      &match=1
    )
  )
  else if (&wild_tail==1)
  (
    if (STRING.MID("gcc_lpass_trig_clk", 0, &clk_input_length-1)==STRING.CUT("&clk", -1))
    ( 
      &match=1
    )
  )
  else if ("gcc_lpass_trig_clk"=="&clk")
  (
    &match=1
  )
  
  if (&match==1)
  (
    &clk_test=&CLK_TEST_GCC_LPASS_TRIG_CLK
    &clk_reg=&HWIO_GCC_LPASS_TRIG_CBCR_ADDR
    &clk_reg_name="GCC_LPASS_TRIG_CBCR"
    &clk_name="gcc_lpass_trig_clk"
    &clk_reg_cbcr_type="sm_cbc"
    &clk_vote_bit=-1.
    &clk_multiplier=4.

    gosub Print_Clk_Info_Line
  )

  &match=0
  &wild_head=0
  &wild_tail=0
  &clk_input_length=STRING.LENGTH("&clk")
  &clk_itr_length=STRING.LENGTH("gcc_mmss_trig_clk")

  if (STRING.SCAN("&clk", "*", 0)==0)
  (
    &wild_head=1
  )
  if (STRING.SCAN("&clk", "*", 1)==(STRING.LENGTH("&clk")-1))
  (
    &wild_tail=1
  )

  if ((&wild_head==1)&&(&wild_tail==1))
  (
    if (STRING.SCAN("gcc_mmss_trig_clk", STRING.MID("&clk", 1, &clk_input_length-2), 0)!=-1)
    ( 
      &match=1
    )
  )
  else if (&wild_head==1)
  (
    if (STRING.MID("gcc_mmss_trig_clk", &clk_itr_length-&clk_input_length+1, &clk_input_length-1)==STRING.CUT("&clk", 1))
    ( 
      &match=1
    )
  )
  else if (&wild_tail==1)
  (
    if (STRING.MID("gcc_mmss_trig_clk", 0, &clk_input_length-1)==STRING.CUT("&clk", -1))
    ( 
      &match=1
    )
  )
  else if ("gcc_mmss_trig_clk"=="&clk")
  (
    &match=1
  )
  
  if (&match==1)
  (
    &clk_test=&CLK_TEST_GCC_MMSS_TRIG_CLK
    &clk_reg=&HWIO_GCC_MMSS_TRIG_CBCR_ADDR
    &clk_reg_name="GCC_MMSS_TRIG_CBCR"
    &clk_name="gcc_mmss_trig_clk"
    &clk_reg_cbcr_type="sm_cbc"
    &clk_vote_bit=-1.
    &clk_multiplier=4.

    gosub Print_Clk_Info_Line
  )

  &match=0
  &wild_head=0
  &wild_tail=0
  &clk_input_length=STRING.LENGTH("&clk")
  &clk_itr_length=STRING.LENGTH("gcc_mss_trig_clk")

  if (STRING.SCAN("&clk", "*", 0)==0)
  (
    &wild_head=1
  )
  if (STRING.SCAN("&clk", "*", 1)==(STRING.LENGTH("&clk")-1))
  (
    &wild_tail=1
  )

  if ((&wild_head==1)&&(&wild_tail==1))
  (
    if (STRING.SCAN("gcc_mss_trig_clk", STRING.MID("&clk", 1, &clk_input_length-2), 0)!=-1)
    ( 
      &match=1
    )
  )
  else if (&wild_head==1)
  (
    if (STRING.MID("gcc_mss_trig_clk", &clk_itr_length-&clk_input_length+1, &clk_input_length-1)==STRING.CUT("&clk", 1))
    ( 
      &match=1
    )
  )
  else if (&wild_tail==1)
  (
    if (STRING.MID("gcc_mss_trig_clk", 0, &clk_input_length-1)==STRING.CUT("&clk", -1))
    ( 
      &match=1
    )
  )
  else if ("gcc_mss_trig_clk"=="&clk")
  (
    &match=1
  )
  
  if (&match==1)
  (
    &clk_test=&CLK_TEST_GCC_MSS_TRIG_CLK
    &clk_reg=&HWIO_GCC_MSS_TRIG_CBCR_ADDR
    &clk_reg_name="GCC_MSS_TRIG_CBCR"
    &clk_name="gcc_mss_trig_clk"
    &clk_reg_cbcr_type="sm_cbc"
    &clk_vote_bit=-1.
    &clk_multiplier=4.

    gosub Print_Clk_Info_Line
  )

  &match=0
  &wild_head=0
  &wild_tail=0
  &clk_input_length=STRING.LENGTH("&clk")
  &clk_itr_length=STRING.LENGTH("gcc_north_apb_clk")

  if (STRING.SCAN("&clk", "*", 0)==0)
  (
    &wild_head=1
  )
  if (STRING.SCAN("&clk", "*", 1)==(STRING.LENGTH("&clk")-1))
  (
    &wild_tail=1
  )

  if ((&wild_head==1)&&(&wild_tail==1))
  (
    if (STRING.SCAN("gcc_north_apb_clk", STRING.MID("&clk", 1, &clk_input_length-2), 0)!=-1)
    ( 
      &match=1
    )
  )
  else if (&wild_head==1)
  (
    if (STRING.MID("gcc_north_apb_clk", &clk_itr_length-&clk_input_length+1, &clk_input_length-1)==STRING.CUT("&clk", 1))
    ( 
      &match=1
    )
  )
  else if (&wild_tail==1)
  (
    if (STRING.MID("gcc_north_apb_clk", 0, &clk_input_length-1)==STRING.CUT("&clk", -1))
    ( 
      &match=1
    )
  )
  else if ("gcc_north_apb_clk"=="&clk")
  (
    &match=1
  )
  
  if (&match==1)
  (
    &clk_test=&CLK_TEST_GCC_NORTH_APB_CLK
    &clk_reg=&HWIO_GCC_NORTH_APB_CBCR_ADDR
    &clk_reg_name="GCC_NORTH_APB_CBCR"
    &clk_name="gcc_north_apb_clk"
    &clk_reg_cbcr_type="sm_cbc"
    &clk_vote_bit=-1.
    &clk_multiplier=4.

    gosub Print_Clk_Info_Line
  )

  &match=0
  &wild_head=0
  &wild_tail=0
  &clk_input_length=STRING.LENGTH("&clk")
  &clk_itr_length=STRING.LENGTH("gcc_qdss_apb2jtag_clk")

  if (STRING.SCAN("&clk", "*", 0)==0)
  (
    &wild_head=1
  )
  if (STRING.SCAN("&clk", "*", 1)==(STRING.LENGTH("&clk")-1))
  (
    &wild_tail=1
  )

  if ((&wild_head==1)&&(&wild_tail==1))
  (
    if (STRING.SCAN("gcc_qdss_apb2jtag_clk", STRING.MID("&clk", 1, &clk_input_length-2), 0)!=-1)
    ( 
      &match=1
    )
  )
  else if (&wild_head==1)
  (
    if (STRING.MID("gcc_qdss_apb2jtag_clk", &clk_itr_length-&clk_input_length+1, &clk_input_length-1)==STRING.CUT("&clk", 1))
    ( 
      &match=1
    )
  )
  else if (&wild_tail==1)
  (
    if (STRING.MID("gcc_qdss_apb2jtag_clk", 0, &clk_input_length-1)==STRING.CUT("&clk", -1))
    ( 
      &match=1
    )
  )
  else if ("gcc_qdss_apb2jtag_clk"=="&clk")
  (
    &match=1
  )
  
  if (&match==1)
  (
    &clk_test=&CLK_TEST_GCC_QDSS_APB2JTAG_CLK
    &clk_reg=&HWIO_GCC_QDSS_APB2JTAG_CBCR_ADDR
    &clk_reg_name="GCC_QDSS_APB2JTAG_CBCR"
    &clk_name="gcc_qdss_apb2jtag_clk"
    &clk_reg_cbcr_type="sm_cbc"
    &clk_vote_bit=-1.
    &clk_multiplier=4.

    gosub Print_Clk_Info_Line
  )

  &match=0
  &wild_head=0
  &wild_tail=0
  &clk_input_length=STRING.LENGTH("&clk")
  &clk_itr_length=STRING.LENGTH("gcc_qdss_dap_clk")

  if (STRING.SCAN("&clk", "*", 0)==0)
  (
    &wild_head=1
  )
  if (STRING.SCAN("&clk", "*", 1)==(STRING.LENGTH("&clk")-1))
  (
    &wild_tail=1
  )

  if ((&wild_head==1)&&(&wild_tail==1))
  (
    if (STRING.SCAN("gcc_qdss_dap_clk", STRING.MID("&clk", 1, &clk_input_length-2), 0)!=-1)
    ( 
      &match=1
    )
  )
  else if (&wild_head==1)
  (
    if (STRING.MID("gcc_qdss_dap_clk", &clk_itr_length-&clk_input_length+1, &clk_input_length-1)==STRING.CUT("&clk", 1))
    ( 
      &match=1
    )
  )
  else if (&wild_tail==1)
  (
    if (STRING.MID("gcc_qdss_dap_clk", 0, &clk_input_length-1)==STRING.CUT("&clk", -1))
    ( 
      &match=1
    )
  )
  else if ("gcc_qdss_dap_clk"=="&clk")
  (
    &match=1
  )
  
  if (&match==1)
  (
    &clk_test=&CLK_TEST_GCC_QDSS_DAP_CLK
    &clk_reg=&HWIO_GCC_QDSS_DAP_CBCR_ADDR
    &clk_reg_name="GCC_QDSS_DAP_CBCR"
    &clk_name="gcc_qdss_dap_clk"
    &clk_reg_cbcr_type="sm_cbc"
    &clk_vote_bit=-1.
    &clk_multiplier=4.

    gosub Print_Clk_Info_Line
  )

  &match=0
  &wild_head=0
  &wild_tail=0
  &clk_input_length=STRING.LENGTH("&clk")
  &clk_itr_length=STRING.LENGTH("gcc_qdss_trig_clk")

  if (STRING.SCAN("&clk", "*", 0)==0)
  (
    &wild_head=1
  )
  if (STRING.SCAN("&clk", "*", 1)==(STRING.LENGTH("&clk")-1))
  (
    &wild_tail=1
  )

  if ((&wild_head==1)&&(&wild_tail==1))
  (
    if (STRING.SCAN("gcc_qdss_trig_clk", STRING.MID("&clk", 1, &clk_input_length-2), 0)!=-1)
    ( 
      &match=1
    )
  )
  else if (&wild_head==1)
  (
    if (STRING.MID("gcc_qdss_trig_clk", &clk_itr_length-&clk_input_length+1, &clk_input_length-1)==STRING.CUT("&clk", 1))
    ( 
      &match=1
    )
  )
  else if (&wild_tail==1)
  (
    if (STRING.MID("gcc_qdss_trig_clk", 0, &clk_input_length-1)==STRING.CUT("&clk", -1))
    ( 
      &match=1
    )
  )
  else if ("gcc_qdss_trig_clk"=="&clk")
  (
    &match=1
  )
  
  if (&match==1)
  (
    &clk_test=&CLK_TEST_GCC_QDSS_TRIG_CLK
    &clk_reg=&HWIO_GCC_QDSS_TRIG_CBCR_ADDR
    &clk_reg_name="GCC_QDSS_TRIG_CBCR"
    &clk_name="gcc_qdss_trig_clk"
    &clk_reg_cbcr_type="sm_cbc"
    &clk_vote_bit=-1.
    &clk_multiplier=4.

    gosub Print_Clk_Info_Line
  )

  &match=0
  &wild_head=0
  &wild_tail=0
  &clk_input_length=STRING.LENGTH("&clk")
  &clk_itr_length=STRING.LENGTH("gcc_spss_trig_clk")

  if (STRING.SCAN("&clk", "*", 0)==0)
  (
    &wild_head=1
  )
  if (STRING.SCAN("&clk", "*", 1)==(STRING.LENGTH("&clk")-1))
  (
    &wild_tail=1
  )

  if ((&wild_head==1)&&(&wild_tail==1))
  (
    if (STRING.SCAN("gcc_spss_trig_clk", STRING.MID("&clk", 1, &clk_input_length-2), 0)!=-1)
    ( 
      &match=1
    )
  )
  else if (&wild_head==1)
  (
    if (STRING.MID("gcc_spss_trig_clk", &clk_itr_length-&clk_input_length+1, &clk_input_length-1)==STRING.CUT("&clk", 1))
    ( 
      &match=1
    )
  )
  else if (&wild_tail==1)
  (
    if (STRING.MID("gcc_spss_trig_clk", 0, &clk_input_length-1)==STRING.CUT("&clk", -1))
    ( 
      &match=1
    )
  )
  else if ("gcc_spss_trig_clk"=="&clk")
  (
    &match=1
  )
  
  if (&match==1)
  (
    &clk_test=&CLK_TEST_GCC_SPSS_TRIG_CLK
    &clk_reg=&HWIO_GCC_SPSS_TRIG_CBCR_ADDR
    &clk_reg_name="GCC_SPSS_TRIG_CBCR"
    &clk_name="gcc_spss_trig_clk"
    &clk_reg_cbcr_type="sm_cbc"
    &clk_vote_bit=-1.
    &clk_multiplier=4.

    gosub Print_Clk_Info_Line
  )

  &match=0
  &wild_head=0
  &wild_tail=0
  &clk_input_length=STRING.LENGTH("&clk")
  &clk_itr_length=STRING.LENGTH("gcc_ssc_apb_clk")

  if (STRING.SCAN("&clk", "*", 0)==0)
  (
    &wild_head=1
  )
  if (STRING.SCAN("&clk", "*", 1)==(STRING.LENGTH("&clk")-1))
  (
    &wild_tail=1
  )

  if ((&wild_head==1)&&(&wild_tail==1))
  (
    if (STRING.SCAN("gcc_ssc_apb_clk", STRING.MID("&clk", 1, &clk_input_length-2), 0)!=-1)
    ( 
      &match=1
    )
  )
  else if (&wild_head==1)
  (
    if (STRING.MID("gcc_ssc_apb_clk", &clk_itr_length-&clk_input_length+1, &clk_input_length-1)==STRING.CUT("&clk", 1))
    ( 
      &match=1
    )
  )
  else if (&wild_tail==1)
  (
    if (STRING.MID("gcc_ssc_apb_clk", 0, &clk_input_length-1)==STRING.CUT("&clk", -1))
    ( 
      &match=1
    )
  )
  else if ("gcc_ssc_apb_clk"=="&clk")
  (
    &match=1
  )
  
  if (&match==1)
  (
    &clk_test=&CLK_TEST_GCC_SSC_APB_CLK
    &clk_reg=&HWIO_GCC_SSC_APB_CBCR_ADDR
    &clk_reg_name="GCC_SSC_APB_CBCR"
    &clk_name="gcc_ssc_apb_clk"
    &clk_reg_cbcr_type="sm_cbc"
    &clk_vote_bit=-1.
    &clk_multiplier=4.

    gosub Print_Clk_Info_Line
  )

  &match=0
  &wild_head=0
  &wild_tail=0
  &clk_input_length=STRING.LENGTH("&clk")
  &clk_itr_length=STRING.LENGTH("gcc_wcss_apb_clk")

  if (STRING.SCAN("&clk", "*", 0)==0)
  (
    &wild_head=1
  )
  if (STRING.SCAN("&clk", "*", 1)==(STRING.LENGTH("&clk")-1))
  (
    &wild_tail=1
  )

  if ((&wild_head==1)&&(&wild_tail==1))
  (
    if (STRING.SCAN("gcc_wcss_apb_clk", STRING.MID("&clk", 1, &clk_input_length-2), 0)!=-1)
    ( 
      &match=1
    )
  )
  else if (&wild_head==1)
  (
    if (STRING.MID("gcc_wcss_apb_clk", &clk_itr_length-&clk_input_length+1, &clk_input_length-1)==STRING.CUT("&clk", 1))
    ( 
      &match=1
    )
  )
  else if (&wild_tail==1)
  (
    if (STRING.MID("gcc_wcss_apb_clk", 0, &clk_input_length-1)==STRING.CUT("&clk", -1))
    ( 
      &match=1
    )
  )
  else if ("gcc_wcss_apb_clk"=="&clk")
  (
    &match=1
  )
  
  if (&match==1)
  (
    &clk_test=&CLK_TEST_GCC_WCSS_APB_CLK
    &clk_reg=&HWIO_GCC_WCSS_APB_CBCR_ADDR
    &clk_reg_name="GCC_WCSS_APB_CBCR"
    &clk_name="gcc_wcss_apb_clk"
    &clk_reg_cbcr_type="sm_cbc"
    &clk_vote_bit=-1.
    &clk_multiplier=4.

    gosub Print_Clk_Info_Line
  )

  &match=0
  &wild_head=0
  &wild_tail=0
  &clk_input_length=STRING.LENGTH("&clk")
  &clk_itr_length=STRING.LENGTH("gcc_west_apb_clk")

  if (STRING.SCAN("&clk", "*", 0)==0)
  (
    &wild_head=1
  )
  if (STRING.SCAN("&clk", "*", 1)==(STRING.LENGTH("&clk")-1))
  (
    &wild_tail=1
  )

  if ((&wild_head==1)&&(&wild_tail==1))
  (
    if (STRING.SCAN("gcc_west_apb_clk", STRING.MID("&clk", 1, &clk_input_length-2), 0)!=-1)
    ( 
      &match=1
    )
  )
  else if (&wild_head==1)
  (
    if (STRING.MID("gcc_west_apb_clk", &clk_itr_length-&clk_input_length+1, &clk_input_length-1)==STRING.CUT("&clk", 1))
    ( 
      &match=1
    )
  )
  else if (&wild_tail==1)
  (
    if (STRING.MID("gcc_west_apb_clk", 0, &clk_input_length-1)==STRING.CUT("&clk", -1))
    ( 
      &match=1
    )
  )
  else if ("gcc_west_apb_clk"=="&clk")
  (
    &match=1
  )
  
  if (&match==1)
  (
    &clk_test=&CLK_TEST_GCC_WEST_APB_CLK
    &clk_reg=&HWIO_GCC_WEST_APB_CBCR_ADDR
    &clk_reg_name="GCC_WEST_APB_CBCR"
    &clk_name="gcc_west_apb_clk"
    &clk_reg_cbcr_type="sm_cbc"
    &clk_vote_bit=-1.
    &clk_multiplier=4.

    gosub Print_Clk_Info_Line
  )

  &match=0
  &wild_head=0
  &wild_tail=0
  &clk_input_length=STRING.LENGTH("&clk")
  &clk_itr_length=STRING.LENGTH("gcc_aggre1_noc_at_clk")

  if (STRING.SCAN("&clk", "*", 0)==0)
  (
    &wild_head=1
  )
  if (STRING.SCAN("&clk", "*", 1)==(STRING.LENGTH("&clk")-1))
  (
    &wild_tail=1
  )

  if ((&wild_head==1)&&(&wild_tail==1))
  (
    if (STRING.SCAN("gcc_aggre1_noc_at_clk", STRING.MID("&clk", 1, &clk_input_length-2), 0)!=-1)
    ( 
      &match=1
    )
  )
  else if (&wild_head==1)
  (
    if (STRING.MID("gcc_aggre1_noc_at_clk", &clk_itr_length-&clk_input_length+1, &clk_input_length-1)==STRING.CUT("&clk", 1))
    ( 
      &match=1
    )
  )
  else if (&wild_tail==1)
  (
    if (STRING.MID("gcc_aggre1_noc_at_clk", 0, &clk_input_length-1)==STRING.CUT("&clk", -1))
    ( 
      &match=1
    )
  )
  else if ("gcc_aggre1_noc_at_clk"=="&clk")
  (
    &match=1
  )
  
  if (&match==1)
  (
    &clk_test=&CLK_TEST_GCC_AGGRE1_NOC_AT_CLK
    &clk_reg=&HWIO_GCC_AGGRE1_NOC_AT_CBCR_ADDR
    &clk_reg_name="GCC_AGGRE1_NOC_AT_CBCR"
    &clk_name="gcc_aggre1_noc_at_clk"
    &clk_reg_cbcr_type="sm_cbc"
    &clk_vote_bit=-1.
    &clk_multiplier=4.

    gosub Print_Clk_Info_Line
  )

  &match=0
  &wild_head=0
  &wild_tail=0
  &clk_input_length=STRING.LENGTH("&clk")
  &clk_itr_length=STRING.LENGTH("gcc_aggre2_noc_at_clk")

  if (STRING.SCAN("&clk", "*", 0)==0)
  (
    &wild_head=1
  )
  if (STRING.SCAN("&clk", "*", 1)==(STRING.LENGTH("&clk")-1))
  (
    &wild_tail=1
  )

  if ((&wild_head==1)&&(&wild_tail==1))
  (
    if (STRING.SCAN("gcc_aggre2_noc_at_clk", STRING.MID("&clk", 1, &clk_input_length-2), 0)!=-1)
    ( 
      &match=1
    )
  )
  else if (&wild_head==1)
  (
    if (STRING.MID("gcc_aggre2_noc_at_clk", &clk_itr_length-&clk_input_length+1, &clk_input_length-1)==STRING.CUT("&clk", 1))
    ( 
      &match=1
    )
  )
  else if (&wild_tail==1)
  (
    if (STRING.MID("gcc_aggre2_noc_at_clk", 0, &clk_input_length-1)==STRING.CUT("&clk", -1))
    ( 
      &match=1
    )
  )
  else if ("gcc_aggre2_noc_at_clk"=="&clk")
  (
    &match=1
  )
  
  if (&match==1)
  (
    &clk_test=&CLK_TEST_GCC_AGGRE2_NOC_AT_CLK
    &clk_reg=&HWIO_GCC_AGGRE2_NOC_AT_CBCR_ADDR
    &clk_reg_name="GCC_AGGRE2_NOC_AT_CBCR"
    &clk_name="gcc_aggre2_noc_at_clk"
    &clk_reg_cbcr_type="sm_cbc"
    &clk_vote_bit=-1.
    &clk_multiplier=4.

    gosub Print_Clk_Info_Line
  )

  &match=0
  &wild_head=0
  &wild_tail=0
  &clk_input_length=STRING.LENGTH("&clk")
  &clk_itr_length=STRING.LENGTH("gcc_east_at_clk")

  if (STRING.SCAN("&clk", "*", 0)==0)
  (
    &wild_head=1
  )
  if (STRING.SCAN("&clk", "*", 1)==(STRING.LENGTH("&clk")-1))
  (
    &wild_tail=1
  )

  if ((&wild_head==1)&&(&wild_tail==1))
  (
    if (STRING.SCAN("gcc_east_at_clk", STRING.MID("&clk", 1, &clk_input_length-2), 0)!=-1)
    ( 
      &match=1
    )
  )
  else if (&wild_head==1)
  (
    if (STRING.MID("gcc_east_at_clk", &clk_itr_length-&clk_input_length+1, &clk_input_length-1)==STRING.CUT("&clk", 1))
    ( 
      &match=1
    )
  )
  else if (&wild_tail==1)
  (
    if (STRING.MID("gcc_east_at_clk", 0, &clk_input_length-1)==STRING.CUT("&clk", -1))
    ( 
      &match=1
    )
  )
  else if ("gcc_east_at_clk"=="&clk")
  (
    &match=1
  )
  
  if (&match==1)
  (
    &clk_test=&CLK_TEST_GCC_EAST_AT_CLK
    &clk_reg=&HWIO_GCC_EAST_AT_CBCR_ADDR
    &clk_reg_name="GCC_EAST_AT_CBCR"
    &clk_name="gcc_east_at_clk"
    &clk_reg_cbcr_type="sm_cbc"
    &clk_vote_bit=-1.
    &clk_multiplier=4.

    gosub Print_Clk_Info_Line
  )

  &match=0
  &wild_head=0
  &wild_tail=0
  &clk_input_length=STRING.LENGTH("&clk")
  &clk_itr_length=STRING.LENGTH("gcc_gpu_at_clk")

  if (STRING.SCAN("&clk", "*", 0)==0)
  (
    &wild_head=1
  )
  if (STRING.SCAN("&clk", "*", 1)==(STRING.LENGTH("&clk")-1))
  (
    &wild_tail=1
  )

  if ((&wild_head==1)&&(&wild_tail==1))
  (
    if (STRING.SCAN("gcc_gpu_at_clk", STRING.MID("&clk", 1, &clk_input_length-2), 0)!=-1)
    ( 
      &match=1
    )
  )
  else if (&wild_head==1)
  (
    if (STRING.MID("gcc_gpu_at_clk", &clk_itr_length-&clk_input_length+1, &clk_input_length-1)==STRING.CUT("&clk", 1))
    ( 
      &match=1
    )
  )
  else if (&wild_tail==1)
  (
    if (STRING.MID("gcc_gpu_at_clk", 0, &clk_input_length-1)==STRING.CUT("&clk", -1))
    ( 
      &match=1
    )
  )
  else if ("gcc_gpu_at_clk"=="&clk")
  (
    &match=1
  )
  
  if (&match==1)
  (
    &clk_test=&CLK_TEST_GCC_GPU_AT_CLK
    &clk_reg=&HWIO_GCC_GPU_AT_CBCR_ADDR
    &clk_reg_name="GCC_GPU_AT_CBCR"
    &clk_name="gcc_gpu_at_clk"
    &clk_reg_cbcr_type="sm_cbc"
    &clk_vote_bit=-1.
    &clk_multiplier=4.

    gosub Print_Clk_Info_Line
  )

  &match=0
  &wild_head=0
  &wild_tail=0
  &clk_input_length=STRING.LENGTH("&clk")
  &clk_itr_length=STRING.LENGTH("gcc_hmss_at_clk")

  if (STRING.SCAN("&clk", "*", 0)==0)
  (
    &wild_head=1
  )
  if (STRING.SCAN("&clk", "*", 1)==(STRING.LENGTH("&clk")-1))
  (
    &wild_tail=1
  )

  if ((&wild_head==1)&&(&wild_tail==1))
  (
    if (STRING.SCAN("gcc_hmss_at_clk", STRING.MID("&clk", 1, &clk_input_length-2), 0)!=-1)
    ( 
      &match=1
    )
  )
  else if (&wild_head==1)
  (
    if (STRING.MID("gcc_hmss_at_clk", &clk_itr_length-&clk_input_length+1, &clk_input_length-1)==STRING.CUT("&clk", 1))
    ( 
      &match=1
    )
  )
  else if (&wild_tail==1)
  (
    if (STRING.MID("gcc_hmss_at_clk", 0, &clk_input_length-1)==STRING.CUT("&clk", -1))
    ( 
      &match=1
    )
  )
  else if ("gcc_hmss_at_clk"=="&clk")
  (
    &match=1
  )
  
  if (&match==1)
  (
    &clk_test=&CLK_TEST_GCC_HMSS_AT_CLK
    &clk_reg=&HWIO_GCC_HMSS_AT_CBCR_ADDR
    &clk_reg_name="GCC_HMSS_AT_CBCR"
    &clk_name="gcc_hmss_at_clk"
    &clk_reg_cbcr_type="sm_cbc"
    &clk_vote_bit=-1.
    &clk_multiplier=4.

    gosub Print_Clk_Info_Line
  )

  &match=0
  &wild_head=0
  &wild_tail=0
  &clk_input_length=STRING.LENGTH("&clk")
  &clk_itr_length=STRING.LENGTH("gcc_mmss_at_clk")

  if (STRING.SCAN("&clk", "*", 0)==0)
  (
    &wild_head=1
  )
  if (STRING.SCAN("&clk", "*", 1)==(STRING.LENGTH("&clk")-1))
  (
    &wild_tail=1
  )

  if ((&wild_head==1)&&(&wild_tail==1))
  (
    if (STRING.SCAN("gcc_mmss_at_clk", STRING.MID("&clk", 1, &clk_input_length-2), 0)!=-1)
    ( 
      &match=1
    )
  )
  else if (&wild_head==1)
  (
    if (STRING.MID("gcc_mmss_at_clk", &clk_itr_length-&clk_input_length+1, &clk_input_length-1)==STRING.CUT("&clk", 1))
    ( 
      &match=1
    )
  )
  else if (&wild_tail==1)
  (
    if (STRING.MID("gcc_mmss_at_clk", 0, &clk_input_length-1)==STRING.CUT("&clk", -1))
    ( 
      &match=1
    )
  )
  else if ("gcc_mmss_at_clk"=="&clk")
  (
    &match=1
  )
  
  if (&match==1)
  (
    &clk_test=&CLK_TEST_GCC_MMSS_AT_CLK
    &clk_reg=&HWIO_GCC_MMSS_AT_CBCR_ADDR
    &clk_reg_name="GCC_MMSS_AT_CBCR"
    &clk_name="gcc_mmss_at_clk"
    &clk_reg_cbcr_type="sm_cbc"
    &clk_vote_bit=-1.
    &clk_multiplier=4.

    gosub Print_Clk_Info_Line
  )

  &match=0
  &wild_head=0
  &wild_tail=0
  &clk_input_length=STRING.LENGTH("&clk")
  &clk_itr_length=STRING.LENGTH("gcc_mmss_noc_at_clk")

  if (STRING.SCAN("&clk", "*", 0)==0)
  (
    &wild_head=1
  )
  if (STRING.SCAN("&clk", "*", 1)==(STRING.LENGTH("&clk")-1))
  (
    &wild_tail=1
  )

  if ((&wild_head==1)&&(&wild_tail==1))
  (
    if (STRING.SCAN("gcc_mmss_noc_at_clk", STRING.MID("&clk", 1, &clk_input_length-2), 0)!=-1)
    ( 
      &match=1
    )
  )
  else if (&wild_head==1)
  (
    if (STRING.MID("gcc_mmss_noc_at_clk", &clk_itr_length-&clk_input_length+1, &clk_input_length-1)==STRING.CUT("&clk", 1))
    ( 
      &match=1
    )
  )
  else if (&wild_tail==1)
  (
    if (STRING.MID("gcc_mmss_noc_at_clk", 0, &clk_input_length-1)==STRING.CUT("&clk", -1))
    ( 
      &match=1
    )
  )
  else if ("gcc_mmss_noc_at_clk"=="&clk")
  (
    &match=1
  )
  
  if (&match==1)
  (
    &clk_test=&CLK_TEST_GCC_MMSS_NOC_AT_CLK
    &clk_reg=&HWIO_GCC_MMSS_NOC_AT_CBCR_ADDR
    &clk_reg_name="GCC_MMSS_NOC_AT_CBCR"
    &clk_name="gcc_mmss_noc_at_clk"
    &clk_reg_cbcr_type="sm_cbc"
    &clk_vote_bit=-1.
    &clk_multiplier=4.

    gosub Print_Clk_Info_Line
  )

  &match=0
  &wild_head=0
  &wild_tail=0
  &clk_input_length=STRING.LENGTH("&clk")
  &clk_itr_length=STRING.LENGTH("gcc_qdss_center_at_clk")

  if (STRING.SCAN("&clk", "*", 0)==0)
  (
    &wild_head=1
  )
  if (STRING.SCAN("&clk", "*", 1)==(STRING.LENGTH("&clk")-1))
  (
    &wild_tail=1
  )

  if ((&wild_head==1)&&(&wild_tail==1))
  (
    if (STRING.SCAN("gcc_qdss_center_at_clk", STRING.MID("&clk", 1, &clk_input_length-2), 0)!=-1)
    ( 
      &match=1
    )
  )
  else if (&wild_head==1)
  (
    if (STRING.MID("gcc_qdss_center_at_clk", &clk_itr_length-&clk_input_length+1, &clk_input_length-1)==STRING.CUT("&clk", 1))
    ( 
      &match=1
    )
  )
  else if (&wild_tail==1)
  (
    if (STRING.MID("gcc_qdss_center_at_clk", 0, &clk_input_length-1)==STRING.CUT("&clk", -1))
    ( 
      &match=1
    )
  )
  else if ("gcc_qdss_center_at_clk"=="&clk")
  (
    &match=1
  )
  
  if (&match==1)
  (
    &clk_test=&CLK_TEST_GCC_QDSS_CENTER_AT_CLK
    &clk_reg=&HWIO_GCC_QDSS_CENTER_AT_CBCR_ADDR
    &clk_reg_name="GCC_QDSS_CENTER_AT_CBCR"
    &clk_name="gcc_qdss_center_at_clk"
    &clk_reg_cbcr_type="sm_pscbc"
    &clk_vote_bit=-1.
    &clk_multiplier=4.

    gosub Print_Clk_Info_Line
  )

  &match=0
  &wild_head=0
  &wild_tail=0
  &clk_input_length=STRING.LENGTH("&clk")
  &clk_itr_length=STRING.LENGTH("gcc_sys_noc_at_clk")

  if (STRING.SCAN("&clk", "*", 0)==0)
  (
    &wild_head=1
  )
  if (STRING.SCAN("&clk", "*", 1)==(STRING.LENGTH("&clk")-1))
  (
    &wild_tail=1
  )

  if ((&wild_head==1)&&(&wild_tail==1))
  (
    if (STRING.SCAN("gcc_sys_noc_at_clk", STRING.MID("&clk", 1, &clk_input_length-2), 0)!=-1)
    ( 
      &match=1
    )
  )
  else if (&wild_head==1)
  (
    if (STRING.MID("gcc_sys_noc_at_clk", &clk_itr_length-&clk_input_length+1, &clk_input_length-1)==STRING.CUT("&clk", 1))
    ( 
      &match=1
    )
  )
  else if (&wild_tail==1)
  (
    if (STRING.MID("gcc_sys_noc_at_clk", 0, &clk_input_length-1)==STRING.CUT("&clk", -1))
    ( 
      &match=1
    )
  )
  else if ("gcc_sys_noc_at_clk"=="&clk")
  (
    &match=1
  )
  
  if (&match==1)
  (
    &clk_test=&CLK_TEST_GCC_SYS_NOC_AT_CLK
    &clk_reg=&HWIO_GCC_SYS_NOC_AT_CBCR_ADDR
    &clk_reg_name="GCC_SYS_NOC_AT_CBCR"
    &clk_name="gcc_sys_noc_at_clk"
    &clk_reg_cbcr_type="sm_cbc"
    &clk_vote_bit=-1.
    &clk_multiplier=4.

    gosub Print_Clk_Info_Line
  )

  &match=0
  &wild_head=0
  &wild_tail=0
  &clk_input_length=STRING.LENGTH("&clk")
  &clk_itr_length=STRING.LENGTH("gcc_wcss_at_clk")

  if (STRING.SCAN("&clk", "*", 0)==0)
  (
    &wild_head=1
  )
  if (STRING.SCAN("&clk", "*", 1)==(STRING.LENGTH("&clk")-1))
  (
    &wild_tail=1
  )

  if ((&wild_head==1)&&(&wild_tail==1))
  (
    if (STRING.SCAN("gcc_wcss_at_clk", STRING.MID("&clk", 1, &clk_input_length-2), 0)!=-1)
    ( 
      &match=1
    )
  )
  else if (&wild_head==1)
  (
    if (STRING.MID("gcc_wcss_at_clk", &clk_itr_length-&clk_input_length+1, &clk_input_length-1)==STRING.CUT("&clk", 1))
    ( 
      &match=1
    )
  )
  else if (&wild_tail==1)
  (
    if (STRING.MID("gcc_wcss_at_clk", 0, &clk_input_length-1)==STRING.CUT("&clk", -1))
    ( 
      &match=1
    )
  )
  else if ("gcc_wcss_at_clk"=="&clk")
  (
    &match=1
  )
  
  if (&match==1)
  (
    &clk_test=&CLK_TEST_GCC_WCSS_AT_CLK
    &clk_reg=&HWIO_GCC_WCSS_AT_CBCR_ADDR
    &clk_reg_name="GCC_WCSS_AT_CBCR"
    &clk_name="gcc_wcss_at_clk"
    &clk_reg_cbcr_type="sm_cbc"
    &clk_vote_bit=-1.
    &clk_multiplier=4.

    gosub Print_Clk_Info_Line
  )

  &match=0
  &wild_head=0
  &wild_tail=0
  &clk_input_length=STRING.LENGTH("&clk")
  &clk_itr_length=STRING.LENGTH("gcc_west_at_clk")

  if (STRING.SCAN("&clk", "*", 0)==0)
  (
    &wild_head=1
  )
  if (STRING.SCAN("&clk", "*", 1)==(STRING.LENGTH("&clk")-1))
  (
    &wild_tail=1
  )

  if ((&wild_head==1)&&(&wild_tail==1))
  (
    if (STRING.SCAN("gcc_west_at_clk", STRING.MID("&clk", 1, &clk_input_length-2), 0)!=-1)
    ( 
      &match=1
    )
  )
  else if (&wild_head==1)
  (
    if (STRING.MID("gcc_west_at_clk", &clk_itr_length-&clk_input_length+1, &clk_input_length-1)==STRING.CUT("&clk", 1))
    ( 
      &match=1
    )
  )
  else if (&wild_tail==1)
  (
    if (STRING.MID("gcc_west_at_clk", 0, &clk_input_length-1)==STRING.CUT("&clk", -1))
    ( 
      &match=1
    )
  )
  else if ("gcc_west_at_clk"=="&clk")
  (
    &match=1
  )
  
  if (&match==1)
  (
    &clk_test=&CLK_TEST_GCC_WEST_AT_CLK
    &clk_reg=&HWIO_GCC_WEST_AT_CBCR_ADDR
    &clk_reg_name="GCC_WEST_AT_CBCR"
    &clk_name="gcc_west_at_clk"
    &clk_reg_cbcr_type="sm_cbc"
    &clk_vote_bit=-1.
    &clk_multiplier=4.

    gosub Print_Clk_Info_Line
  )

  &match=0
  &wild_head=0
  &wild_tail=0
  &clk_input_length=STRING.LENGTH("&clk")
  &clk_itr_length=STRING.LENGTH("gcc_bimc_at_clk")

  if (STRING.SCAN("&clk", "*", 0)==0)
  (
    &wild_head=1
  )
  if (STRING.SCAN("&clk", "*", 1)==(STRING.LENGTH("&clk")-1))
  (
    &wild_tail=1
  )

  if ((&wild_head==1)&&(&wild_tail==1))
  (
    if (STRING.SCAN("gcc_bimc_at_clk", STRING.MID("&clk", 1, &clk_input_length-2), 0)!=-1)
    ( 
      &match=1
    )
  )
  else if (&wild_head==1)
  (
    if (STRING.MID("gcc_bimc_at_clk", &clk_itr_length-&clk_input_length+1, &clk_input_length-1)==STRING.CUT("&clk", 1))
    ( 
      &match=1
    )
  )
  else if (&wild_tail==1)
  (
    if (STRING.MID("gcc_bimc_at_clk", 0, &clk_input_length-1)==STRING.CUT("&clk", -1))
    ( 
      &match=1
    )
  )
  else if ("gcc_bimc_at_clk"=="&clk")
  (
    &match=1
  )
  
  if (&match==1)
  (
    &clk_test=&CLK_TEST_GCC_BIMC_AT_CLK
    &clk_reg=&HWIO_GCC_BIMC_AT_CBCR_ADDR
    &clk_reg_name="GCC_BIMC_AT_CBCR"
    &clk_name="gcc_bimc_at_clk"
    &clk_reg_cbcr_type="sm_cbc"
    &clk_vote_bit=-1.
    &clk_multiplier=4.

    gosub Print_Clk_Info_Line
  )

  &match=0
  &wild_head=0
  &wild_tail=0
  &clk_input_length=STRING.LENGTH("&clk")
  &clk_itr_length=STRING.LENGTH("gcc_mss_at_clk")

  if (STRING.SCAN("&clk", "*", 0)==0)
  (
    &wild_head=1
  )
  if (STRING.SCAN("&clk", "*", 1)==(STRING.LENGTH("&clk")-1))
  (
    &wild_tail=1
  )

  if ((&wild_head==1)&&(&wild_tail==1))
  (
    if (STRING.SCAN("gcc_mss_at_clk", STRING.MID("&clk", 1, &clk_input_length-2), 0)!=-1)
    ( 
      &match=1
    )
  )
  else if (&wild_head==1)
  (
    if (STRING.MID("gcc_mss_at_clk", &clk_itr_length-&clk_input_length+1, &clk_input_length-1)==STRING.CUT("&clk", 1))
    ( 
      &match=1
    )
  )
  else if (&wild_tail==1)
  (
    if (STRING.MID("gcc_mss_at_clk", 0, &clk_input_length-1)==STRING.CUT("&clk", -1))
    ( 
      &match=1
    )
  )
  else if ("gcc_mss_at_clk"=="&clk")
  (
    &match=1
  )
  
  if (&match==1)
  (
    &clk_test=&CLK_TEST_GCC_MSS_AT_CLK
    &clk_reg=&HWIO_GCC_MSS_AT_CBCR_ADDR
    &clk_reg_name="GCC_MSS_AT_CBCR"
    &clk_name="gcc_mss_at_clk"
    &clk_reg_cbcr_type="sm_cbc"
    &clk_vote_bit=-1.
    &clk_multiplier=4.

    gosub Print_Clk_Info_Line
  )

  &match=0
  &wild_head=0
  &wild_tail=0
  &clk_input_length=STRING.LENGTH("&clk")
  &clk_itr_length=STRING.LENGTH("gcc_lpass_at_clk")

  if (STRING.SCAN("&clk", "*", 0)==0)
  (
    &wild_head=1
  )
  if (STRING.SCAN("&clk", "*", 1)==(STRING.LENGTH("&clk")-1))
  (
    &wild_tail=1
  )

  if ((&wild_head==1)&&(&wild_tail==1))
  (
    if (STRING.SCAN("gcc_lpass_at_clk", STRING.MID("&clk", 1, &clk_input_length-2), 0)!=-1)
    ( 
      &match=1
    )
  )
  else if (&wild_head==1)
  (
    if (STRING.MID("gcc_lpass_at_clk", &clk_itr_length-&clk_input_length+1, &clk_input_length-1)==STRING.CUT("&clk", 1))
    ( 
      &match=1
    )
  )
  else if (&wild_tail==1)
  (
    if (STRING.MID("gcc_lpass_at_clk", 0, &clk_input_length-1)==STRING.CUT("&clk", -1))
    ( 
      &match=1
    )
  )
  else if ("gcc_lpass_at_clk"=="&clk")
  (
    &match=1
  )
  
  if (&match==1)
  (
    &clk_test=&CLK_TEST_GCC_LPASS_AT_CLK
    &clk_reg=&HWIO_GCC_LPASS_AT_CBCR_ADDR
    &clk_reg_name="GCC_LPASS_AT_CBCR"
    &clk_name="gcc_lpass_at_clk"
    &clk_reg_cbcr_type="sm_cbc"
    &clk_vote_bit=-1.
    &clk_multiplier=4.

    gosub Print_Clk_Info_Line
  )

  &match=0
  &wild_head=0
  &wild_tail=0
  &clk_input_length=STRING.LENGTH("&clk")
  &clk_itr_length=STRING.LENGTH("gcc_north_at_clk")

  if (STRING.SCAN("&clk", "*", 0)==0)
  (
    &wild_head=1
  )
  if (STRING.SCAN("&clk", "*", 1)==(STRING.LENGTH("&clk")-1))
  (
    &wild_tail=1
  )

  if ((&wild_head==1)&&(&wild_tail==1))
  (
    if (STRING.SCAN("gcc_north_at_clk", STRING.MID("&clk", 1, &clk_input_length-2), 0)!=-1)
    ( 
      &match=1
    )
  )
  else if (&wild_head==1)
  (
    if (STRING.MID("gcc_north_at_clk", &clk_itr_length-&clk_input_length+1, &clk_input_length-1)==STRING.CUT("&clk", 1))
    ( 
      &match=1
    )
  )
  else if (&wild_tail==1)
  (
    if (STRING.MID("gcc_north_at_clk", 0, &clk_input_length-1)==STRING.CUT("&clk", -1))
    ( 
      &match=1
    )
  )
  else if ("gcc_north_at_clk"=="&clk")
  (
    &match=1
  )
  
  if (&match==1)
  (
    &clk_test=&CLK_TEST_GCC_NORTH_AT_CLK
    &clk_reg=&HWIO_GCC_NORTH_AT_CBCR_ADDR
    &clk_reg_name="GCC_NORTH_AT_CBCR"
    &clk_name="gcc_north_at_clk"
    &clk_reg_cbcr_type="sm_cbc"
    &clk_vote_bit=-1.
    &clk_multiplier=4.

    gosub Print_Clk_Info_Line
  )

  &match=0
  &wild_head=0
  &wild_tail=0
  &clk_input_length=STRING.LENGTH("&clk")
  &clk_itr_length=STRING.LENGTH("gcc_ssc_at_clk")

  if (STRING.SCAN("&clk", "*", 0)==0)
  (
    &wild_head=1
  )
  if (STRING.SCAN("&clk", "*", 1)==(STRING.LENGTH("&clk")-1))
  (
    &wild_tail=1
  )

  if ((&wild_head==1)&&(&wild_tail==1))
  (
    if (STRING.SCAN("gcc_ssc_at_clk", STRING.MID("&clk", 1, &clk_input_length-2), 0)!=-1)
    ( 
      &match=1
    )
  )
  else if (&wild_head==1)
  (
    if (STRING.MID("gcc_ssc_at_clk", &clk_itr_length-&clk_input_length+1, &clk_input_length-1)==STRING.CUT("&clk", 1))
    ( 
      &match=1
    )
  )
  else if (&wild_tail==1)
  (
    if (STRING.MID("gcc_ssc_at_clk", 0, &clk_input_length-1)==STRING.CUT("&clk", -1))
    ( 
      &match=1
    )
  )
  else if ("gcc_ssc_at_clk"=="&clk")
  (
    &match=1
  )
  
  if (&match==1)
  (
    &clk_test=&CLK_TEST_GCC_SSC_AT_CLK
    &clk_reg=&HWIO_GCC_SSC_AT_CBCR_ADDR
    &clk_reg_name="GCC_SSC_AT_CBCR"
    &clk_name="gcc_ssc_at_clk"
    &clk_reg_cbcr_type="sm_cbc"
    &clk_vote_bit=-1.
    &clk_multiplier=4.

    gosub Print_Clk_Info_Line
  )

  &match=0
  &wild_head=0
  &wild_tail=0
  &clk_input_length=STRING.LENGTH("&clk")
  &clk_itr_length=STRING.LENGTH("gcc_qdss_stm_clk")

  if (STRING.SCAN("&clk", "*", 0)==0)
  (
    &wild_head=1
  )
  if (STRING.SCAN("&clk", "*", 1)==(STRING.LENGTH("&clk")-1))
  (
    &wild_tail=1
  )

  if ((&wild_head==1)&&(&wild_tail==1))
  (
    if (STRING.SCAN("gcc_qdss_stm_clk", STRING.MID("&clk", 1, &clk_input_length-2), 0)!=-1)
    ( 
      &match=1
    )
  )
  else if (&wild_head==1)
  (
    if (STRING.MID("gcc_qdss_stm_clk", &clk_itr_length-&clk_input_length+1, &clk_input_length-1)==STRING.CUT("&clk", 1))
    ( 
      &match=1
    )
  )
  else if (&wild_tail==1)
  (
    if (STRING.MID("gcc_qdss_stm_clk", 0, &clk_input_length-1)==STRING.CUT("&clk", -1))
    ( 
      &match=1
    )
  )
  else if ("gcc_qdss_stm_clk"=="&clk")
  (
    &match=1
  )
  
  if (&match==1)
  (
    &clk_test=&CLK_TEST_GCC_QDSS_STM_CLK
    &clk_reg=&HWIO_GCC_QDSS_STM_CBCR_ADDR
    &clk_reg_name="GCC_QDSS_STM_CBCR"
    &clk_name="gcc_qdss_stm_clk"
    &clk_reg_cbcr_type="sm_cbc"
    &clk_vote_bit=-1.
    &clk_multiplier=4.

    gosub Print_Clk_Info_Line
  )

  &match=0
  &wild_head=0
  &wild_tail=0
  &clk_input_length=STRING.LENGTH("&clk")
  &clk_itr_length=STRING.LENGTH("gcc_sys_noc_qdss_stm_axi_clk")

  if (STRING.SCAN("&clk", "*", 0)==0)
  (
    &wild_head=1
  )
  if (STRING.SCAN("&clk", "*", 1)==(STRING.LENGTH("&clk")-1))
  (
    &wild_tail=1
  )

  if ((&wild_head==1)&&(&wild_tail==1))
  (
    if (STRING.SCAN("gcc_sys_noc_qdss_stm_axi_clk", STRING.MID("&clk", 1, &clk_input_length-2), 0)!=-1)
    ( 
      &match=1
    )
  )
  else if (&wild_head==1)
  (
    if (STRING.MID("gcc_sys_noc_qdss_stm_axi_clk", &clk_itr_length-&clk_input_length+1, &clk_input_length-1)==STRING.CUT("&clk", 1))
    ( 
      &match=1
    )
  )
  else if (&wild_tail==1)
  (
    if (STRING.MID("gcc_sys_noc_qdss_stm_axi_clk", 0, &clk_input_length-1)==STRING.CUT("&clk", -1))
    ( 
      &match=1
    )
  )
  else if ("gcc_sys_noc_qdss_stm_axi_clk"=="&clk")
  (
    &match=1
  )
  
  if (&match==1)
  (
    &clk_test=&CLK_TEST_GCC_SYS_NOC_QDSS_STM_AXI_CLK
    &clk_reg=&HWIO_GCC_SYS_NOC_QDSS_STM_AXI_CBCR_ADDR
    &clk_reg_name="GCC_SYS_NOC_QDSS_STM_AXI_CBCR"
    &clk_name="gcc_sys_noc_qdss_stm_axi_clk"
    &clk_reg_cbcr_type="sm_cbc"
    &clk_vote_bit=-1.
    &clk_multiplier=4.

    gosub Print_Clk_Info_Line
  )

  &match=0
  &wild_head=0
  &wild_tail=0
  &clk_input_length=STRING.LENGTH("&clk")
  &clk_itr_length=STRING.LENGTH("gcc_qdss_traceclkin_clk")

  if (STRING.SCAN("&clk", "*", 0)==0)
  (
    &wild_head=1
  )
  if (STRING.SCAN("&clk", "*", 1)==(STRING.LENGTH("&clk")-1))
  (
    &wild_tail=1
  )

  if ((&wild_head==1)&&(&wild_tail==1))
  (
    if (STRING.SCAN("gcc_qdss_traceclkin_clk", STRING.MID("&clk", 1, &clk_input_length-2), 0)!=-1)
    ( 
      &match=1
    )
  )
  else if (&wild_head==1)
  (
    if (STRING.MID("gcc_qdss_traceclkin_clk", &clk_itr_length-&clk_input_length+1, &clk_input_length-1)==STRING.CUT("&clk", 1))
    ( 
      &match=1
    )
  )
  else if (&wild_tail==1)
  (
    if (STRING.MID("gcc_qdss_traceclkin_clk", 0, &clk_input_length-1)==STRING.CUT("&clk", -1))
    ( 
      &match=1
    )
  )
  else if ("gcc_qdss_traceclkin_clk"=="&clk")
  (
    &match=1
  )
  
  if (&match==1)
  (
    &clk_test=&CLK_TEST_GCC_QDSS_TRACECLKIN_CLK
    &clk_reg=&HWIO_GCC_QDSS_TRACECLKIN_CBCR_ADDR
    &clk_reg_name="GCC_QDSS_TRACECLKIN_CBCR"
    &clk_name="gcc_qdss_traceclkin_clk"
    &clk_reg_cbcr_type="sm_cbc"
    &clk_vote_bit=-1.
    &clk_multiplier=4.

    gosub Print_Clk_Info_Line
  )

  &match=0
  &wild_head=0
  &wild_tail=0
  &clk_input_length=STRING.LENGTH("&clk")
  &clk_itr_length=STRING.LENGTH("gcc_qdss_tsctr_div16_clk")

  if (STRING.SCAN("&clk", "*", 0)==0)
  (
    &wild_head=1
  )
  if (STRING.SCAN("&clk", "*", 1)==(STRING.LENGTH("&clk")-1))
  (
    &wild_tail=1
  )

  if ((&wild_head==1)&&(&wild_tail==1))
  (
    if (STRING.SCAN("gcc_qdss_tsctr_div16_clk", STRING.MID("&clk", 1, &clk_input_length-2), 0)!=-1)
    ( 
      &match=1
    )
  )
  else if (&wild_head==1)
  (
    if (STRING.MID("gcc_qdss_tsctr_div16_clk", &clk_itr_length-&clk_input_length+1, &clk_input_length-1)==STRING.CUT("&clk", 1))
    ( 
      &match=1
    )
  )
  else if (&wild_tail==1)
  (
    if (STRING.MID("gcc_qdss_tsctr_div16_clk", 0, &clk_input_length-1)==STRING.CUT("&clk", -1))
    ( 
      &match=1
    )
  )
  else if ("gcc_qdss_tsctr_div16_clk"=="&clk")
  (
    &match=1
  )
  
  if (&match==1)
  (
    &clk_test=&CLK_TEST_GCC_QDSS_TSCTR_DIV16_CLK
    &clk_reg=&HWIO_GCC_QDSS_TSCTR_DIV16_CBCR_ADDR
    &clk_reg_name="GCC_QDSS_TSCTR_DIV16_CBCR"
    &clk_name="gcc_qdss_tsctr_div16_clk"
    &clk_reg_cbcr_type="sm_cbc"
    &clk_vote_bit=-1.
    &clk_multiplier=4.

    gosub Print_Clk_Info_Line
  )

  &match=0
  &wild_head=0
  &wild_tail=0
  &clk_input_length=STRING.LENGTH("&clk")
  &clk_itr_length=STRING.LENGTH("gcc_qdss_tsctr_div2_clk")

  if (STRING.SCAN("&clk", "*", 0)==0)
  (
    &wild_head=1
  )
  if (STRING.SCAN("&clk", "*", 1)==(STRING.LENGTH("&clk")-1))
  (
    &wild_tail=1
  )

  if ((&wild_head==1)&&(&wild_tail==1))
  (
    if (STRING.SCAN("gcc_qdss_tsctr_div2_clk", STRING.MID("&clk", 1, &clk_input_length-2), 0)!=-1)
    ( 
      &match=1
    )
  )
  else if (&wild_head==1)
  (
    if (STRING.MID("gcc_qdss_tsctr_div2_clk", &clk_itr_length-&clk_input_length+1, &clk_input_length-1)==STRING.CUT("&clk", 1))
    ( 
      &match=1
    )
  )
  else if (&wild_tail==1)
  (
    if (STRING.MID("gcc_qdss_tsctr_div2_clk", 0, &clk_input_length-1)==STRING.CUT("&clk", -1))
    ( 
      &match=1
    )
  )
  else if ("gcc_qdss_tsctr_div2_clk"=="&clk")
  (
    &match=1
  )
  
  if (&match==1)
  (
    &clk_test=&CLK_TEST_GCC_QDSS_TSCTR_DIV2_CLK
    &clk_reg=&HWIO_GCC_QDSS_TSCTR_DIV2_CBCR_ADDR
    &clk_reg_name="GCC_QDSS_TSCTR_DIV2_CBCR"
    &clk_name="gcc_qdss_tsctr_div2_clk"
    &clk_reg_cbcr_type="sm_cbc"
    &clk_vote_bit=-1.
    &clk_multiplier=4.

    gosub Print_Clk_Info_Line
  )

  &match=0
  &wild_head=0
  &wild_tail=0
  &clk_input_length=STRING.LENGTH("&clk")
  &clk_itr_length=STRING.LENGTH("gcc_qdss_tsctr_div3_clk")

  if (STRING.SCAN("&clk", "*", 0)==0)
  (
    &wild_head=1
  )
  if (STRING.SCAN("&clk", "*", 1)==(STRING.LENGTH("&clk")-1))
  (
    &wild_tail=1
  )

  if ((&wild_head==1)&&(&wild_tail==1))
  (
    if (STRING.SCAN("gcc_qdss_tsctr_div3_clk", STRING.MID("&clk", 1, &clk_input_length-2), 0)!=-1)
    ( 
      &match=1
    )
  )
  else if (&wild_head==1)
  (
    if (STRING.MID("gcc_qdss_tsctr_div3_clk", &clk_itr_length-&clk_input_length+1, &clk_input_length-1)==STRING.CUT("&clk", 1))
    ( 
      &match=1
    )
  )
  else if (&wild_tail==1)
  (
    if (STRING.MID("gcc_qdss_tsctr_div3_clk", 0, &clk_input_length-1)==STRING.CUT("&clk", -1))
    ( 
      &match=1
    )
  )
  else if ("gcc_qdss_tsctr_div3_clk"=="&clk")
  (
    &match=1
  )
  
  if (&match==1)
  (
    &clk_test=&CLK_TEST_GCC_QDSS_TSCTR_DIV3_CLK
    &clk_reg=&HWIO_GCC_QDSS_TSCTR_DIV3_CBCR_ADDR
    &clk_reg_name="GCC_QDSS_TSCTR_DIV3_CBCR"
    &clk_name="gcc_qdss_tsctr_div3_clk"
    &clk_reg_cbcr_type="sm_cbc"
    &clk_vote_bit=-1.
    &clk_multiplier=4.

    gosub Print_Clk_Info_Line
  )

  &match=0
  &wild_head=0
  &wild_tail=0
  &clk_input_length=STRING.LENGTH("&clk")
  &clk_itr_length=STRING.LENGTH("gcc_qdss_tsctr_div4_clk")

  if (STRING.SCAN("&clk", "*", 0)==0)
  (
    &wild_head=1
  )
  if (STRING.SCAN("&clk", "*", 1)==(STRING.LENGTH("&clk")-1))
  (
    &wild_tail=1
  )

  if ((&wild_head==1)&&(&wild_tail==1))
  (
    if (STRING.SCAN("gcc_qdss_tsctr_div4_clk", STRING.MID("&clk", 1, &clk_input_length-2), 0)!=-1)
    ( 
      &match=1
    )
  )
  else if (&wild_head==1)
  (
    if (STRING.MID("gcc_qdss_tsctr_div4_clk", &clk_itr_length-&clk_input_length+1, &clk_input_length-1)==STRING.CUT("&clk", 1))
    ( 
      &match=1
    )
  )
  else if (&wild_tail==1)
  (
    if (STRING.MID("gcc_qdss_tsctr_div4_clk", 0, &clk_input_length-1)==STRING.CUT("&clk", -1))
    ( 
      &match=1
    )
  )
  else if ("gcc_qdss_tsctr_div4_clk"=="&clk")
  (
    &match=1
  )
  
  if (&match==1)
  (
    &clk_test=&CLK_TEST_GCC_QDSS_TSCTR_DIV4_CLK
    &clk_reg=&HWIO_GCC_QDSS_TSCTR_DIV4_CBCR_ADDR
    &clk_reg_name="GCC_QDSS_TSCTR_DIV4_CBCR"
    &clk_name="gcc_qdss_tsctr_div4_clk"
    &clk_reg_cbcr_type="sm_cbc"
    &clk_vote_bit=-1.
    &clk_multiplier=4.

    gosub Print_Clk_Info_Line
  )

  &match=0
  &wild_head=0
  &wild_tail=0
  &clk_input_length=STRING.LENGTH("&clk")
  &clk_itr_length=STRING.LENGTH("gcc_qdss_tsctr_div8_clk")

  if (STRING.SCAN("&clk", "*", 0)==0)
  (
    &wild_head=1
  )
  if (STRING.SCAN("&clk", "*", 1)==(STRING.LENGTH("&clk")-1))
  (
    &wild_tail=1
  )

  if ((&wild_head==1)&&(&wild_tail==1))
  (
    if (STRING.SCAN("gcc_qdss_tsctr_div8_clk", STRING.MID("&clk", 1, &clk_input_length-2), 0)!=-1)
    ( 
      &match=1
    )
  )
  else if (&wild_head==1)
  (
    if (STRING.MID("gcc_qdss_tsctr_div8_clk", &clk_itr_length-&clk_input_length+1, &clk_input_length-1)==STRING.CUT("&clk", 1))
    ( 
      &match=1
    )
  )
  else if (&wild_tail==1)
  (
    if (STRING.MID("gcc_qdss_tsctr_div8_clk", 0, &clk_input_length-1)==STRING.CUT("&clk", -1))
    ( 
      &match=1
    )
  )
  else if ("gcc_qdss_tsctr_div8_clk"=="&clk")
  (
    &match=1
  )
  
  if (&match==1)
  (
    &clk_test=&CLK_TEST_GCC_QDSS_TSCTR_DIV8_CLK
    &clk_reg=&HWIO_GCC_QDSS_TSCTR_DIV8_CBCR_ADDR
    &clk_reg_name="GCC_QDSS_TSCTR_DIV8_CBCR"
    &clk_name="gcc_qdss_tsctr_div8_clk"
    &clk_reg_cbcr_type="sm_cbc"
    &clk_vote_bit=-1.
    &clk_multiplier=4.

    gosub Print_Clk_Info_Line
  )

  &match=0
  &wild_head=0
  &wild_tail=0
  &clk_input_length=STRING.LENGTH("&clk")
  &clk_itr_length=STRING.LENGTH("gcc_wcss_tsctr_div2_clk")

  if (STRING.SCAN("&clk", "*", 0)==0)
  (
    &wild_head=1
  )
  if (STRING.SCAN("&clk", "*", 1)==(STRING.LENGTH("&clk")-1))
  (
    &wild_tail=1
  )

  if ((&wild_head==1)&&(&wild_tail==1))
  (
    if (STRING.SCAN("gcc_wcss_tsctr_div2_clk", STRING.MID("&clk", 1, &clk_input_length-2), 0)!=-1)
    ( 
      &match=1
    )
  )
  else if (&wild_head==1)
  (
    if (STRING.MID("gcc_wcss_tsctr_div2_clk", &clk_itr_length-&clk_input_length+1, &clk_input_length-1)==STRING.CUT("&clk", 1))
    ( 
      &match=1
    )
  )
  else if (&wild_tail==1)
  (
    if (STRING.MID("gcc_wcss_tsctr_div2_clk", 0, &clk_input_length-1)==STRING.CUT("&clk", -1))
    ( 
      &match=1
    )
  )
  else if ("gcc_wcss_tsctr_div2_clk"=="&clk")
  (
    &match=1
  )
  
  if (&match==1)
  (
    &clk_test=&CLK_TEST_GCC_WCSS_TSCTR_DIV2_CLK
    &clk_reg=&HWIO_GCC_WCSS_TSCTR_DIV2_CBCR_ADDR
    &clk_reg_name="GCC_WCSS_TSCTR_DIV2_CBCR"
    &clk_name="gcc_wcss_tsctr_div2_clk"
    &clk_reg_cbcr_type="sm_cbc"
    &clk_vote_bit=-1.
    &clk_multiplier=4.

    gosub Print_Clk_Info_Line
  )

  &match=0
  &wild_head=0
  &wild_tail=0
  &clk_input_length=STRING.LENGTH("&clk")
  &clk_itr_length=STRING.LENGTH("gcc_apss_qdss_tsctr_div2_clk")

  if (STRING.SCAN("&clk", "*", 0)==0)
  (
    &wild_head=1
  )
  if (STRING.SCAN("&clk", "*", 1)==(STRING.LENGTH("&clk")-1))
  (
    &wild_tail=1
  )

  if ((&wild_head==1)&&(&wild_tail==1))
  (
    if (STRING.SCAN("gcc_apss_qdss_tsctr_div2_clk", STRING.MID("&clk", 1, &clk_input_length-2), 0)!=-1)
    ( 
      &match=1
    )
  )
  else if (&wild_head==1)
  (
    if (STRING.MID("gcc_apss_qdss_tsctr_div2_clk", &clk_itr_length-&clk_input_length+1, &clk_input_length-1)==STRING.CUT("&clk", 1))
    ( 
      &match=1
    )
  )
  else if (&wild_tail==1)
  (
    if (STRING.MID("gcc_apss_qdss_tsctr_div2_clk", 0, &clk_input_length-1)==STRING.CUT("&clk", -1))
    ( 
      &match=1
    )
  )
  else if ("gcc_apss_qdss_tsctr_div2_clk"=="&clk")
  (
    &match=1
  )
  
  if (&match==1)
  (
    &clk_test=&CLK_TEST_GCC_APSS_QDSS_TSCTR_DIV2_CLK
    &clk_reg=&HWIO_GCC_APSS_QDSS_TSCTR_DIV2_CBCR_ADDR
    &clk_reg_name="GCC_APSS_QDSS_TSCTR_DIV2_CBCR"
    &clk_name="gcc_apss_qdss_tsctr_div2_clk"
    &clk_reg_cbcr_type="sm_cbc"
    &clk_vote_bit=-1.
    &clk_multiplier=4.

    gosub Print_Clk_Info_Line
  )

  &match=0
  &wild_head=0
  &wild_tail=0
  &clk_input_length=STRING.LENGTH("&clk")
  &clk_itr_length=STRING.LENGTH("gcc_apss_qdss_tsctr_div8_clk")

  if (STRING.SCAN("&clk", "*", 0)==0)
  (
    &wild_head=1
  )
  if (STRING.SCAN("&clk", "*", 1)==(STRING.LENGTH("&clk")-1))
  (
    &wild_tail=1
  )

  if ((&wild_head==1)&&(&wild_tail==1))
  (
    if (STRING.SCAN("gcc_apss_qdss_tsctr_div8_clk", STRING.MID("&clk", 1, &clk_input_length-2), 0)!=-1)
    ( 
      &match=1
    )
  )
  else if (&wild_head==1)
  (
    if (STRING.MID("gcc_apss_qdss_tsctr_div8_clk", &clk_itr_length-&clk_input_length+1, &clk_input_length-1)==STRING.CUT("&clk", 1))
    ( 
      &match=1
    )
  )
  else if (&wild_tail==1)
  (
    if (STRING.MID("gcc_apss_qdss_tsctr_div8_clk", 0, &clk_input_length-1)==STRING.CUT("&clk", -1))
    ( 
      &match=1
    )
  )
  else if ("gcc_apss_qdss_tsctr_div8_clk"=="&clk")
  (
    &match=1
  )
  
  if (&match==1)
  (
    &clk_test=&CLK_TEST_GCC_APSS_QDSS_TSCTR_DIV8_CLK
    &clk_reg=&HWIO_GCC_APSS_QDSS_TSCTR_DIV8_CBCR_ADDR
    &clk_reg_name="GCC_APSS_QDSS_TSCTR_DIV8_CBCR"
    &clk_name="gcc_apss_qdss_tsctr_div8_clk"
    &clk_reg_cbcr_type="sm_cbc"
    &clk_vote_bit=-1.
    &clk_multiplier=4.

    gosub Print_Clk_Info_Line
  )

  &match=0
  &wild_head=0
  &wild_tail=0
  &clk_input_length=STRING.LENGTH("&clk")
  &clk_itr_length=STRING.LENGTH("gcc_rbcpr_cx_clk")

  if (STRING.SCAN("&clk", "*", 0)==0)
  (
    &wild_head=1
  )
  if (STRING.SCAN("&clk", "*", 1)==(STRING.LENGTH("&clk")-1))
  (
    &wild_tail=1
  )

  if ((&wild_head==1)&&(&wild_tail==1))
  (
    if (STRING.SCAN("gcc_rbcpr_cx_clk", STRING.MID("&clk", 1, &clk_input_length-2), 0)!=-1)
    ( 
      &match=1
    )
  )
  else if (&wild_head==1)
  (
    if (STRING.MID("gcc_rbcpr_cx_clk", &clk_itr_length-&clk_input_length+1, &clk_input_length-1)==STRING.CUT("&clk", 1))
    ( 
      &match=1
    )
  )
  else if (&wild_tail==1)
  (
    if (STRING.MID("gcc_rbcpr_cx_clk", 0, &clk_input_length-1)==STRING.CUT("&clk", -1))
    ( 
      &match=1
    )
  )
  else if ("gcc_rbcpr_cx_clk"=="&clk")
  (
    &match=1
  )
  
  if (&match==1)
  (
    &clk_test=&CLK_TEST_GCC_RBCPR_CX_CLK
    &clk_reg=&HWIO_GCC_RBCPR_CX_CBCR_ADDR
    &clk_reg_name="GCC_RBCPR_CX_CBCR"
    &clk_name="gcc_rbcpr_cx_clk"
    &clk_reg_cbcr_type="sm_cbc"
    &clk_vote_bit=-1.
    &clk_multiplier=4.

    gosub Print_Clk_Info_Line
  )

  &match=0
  &wild_head=0
  &wild_tail=0
  &clk_input_length=STRING.LENGTH("&clk")
  &clk_itr_length=STRING.LENGTH("gcc_rbcpr_mx_clk")

  if (STRING.SCAN("&clk", "*", 0)==0)
  (
    &wild_head=1
  )
  if (STRING.SCAN("&clk", "*", 1)==(STRING.LENGTH("&clk")-1))
  (
    &wild_tail=1
  )

  if ((&wild_head==1)&&(&wild_tail==1))
  (
    if (STRING.SCAN("gcc_rbcpr_mx_clk", STRING.MID("&clk", 1, &clk_input_length-2), 0)!=-1)
    ( 
      &match=1
    )
  )
  else if (&wild_head==1)
  (
    if (STRING.MID("gcc_rbcpr_mx_clk", &clk_itr_length-&clk_input_length+1, &clk_input_length-1)==STRING.CUT("&clk", 1))
    ( 
      &match=1
    )
  )
  else if (&wild_tail==1)
  (
    if (STRING.MID("gcc_rbcpr_mx_clk", 0, &clk_input_length-1)==STRING.CUT("&clk", -1))
    ( 
      &match=1
    )
  )
  else if ("gcc_rbcpr_mx_clk"=="&clk")
  (
    &match=1
  )
  
  if (&match==1)
  (
    &clk_test=&CLK_TEST_GCC_RBCPR_MX_CLK
    &clk_reg=&HWIO_GCC_RBCPR_MX_CBCR_ADDR
    &clk_reg_name="GCC_RBCPR_MX_CBCR"
    &clk_name="gcc_rbcpr_mx_clk"
    &clk_reg_cbcr_type="sm_cbc"
    &clk_vote_bit=-1.
    &clk_multiplier=4.

    gosub Print_Clk_Info_Line
  )

  &match=0
  &wild_head=0
  &wild_tail=0
  &clk_input_length=STRING.LENGTH("&clk")
  &clk_itr_length=STRING.LENGTH("gcc_rpm_bus_ahb_clk")

  if (STRING.SCAN("&clk", "*", 0)==0)
  (
    &wild_head=1
  )
  if (STRING.SCAN("&clk", "*", 1)==(STRING.LENGTH("&clk")-1))
  (
    &wild_tail=1
  )

  if ((&wild_head==1)&&(&wild_tail==1))
  (
    if (STRING.SCAN("gcc_rpm_bus_ahb_clk", STRING.MID("&clk", 1, &clk_input_length-2), 0)!=-1)
    ( 
      &match=1
    )
  )
  else if (&wild_head==1)
  (
    if (STRING.MID("gcc_rpm_bus_ahb_clk", &clk_itr_length-&clk_input_length+1, &clk_input_length-1)==STRING.CUT("&clk", 1))
    ( 
      &match=1
    )
  )
  else if (&wild_tail==1)
  (
    if (STRING.MID("gcc_rpm_bus_ahb_clk", 0, &clk_input_length-1)==STRING.CUT("&clk", -1))
    ( 
      &match=1
    )
  )
  else if ("gcc_rpm_bus_ahb_clk"=="&clk")
  (
    &match=1
  )
  
  if (&match==1)
  (
    &clk_test=&CLK_TEST_GCC_RPM_BUS_AHB_CLK
    &clk_reg=&HWIO_GCC_RPM_BUS_AHB_CBCR_ADDR
    &clk_reg_name="GCC_RPM_BUS_AHB_CBCR"
    &clk_name="gcc_rpm_bus_ahb_clk"
    &clk_reg_cbcr_type="sm_pscbc"
    &clk_vote_bit=-1.
    &clk_multiplier=4.

    gosub Print_Clk_Info_Line
  )

  &match=0
  &wild_head=0
  &wild_tail=0
  &clk_input_length=STRING.LENGTH("&clk")
  &clk_itr_length=STRING.LENGTH("gcc_rpm_proc_fclk")

  if (STRING.SCAN("&clk", "*", 0)==0)
  (
    &wild_head=1
  )
  if (STRING.SCAN("&clk", "*", 1)==(STRING.LENGTH("&clk")-1))
  (
    &wild_tail=1
  )

  if ((&wild_head==1)&&(&wild_tail==1))
  (
    if (STRING.SCAN("gcc_rpm_proc_fclk", STRING.MID("&clk", 1, &clk_input_length-2), 0)!=-1)
    ( 
      &match=1
    )
  )
  else if (&wild_head==1)
  (
    if (STRING.MID("gcc_rpm_proc_fclk", &clk_itr_length-&clk_input_length+1, &clk_input_length-1)==STRING.CUT("&clk", 1))
    ( 
      &match=1
    )
  )
  else if (&wild_tail==1)
  (
    if (STRING.MID("gcc_rpm_proc_fclk", 0, &clk_input_length-1)==STRING.CUT("&clk", -1))
    ( 
      &match=1
    )
  )
  else if ("gcc_rpm_proc_fclk"=="&clk")||("cpus"=="&clk")
  (
    &match=1
  )
  
  if (&match==1)
  (
    &clk_test=&CLK_TEST_GCC_RPM_PROC_FCLK
    &clk_reg=0
    &clk_reg_name="No CBCR"
    &clk_name="gcc_rpm_proc_fclk"
    &clk_reg_cbcr_type=""
    &clk_vote_bit=-1.
    &clk_multiplier=4.

    gosub Print_Clk_Info_Line
  )

  &match=0
  &wild_head=0
  &wild_tail=0
  &clk_input_length=STRING.LENGTH("&clk")
  &clk_itr_length=STRING.LENGTH("gcc_rpm_proc_hclk")

  if (STRING.SCAN("&clk", "*", 0)==0)
  (
    &wild_head=1
  )
  if (STRING.SCAN("&clk", "*", 1)==(STRING.LENGTH("&clk")-1))
  (
    &wild_tail=1
  )

  if ((&wild_head==1)&&(&wild_tail==1))
  (
    if (STRING.SCAN("gcc_rpm_proc_hclk", STRING.MID("&clk", 1, &clk_input_length-2), 0)!=-1)
    ( 
      &match=1
    )
  )
  else if (&wild_head==1)
  (
    if (STRING.MID("gcc_rpm_proc_hclk", &clk_itr_length-&clk_input_length+1, &clk_input_length-1)==STRING.CUT("&clk", 1))
    ( 
      &match=1
    )
  )
  else if (&wild_tail==1)
  (
    if (STRING.MID("gcc_rpm_proc_hclk", 0, &clk_input_length-1)==STRING.CUT("&clk", -1))
    ( 
      &match=1
    )
  )
  else if ("gcc_rpm_proc_hclk"=="&clk")
  (
    &match=1
  )
  
  if (&match==1)
  (
    &clk_test=&CLK_TEST_GCC_RPM_PROC_HCLK
    &clk_reg=&HWIO_GCC_RPM_PROC_HCLK_CBCR_ADDR
    &clk_reg_name="GCC_RPM_PROC_HCLK_CBCR"
    &clk_name="gcc_rpm_proc_hclk"
    &clk_reg_cbcr_type="sm_cbc"
    &clk_vote_bit=-1.
    &clk_multiplier=4.

    gosub Print_Clk_Info_Line
  )

  &match=0
  &wild_head=0
  &wild_tail=0
  &clk_input_length=STRING.LENGTH("&clk")
  &clk_itr_length=STRING.LENGTH("gcc_spdm_rpm_cy_clk")

  if (STRING.SCAN("&clk", "*", 0)==0)
  (
    &wild_head=1
  )
  if (STRING.SCAN("&clk", "*", 1)==(STRING.LENGTH("&clk")-1))
  (
    &wild_tail=1
  )

  if ((&wild_head==1)&&(&wild_tail==1))
  (
    if (STRING.SCAN("gcc_spdm_rpm_cy_clk", STRING.MID("&clk", 1, &clk_input_length-2), 0)!=-1)
    ( 
      &match=1
    )
  )
  else if (&wild_head==1)
  (
    if (STRING.MID("gcc_spdm_rpm_cy_clk", &clk_itr_length-&clk_input_length+1, &clk_input_length-1)==STRING.CUT("&clk", 1))
    ( 
      &match=1
    )
  )
  else if (&wild_tail==1)
  (
    if (STRING.MID("gcc_spdm_rpm_cy_clk", 0, &clk_input_length-1)==STRING.CUT("&clk", -1))
    ( 
      &match=1
    )
  )
  else if ("gcc_spdm_rpm_cy_clk"=="&clk")
  (
    &match=1
  )
  
  if (&match==1)
  (
    &clk_test=&CLK_TEST_GCC_SPDM_RPM_CY_CLK
    &clk_reg=&HWIO_GCC_SPDM_RPM_CY_CBCR_ADDR
    &clk_reg_name="GCC_SPDM_RPM_CY_CBCR"
    &clk_name="gcc_spdm_rpm_cy_clk"
    &clk_reg_cbcr_type="sm_cbc"
    &clk_vote_bit=-1.
    &clk_multiplier=4.

    gosub Print_Clk_Info_Line
  )

  &match=0
  &wild_head=0
  &wild_tail=0
  &clk_input_length=STRING.LENGTH("&clk")
  &clk_itr_length=STRING.LENGTH("gcc_sdcc2_apps_clk")

  if (STRING.SCAN("&clk", "*", 0)==0)
  (
    &wild_head=1
  )
  if (STRING.SCAN("&clk", "*", 1)==(STRING.LENGTH("&clk")-1))
  (
    &wild_tail=1
  )

  if ((&wild_head==1)&&(&wild_tail==1))
  (
    if (STRING.SCAN("gcc_sdcc2_apps_clk", STRING.MID("&clk", 1, &clk_input_length-2), 0)!=-1)
    ( 
      &match=1
    )
  )
  else if (&wild_head==1)
  (
    if (STRING.MID("gcc_sdcc2_apps_clk", &clk_itr_length-&clk_input_length+1, &clk_input_length-1)==STRING.CUT("&clk", 1))
    ( 
      &match=1
    )
  )
  else if (&wild_tail==1)
  (
    if (STRING.MID("gcc_sdcc2_apps_clk", 0, &clk_input_length-1)==STRING.CUT("&clk", -1))
    ( 
      &match=1
    )
  )
  else if ("gcc_sdcc2_apps_clk"=="&clk")
  (
    &match=1
  )
  
  if (&match==1)
  (
    &clk_test=&CLK_TEST_GCC_SDCC2_APPS_CLK
    &clk_reg=&HWIO_GCC_SDCC2_APPS_CBCR_ADDR
    &clk_reg_name="GCC_SDCC2_APPS_CBCR"
    &clk_name="gcc_sdcc2_apps_clk"
    &clk_reg_cbcr_type="sm_pscbc"
    &clk_vote_bit=-1.
    &clk_multiplier=4.

    gosub Print_Clk_Info_Line
  )

  &match=0
  &wild_head=0
  &wild_tail=0
  &clk_input_length=STRING.LENGTH("&clk")
  &clk_itr_length=STRING.LENGTH("gcc_sdcc4_apps_clk")

  if (STRING.SCAN("&clk", "*", 0)==0)
  (
    &wild_head=1
  )
  if (STRING.SCAN("&clk", "*", 1)==(STRING.LENGTH("&clk")-1))
  (
    &wild_tail=1
  )

  if ((&wild_head==1)&&(&wild_tail==1))
  (
    if (STRING.SCAN("gcc_sdcc4_apps_clk", STRING.MID("&clk", 1, &clk_input_length-2), 0)!=-1)
    ( 
      &match=1
    )
  )
  else if (&wild_head==1)
  (
    if (STRING.MID("gcc_sdcc4_apps_clk", &clk_itr_length-&clk_input_length+1, &clk_input_length-1)==STRING.CUT("&clk", 1))
    ( 
      &match=1
    )
  )
  else if (&wild_tail==1)
  (
    if (STRING.MID("gcc_sdcc4_apps_clk", 0, &clk_input_length-1)==STRING.CUT("&clk", -1))
    ( 
      &match=1
    )
  )
  else if ("gcc_sdcc4_apps_clk"=="&clk")
  (
    &match=1
  )
  
  if (&match==1)
  (
    &clk_test=&CLK_TEST_GCC_SDCC4_APPS_CLK
    &clk_reg=&HWIO_GCC_SDCC4_APPS_CBCR_ADDR
    &clk_reg_name="GCC_SDCC4_APPS_CBCR"
    &clk_name="gcc_sdcc4_apps_clk"
    &clk_reg_cbcr_type="sm_pscbc"
    &clk_vote_bit=-1.
    &clk_multiplier=4.

    gosub Print_Clk_Info_Line
  )

  &match=0
  &wild_head=0
  &wild_tail=0
  &clk_input_length=STRING.LENGTH("&clk")
  &clk_itr_length=STRING.LENGTH("gcc_sec_ctrl_clk")

  if (STRING.SCAN("&clk", "*", 0)==0)
  (
    &wild_head=1
  )
  if (STRING.SCAN("&clk", "*", 1)==(STRING.LENGTH("&clk")-1))
  (
    &wild_tail=1
  )

  if ((&wild_head==1)&&(&wild_tail==1))
  (
    if (STRING.SCAN("gcc_sec_ctrl_clk", STRING.MID("&clk", 1, &clk_input_length-2), 0)!=-1)
    ( 
      &match=1
    )
  )
  else if (&wild_head==1)
  (
    if (STRING.MID("gcc_sec_ctrl_clk", &clk_itr_length-&clk_input_length+1, &clk_input_length-1)==STRING.CUT("&clk", 1))
    ( 
      &match=1
    )
  )
  else if (&wild_tail==1)
  (
    if (STRING.MID("gcc_sec_ctrl_clk", 0, &clk_input_length-1)==STRING.CUT("&clk", -1))
    ( 
      &match=1
    )
  )
  else if ("gcc_sec_ctrl_clk"=="&clk")
  (
    &match=1
  )
  
  if (&match==1)
  (
    &clk_test=&CLK_TEST_GCC_SEC_CTRL_CLK
    &clk_reg=&HWIO_GCC_SEC_CTRL_CBCR_ADDR
    &clk_reg_name="GCC_SEC_CTRL_CBCR"
    &clk_name="gcc_sec_ctrl_clk"
    &clk_reg_cbcr_type="sm_pscbc"
    &clk_vote_bit=-1.
    &clk_multiplier=4.

    gosub Print_Clk_Info_Line
  )

  &match=0
  &wild_head=0
  &wild_tail=0
  &clk_input_length=STRING.LENGTH("&clk")
  &clk_itr_length=STRING.LENGTH("gcc_sec_ctrl_sense_clk")

  if (STRING.SCAN("&clk", "*", 0)==0)
  (
    &wild_head=1
  )
  if (STRING.SCAN("&clk", "*", 1)==(STRING.LENGTH("&clk")-1))
  (
    &wild_tail=1
  )

  if ((&wild_head==1)&&(&wild_tail==1))
  (
    if (STRING.SCAN("gcc_sec_ctrl_sense_clk", STRING.MID("&clk", 1, &clk_input_length-2), 0)!=-1)
    ( 
      &match=1
    )
  )
  else if (&wild_head==1)
  (
    if (STRING.MID("gcc_sec_ctrl_sense_clk", &clk_itr_length-&clk_input_length+1, &clk_input_length-1)==STRING.CUT("&clk", 1))
    ( 
      &match=1
    )
  )
  else if (&wild_tail==1)
  (
    if (STRING.MID("gcc_sec_ctrl_sense_clk", 0, &clk_input_length-1)==STRING.CUT("&clk", -1))
    ( 
      &match=1
    )
  )
  else if ("gcc_sec_ctrl_sense_clk"=="&clk")
  (
    &match=1
  )
  
  if (&match==1)
  (
    &clk_test=&CLK_TEST_GCC_SEC_CTRL_SENSE_CLK
    &clk_reg=&HWIO_GCC_SEC_CTRL_SENSE_CBCR_ADDR
    &clk_reg_name="GCC_SEC_CTRL_SENSE_CBCR"
    &clk_name="gcc_sec_ctrl_sense_clk"
    &clk_reg_cbcr_type="sm_cbc"
    &clk_vote_bit=-1.
    &clk_multiplier=4.

    gosub Print_Clk_Info_Line
  )

  &match=0
  &wild_head=0
  &wild_tail=0
  &clk_input_length=STRING.LENGTH("&clk")
  &clk_itr_length=STRING.LENGTH("gcc_spss_sec_ctrl_clk")

  if (STRING.SCAN("&clk", "*", 0)==0)
  (
    &wild_head=1
  )
  if (STRING.SCAN("&clk", "*", 1)==(STRING.LENGTH("&clk")-1))
  (
    &wild_tail=1
  )

  if ((&wild_head==1)&&(&wild_tail==1))
  (
    if (STRING.SCAN("gcc_spss_sec_ctrl_clk", STRING.MID("&clk", 1, &clk_input_length-2), 0)!=-1)
    ( 
      &match=1
    )
  )
  else if (&wild_head==1)
  (
    if (STRING.MID("gcc_spss_sec_ctrl_clk", &clk_itr_length-&clk_input_length+1, &clk_input_length-1)==STRING.CUT("&clk", 1))
    ( 
      &match=1
    )
  )
  else if (&wild_tail==1)
  (
    if (STRING.MID("gcc_spss_sec_ctrl_clk", 0, &clk_input_length-1)==STRING.CUT("&clk", -1))
    ( 
      &match=1
    )
  )
  else if ("gcc_spss_sec_ctrl_clk"=="&clk")
  (
    &match=1
  )
  
  if (&match==1)
  (
    &clk_test=&CLK_TEST_GCC_SPSS_SEC_CTRL_CLK
    &clk_reg=&HWIO_GCC_SPSS_SEC_CTRL_CBCR_ADDR
    &clk_reg_name="GCC_SPSS_SEC_CTRL_CBCR"
    &clk_name="gcc_spss_sec_ctrl_clk"
    &clk_reg_cbcr_type="sm_cbc"
    &clk_vote_bit=-1.
    &clk_multiplier=4.

    gosub Print_Clk_Info_Line
  )

  &match=0
  &wild_head=0
  &wild_tail=0
  &clk_input_length=STRING.LENGTH("&clk")
  &clk_itr_length=STRING.LENGTH("gcc_spmi_ahb_clk")

  if (STRING.SCAN("&clk", "*", 0)==0)
  (
    &wild_head=1
  )
  if (STRING.SCAN("&clk", "*", 1)==(STRING.LENGTH("&clk")-1))
  (
    &wild_tail=1
  )

  if ((&wild_head==1)&&(&wild_tail==1))
  (
    if (STRING.SCAN("gcc_spmi_ahb_clk", STRING.MID("&clk", 1, &clk_input_length-2), 0)!=-1)
    ( 
      &match=1
    )
  )
  else if (&wild_head==1)
  (
    if (STRING.MID("gcc_spmi_ahb_clk", &clk_itr_length-&clk_input_length+1, &clk_input_length-1)==STRING.CUT("&clk", 1))
    ( 
      &match=1
    )
  )
  else if (&wild_tail==1)
  (
    if (STRING.MID("gcc_spmi_ahb_clk", 0, &clk_input_length-1)==STRING.CUT("&clk", -1))
    ( 
      &match=1
    )
  )
  else if ("gcc_spmi_ahb_clk"=="&clk")
  (
    &match=1
  )
  
  if (&match==1)
  (
    &clk_test=&CLK_TEST_GCC_SPMI_AHB_CLK
    &clk_reg=&HWIO_GCC_SPMI_AHB_CBCR_ADDR
    &clk_reg_name="GCC_SPMI_AHB_CBCR"
    &clk_name="gcc_spmi_ahb_clk"
    &clk_reg_cbcr_type="sm_pscbc"
    &clk_vote_bit=-1.
    &clk_multiplier=4.

    gosub Print_Clk_Info_Line
  )

  &match=0
  &wild_head=0
  &wild_tail=0
  &clk_input_length=STRING.LENGTH("&clk")
  &clk_itr_length=STRING.LENGTH("gcc_spmi_ser_clk")

  if (STRING.SCAN("&clk", "*", 0)==0)
  (
    &wild_head=1
  )
  if (STRING.SCAN("&clk", "*", 1)==(STRING.LENGTH("&clk")-1))
  (
    &wild_tail=1
  )

  if ((&wild_head==1)&&(&wild_tail==1))
  (
    if (STRING.SCAN("gcc_spmi_ser_clk", STRING.MID("&clk", 1, &clk_input_length-2), 0)!=-1)
    ( 
      &match=1
    )
  )
  else if (&wild_head==1)
  (
    if (STRING.MID("gcc_spmi_ser_clk", &clk_itr_length-&clk_input_length+1, &clk_input_length-1)==STRING.CUT("&clk", 1))
    ( 
      &match=1
    )
  )
  else if (&wild_tail==1)
  (
    if (STRING.MID("gcc_spmi_ser_clk", 0, &clk_input_length-1)==STRING.CUT("&clk", -1))
    ( 
      &match=1
    )
  )
  else if ("gcc_spmi_ser_clk"=="&clk")
  (
    &match=1
  )
  
  if (&match==1)
  (
    &clk_test=&CLK_TEST_GCC_SPMI_SER_CLK
    &clk_reg=&HWIO_GCC_SPMI_SER_CBCR_ADDR
    &clk_reg_name="GCC_SPMI_SER_CBCR"
    &clk_name="gcc_spmi_ser_clk"
    &clk_reg_cbcr_type="sm_pscbc"
    &clk_vote_bit=-1.
    &clk_multiplier=4.

    gosub Print_Clk_Info_Line
  )

  &match=0
  &wild_head=0
  &wild_tail=0
  &clk_input_length=STRING.LENGTH("&clk")
  &clk_itr_length=STRING.LENGTH("gcc_bimc_nius_hs_axi_clk")

  if (STRING.SCAN("&clk", "*", 0)==0)
  (
    &wild_head=1
  )
  if (STRING.SCAN("&clk", "*", 1)==(STRING.LENGTH("&clk")-1))
  (
    &wild_tail=1
  )

  if ((&wild_head==1)&&(&wild_tail==1))
  (
    if (STRING.SCAN("gcc_bimc_nius_hs_axi_clk", STRING.MID("&clk", 1, &clk_input_length-2), 0)!=-1)
    ( 
      &match=1
    )
  )
  else if (&wild_head==1)
  (
    if (STRING.MID("gcc_bimc_nius_hs_axi_clk", &clk_itr_length-&clk_input_length+1, &clk_input_length-1)==STRING.CUT("&clk", 1))
    ( 
      &match=1
    )
  )
  else if (&wild_tail==1)
  (
    if (STRING.MID("gcc_bimc_nius_hs_axi_clk", 0, &clk_input_length-1)==STRING.CUT("&clk", -1))
    ( 
      &match=1
    )
  )
  else if ("gcc_bimc_nius_hs_axi_clk"=="&clk")
  (
    &match=1
  )
  
  if (&match==1)
  (
    &clk_test=&CLK_TEST_GCC_BIMC_NIUS_HS_AXI_CLK
    &clk_reg=&HWIO_GCC_BIMC_NIUS_HS_AXI_CBCR_ADDR
    &clk_reg_name="GCC_BIMC_NIUS_HS_AXI_CBCR"
    &clk_name="gcc_bimc_nius_hs_axi_clk"
    &clk_reg_cbcr_type="sm_cbc"
    &clk_vote_bit=-1.
    &clk_multiplier=4.

    gosub Print_Clk_Info_Line
  )

  &match=0
  &wild_head=0
  &wild_tail=0
  &clk_input_length=STRING.LENGTH("&clk")
  &clk_itr_length=STRING.LENGTH("gcc_bimc_sysnoc_hs_axi_clk")

  if (STRING.SCAN("&clk", "*", 0)==0)
  (
    &wild_head=1
  )
  if (STRING.SCAN("&clk", "*", 1)==(STRING.LENGTH("&clk")-1))
  (
    &wild_tail=1
  )

  if ((&wild_head==1)&&(&wild_tail==1))
  (
    if (STRING.SCAN("gcc_bimc_sysnoc_hs_axi_clk", STRING.MID("&clk", 1, &clk_input_length-2), 0)!=-1)
    ( 
      &match=1
    )
  )
  else if (&wild_head==1)
  (
    if (STRING.MID("gcc_bimc_sysnoc_hs_axi_clk", &clk_itr_length-&clk_input_length+1, &clk_input_length-1)==STRING.CUT("&clk", 1))
    ( 
      &match=1
    )
  )
  else if (&wild_tail==1)
  (
    if (STRING.MID("gcc_bimc_sysnoc_hs_axi_clk", 0, &clk_input_length-1)==STRING.CUT("&clk", -1))
    ( 
      &match=1
    )
  )
  else if ("gcc_bimc_sysnoc_hs_axi_clk"=="&clk")
  (
    &match=1
  )
  
  if (&match==1)
  (
    &clk_test=&CLK_TEST_GCC_BIMC_SYSNOC_HS_AXI_CLK
    &clk_reg=&HWIO_GCC_BIMC_SYSNOC_HS_AXI_CBCR_ADDR
    &clk_reg_name="GCC_BIMC_SYSNOC_HS_AXI_CBCR"
    &clk_name="gcc_bimc_sysnoc_hs_axi_clk"
    &clk_reg_cbcr_type="sm_cbc"
    &clk_vote_bit=-1.
    &clk_multiplier=4.

    gosub Print_Clk_Info_Line
  )

  &match=0
  &wild_head=0
  &wild_tail=0
  &clk_input_length=STRING.LENGTH("&clk")
  &clk_itr_length=STRING.LENGTH("gcc_lpass_q6_axi_clk")

  if (STRING.SCAN("&clk", "*", 0)==0)
  (
    &wild_head=1
  )
  if (STRING.SCAN("&clk", "*", 1)==(STRING.LENGTH("&clk")-1))
  (
    &wild_tail=1
  )

  if ((&wild_head==1)&&(&wild_tail==1))
  (
    if (STRING.SCAN("gcc_lpass_q6_axi_clk", STRING.MID("&clk", 1, &clk_input_length-2), 0)!=-1)
    ( 
      &match=1
    )
  )
  else if (&wild_head==1)
  (
    if (STRING.MID("gcc_lpass_q6_axi_clk", &clk_itr_length-&clk_input_length+1, &clk_input_length-1)==STRING.CUT("&clk", 1))
    ( 
      &match=1
    )
  )
  else if (&wild_tail==1)
  (
    if (STRING.MID("gcc_lpass_q6_axi_clk", 0, &clk_input_length-1)==STRING.CUT("&clk", -1))
    ( 
      &match=1
    )
  )
  else if ("gcc_lpass_q6_axi_clk"=="&clk")
  (
    &match=1
  )
  
  if (&match==1)
  (
    &clk_test=&CLK_TEST_GCC_LPASS_Q6_AXI_CLK
    &clk_reg=&HWIO_GCC_LPASS_Q6_AXI_CBCR_ADDR
    &clk_reg_name="GCC_LPASS_Q6_AXI_CBCR"
    &clk_name="gcc_lpass_q6_axi_clk"
    &clk_reg_cbcr_type="sm_cbc"
    &clk_vote_bit=-1.
    &clk_multiplier=4.

    gosub Print_Clk_Info_Line
  )

  &match=0
  &wild_head=0
  &wild_tail=0
  &clk_input_length=STRING.LENGTH("&clk")
  &clk_itr_length=STRING.LENGTH("gcc_lpass_q6_smmu_axi_clk")

  if (STRING.SCAN("&clk", "*", 0)==0)
  (
    &wild_head=1
  )
  if (STRING.SCAN("&clk", "*", 1)==(STRING.LENGTH("&clk")-1))
  (
    &wild_tail=1
  )

  if ((&wild_head==1)&&(&wild_tail==1))
  (
    if (STRING.SCAN("gcc_lpass_q6_smmu_axi_clk", STRING.MID("&clk", 1, &clk_input_length-2), 0)!=-1)
    ( 
      &match=1
    )
  )
  else if (&wild_head==1)
  (
    if (STRING.MID("gcc_lpass_q6_smmu_axi_clk", &clk_itr_length-&clk_input_length+1, &clk_input_length-1)==STRING.CUT("&clk", 1))
    ( 
      &match=1
    )
  )
  else if (&wild_tail==1)
  (
    if (STRING.MID("gcc_lpass_q6_smmu_axi_clk", 0, &clk_input_length-1)==STRING.CUT("&clk", -1))
    ( 
      &match=1
    )
  )
  else if ("gcc_lpass_q6_smmu_axi_clk"=="&clk")
  (
    &match=1
  )
  
  if (&match==1)
  (
    &clk_test=&CLK_TEST_GCC_LPASS_Q6_SMMU_AXI_CLK
    &clk_reg=&HWIO_GCC_LPASS_Q6_SMMU_AXI_CBCR_ADDR
    &clk_reg_name="GCC_LPASS_Q6_SMMU_AXI_CBCR"
    &clk_name="gcc_lpass_q6_smmu_axi_clk"
    &clk_reg_cbcr_type="sm_cbc"
    &clk_vote_bit=-1.
    &clk_multiplier=4.

    gosub Print_Clk_Info_Line
  )

  &match=0
  &wild_head=0
  &wild_tail=0
  &clk_input_length=STRING.LENGTH("&clk")
  &clk_itr_length=STRING.LENGTH("gcc_lpass_q6_smmu_axi_src_clk")

  if (STRING.SCAN("&clk", "*", 0)==0)
  (
    &wild_head=1
  )
  if (STRING.SCAN("&clk", "*", 1)==(STRING.LENGTH("&clk")-1))
  (
    &wild_tail=1
  )

  if ((&wild_head==1)&&(&wild_tail==1))
  (
    if (STRING.SCAN("gcc_lpass_q6_smmu_axi_src_clk", STRING.MID("&clk", 1, &clk_input_length-2), 0)!=-1)
    ( 
      &match=1
    )
  )
  else if (&wild_head==1)
  (
    if (STRING.MID("gcc_lpass_q6_smmu_axi_src_clk", &clk_itr_length-&clk_input_length+1, &clk_input_length-1)==STRING.CUT("&clk", 1))
    ( 
      &match=1
    )
  )
  else if (&wild_tail==1)
  (
    if (STRING.MID("gcc_lpass_q6_smmu_axi_src_clk", 0, &clk_input_length-1)==STRING.CUT("&clk", -1))
    ( 
      &match=1
    )
  )
  else if ("gcc_lpass_q6_smmu_axi_src_clk"=="&clk")
  (
    &match=1
  )
  
  if (&match==1)
  (
    &clk_test=&CLK_TEST_GCC_LPASS_Q6_SMMU_AXI_SRC_CLK
    &clk_reg=&HWIO_GCC_LPASS_Q6_SMMU_AXI_SRC_CBCR_ADDR
    &clk_reg_name="GCC_LPASS_Q6_SMMU_AXI_SRC_CBCR"
    &clk_name="gcc_lpass_q6_smmu_axi_src_clk"
    &clk_reg_cbcr_type="sm_pscbc"
    &clk_vote_bit=-1.
    &clk_multiplier=4.

    gosub Print_Clk_Info_Line
  )

  &match=0
  &wild_head=0
  &wild_tail=0
  &clk_input_length=STRING.LENGTH("&clk")
  &clk_itr_length=STRING.LENGTH("gcc_mss_mnoc_bimc_axi_clk")

  if (STRING.SCAN("&clk", "*", 0)==0)
  (
    &wild_head=1
  )
  if (STRING.SCAN("&clk", "*", 1)==(STRING.LENGTH("&clk")-1))
  (
    &wild_tail=1
  )

  if ((&wild_head==1)&&(&wild_tail==1))
  (
    if (STRING.SCAN("gcc_mss_mnoc_bimc_axi_clk", STRING.MID("&clk", 1, &clk_input_length-2), 0)!=-1)
    ( 
      &match=1
    )
  )
  else if (&wild_head==1)
  (
    if (STRING.MID("gcc_mss_mnoc_bimc_axi_clk", &clk_itr_length-&clk_input_length+1, &clk_input_length-1)==STRING.CUT("&clk", 1))
    ( 
      &match=1
    )
  )
  else if (&wild_tail==1)
  (
    if (STRING.MID("gcc_mss_mnoc_bimc_axi_clk", 0, &clk_input_length-1)==STRING.CUT("&clk", -1))
    ( 
      &match=1
    )
  )
  else if ("gcc_mss_mnoc_bimc_axi_clk"=="&clk")
  (
    &match=1
  )
  
  if (&match==1)
  (
    &clk_test=&CLK_TEST_GCC_MSS_MNOC_BIMC_AXI_CLK
    &clk_reg=&HWIO_GCC_MSS_MNOC_BIMC_AXI_CBCR_ADDR
    &clk_reg_name="GCC_MSS_MNOC_BIMC_AXI_CBCR"
    &clk_name="gcc_mss_mnoc_bimc_axi_clk"
    &clk_reg_cbcr_type="sm_cbc"
    &clk_vote_bit=-1.
    &clk_multiplier=4.

    gosub Print_Clk_Info_Line
  )

  &match=0
  &wild_head=0
  &wild_tail=0
  &clk_input_length=STRING.LENGTH("&clk")
  &clk_itr_length=STRING.LENGTH("gcc_mss_msmpu_client_axi_clk")

  if (STRING.SCAN("&clk", "*", 0)==0)
  (
    &wild_head=1
  )
  if (STRING.SCAN("&clk", "*", 1)==(STRING.LENGTH("&clk")-1))
  (
    &wild_tail=1
  )

  if ((&wild_head==1)&&(&wild_tail==1))
  (
    if (STRING.SCAN("gcc_mss_msmpu_client_axi_clk", STRING.MID("&clk", 1, &clk_input_length-2), 0)!=-1)
    ( 
      &match=1
    )
  )
  else if (&wild_head==1)
  (
    if (STRING.MID("gcc_mss_msmpu_client_axi_clk", &clk_itr_length-&clk_input_length+1, &clk_input_length-1)==STRING.CUT("&clk", 1))
    ( 
      &match=1
    )
  )
  else if (&wild_tail==1)
  (
    if (STRING.MID("gcc_mss_msmpu_client_axi_clk", 0, &clk_input_length-1)==STRING.CUT("&clk", -1))
    ( 
      &match=1
    )
  )
  else if ("gcc_mss_msmpu_client_axi_clk"=="&clk")
  (
    &match=1
  )
  
  if (&match==1)
  (
    &clk_test=&CLK_TEST_GCC_MSS_MSMPU_CLIENT_AXI_CLK
    &clk_reg=&HWIO_GCC_MSS_MSMPU_CLIENT_AXI_CBCR_ADDR
    &clk_reg_name="GCC_MSS_MSMPU_CLIENT_AXI_CBCR"
    &clk_name="gcc_mss_msmpu_client_axi_clk"
    &clk_reg_cbcr_type="sm_cbc"
    &clk_vote_bit=-1.
    &clk_multiplier=4.

    gosub Print_Clk_Info_Line
  )

  &match=0
  &wild_head=0
  &wild_tail=0
  &clk_input_length=STRING.LENGTH("&clk")
  &clk_itr_length=STRING.LENGTH("gcc_sys_noc_hs_axi_clk")

  if (STRING.SCAN("&clk", "*", 0)==0)
  (
    &wild_head=1
  )
  if (STRING.SCAN("&clk", "*", 1)==(STRING.LENGTH("&clk")-1))
  (
    &wild_tail=1
  )

  if ((&wild_head==1)&&(&wild_tail==1))
  (
    if (STRING.SCAN("gcc_sys_noc_hs_axi_clk", STRING.MID("&clk", 1, &clk_input_length-2), 0)!=-1)
    ( 
      &match=1
    )
  )
  else if (&wild_head==1)
  (
    if (STRING.MID("gcc_sys_noc_hs_axi_clk", &clk_itr_length-&clk_input_length+1, &clk_input_length-1)==STRING.CUT("&clk", 1))
    ( 
      &match=1
    )
  )
  else if (&wild_tail==1)
  (
    if (STRING.MID("gcc_sys_noc_hs_axi_clk", 0, &clk_input_length-1)==STRING.CUT("&clk", -1))
    ( 
      &match=1
    )
  )
  else if ("gcc_sys_noc_hs_axi_clk"=="&clk")
  (
    &match=1
  )
  
  if (&match==1)
  (
    &clk_test=&CLK_TEST_GCC_SYS_NOC_HS_AXI_CLK
    &clk_reg=&HWIO_GCC_SYS_NOC_HS_AXI_CBCR_ADDR
    &clk_reg_name="GCC_SYS_NOC_HS_AXI_CBCR"
    &clk_name="gcc_sys_noc_hs_axi_clk"
    &clk_reg_cbcr_type="sm_cbc"
    &clk_vote_bit=-1.
    &clk_multiplier=4.

    gosub Print_Clk_Info_Line
  )

  &match=0
  &wild_head=0
  &wild_tail=0
  &clk_input_length=STRING.LENGTH("&clk")
  &clk_itr_length=STRING.LENGTH("gcc_aggre1_snoc_axi_clk")

  if (STRING.SCAN("&clk", "*", 0)==0)
  (
    &wild_head=1
  )
  if (STRING.SCAN("&clk", "*", 1)==(STRING.LENGTH("&clk")-1))
  (
    &wild_tail=1
  )

  if ((&wild_head==1)&&(&wild_tail==1))
  (
    if (STRING.SCAN("gcc_aggre1_snoc_axi_clk", STRING.MID("&clk", 1, &clk_input_length-2), 0)!=-1)
    ( 
      &match=1
    )
  )
  else if (&wild_head==1)
  (
    if (STRING.MID("gcc_aggre1_snoc_axi_clk", &clk_itr_length-&clk_input_length+1, &clk_input_length-1)==STRING.CUT("&clk", 1))
    ( 
      &match=1
    )
  )
  else if (&wild_tail==1)
  (
    if (STRING.MID("gcc_aggre1_snoc_axi_clk", 0, &clk_input_length-1)==STRING.CUT("&clk", -1))
    ( 
      &match=1
    )
  )
  else if ("gcc_aggre1_snoc_axi_clk"=="&clk")
  (
    &match=1
  )
  
  if (&match==1)
  (
    &clk_test=&CLK_TEST_GCC_AGGRE1_SNOC_AXI_CLK
    &clk_reg=&HWIO_GCC_AGGRE1_SNOC_AXI_CBCR_ADDR
    &clk_reg_name="GCC_AGGRE1_SNOC_AXI_CBCR"
    &clk_name="gcc_aggre1_snoc_axi_clk"
    &clk_reg_cbcr_type="sm_cbc"
    &clk_vote_bit=-1.
    &clk_multiplier=4.

    gosub Print_Clk_Info_Line
  )

  &match=0
  &wild_head=0
  &wild_tail=0
  &clk_input_length=STRING.LENGTH("&clk")
  &clk_itr_length=STRING.LENGTH("gcc_aggre1_snoc_msmpu_client_axi_clk")

  if (STRING.SCAN("&clk", "*", 0)==0)
  (
    &wild_head=1
  )
  if (STRING.SCAN("&clk", "*", 1)==(STRING.LENGTH("&clk")-1))
  (
    &wild_tail=1
  )

  if ((&wild_head==1)&&(&wild_tail==1))
  (
    if (STRING.SCAN("gcc_aggre1_snoc_msmpu_client_axi_clk", STRING.MID("&clk", 1, &clk_input_length-2), 0)!=-1)
    ( 
      &match=1
    )
  )
  else if (&wild_head==1)
  (
    if (STRING.MID("gcc_aggre1_snoc_msmpu_client_axi_clk", &clk_itr_length-&clk_input_length+1, &clk_input_length-1)==STRING.CUT("&clk", 1))
    ( 
      &match=1
    )
  )
  else if (&wild_tail==1)
  (
    if (STRING.MID("gcc_aggre1_snoc_msmpu_client_axi_clk", 0, &clk_input_length-1)==STRING.CUT("&clk", -1))
    ( 
      &match=1
    )
  )
  else if ("gcc_aggre1_snoc_msmpu_client_axi_clk"=="&clk")
  (
    &match=1
  )
  
  if (&match==1)
  (
    &clk_test=&CLK_TEST_GCC_AGGRE1_SNOC_MSMPU_CLIENT_AXI_CLK
    &clk_reg=&HWIO_GCC_AGGRE1_SNOC_MSMPU_CLIENT_AXI_CBCR_ADDR
    &clk_reg_name="GCC_AGGRE1_SNOC_MSMPU_CLIENT_AXI_CBCR"
    &clk_name="gcc_aggre1_snoc_msmpu_client_axi_clk"
    &clk_reg_cbcr_type="sm_cbc"
    &clk_vote_bit=-1.
    &clk_multiplier=4.

    gosub Print_Clk_Info_Line
  )

  &match=0
  &wild_head=0
  &wild_tail=0
  &clk_input_length=STRING.LENGTH("&clk")
  &clk_itr_length=STRING.LENGTH("gcc_aggre2_snoc_axi_clk")

  if (STRING.SCAN("&clk", "*", 0)==0)
  (
    &wild_head=1
  )
  if (STRING.SCAN("&clk", "*", 1)==(STRING.LENGTH("&clk")-1))
  (
    &wild_tail=1
  )

  if ((&wild_head==1)&&(&wild_tail==1))
  (
    if (STRING.SCAN("gcc_aggre2_snoc_axi_clk", STRING.MID("&clk", 1, &clk_input_length-2), 0)!=-1)
    ( 
      &match=1
    )
  )
  else if (&wild_head==1)
  (
    if (STRING.MID("gcc_aggre2_snoc_axi_clk", &clk_itr_length-&clk_input_length+1, &clk_input_length-1)==STRING.CUT("&clk", 1))
    ( 
      &match=1
    )
  )
  else if (&wild_tail==1)
  (
    if (STRING.MID("gcc_aggre2_snoc_axi_clk", 0, &clk_input_length-1)==STRING.CUT("&clk", -1))
    ( 
      &match=1
    )
  )
  else if ("gcc_aggre2_snoc_axi_clk"=="&clk")
  (
    &match=1
  )
  
  if (&match==1)
  (
    &clk_test=&CLK_TEST_GCC_AGGRE2_SNOC_AXI_CLK
    &clk_reg=&HWIO_GCC_AGGRE2_SNOC_AXI_CBCR_ADDR
    &clk_reg_name="GCC_AGGRE2_SNOC_AXI_CBCR"
    &clk_name="gcc_aggre2_snoc_axi_clk"
    &clk_reg_cbcr_type="sm_cbc"
    &clk_vote_bit=-1.
    &clk_multiplier=4.

    gosub Print_Clk_Info_Line
  )

  &match=0
  &wild_head=0
  &wild_tail=0
  &clk_input_length=STRING.LENGTH("&clk")
  &clk_itr_length=STRING.LENGTH("gcc_aggre2_snoc_east_axi_clk")

  if (STRING.SCAN("&clk", "*", 0)==0)
  (
    &wild_head=1
  )
  if (STRING.SCAN("&clk", "*", 1)==(STRING.LENGTH("&clk")-1))
  (
    &wild_tail=1
  )

  if ((&wild_head==1)&&(&wild_tail==1))
  (
    if (STRING.SCAN("gcc_aggre2_snoc_east_axi_clk", STRING.MID("&clk", 1, &clk_input_length-2), 0)!=-1)
    ( 
      &match=1
    )
  )
  else if (&wild_head==1)
  (
    if (STRING.MID("gcc_aggre2_snoc_east_axi_clk", &clk_itr_length-&clk_input_length+1, &clk_input_length-1)==STRING.CUT("&clk", 1))
    ( 
      &match=1
    )
  )
  else if (&wild_tail==1)
  (
    if (STRING.MID("gcc_aggre2_snoc_east_axi_clk", 0, &clk_input_length-1)==STRING.CUT("&clk", -1))
    ( 
      &match=1
    )
  )
  else if ("gcc_aggre2_snoc_east_axi_clk"=="&clk")
  (
    &match=1
  )
  
  if (&match==1)
  (
    &clk_test=&CLK_TEST_GCC_AGGRE2_SNOC_EAST_AXI_CLK
    &clk_reg=&HWIO_GCC_AGGRE2_SNOC_EAST_AXI_CBCR_ADDR
    &clk_reg_name="GCC_AGGRE2_SNOC_EAST_AXI_CBCR"
    &clk_name="gcc_aggre2_snoc_east_axi_clk"
    &clk_reg_cbcr_type="sm_cbc"
    &clk_vote_bit=-1.
    &clk_multiplier=4.

    gosub Print_Clk_Info_Line
  )

  &match=0
  &wild_head=0
  &wild_tail=0
  &clk_input_length=STRING.LENGTH("&clk")
  &clk_itr_length=STRING.LENGTH("gcc_aggre2_snoc_msmpu_client_axi_clk")

  if (STRING.SCAN("&clk", "*", 0)==0)
  (
    &wild_head=1
  )
  if (STRING.SCAN("&clk", "*", 1)==(STRING.LENGTH("&clk")-1))
  (
    &wild_tail=1
  )

  if ((&wild_head==1)&&(&wild_tail==1))
  (
    if (STRING.SCAN("gcc_aggre2_snoc_msmpu_client_axi_clk", STRING.MID("&clk", 1, &clk_input_length-2), 0)!=-1)
    ( 
      &match=1
    )
  )
  else if (&wild_head==1)
  (
    if (STRING.MID("gcc_aggre2_snoc_msmpu_client_axi_clk", &clk_itr_length-&clk_input_length+1, &clk_input_length-1)==STRING.CUT("&clk", 1))
    ( 
      &match=1
    )
  )
  else if (&wild_tail==1)
  (
    if (STRING.MID("gcc_aggre2_snoc_msmpu_client_axi_clk", 0, &clk_input_length-1)==STRING.CUT("&clk", -1))
    ( 
      &match=1
    )
  )
  else if ("gcc_aggre2_snoc_msmpu_client_axi_clk"=="&clk")
  (
    &match=1
  )
  
  if (&match==1)
  (
    &clk_test=&CLK_TEST_GCC_AGGRE2_SNOC_MSMPU_CLIENT_AXI_CLK
    &clk_reg=&HWIO_GCC_AGGRE2_SNOC_MSMPU_CLIENT_AXI_CBCR_ADDR
    &clk_reg_name="GCC_AGGRE2_SNOC_MSMPU_CLIENT_AXI_CBCR"
    &clk_name="gcc_aggre2_snoc_msmpu_client_axi_clk"
    &clk_reg_cbcr_type="sm_cbc"
    &clk_vote_bit=-1.
    &clk_multiplier=4.

    gosub Print_Clk_Info_Line
  )

  &match=0
  &wild_head=0
  &wild_tail=0
  &clk_input_length=STRING.LENGTH("&clk")
  &clk_itr_length=STRING.LENGTH("gcc_aggre2_snoc_north_axi_clk")

  if (STRING.SCAN("&clk", "*", 0)==0)
  (
    &wild_head=1
  )
  if (STRING.SCAN("&clk", "*", 1)==(STRING.LENGTH("&clk")-1))
  (
    &wild_tail=1
  )

  if ((&wild_head==1)&&(&wild_tail==1))
  (
    if (STRING.SCAN("gcc_aggre2_snoc_north_axi_clk", STRING.MID("&clk", 1, &clk_input_length-2), 0)!=-1)
    ( 
      &match=1
    )
  )
  else if (&wild_head==1)
  (
    if (STRING.MID("gcc_aggre2_snoc_north_axi_clk", &clk_itr_length-&clk_input_length+1, &clk_input_length-1)==STRING.CUT("&clk", 1))
    ( 
      &match=1
    )
  )
  else if (&wild_tail==1)
  (
    if (STRING.MID("gcc_aggre2_snoc_north_axi_clk", 0, &clk_input_length-1)==STRING.CUT("&clk", -1))
    ( 
      &match=1
    )
  )
  else if ("gcc_aggre2_snoc_north_axi_clk"=="&clk")
  (
    &match=1
  )
  
  if (&match==1)
  (
    &clk_test=&CLK_TEST_GCC_AGGRE2_SNOC_NORTH_AXI_CLK
    &clk_reg=&HWIO_GCC_AGGRE2_SNOC_NORTH_AXI_CBCR_ADDR
    &clk_reg_name="GCC_AGGRE2_SNOC_NORTH_AXI_CBCR"
    &clk_name="gcc_aggre2_snoc_north_axi_clk"
    &clk_reg_cbcr_type="sm_cbc"
    &clk_vote_bit=-1.
    &clk_multiplier=4.

    gosub Print_Clk_Info_Line
  )

  &match=0
  &wild_head=0
  &wild_tail=0
  &clk_input_length=STRING.LENGTH("&clk")
  &clk_itr_length=STRING.LENGTH("gcc_bimc_nius_axi_clk")

  if (STRING.SCAN("&clk", "*", 0)==0)
  (
    &wild_head=1
  )
  if (STRING.SCAN("&clk", "*", 1)==(STRING.LENGTH("&clk")-1))
  (
    &wild_tail=1
  )

  if ((&wild_head==1)&&(&wild_tail==1))
  (
    if (STRING.SCAN("gcc_bimc_nius_axi_clk", STRING.MID("&clk", 1, &clk_input_length-2), 0)!=-1)
    ( 
      &match=1
    )
  )
  else if (&wild_head==1)
  (
    if (STRING.MID("gcc_bimc_nius_axi_clk", &clk_itr_length-&clk_input_length+1, &clk_input_length-1)==STRING.CUT("&clk", 1))
    ( 
      &match=1
    )
  )
  else if (&wild_tail==1)
  (
    if (STRING.MID("gcc_bimc_nius_axi_clk", 0, &clk_input_length-1)==STRING.CUT("&clk", -1))
    ( 
      &match=1
    )
  )
  else if ("gcc_bimc_nius_axi_clk"=="&clk")
  (
    &match=1
  )
  
  if (&match==1)
  (
    &clk_test=&CLK_TEST_GCC_BIMC_NIUS_AXI_CLK
    &clk_reg=&HWIO_GCC_BIMC_NIUS_AXI_CBCR_ADDR
    &clk_reg_name="GCC_BIMC_NIUS_AXI_CBCR"
    &clk_name="gcc_bimc_nius_axi_clk"
    &clk_reg_cbcr_type="sm_cbc"
    &clk_vote_bit=-1.
    &clk_multiplier=4.

    gosub Print_Clk_Info_Line
  )

  &match=0
  &wild_head=0
  &wild_tail=0
  &clk_input_length=STRING.LENGTH("&clk")
  &clk_itr_length=STRING.LENGTH("gcc_bimc_sysnoc_axi_clk")

  if (STRING.SCAN("&clk", "*", 0)==0)
  (
    &wild_head=1
  )
  if (STRING.SCAN("&clk", "*", 1)==(STRING.LENGTH("&clk")-1))
  (
    &wild_tail=1
  )

  if ((&wild_head==1)&&(&wild_tail==1))
  (
    if (STRING.SCAN("gcc_bimc_sysnoc_axi_clk", STRING.MID("&clk", 1, &clk_input_length-2), 0)!=-1)
    ( 
      &match=1
    )
  )
  else if (&wild_head==1)
  (
    if (STRING.MID("gcc_bimc_sysnoc_axi_clk", &clk_itr_length-&clk_input_length+1, &clk_input_length-1)==STRING.CUT("&clk", 1))
    ( 
      &match=1
    )
  )
  else if (&wild_tail==1)
  (
    if (STRING.MID("gcc_bimc_sysnoc_axi_clk", 0, &clk_input_length-1)==STRING.CUT("&clk", -1))
    ( 
      &match=1
    )
  )
  else if ("gcc_bimc_sysnoc_axi_clk"=="&clk")
  (
    &match=1
  )
  
  if (&match==1)
  (
    &clk_test=&CLK_TEST_GCC_BIMC_SYSNOC_AXI_CLK
    &clk_reg=&HWIO_GCC_BIMC_SYSNOC_AXI_CBCR_ADDR
    &clk_reg_name="GCC_BIMC_SYSNOC_AXI_CBCR"
    &clk_name="gcc_bimc_sysnoc_axi_clk"
    &clk_reg_cbcr_type="sm_cbc"
    &clk_vote_bit=-1.
    &clk_multiplier=4.

    gosub Print_Clk_Info_Line
  )

  &match=0
  &wild_head=0
  &wild_tail=0
  &clk_input_length=STRING.LENGTH("&clk")
  &clk_itr_length=STRING.LENGTH("gcc_ce1_axi_clk")

  if (STRING.SCAN("&clk", "*", 0)==0)
  (
    &wild_head=1
  )
  if (STRING.SCAN("&clk", "*", 1)==(STRING.LENGTH("&clk")-1))
  (
    &wild_tail=1
  )

  if ((&wild_head==1)&&(&wild_tail==1))
  (
    if (STRING.SCAN("gcc_ce1_axi_clk", STRING.MID("&clk", 1, &clk_input_length-2), 0)!=-1)
    ( 
      &match=1
    )
  )
  else if (&wild_head==1)
  (
    if (STRING.MID("gcc_ce1_axi_clk", &clk_itr_length-&clk_input_length+1, &clk_input_length-1)==STRING.CUT("&clk", 1))
    ( 
      &match=1
    )
  )
  else if (&wild_tail==1)
  (
    if (STRING.MID("gcc_ce1_axi_clk", 0, &clk_input_length-1)==STRING.CUT("&clk", -1))
    ( 
      &match=1
    )
  )
  else if ("gcc_ce1_axi_clk"=="&clk")
  (
    &match=1
  )
  
  if (&match==1)
  (
    &clk_test=&CLK_TEST_GCC_CE1_AXI_CLK
    &clk_reg=&HWIO_GCC_CE1_AXI_CBCR_ADDR
    &clk_reg_name="GCC_CE1_AXI_CBCR"
    &clk_name="gcc_ce1_axi_clk"
    &clk_reg_cbcr_type="sm_cbc"
    &clk_vote_bit=4.
    &clk_multiplier=4.

    gosub Print_Clk_Info_Line
  )

  &match=0
  &wild_head=0
  &wild_tail=0
  &clk_input_length=STRING.LENGTH("&clk")
  &clk_itr_length=STRING.LENGTH("gcc_hmss_dvm_bus_clk")

  if (STRING.SCAN("&clk", "*", 0)==0)
  (
    &wild_head=1
  )
  if (STRING.SCAN("&clk", "*", 1)==(STRING.LENGTH("&clk")-1))
  (
    &wild_tail=1
  )

  if ((&wild_head==1)&&(&wild_tail==1))
  (
    if (STRING.SCAN("gcc_hmss_dvm_bus_clk", STRING.MID("&clk", 1, &clk_input_length-2), 0)!=-1)
    ( 
      &match=1
    )
  )
  else if (&wild_head==1)
  (
    if (STRING.MID("gcc_hmss_dvm_bus_clk", &clk_itr_length-&clk_input_length+1, &clk_input_length-1)==STRING.CUT("&clk", 1))
    ( 
      &match=1
    )
  )
  else if (&wild_tail==1)
  (
    if (STRING.MID("gcc_hmss_dvm_bus_clk", 0, &clk_input_length-1)==STRING.CUT("&clk", -1))
    ( 
      &match=1
    )
  )
  else if ("gcc_hmss_dvm_bus_clk"=="&clk")
  (
    &match=1
  )
  
  if (&match==1)
  (
    &clk_test=&CLK_TEST_GCC_HMSS_DVM_BUS_CLK
    &clk_reg=&HWIO_GCC_HMSS_DVM_BUS_CBCR_ADDR
    &clk_reg_name="GCC_HMSS_DVM_BUS_CBCR"
    &clk_name="gcc_hmss_dvm_bus_clk"
    &clk_reg_cbcr_type="sm_cbc"
    &clk_vote_bit=-1.
    &clk_multiplier=4.

    gosub Print_Clk_Info_Line
  )

  &match=0
  &wild_head=0
  &wild_tail=0
  &clk_input_length=STRING.LENGTH("&clk")
  &clk_itr_length=STRING.LENGTH("gcc_imem_axi_clk")

  if (STRING.SCAN("&clk", "*", 0)==0)
  (
    &wild_head=1
  )
  if (STRING.SCAN("&clk", "*", 1)==(STRING.LENGTH("&clk")-1))
  (
    &wild_tail=1
  )

  if ((&wild_head==1)&&(&wild_tail==1))
  (
    if (STRING.SCAN("gcc_imem_axi_clk", STRING.MID("&clk", 1, &clk_input_length-2), 0)!=-1)
    ( 
      &match=1
    )
  )
  else if (&wild_head==1)
  (
    if (STRING.MID("gcc_imem_axi_clk", &clk_itr_length-&clk_input_length+1, &clk_input_length-1)==STRING.CUT("&clk", 1))
    ( 
      &match=1
    )
  )
  else if (&wild_tail==1)
  (
    if (STRING.MID("gcc_imem_axi_clk", 0, &clk_input_length-1)==STRING.CUT("&clk", -1))
    ( 
      &match=1
    )
  )
  else if ("gcc_imem_axi_clk"=="&clk")
  (
    &match=1
  )
  
  if (&match==1)
  (
    &clk_test=&CLK_TEST_GCC_IMEM_AXI_CLK
    &clk_reg=&HWIO_GCC_IMEM_AXI_CBCR_ADDR
    &clk_reg_name="GCC_IMEM_AXI_CBCR"
    &clk_name="gcc_imem_axi_clk"
    &clk_reg_cbcr_type="sm_pscbc"
    &clk_vote_bit=24.
    &clk_multiplier=4.

    gosub Print_Clk_Info_Line
  )

  &match=0
  &wild_head=0
  &wild_tail=0
  &clk_input_length=STRING.LENGTH("&clk")
  &clk_itr_length=STRING.LENGTH("gcc_lpass_core_smmu_client_clk")

  if (STRING.SCAN("&clk", "*", 0)==0)
  (
    &wild_head=1
  )
  if (STRING.SCAN("&clk", "*", 1)==(STRING.LENGTH("&clk")-1))
  (
    &wild_tail=1
  )

  if ((&wild_head==1)&&(&wild_tail==1))
  (
    if (STRING.SCAN("gcc_lpass_core_smmu_client_clk", STRING.MID("&clk", 1, &clk_input_length-2), 0)!=-1)
    ( 
      &match=1
    )
  )
  else if (&wild_head==1)
  (
    if (STRING.MID("gcc_lpass_core_smmu_client_clk", &clk_itr_length-&clk_input_length+1, &clk_input_length-1)==STRING.CUT("&clk", 1))
    ( 
      &match=1
    )
  )
  else if (&wild_tail==1)
  (
    if (STRING.MID("gcc_lpass_core_smmu_client_clk", 0, &clk_input_length-1)==STRING.CUT("&clk", -1))
    ( 
      &match=1
    )
  )
  else if ("gcc_lpass_core_smmu_client_clk"=="&clk")
  (
    &match=1
  )
  
  if (&match==1)
  (
    &clk_test=&CLK_TEST_GCC_LPASS_CORE_SMMU_CLIENT_CLK
    &clk_reg=&HWIO_GCC_LPASS_CORE_SMMU_CLIENT_CBCR_ADDR
    &clk_reg_name="GCC_LPASS_CORE_SMMU_CLIENT_CBCR"
    &clk_name="gcc_lpass_core_smmu_client_clk"
    &clk_reg_cbcr_type="sm_cbc"
    &clk_vote_bit=-1.
    &clk_multiplier=4.

    gosub Print_Clk_Info_Line
  )

  &match=0
  &wild_head=0
  &wild_tail=0
  &clk_input_length=STRING.LENGTH("&clk")
  &clk_itr_length=STRING.LENGTH("gcc_lpass_core_smmu_client_src_clk")

  if (STRING.SCAN("&clk", "*", 0)==0)
  (
    &wild_head=1
  )
  if (STRING.SCAN("&clk", "*", 1)==(STRING.LENGTH("&clk")-1))
  (
    &wild_tail=1
  )

  if ((&wild_head==1)&&(&wild_tail==1))
  (
    if (STRING.SCAN("gcc_lpass_core_smmu_client_src_clk", STRING.MID("&clk", 1, &clk_input_length-2), 0)!=-1)
    ( 
      &match=1
    )
  )
  else if (&wild_head==1)
  (
    if (STRING.MID("gcc_lpass_core_smmu_client_src_clk", &clk_itr_length-&clk_input_length+1, &clk_input_length-1)==STRING.CUT("&clk", 1))
    ( 
      &match=1
    )
  )
  else if (&wild_tail==1)
  (
    if (STRING.MID("gcc_lpass_core_smmu_client_src_clk", 0, &clk_input_length-1)==STRING.CUT("&clk", -1))
    ( 
      &match=1
    )
  )
  else if ("gcc_lpass_core_smmu_client_src_clk"=="&clk")
  (
    &match=1
  )
  
  if (&match==1)
  (
    &clk_test=&CLK_TEST_GCC_LPASS_CORE_SMMU_CLIENT_SRC_CLK
    &clk_reg=&HWIO_GCC_LPASS_CORE_SMMU_CLIENT_SRC_CBCR_ADDR
    &clk_reg_name="GCC_LPASS_CORE_SMMU_CLIENT_SRC_CBCR"
    &clk_name="gcc_lpass_core_smmu_client_src_clk"
    &clk_reg_cbcr_type="sm_pscbc"
    &clk_vote_bit=-1.
    &clk_multiplier=4.

    gosub Print_Clk_Info_Line
  )

  &match=0
  &wild_head=0
  &wild_tail=0
  &clk_input_length=STRING.LENGTH("&clk")
  &clk_itr_length=STRING.LENGTH("gcc_lpass_sway_clk")

  if (STRING.SCAN("&clk", "*", 0)==0)
  (
    &wild_head=1
  )
  if (STRING.SCAN("&clk", "*", 1)==(STRING.LENGTH("&clk")-1))
  (
    &wild_tail=1
  )

  if ((&wild_head==1)&&(&wild_tail==1))
  (
    if (STRING.SCAN("gcc_lpass_sway_clk", STRING.MID("&clk", 1, &clk_input_length-2), 0)!=-1)
    ( 
      &match=1
    )
  )
  else if (&wild_head==1)
  (
    if (STRING.MID("gcc_lpass_sway_clk", &clk_itr_length-&clk_input_length+1, &clk_input_length-1)==STRING.CUT("&clk", 1))
    ( 
      &match=1
    )
  )
  else if (&wild_tail==1)
  (
    if (STRING.MID("gcc_lpass_sway_clk", 0, &clk_input_length-1)==STRING.CUT("&clk", -1))
    ( 
      &match=1
    )
  )
  else if ("gcc_lpass_sway_clk"=="&clk")
  (
    &match=1
  )
  
  if (&match==1)
  (
    &clk_test=&CLK_TEST_GCC_LPASS_SWAY_CLK
    &clk_reg=&HWIO_GCC_LPASS_SWAY_CBCR_ADDR
    &clk_reg_name="GCC_LPASS_SWAY_CBCR"
    &clk_name="gcc_lpass_sway_clk"
    &clk_reg_cbcr_type="sm_cbc"
    &clk_vote_bit=-1.
    &clk_multiplier=4.

    gosub Print_Clk_Info_Line
  )

  &match=0
  &wild_head=0
  &wild_tail=0
  &clk_input_length=STRING.LENGTH("&clk")
  &clk_itr_length=STRING.LENGTH("gcc_mmss_sys_noc_axi_clk")

  if (STRING.SCAN("&clk", "*", 0)==0)
  (
    &wild_head=1
  )
  if (STRING.SCAN("&clk", "*", 1)==(STRING.LENGTH("&clk")-1))
  (
    &wild_tail=1
  )

  if ((&wild_head==1)&&(&wild_tail==1))
  (
    if (STRING.SCAN("gcc_mmss_sys_noc_axi_clk", STRING.MID("&clk", 1, &clk_input_length-2), 0)!=-1)
    ( 
      &match=1
    )
  )
  else if (&wild_head==1)
  (
    if (STRING.MID("gcc_mmss_sys_noc_axi_clk", &clk_itr_length-&clk_input_length+1, &clk_input_length-1)==STRING.CUT("&clk", 1))
    ( 
      &match=1
    )
  )
  else if (&wild_tail==1)
  (
    if (STRING.MID("gcc_mmss_sys_noc_axi_clk", 0, &clk_input_length-1)==STRING.CUT("&clk", -1))
    ( 
      &match=1
    )
  )
  else if ("gcc_mmss_sys_noc_axi_clk"=="&clk")
  (
    &match=1
  )
  
  if (&match==1)
  (
    &clk_test=&CLK_TEST_GCC_MMSS_SYS_NOC_AXI_CLK
    &clk_reg=&HWIO_GCC_MMSS_SYS_NOC_AXI_CBCR_ADDR
    &clk_reg_name="GCC_MMSS_SYS_NOC_AXI_CBCR"
    &clk_name="gcc_mmss_sys_noc_axi_clk"
    &clk_reg_cbcr_type="sm_cbc"
    &clk_vote_bit=-1.
    &clk_multiplier=4.

    gosub Print_Clk_Info_Line
  )

  &match=0
  &wild_head=0
  &wild_tail=0
  &clk_input_length=STRING.LENGTH("&clk")
  &clk_itr_length=STRING.LENGTH("gcc_mss_snoc_axi_clk")

  if (STRING.SCAN("&clk", "*", 0)==0)
  (
    &wild_head=1
  )
  if (STRING.SCAN("&clk", "*", 1)==(STRING.LENGTH("&clk")-1))
  (
    &wild_tail=1
  )

  if ((&wild_head==1)&&(&wild_tail==1))
  (
    if (STRING.SCAN("gcc_mss_snoc_axi_clk", STRING.MID("&clk", 1, &clk_input_length-2), 0)!=-1)
    ( 
      &match=1
    )
  )
  else if (&wild_head==1)
  (
    if (STRING.MID("gcc_mss_snoc_axi_clk", &clk_itr_length-&clk_input_length+1, &clk_input_length-1)==STRING.CUT("&clk", 1))
    ( 
      &match=1
    )
  )
  else if (&wild_tail==1)
  (
    if (STRING.MID("gcc_mss_snoc_axi_clk", 0, &clk_input_length-1)==STRING.CUT("&clk", -1))
    ( 
      &match=1
    )
  )
  else if ("gcc_mss_snoc_axi_clk"=="&clk")
  (
    &match=1
  )
  
  if (&match==1)
  (
    &clk_test=&CLK_TEST_GCC_MSS_SNOC_AXI_CLK
    &clk_reg=&HWIO_GCC_MSS_SNOC_AXI_CBCR_ADDR
    &clk_reg_name="GCC_MSS_SNOC_AXI_CBCR"
    &clk_name="gcc_mss_snoc_axi_clk"
    &clk_reg_cbcr_type="sm_cbc"
    &clk_vote_bit=-1.
    &clk_multiplier=4.

    gosub Print_Clk_Info_Line
  )

  &match=0
  &wild_head=0
  &wild_tail=0
  &clk_input_length=STRING.LENGTH("&clk")
  &clk_itr_length=STRING.LENGTH("gcc_pcie_0_mstr_axi_clk")

  if (STRING.SCAN("&clk", "*", 0)==0)
  (
    &wild_head=1
  )
  if (STRING.SCAN("&clk", "*", 1)==(STRING.LENGTH("&clk")-1))
  (
    &wild_tail=1
  )

  if ((&wild_head==1)&&(&wild_tail==1))
  (
    if (STRING.SCAN("gcc_pcie_0_mstr_axi_clk", STRING.MID("&clk", 1, &clk_input_length-2), 0)!=-1)
    ( 
      &match=1
    )
  )
  else if (&wild_head==1)
  (
    if (STRING.MID("gcc_pcie_0_mstr_axi_clk", &clk_itr_length-&clk_input_length+1, &clk_input_length-1)==STRING.CUT("&clk", 1))
    ( 
      &match=1
    )
  )
  else if (&wild_tail==1)
  (
    if (STRING.MID("gcc_pcie_0_mstr_axi_clk", 0, &clk_input_length-1)==STRING.CUT("&clk", -1))
    ( 
      &match=1
    )
  )
  else if ("gcc_pcie_0_mstr_axi_clk"=="&clk")
  (
    &match=1
  )
  
  if (&match==1)
  (
    &clk_test=&CLK_TEST_GCC_PCIE_0_MSTR_AXI_CLK
    &clk_reg=&HWIO_GCC_PCIE_0_MSTR_AXI_CBCR_ADDR
    &clk_reg_name="GCC_PCIE_0_MSTR_AXI_CBCR"
    &clk_name="gcc_pcie_0_mstr_axi_clk"
    &clk_reg_cbcr_type="sm_pscbc"
    &clk_vote_bit=-1.
    &clk_multiplier=4.

    gosub Print_Clk_Info_Line
  )

  &match=0
  &wild_head=0
  &wild_tail=0
  &clk_input_length=STRING.LENGTH("&clk")
  &clk_itr_length=STRING.LENGTH("gcc_pcie_0_slv_axi_clk")

  if (STRING.SCAN("&clk", "*", 0)==0)
  (
    &wild_head=1
  )
  if (STRING.SCAN("&clk", "*", 1)==(STRING.LENGTH("&clk")-1))
  (
    &wild_tail=1
  )

  if ((&wild_head==1)&&(&wild_tail==1))
  (
    if (STRING.SCAN("gcc_pcie_0_slv_axi_clk", STRING.MID("&clk", 1, &clk_input_length-2), 0)!=-1)
    ( 
      &match=1
    )
  )
  else if (&wild_head==1)
  (
    if (STRING.MID("gcc_pcie_0_slv_axi_clk", &clk_itr_length-&clk_input_length+1, &clk_input_length-1)==STRING.CUT("&clk", 1))
    ( 
      &match=1
    )
  )
  else if (&wild_tail==1)
  (
    if (STRING.MID("gcc_pcie_0_slv_axi_clk", 0, &clk_input_length-1)==STRING.CUT("&clk", -1))
    ( 
      &match=1
    )
  )
  else if ("gcc_pcie_0_slv_axi_clk"=="&clk")
  (
    &match=1
  )
  
  if (&match==1)
  (
    &clk_test=&CLK_TEST_GCC_PCIE_0_SLV_AXI_CLK
    &clk_reg=&HWIO_GCC_PCIE_0_SLV_AXI_CBCR_ADDR
    &clk_reg_name="GCC_PCIE_0_SLV_AXI_CBCR"
    &clk_name="gcc_pcie_0_slv_axi_clk"
    &clk_reg_cbcr_type="sm_pscbc"
    &clk_vote_bit=-1.
    &clk_multiplier=4.

    gosub Print_Clk_Info_Line
  )

  &match=0
  &wild_head=0
  &wild_tail=0
  &clk_input_length=STRING.LENGTH("&clk")
  &clk_itr_length=STRING.LENGTH("gcc_qdss_etr_usb_clk")

  if (STRING.SCAN("&clk", "*", 0)==0)
  (
    &wild_head=1
  )
  if (STRING.SCAN("&clk", "*", 1)==(STRING.LENGTH("&clk")-1))
  (
    &wild_tail=1
  )

  if ((&wild_head==1)&&(&wild_tail==1))
  (
    if (STRING.SCAN("gcc_qdss_etr_usb_clk", STRING.MID("&clk", 1, &clk_input_length-2), 0)!=-1)
    ( 
      &match=1
    )
  )
  else if (&wild_head==1)
  (
    if (STRING.MID("gcc_qdss_etr_usb_clk", &clk_itr_length-&clk_input_length+1, &clk_input_length-1)==STRING.CUT("&clk", 1))
    ( 
      &match=1
    )
  )
  else if (&wild_tail==1)
  (
    if (STRING.MID("gcc_qdss_etr_usb_clk", 0, &clk_input_length-1)==STRING.CUT("&clk", -1))
    ( 
      &match=1
    )
  )
  else if ("gcc_qdss_etr_usb_clk"=="&clk")
  (
    &match=1
  )
  
  if (&match==1)
  (
    &clk_test=&CLK_TEST_GCC_QDSS_ETR_USB_CLK
    &clk_reg=&HWIO_GCC_QDSS_ETR_USB_CBCR_ADDR
    &clk_reg_name="GCC_QDSS_ETR_USB_CBCR"
    &clk_name="gcc_qdss_etr_usb_clk"
    &clk_reg_cbcr_type="sm_cbc"
    &clk_vote_bit=-1.
    &clk_multiplier=4.

    gosub Print_Clk_Info_Line
  )

  &match=0
  &wild_head=0
  &wild_tail=0
  &clk_input_length=STRING.LENGTH("&clk")
  &clk_itr_length=STRING.LENGTH("gcc_smmu_aggre1_axi_clk")

  if (STRING.SCAN("&clk", "*", 0)==0)
  (
    &wild_head=1
  )
  if (STRING.SCAN("&clk", "*", 1)==(STRING.LENGTH("&clk")-1))
  (
    &wild_tail=1
  )

  if ((&wild_head==1)&&(&wild_tail==1))
  (
    if (STRING.SCAN("gcc_smmu_aggre1_axi_clk", STRING.MID("&clk", 1, &clk_input_length-2), 0)!=-1)
    ( 
      &match=1
    )
  )
  else if (&wild_head==1)
  (
    if (STRING.MID("gcc_smmu_aggre1_axi_clk", &clk_itr_length-&clk_input_length+1, &clk_input_length-1)==STRING.CUT("&clk", 1))
    ( 
      &match=1
    )
  )
  else if (&wild_tail==1)
  (
    if (STRING.MID("gcc_smmu_aggre1_axi_clk", 0, &clk_input_length-1)==STRING.CUT("&clk", -1))
    ( 
      &match=1
    )
  )
  else if ("gcc_smmu_aggre1_axi_clk"=="&clk")
  (
    &match=1
  )
  
  if (&match==1)
  (
    &clk_test=&CLK_TEST_GCC_SMMU_AGGRE1_AXI_CLK
    &clk_reg=&HWIO_GCC_SMMU_AGGRE1_AXI_CBCR_ADDR
    &clk_reg_name="GCC_SMMU_AGGRE1_AXI_CBCR"
    &clk_name="gcc_smmu_aggre1_axi_clk"
    &clk_reg_cbcr_type="sm_cbc"
    &clk_vote_bit=-1.
    &clk_multiplier=4.

    gosub Print_Clk_Info_Line
  )

  &match=0
  &wild_head=0
  &wild_tail=0
  &clk_input_length=STRING.LENGTH("&clk")
  &clk_itr_length=STRING.LENGTH("gcc_smmu_aggre1_axi_src_clk")

  if (STRING.SCAN("&clk", "*", 0)==0)
  (
    &wild_head=1
  )
  if (STRING.SCAN("&clk", "*", 1)==(STRING.LENGTH("&clk")-1))
  (
    &wild_tail=1
  )

  if ((&wild_head==1)&&(&wild_tail==1))
  (
    if (STRING.SCAN("gcc_smmu_aggre1_axi_src_clk", STRING.MID("&clk", 1, &clk_input_length-2), 0)!=-1)
    ( 
      &match=1
    )
  )
  else if (&wild_head==1)
  (
    if (STRING.MID("gcc_smmu_aggre1_axi_src_clk", &clk_itr_length-&clk_input_length+1, &clk_input_length-1)==STRING.CUT("&clk", 1))
    ( 
      &match=1
    )
  )
  else if (&wild_tail==1)
  (
    if (STRING.MID("gcc_smmu_aggre1_axi_src_clk", 0, &clk_input_length-1)==STRING.CUT("&clk", -1))
    ( 
      &match=1
    )
  )
  else if ("gcc_smmu_aggre1_axi_src_clk"=="&clk")
  (
    &match=1
  )
  
  if (&match==1)
  (
    &clk_test=&CLK_TEST_GCC_SMMU_AGGRE1_AXI_SRC_CLK
    &clk_reg=&HWIO_GCC_SMMU_AGGRE1_AXI_SRC_CBCR_ADDR
    &clk_reg_name="GCC_SMMU_AGGRE1_AXI_SRC_CBCR"
    &clk_name="gcc_smmu_aggre1_axi_src_clk"
    &clk_reg_cbcr_type="sm_pscbc"
    &clk_vote_bit=-1.
    &clk_multiplier=4.

    gosub Print_Clk_Info_Line
  )

  &match=0
  &wild_head=0
  &wild_tail=0
  &clk_input_length=STRING.LENGTH("&clk")
  &clk_itr_length=STRING.LENGTH("gcc_smmu_aggre2_axi_clk")

  if (STRING.SCAN("&clk", "*", 0)==0)
  (
    &wild_head=1
  )
  if (STRING.SCAN("&clk", "*", 1)==(STRING.LENGTH("&clk")-1))
  (
    &wild_tail=1
  )

  if ((&wild_head==1)&&(&wild_tail==1))
  (
    if (STRING.SCAN("gcc_smmu_aggre2_axi_clk", STRING.MID("&clk", 1, &clk_input_length-2), 0)!=-1)
    ( 
      &match=1
    )
  )
  else if (&wild_head==1)
  (
    if (STRING.MID("gcc_smmu_aggre2_axi_clk", &clk_itr_length-&clk_input_length+1, &clk_input_length-1)==STRING.CUT("&clk", 1))
    ( 
      &match=1
    )
  )
  else if (&wild_tail==1)
  (
    if (STRING.MID("gcc_smmu_aggre2_axi_clk", 0, &clk_input_length-1)==STRING.CUT("&clk", -1))
    ( 
      &match=1
    )
  )
  else if ("gcc_smmu_aggre2_axi_clk"=="&clk")
  (
    &match=1
  )
  
  if (&match==1)
  (
    &clk_test=&CLK_TEST_GCC_SMMU_AGGRE2_AXI_CLK
    &clk_reg=&HWIO_GCC_SMMU_AGGRE2_AXI_CBCR_ADDR
    &clk_reg_name="GCC_SMMU_AGGRE2_AXI_CBCR"
    &clk_name="gcc_smmu_aggre2_axi_clk"
    &clk_reg_cbcr_type="sm_cbc"
    &clk_vote_bit=-1.
    &clk_multiplier=4.

    gosub Print_Clk_Info_Line
  )

  &match=0
  &wild_head=0
  &wild_tail=0
  &clk_input_length=STRING.LENGTH("&clk")
  &clk_itr_length=STRING.LENGTH("gcc_smmu_aggre2_axi_src_clk")

  if (STRING.SCAN("&clk", "*", 0)==0)
  (
    &wild_head=1
  )
  if (STRING.SCAN("&clk", "*", 1)==(STRING.LENGTH("&clk")-1))
  (
    &wild_tail=1
  )

  if ((&wild_head==1)&&(&wild_tail==1))
  (
    if (STRING.SCAN("gcc_smmu_aggre2_axi_src_clk", STRING.MID("&clk", 1, &clk_input_length-2), 0)!=-1)
    ( 
      &match=1
    )
  )
  else if (&wild_head==1)
  (
    if (STRING.MID("gcc_smmu_aggre2_axi_src_clk", &clk_itr_length-&clk_input_length+1, &clk_input_length-1)==STRING.CUT("&clk", 1))
    ( 
      &match=1
    )
  )
  else if (&wild_tail==1)
  (
    if (STRING.MID("gcc_smmu_aggre2_axi_src_clk", 0, &clk_input_length-1)==STRING.CUT("&clk", -1))
    ( 
      &match=1
    )
  )
  else if ("gcc_smmu_aggre2_axi_src_clk"=="&clk")
  (
    &match=1
  )
  
  if (&match==1)
  (
    &clk_test=&CLK_TEST_GCC_SMMU_AGGRE2_AXI_SRC_CLK
    &clk_reg=&HWIO_GCC_SMMU_AGGRE2_AXI_SRC_CBCR_ADDR
    &clk_reg_name="GCC_SMMU_AGGRE2_AXI_SRC_CBCR"
    &clk_name="gcc_smmu_aggre2_axi_src_clk"
    &clk_reg_cbcr_type="sm_pscbc"
    &clk_vote_bit=-1.
    &clk_multiplier=4.

    gosub Print_Clk_Info_Line
  )

  &match=0
  &wild_head=0
  &wild_tail=0
  &clk_input_length=STRING.LENGTH("&clk")
  &clk_itr_length=STRING.LENGTH("gcc_snoc_bus_timeout1_ahb_clk")

  if (STRING.SCAN("&clk", "*", 0)==0)
  (
    &wild_head=1
  )
  if (STRING.SCAN("&clk", "*", 1)==(STRING.LENGTH("&clk")-1))
  (
    &wild_tail=1
  )

  if ((&wild_head==1)&&(&wild_tail==1))
  (
    if (STRING.SCAN("gcc_snoc_bus_timeout1_ahb_clk", STRING.MID("&clk", 1, &clk_input_length-2), 0)!=-1)
    ( 
      &match=1
    )
  )
  else if (&wild_head==1)
  (
    if (STRING.MID("gcc_snoc_bus_timeout1_ahb_clk", &clk_itr_length-&clk_input_length+1, &clk_input_length-1)==STRING.CUT("&clk", 1))
    ( 
      &match=1
    )
  )
  else if (&wild_tail==1)
  (
    if (STRING.MID("gcc_snoc_bus_timeout1_ahb_clk", 0, &clk_input_length-1)==STRING.CUT("&clk", -1))
    ( 
      &match=1
    )
  )
  else if ("gcc_snoc_bus_timeout1_ahb_clk"=="&clk")
  (
    &match=1
  )
  
  if (&match==1)
  (
    &clk_test=&CLK_TEST_GCC_SNOC_BUS_TIMEOUT1_AHB_CLK
    &clk_reg=&HWIO_GCC_SNOC_BUS_TIMEOUT1_AHB_CBCR_ADDR
    &clk_reg_name="GCC_SNOC_BUS_TIMEOUT1_AHB_CBCR"
    &clk_name="gcc_snoc_bus_timeout1_ahb_clk"
    &clk_reg_cbcr_type="sm_cbc"
    &clk_vote_bit=-1.
    &clk_multiplier=4.

    gosub Print_Clk_Info_Line
  )

  &match=0
  &wild_head=0
  &wild_tail=0
  &clk_input_length=STRING.LENGTH("&clk")
  &clk_itr_length=STRING.LENGTH("gcc_snoc_bus_timeout3_ahb_clk")

  if (STRING.SCAN("&clk", "*", 0)==0)
  (
    &wild_head=1
  )
  if (STRING.SCAN("&clk", "*", 1)==(STRING.LENGTH("&clk")-1))
  (
    &wild_tail=1
  )

  if ((&wild_head==1)&&(&wild_tail==1))
  (
    if (STRING.SCAN("gcc_snoc_bus_timeout3_ahb_clk", STRING.MID("&clk", 1, &clk_input_length-2), 0)!=-1)
    ( 
      &match=1
    )
  )
  else if (&wild_head==1)
  (
    if (STRING.MID("gcc_snoc_bus_timeout3_ahb_clk", &clk_itr_length-&clk_input_length+1, &clk_input_length-1)==STRING.CUT("&clk", 1))
    ( 
      &match=1
    )
  )
  else if (&wild_tail==1)
  (
    if (STRING.MID("gcc_snoc_bus_timeout3_ahb_clk", 0, &clk_input_length-1)==STRING.CUT("&clk", -1))
    ( 
      &match=1
    )
  )
  else if ("gcc_snoc_bus_timeout3_ahb_clk"=="&clk")
  (
    &match=1
  )
  
  if (&match==1)
  (
    &clk_test=&CLK_TEST_GCC_SNOC_BUS_TIMEOUT3_AHB_CLK
    &clk_reg=&HWIO_GCC_SNOC_BUS_TIMEOUT3_AHB_CBCR_ADDR
    &clk_reg_name="GCC_SNOC_BUS_TIMEOUT3_AHB_CBCR"
    &clk_name="gcc_snoc_bus_timeout3_ahb_clk"
    &clk_reg_cbcr_type="sm_cbc"
    &clk_vote_bit=-1.
    &clk_multiplier=4.

    gosub Print_Clk_Info_Line
  )

  &match=0
  &wild_head=0
  &wild_tail=0
  &clk_input_length=STRING.LENGTH("&clk")
  &clk_itr_length=STRING.LENGTH("gcc_spdm_snoc_cy_clk")

  if (STRING.SCAN("&clk", "*", 0)==0)
  (
    &wild_head=1
  )
  if (STRING.SCAN("&clk", "*", 1)==(STRING.LENGTH("&clk")-1))
  (
    &wild_tail=1
  )

  if ((&wild_head==1)&&(&wild_tail==1))
  (
    if (STRING.SCAN("gcc_spdm_snoc_cy_clk", STRING.MID("&clk", 1, &clk_input_length-2), 0)!=-1)
    ( 
      &match=1
    )
  )
  else if (&wild_head==1)
  (
    if (STRING.MID("gcc_spdm_snoc_cy_clk", &clk_itr_length-&clk_input_length+1, &clk_input_length-1)==STRING.CUT("&clk", 1))
    ( 
      &match=1
    )
  )
  else if (&wild_tail==1)
  (
    if (STRING.MID("gcc_spdm_snoc_cy_clk", 0, &clk_input_length-1)==STRING.CUT("&clk", -1))
    ( 
      &match=1
    )
  )
  else if ("gcc_spdm_snoc_cy_clk"=="&clk")
  (
    &match=1
  )
  
  if (&match==1)
  (
    &clk_test=&CLK_TEST_GCC_SPDM_SNOC_CY_CLK
    &clk_reg=&HWIO_GCC_SPDM_SNOC_CY_CBCR_ADDR
    &clk_reg_name="GCC_SPDM_SNOC_CY_CBCR"
    &clk_name="gcc_spdm_snoc_cy_clk"
    &clk_reg_cbcr_type="sm_cbc"
    &clk_vote_bit=-1.
    &clk_multiplier=4.

    gosub Print_Clk_Info_Line
  )

  &match=0
  &wild_head=0
  &wild_tail=0
  &clk_input_length=STRING.LENGTH("&clk")
  &clk_itr_length=STRING.LENGTH("gcc_spss_snoc_emm_clk")

  if (STRING.SCAN("&clk", "*", 0)==0)
  (
    &wild_head=1
  )
  if (STRING.SCAN("&clk", "*", 1)==(STRING.LENGTH("&clk")-1))
  (
    &wild_tail=1
  )

  if ((&wild_head==1)&&(&wild_tail==1))
  (
    if (STRING.SCAN("gcc_spss_snoc_emm_clk", STRING.MID("&clk", 1, &clk_input_length-2), 0)!=-1)
    ( 
      &match=1
    )
  )
  else if (&wild_head==1)
  (
    if (STRING.MID("gcc_spss_snoc_emm_clk", &clk_itr_length-&clk_input_length+1, &clk_input_length-1)==STRING.CUT("&clk", 1))
    ( 
      &match=1
    )
  )
  else if (&wild_tail==1)
  (
    if (STRING.MID("gcc_spss_snoc_emm_clk", 0, &clk_input_length-1)==STRING.CUT("&clk", -1))
    ( 
      &match=1
    )
  )
  else if ("gcc_spss_snoc_emm_clk"=="&clk")
  (
    &match=1
  )
  
  if (&match==1)
  (
    &clk_test=&CLK_TEST_GCC_SPSS_SNOC_EMM_CLK
    &clk_reg=&HWIO_GCC_SPSS_SNOC_EMM_CBCR_ADDR
    &clk_reg_name="GCC_SPSS_SNOC_EMM_CBCR"
    &clk_name="gcc_spss_snoc_emm_clk"
    &clk_reg_cbcr_type="sm_cbc"
    &clk_vote_bit=-1.
    &clk_multiplier=4.

    gosub Print_Clk_Info_Line
  )

  &match=0
  &wild_head=0
  &wild_tail=0
  &clk_input_length=STRING.LENGTH("&clk")
  &clk_itr_length=STRING.LENGTH("gcc_ssc_snoc_ahbm_clk")

  if (STRING.SCAN("&clk", "*", 0)==0)
  (
    &wild_head=1
  )
  if (STRING.SCAN("&clk", "*", 1)==(STRING.LENGTH("&clk")-1))
  (
    &wild_tail=1
  )

  if ((&wild_head==1)&&(&wild_tail==1))
  (
    if (STRING.SCAN("gcc_ssc_snoc_ahbm_clk", STRING.MID("&clk", 1, &clk_input_length-2), 0)!=-1)
    ( 
      &match=1
    )
  )
  else if (&wild_head==1)
  (
    if (STRING.MID("gcc_ssc_snoc_ahbm_clk", &clk_itr_length-&clk_input_length+1, &clk_input_length-1)==STRING.CUT("&clk", 1))
    ( 
      &match=1
    )
  )
  else if (&wild_tail==1)
  (
    if (STRING.MID("gcc_ssc_snoc_ahbm_clk", 0, &clk_input_length-1)==STRING.CUT("&clk", -1))
    ( 
      &match=1
    )
  )
  else if ("gcc_ssc_snoc_ahbm_clk"=="&clk")
  (
    &match=1
  )
  
  if (&match==1)
  (
    &clk_test=&CLK_TEST_GCC_SSC_SNOC_AHBM_CLK
    &clk_reg=&HWIO_GCC_SSC_SNOC_AHBM_CBCR_ADDR
    &clk_reg_name="GCC_SSC_SNOC_AHBM_CBCR"
    &clk_name="gcc_ssc_snoc_ahbm_clk"
    &clk_reg_cbcr_type="sm_cbc"
    &clk_vote_bit=-1.
    &clk_multiplier=4.

    gosub Print_Clk_Info_Line
  )

  &match=0
  &wild_head=0
  &wild_tail=0
  &clk_input_length=STRING.LENGTH("&clk")
  &clk_itr_length=STRING.LENGTH("gcc_sys_noc_axi_clk")

  if (STRING.SCAN("&clk", "*", 0)==0)
  (
    &wild_head=1
  )
  if (STRING.SCAN("&clk", "*", 1)==(STRING.LENGTH("&clk")-1))
  (
    &wild_tail=1
  )

  if ((&wild_head==1)&&(&wild_tail==1))
  (
    if (STRING.SCAN("gcc_sys_noc_axi_clk", STRING.MID("&clk", 1, &clk_input_length-2), 0)!=-1)
    ( 
      &match=1
    )
  )
  else if (&wild_head==1)
  (
    if (STRING.MID("gcc_sys_noc_axi_clk", &clk_itr_length-&clk_input_length+1, &clk_input_length-1)==STRING.CUT("&clk", 1))
    ( 
      &match=1
    )
  )
  else if (&wild_tail==1)
  (
    if (STRING.MID("gcc_sys_noc_axi_clk", 0, &clk_input_length-1)==STRING.CUT("&clk", -1))
    ( 
      &match=1
    )
  )
  else if ("gcc_sys_noc_axi_clk"=="&clk")
  (
    &match=1
  )
  
  if (&match==1)
  (
    &clk_test=&CLK_TEST_GCC_SYS_NOC_AXI_CLK
    &clk_reg=&HWIO_GCC_SYS_NOC_AXI_CBCR_ADDR
    &clk_reg_name="GCC_SYS_NOC_AXI_CBCR"
    &clk_name="gcc_sys_noc_axi_clk"
    &clk_reg_cbcr_type="sm_cbc"
    &clk_vote_bit=-1.
    &clk_multiplier=4.

    gosub Print_Clk_Info_Line
  )

  &match=0
  &wild_head=0
  &wild_tail=0
  &clk_input_length=STRING.LENGTH("&clk")
  &clk_itr_length=STRING.LENGTH("gcc_sys_noc_east_axi_clk")

  if (STRING.SCAN("&clk", "*", 0)==0)
  (
    &wild_head=1
  )
  if (STRING.SCAN("&clk", "*", 1)==(STRING.LENGTH("&clk")-1))
  (
    &wild_tail=1
  )

  if ((&wild_head==1)&&(&wild_tail==1))
  (
    if (STRING.SCAN("gcc_sys_noc_east_axi_clk", STRING.MID("&clk", 1, &clk_input_length-2), 0)!=-1)
    ( 
      &match=1
    )
  )
  else if (&wild_head==1)
  (
    if (STRING.MID("gcc_sys_noc_east_axi_clk", &clk_itr_length-&clk_input_length+1, &clk_input_length-1)==STRING.CUT("&clk", 1))
    ( 
      &match=1
    )
  )
  else if (&wild_tail==1)
  (
    if (STRING.MID("gcc_sys_noc_east_axi_clk", 0, &clk_input_length-1)==STRING.CUT("&clk", -1))
    ( 
      &match=1
    )
  )
  else if ("gcc_sys_noc_east_axi_clk"=="&clk")
  (
    &match=1
  )
  
  if (&match==1)
  (
    &clk_test=&CLK_TEST_GCC_SYS_NOC_EAST_AXI_CLK
    &clk_reg=&HWIO_GCC_SYS_NOC_EAST_AXI_CBCR_ADDR
    &clk_reg_name="GCC_SYS_NOC_EAST_AXI_CBCR"
    &clk_name="gcc_sys_noc_east_axi_clk"
    &clk_reg_cbcr_type="sm_cbc"
    &clk_vote_bit=-1.
    &clk_multiplier=4.

    gosub Print_Clk_Info_Line
  )

  &match=0
  &wild_head=0
  &wild_tail=0
  &clk_input_length=STRING.LENGTH("&clk")
  &clk_itr_length=STRING.LENGTH("gcc_sys_noc_ssc_q6_axi_clk")

  if (STRING.SCAN("&clk", "*", 0)==0)
  (
    &wild_head=1
  )
  if (STRING.SCAN("&clk", "*", 1)==(STRING.LENGTH("&clk")-1))
  (
    &wild_tail=1
  )

  if ((&wild_head==1)&&(&wild_tail==1))
  (
    if (STRING.SCAN("gcc_sys_noc_ssc_q6_axi_clk", STRING.MID("&clk", 1, &clk_input_length-2), 0)!=-1)
    ( 
      &match=1
    )
  )
  else if (&wild_head==1)
  (
    if (STRING.MID("gcc_sys_noc_ssc_q6_axi_clk", &clk_itr_length-&clk_input_length+1, &clk_input_length-1)==STRING.CUT("&clk", 1))
    ( 
      &match=1
    )
  )
  else if (&wild_tail==1)
  (
    if (STRING.MID("gcc_sys_noc_ssc_q6_axi_clk", 0, &clk_input_length-1)==STRING.CUT("&clk", -1))
    ( 
      &match=1
    )
  )
  else if ("gcc_sys_noc_ssc_q6_axi_clk"=="&clk")
  (
    &match=1
  )
  
  if (&match==1)
  (
    &clk_test=&CLK_TEST_GCC_SYS_NOC_SSC_Q6_AXI_CLK
    &clk_reg=&HWIO_GCC_SYS_NOC_SSC_Q6_AXI_CBCR_ADDR
    &clk_reg_name="GCC_SYS_NOC_SSC_Q6_AXI_CBCR"
    &clk_name="gcc_sys_noc_ssc_q6_axi_clk"
    &clk_reg_cbcr_type="sm_pscbc"
    &clk_vote_bit=-1.
    &clk_multiplier=4.

    gosub Print_Clk_Info_Line
  )

  &match=0
  &wild_head=0
  &wild_tail=0
  &clk_input_length=STRING.LENGTH("&clk")
  &clk_itr_length=STRING.LENGTH("gcc_sys_noc_west_axi_clk")

  if (STRING.SCAN("&clk", "*", 0)==0)
  (
    &wild_head=1
  )
  if (STRING.SCAN("&clk", "*", 1)==(STRING.LENGTH("&clk")-1))
  (
    &wild_tail=1
  )

  if ((&wild_head==1)&&(&wild_tail==1))
  (
    if (STRING.SCAN("gcc_sys_noc_west_axi_clk", STRING.MID("&clk", 1, &clk_input_length-2), 0)!=-1)
    ( 
      &match=1
    )
  )
  else if (&wild_head==1)
  (
    if (STRING.MID("gcc_sys_noc_west_axi_clk", &clk_itr_length-&clk_input_length+1, &clk_input_length-1)==STRING.CUT("&clk", 1))
    ( 
      &match=1
    )
  )
  else if (&wild_tail==1)
  (
    if (STRING.MID("gcc_sys_noc_west_axi_clk", 0, &clk_input_length-1)==STRING.CUT("&clk", -1))
    ( 
      &match=1
    )
  )
  else if ("gcc_sys_noc_west_axi_clk"=="&clk")
  (
    &match=1
  )
  
  if (&match==1)
  (
    &clk_test=&CLK_TEST_GCC_SYS_NOC_WEST_AXI_CLK
    &clk_reg=&HWIO_GCC_SYS_NOC_WEST_AXI_CBCR_ADDR
    &clk_reg_name="GCC_SYS_NOC_WEST_AXI_CBCR"
    &clk_name="gcc_sys_noc_west_axi_clk"
    &clk_reg_cbcr_type="sm_cbc"
    &clk_vote_bit=-1.
    &clk_multiplier=4.

    gosub Print_Clk_Info_Line
  )

  &match=0
  &wild_head=0
  &wild_tail=0
  &clk_input_length=STRING.LENGTH("&clk")
  &clk_itr_length=STRING.LENGTH("gcc_wcss_ahb_s0_clk")

  if (STRING.SCAN("&clk", "*", 0)==0)
  (
    &wild_head=1
  )
  if (STRING.SCAN("&clk", "*", 1)==(STRING.LENGTH("&clk")-1))
  (
    &wild_tail=1
  )

  if ((&wild_head==1)&&(&wild_tail==1))
  (
    if (STRING.SCAN("gcc_wcss_ahb_s0_clk", STRING.MID("&clk", 1, &clk_input_length-2), 0)!=-1)
    ( 
      &match=1
    )
  )
  else if (&wild_head==1)
  (
    if (STRING.MID("gcc_wcss_ahb_s0_clk", &clk_itr_length-&clk_input_length+1, &clk_input_length-1)==STRING.CUT("&clk", 1))
    ( 
      &match=1
    )
  )
  else if (&wild_tail==1)
  (
    if (STRING.MID("gcc_wcss_ahb_s0_clk", 0, &clk_input_length-1)==STRING.CUT("&clk", -1))
    ( 
      &match=1
    )
  )
  else if ("gcc_wcss_ahb_s0_clk"=="&clk")
  (
    &match=1
  )
  
  if (&match==1)
  (
    &clk_test=&CLK_TEST_GCC_WCSS_AHB_S0_CLK
    &clk_reg=&HWIO_GCC_WCSS_AHB_S0_CBCR_ADDR
    &clk_reg_name="GCC_WCSS_AHB_S0_CBCR"
    &clk_name="gcc_wcss_ahb_s0_clk"
    &clk_reg_cbcr_type="sm_cbc"
    &clk_vote_bit=-1.
    &clk_multiplier=4.

    gosub Print_Clk_Info_Line
  )

  &match=0
  &wild_head=0
  &wild_tail=0
  &clk_input_length=STRING.LENGTH("&clk")
  &clk_itr_length=STRING.LENGTH("gcc_wcss_axi_m_clk")

  if (STRING.SCAN("&clk", "*", 0)==0)
  (
    &wild_head=1
  )
  if (STRING.SCAN("&clk", "*", 1)==(STRING.LENGTH("&clk")-1))
  (
    &wild_tail=1
  )

  if ((&wild_head==1)&&(&wild_tail==1))
  (
    if (STRING.SCAN("gcc_wcss_axi_m_clk", STRING.MID("&clk", 1, &clk_input_length-2), 0)!=-1)
    ( 
      &match=1
    )
  )
  else if (&wild_head==1)
  (
    if (STRING.MID("gcc_wcss_axi_m_clk", &clk_itr_length-&clk_input_length+1, &clk_input_length-1)==STRING.CUT("&clk", 1))
    ( 
      &match=1
    )
  )
  else if (&wild_tail==1)
  (
    if (STRING.MID("gcc_wcss_axi_m_clk", 0, &clk_input_length-1)==STRING.CUT("&clk", -1))
    ( 
      &match=1
    )
  )
  else if ("gcc_wcss_axi_m_clk"=="&clk")
  (
    &match=1
  )
  
  if (&match==1)
  (
    &clk_test=&CLK_TEST_GCC_WCSS_AXI_M_CLK
    &clk_reg=&HWIO_GCC_WCSS_AXI_M_CBCR_ADDR
    &clk_reg_name="GCC_WCSS_AXI_M_CBCR"
    &clk_name="gcc_wcss_axi_m_clk"
    &clk_reg_cbcr_type="sm_cbc"
    &clk_vote_bit=-1.
    &clk_multiplier=4.

    gosub Print_Clk_Info_Line
  )

  &match=0
  &wild_head=0
  &wild_tail=0
  &clk_input_length=STRING.LENGTH("&clk")
  &clk_itr_length=STRING.LENGTH("gcc_wcss_ecahb_clk")

  if (STRING.SCAN("&clk", "*", 0)==0)
  (
    &wild_head=1
  )
  if (STRING.SCAN("&clk", "*", 1)==(STRING.LENGTH("&clk")-1))
  (
    &wild_tail=1
  )

  if ((&wild_head==1)&&(&wild_tail==1))
  (
    if (STRING.SCAN("gcc_wcss_ecahb_clk", STRING.MID("&clk", 1, &clk_input_length-2), 0)!=-1)
    ( 
      &match=1
    )
  )
  else if (&wild_head==1)
  (
    if (STRING.MID("gcc_wcss_ecahb_clk", &clk_itr_length-&clk_input_length+1, &clk_input_length-1)==STRING.CUT("&clk", 1))
    ( 
      &match=1
    )
  )
  else if (&wild_tail==1)
  (
    if (STRING.MID("gcc_wcss_ecahb_clk", 0, &clk_input_length-1)==STRING.CUT("&clk", -1))
    ( 
      &match=1
    )
  )
  else if ("gcc_wcss_ecahb_clk"=="&clk")
  (
    &match=1
  )
  
  if (&match==1)
  (
    &clk_test=&CLK_TEST_GCC_WCSS_ECAHB_CLK
    &clk_reg=&HWIO_GCC_WCSS_ECAHB_CBCR_ADDR
    &clk_reg_name="GCC_WCSS_ECAHB_CBCR"
    &clk_name="gcc_wcss_ecahb_clk"
    &clk_reg_cbcr_type="sm_cbc"
    &clk_vote_bit=-1.
    &clk_multiplier=4.

    gosub Print_Clk_Info_Line
  )

  &match=0
  &wild_head=0
  &wild_tail=0
  &clk_input_length=STRING.LENGTH("&clk")
  &clk_itr_length=STRING.LENGTH("gcc_wcss_shdreg_ahb_clk")

  if (STRING.SCAN("&clk", "*", 0)==0)
  (
    &wild_head=1
  )
  if (STRING.SCAN("&clk", "*", 1)==(STRING.LENGTH("&clk")-1))
  (
    &wild_tail=1
  )

  if ((&wild_head==1)&&(&wild_tail==1))
  (
    if (STRING.SCAN("gcc_wcss_shdreg_ahb_clk", STRING.MID("&clk", 1, &clk_input_length-2), 0)!=-1)
    ( 
      &match=1
    )
  )
  else if (&wild_head==1)
  (
    if (STRING.MID("gcc_wcss_shdreg_ahb_clk", &clk_itr_length-&clk_input_length+1, &clk_input_length-1)==STRING.CUT("&clk", 1))
    ( 
      &match=1
    )
  )
  else if (&wild_tail==1)
  (
    if (STRING.MID("gcc_wcss_shdreg_ahb_clk", 0, &clk_input_length-1)==STRING.CUT("&clk", -1))
    ( 
      &match=1
    )
  )
  else if ("gcc_wcss_shdreg_ahb_clk"=="&clk")
  (
    &match=1
  )
  
  if (&match==1)
  (
    &clk_test=&CLK_TEST_GCC_WCSS_SHDREG_AHB_CLK
    &clk_reg=&HWIO_GCC_WCSS_SHDREG_AHB_CBCR_ADDR
    &clk_reg_name="GCC_WCSS_SHDREG_AHB_CBCR"
    &clk_name="gcc_wcss_shdreg_ahb_clk"
    &clk_reg_cbcr_type="sm_cbc"
    &clk_vote_bit=-1.
    &clk_multiplier=4.

    gosub Print_Clk_Info_Line
  )

  &match=0
  &wild_head=0
  &wild_tail=0
  &clk_input_length=STRING.LENGTH("&clk")
  &clk_itr_length=STRING.LENGTH("gcc_cfg_noc_tic_clk")

  if (STRING.SCAN("&clk", "*", 0)==0)
  (
    &wild_head=1
  )
  if (STRING.SCAN("&clk", "*", 1)==(STRING.LENGTH("&clk")-1))
  (
    &wild_tail=1
  )

  if ((&wild_head==1)&&(&wild_tail==1))
  (
    if (STRING.SCAN("gcc_cfg_noc_tic_clk", STRING.MID("&clk", 1, &clk_input_length-2), 0)!=-1)
    ( 
      &match=1
    )
  )
  else if (&wild_head==1)
  (
    if (STRING.MID("gcc_cfg_noc_tic_clk", &clk_itr_length-&clk_input_length+1, &clk_input_length-1)==STRING.CUT("&clk", 1))
    ( 
      &match=1
    )
  )
  else if (&wild_tail==1)
  (
    if (STRING.MID("gcc_cfg_noc_tic_clk", 0, &clk_input_length-1)==STRING.CUT("&clk", -1))
    ( 
      &match=1
    )
  )
  else if ("gcc_cfg_noc_tic_clk"=="&clk")
  (
    &match=1
  )
  
  if (&match==1)
  (
    &clk_test=&CLK_TEST_GCC_CFG_NOC_TIC_CLK
    &clk_reg=0
    &clk_reg_name="No CBCR"
    &clk_name="gcc_cfg_noc_tic_clk"
    &clk_reg_cbcr_type=""
    &clk_vote_bit=-1.
    &clk_multiplier=4.

    gosub Print_Clk_Info_Line
  )

  &match=0
  &wild_head=0
  &wild_tail=0
  &clk_input_length=STRING.LENGTH("&clk")
  &clk_itr_length=STRING.LENGTH("gcc_tic_clk")

  if (STRING.SCAN("&clk", "*", 0)==0)
  (
    &wild_head=1
  )
  if (STRING.SCAN("&clk", "*", 1)==(STRING.LENGTH("&clk")-1))
  (
    &wild_tail=1
  )

  if ((&wild_head==1)&&(&wild_tail==1))
  (
    if (STRING.SCAN("gcc_tic_clk", STRING.MID("&clk", 1, &clk_input_length-2), 0)!=-1)
    ( 
      &match=1
    )
  )
  else if (&wild_head==1)
  (
    if (STRING.MID("gcc_tic_clk", &clk_itr_length-&clk_input_length+1, &clk_input_length-1)==STRING.CUT("&clk", 1))
    ( 
      &match=1
    )
  )
  else if (&wild_tail==1)
  (
    if (STRING.MID("gcc_tic_clk", 0, &clk_input_length-1)==STRING.CUT("&clk", -1))
    ( 
      &match=1
    )
  )
  else if ("gcc_tic_clk"=="&clk")
  (
    &match=1
  )
  
  if (&match==1)
  (
    &clk_test=0
    &clk_reg=0
    &clk_reg_name="No CBCR"
    &clk_name="gcc_tic_clk"
    &clk_reg_cbcr_type=""
    &clk_vote_bit=-1.
    &clk_multiplier=4.

    gosub Print_Clk_Info_Line
  )

  &match=0
  &wild_head=0
  &wild_tail=0
  &clk_input_length=STRING.LENGTH("&clk")
  &clk_itr_length=STRING.LENGTH("gcc_tsif_ref_clk")

  if (STRING.SCAN("&clk", "*", 0)==0)
  (
    &wild_head=1
  )
  if (STRING.SCAN("&clk", "*", 1)==(STRING.LENGTH("&clk")-1))
  (
    &wild_tail=1
  )

  if ((&wild_head==1)&&(&wild_tail==1))
  (
    if (STRING.SCAN("gcc_tsif_ref_clk", STRING.MID("&clk", 1, &clk_input_length-2), 0)!=-1)
    ( 
      &match=1
    )
  )
  else if (&wild_head==1)
  (
    if (STRING.MID("gcc_tsif_ref_clk", &clk_itr_length-&clk_input_length+1, &clk_input_length-1)==STRING.CUT("&clk", 1))
    ( 
      &match=1
    )
  )
  else if (&wild_tail==1)
  (
    if (STRING.MID("gcc_tsif_ref_clk", 0, &clk_input_length-1)==STRING.CUT("&clk", -1))
    ( 
      &match=1
    )
  )
  else if ("gcc_tsif_ref_clk"=="&clk")
  (
    &match=1
  )
  
  if (&match==1)
  (
    &clk_test=&CLK_TEST_GCC_TSIF_REF_CLK
    &clk_reg=&HWIO_GCC_TSIF_REF_CBCR_ADDR
    &clk_reg_name="GCC_TSIF_REF_CBCR"
    &clk_name="gcc_tsif_ref_clk"
    &clk_reg_cbcr_type="sm_cbc"
    &clk_vote_bit=-1.
    &clk_multiplier=4.

    gosub Print_Clk_Info_Line
  )

  &match=0
  &wild_head=0
  &wild_tail=0
  &clk_input_length=STRING.LENGTH("&clk")
  &clk_itr_length=STRING.LENGTH("gcc_aggre1_ufs_axi_clk")

  if (STRING.SCAN("&clk", "*", 0)==0)
  (
    &wild_head=1
  )
  if (STRING.SCAN("&clk", "*", 1)==(STRING.LENGTH("&clk")-1))
  (
    &wild_tail=1
  )

  if ((&wild_head==1)&&(&wild_tail==1))
  (
    if (STRING.SCAN("gcc_aggre1_ufs_axi_clk", STRING.MID("&clk", 1, &clk_input_length-2), 0)!=-1)
    ( 
      &match=1
    )
  )
  else if (&wild_head==1)
  (
    if (STRING.MID("gcc_aggre1_ufs_axi_clk", &clk_itr_length-&clk_input_length+1, &clk_input_length-1)==STRING.CUT("&clk", 1))
    ( 
      &match=1
    )
  )
  else if (&wild_tail==1)
  (
    if (STRING.MID("gcc_aggre1_ufs_axi_clk", 0, &clk_input_length-1)==STRING.CUT("&clk", -1))
    ( 
      &match=1
    )
  )
  else if ("gcc_aggre1_ufs_axi_clk"=="&clk")
  (
    &match=1
  )
  
  if (&match==1)
  (
    &clk_test=&CLK_TEST_GCC_AGGRE1_UFS_AXI_CLK
    &clk_reg=&HWIO_GCC_AGGRE1_UFS_AXI_CBCR_ADDR
    &clk_reg_name="GCC_AGGRE1_UFS_AXI_CBCR"
    &clk_name="gcc_aggre1_ufs_axi_clk"
    &clk_reg_cbcr_type="sm_cbc"
    &clk_vote_bit=-1.
    &clk_multiplier=4.

    gosub Print_Clk_Info_Line
  )

  &match=0
  &wild_head=0
  &wild_tail=0
  &clk_input_length=STRING.LENGTH("&clk")
  &clk_itr_length=STRING.LENGTH("gcc_ufs_axi_clk")

  if (STRING.SCAN("&clk", "*", 0)==0)
  (
    &wild_head=1
  )
  if (STRING.SCAN("&clk", "*", 1)==(STRING.LENGTH("&clk")-1))
  (
    &wild_tail=1
  )

  if ((&wild_head==1)&&(&wild_tail==1))
  (
    if (STRING.SCAN("gcc_ufs_axi_clk", STRING.MID("&clk", 1, &clk_input_length-2), 0)!=-1)
    ( 
      &match=1
    )
  )
  else if (&wild_head==1)
  (
    if (STRING.MID("gcc_ufs_axi_clk", &clk_itr_length-&clk_input_length+1, &clk_input_length-1)==STRING.CUT("&clk", 1))
    ( 
      &match=1
    )
  )
  else if (&wild_tail==1)
  (
    if (STRING.MID("gcc_ufs_axi_clk", 0, &clk_input_length-1)==STRING.CUT("&clk", -1))
    ( 
      &match=1
    )
  )
  else if ("gcc_ufs_axi_clk"=="&clk")
  (
    &match=1
  )
  
  if (&match==1)
  (
    &clk_test=&CLK_TEST_GCC_UFS_AXI_CLK
    &clk_reg=&HWIO_GCC_UFS_AXI_CBCR_ADDR
    &clk_reg_name="GCC_UFS_AXI_CBCR"
    &clk_name="gcc_ufs_axi_clk"
    &clk_reg_cbcr_type="sm_pscbc"
    &clk_vote_bit=-1.
    &clk_multiplier=4.

    gosub Print_Clk_Info_Line
  )

  &match=0
  &wild_head=0
  &wild_tail=0
  &clk_input_length=STRING.LENGTH("&clk")
  &clk_itr_length=STRING.LENGTH("gcc_ufs_ice_core_clk")

  if (STRING.SCAN("&clk", "*", 0)==0)
  (
    &wild_head=1
  )
  if (STRING.SCAN("&clk", "*", 1)==(STRING.LENGTH("&clk")-1))
  (
    &wild_tail=1
  )

  if ((&wild_head==1)&&(&wild_tail==1))
  (
    if (STRING.SCAN("gcc_ufs_ice_core_clk", STRING.MID("&clk", 1, &clk_input_length-2), 0)!=-1)
    ( 
      &match=1
    )
  )
  else if (&wild_head==1)
  (
    if (STRING.MID("gcc_ufs_ice_core_clk", &clk_itr_length-&clk_input_length+1, &clk_input_length-1)==STRING.CUT("&clk", 1))
    ( 
      &match=1
    )
  )
  else if (&wild_tail==1)
  (
    if (STRING.MID("gcc_ufs_ice_core_clk", 0, &clk_input_length-1)==STRING.CUT("&clk", -1))
    ( 
      &match=1
    )
  )
  else if ("gcc_ufs_ice_core_clk"=="&clk")
  (
    &match=1
  )
  
  if (&match==1)
  (
    &clk_test=&CLK_TEST_GCC_UFS_ICE_CORE_CLK
    &clk_reg=&HWIO_GCC_UFS_ICE_CORE_CBCR_ADDR
    &clk_reg_name="GCC_UFS_ICE_CORE_CBCR"
    &clk_name="gcc_ufs_ice_core_clk"
    &clk_reg_cbcr_type="sm_pscbc"
    &clk_vote_bit=-1.
    &clk_multiplier=4.

    gosub Print_Clk_Info_Line
  )

  &match=0
  &wild_head=0
  &wild_tail=0
  &clk_input_length=STRING.LENGTH("&clk")
  &clk_itr_length=STRING.LENGTH("gcc_ufs_phy_aux_clk")

  if (STRING.SCAN("&clk", "*", 0)==0)
  (
    &wild_head=1
  )
  if (STRING.SCAN("&clk", "*", 1)==(STRING.LENGTH("&clk")-1))
  (
    &wild_tail=1
  )

  if ((&wild_head==1)&&(&wild_tail==1))
  (
    if (STRING.SCAN("gcc_ufs_phy_aux_clk", STRING.MID("&clk", 1, &clk_input_length-2), 0)!=-1)
    ( 
      &match=1
    )
  )
  else if (&wild_head==1)
  (
    if (STRING.MID("gcc_ufs_phy_aux_clk", &clk_itr_length-&clk_input_length+1, &clk_input_length-1)==STRING.CUT("&clk", 1))
    ( 
      &match=1
    )
  )
  else if (&wild_tail==1)
  (
    if (STRING.MID("gcc_ufs_phy_aux_clk", 0, &clk_input_length-1)==STRING.CUT("&clk", -1))
    ( 
      &match=1
    )
  )
  else if ("gcc_ufs_phy_aux_clk"=="&clk")
  (
    &match=1
  )
  
  if (&match==1)
  (
    &clk_test=&CLK_TEST_GCC_UFS_PHY_AUX_CLK
    &clk_reg=&HWIO_GCC_UFS_PHY_AUX_CBCR_ADDR
    &clk_reg_name="GCC_UFS_PHY_AUX_CBCR"
    &clk_name="gcc_ufs_phy_aux_clk"
    &clk_reg_cbcr_type="sm_cbc"
    &clk_vote_bit=-1.
    &clk_multiplier=4.

    gosub Print_Clk_Info_Line
  )

  &match=0
  &wild_head=0
  &wild_tail=0
  &clk_input_length=STRING.LENGTH("&clk")
  &clk_itr_length=STRING.LENGTH("gcc_ufs_rx_symbol_0_clk")

  if (STRING.SCAN("&clk", "*", 0)==0)
  (
    &wild_head=1
  )
  if (STRING.SCAN("&clk", "*", 1)==(STRING.LENGTH("&clk")-1))
  (
    &wild_tail=1
  )

  if ((&wild_head==1)&&(&wild_tail==1))
  (
    if (STRING.SCAN("gcc_ufs_rx_symbol_0_clk", STRING.MID("&clk", 1, &clk_input_length-2), 0)!=-1)
    ( 
      &match=1
    )
  )
  else if (&wild_head==1)
  (
    if (STRING.MID("gcc_ufs_rx_symbol_0_clk", &clk_itr_length-&clk_input_length+1, &clk_input_length-1)==STRING.CUT("&clk", 1))
    ( 
      &match=1
    )
  )
  else if (&wild_tail==1)
  (
    if (STRING.MID("gcc_ufs_rx_symbol_0_clk", 0, &clk_input_length-1)==STRING.CUT("&clk", -1))
    ( 
      &match=1
    )
  )
  else if ("gcc_ufs_rx_symbol_0_clk"=="&clk")
  (
    &match=1
  )
  
  if (&match==1)
  (
    &clk_test=&CLK_TEST_GCC_UFS_RX_SYMBOL_0_CLK
    &clk_reg=&HWIO_GCC_UFS_RX_SYMBOL_0_CBCR_ADDR
    &clk_reg_name="GCC_UFS_RX_SYMBOL_0_CBCR"
    &clk_name="gcc_ufs_rx_symbol_0_clk"
    &clk_reg_cbcr_type="sm_cbc"
    &clk_vote_bit=-1.
    &clk_multiplier=4.

    gosub Print_Clk_Info_Line
  )

  &match=0
  &wild_head=0
  &wild_tail=0
  &clk_input_length=STRING.LENGTH("&clk")
  &clk_itr_length=STRING.LENGTH("gcc_ufs_rx_symbol_1_clk")

  if (STRING.SCAN("&clk", "*", 0)==0)
  (
    &wild_head=1
  )
  if (STRING.SCAN("&clk", "*", 1)==(STRING.LENGTH("&clk")-1))
  (
    &wild_tail=1
  )

  if ((&wild_head==1)&&(&wild_tail==1))
  (
    if (STRING.SCAN("gcc_ufs_rx_symbol_1_clk", STRING.MID("&clk", 1, &clk_input_length-2), 0)!=-1)
    ( 
      &match=1
    )
  )
  else if (&wild_head==1)
  (
    if (STRING.MID("gcc_ufs_rx_symbol_1_clk", &clk_itr_length-&clk_input_length+1, &clk_input_length-1)==STRING.CUT("&clk", 1))
    ( 
      &match=1
    )
  )
  else if (&wild_tail==1)
  (
    if (STRING.MID("gcc_ufs_rx_symbol_1_clk", 0, &clk_input_length-1)==STRING.CUT("&clk", -1))
    ( 
      &match=1
    )
  )
  else if ("gcc_ufs_rx_symbol_1_clk"=="&clk")
  (
    &match=1
  )
  
  if (&match==1)
  (
    &clk_test=&CLK_TEST_GCC_UFS_RX_SYMBOL_1_CLK
    &clk_reg=&HWIO_GCC_UFS_RX_SYMBOL_1_CBCR_ADDR
    &clk_reg_name="GCC_UFS_RX_SYMBOL_1_CBCR"
    &clk_name="gcc_ufs_rx_symbol_1_clk"
    &clk_reg_cbcr_type="sm_cbc"
    &clk_vote_bit=-1.
    &clk_multiplier=4.

    gosub Print_Clk_Info_Line
  )

  &match=0
  &wild_head=0
  &wild_tail=0
  &clk_input_length=STRING.LENGTH("&clk")
  &clk_itr_length=STRING.LENGTH("gcc_ufs_tx_symbol_0_clk")

  if (STRING.SCAN("&clk", "*", 0)==0)
  (
    &wild_head=1
  )
  if (STRING.SCAN("&clk", "*", 1)==(STRING.LENGTH("&clk")-1))
  (
    &wild_tail=1
  )

  if ((&wild_head==1)&&(&wild_tail==1))
  (
    if (STRING.SCAN("gcc_ufs_tx_symbol_0_clk", STRING.MID("&clk", 1, &clk_input_length-2), 0)!=-1)
    ( 
      &match=1
    )
  )
  else if (&wild_head==1)
  (
    if (STRING.MID("gcc_ufs_tx_symbol_0_clk", &clk_itr_length-&clk_input_length+1, &clk_input_length-1)==STRING.CUT("&clk", 1))
    ( 
      &match=1
    )
  )
  else if (&wild_tail==1)
  (
    if (STRING.MID("gcc_ufs_tx_symbol_0_clk", 0, &clk_input_length-1)==STRING.CUT("&clk", -1))
    ( 
      &match=1
    )
  )
  else if ("gcc_ufs_tx_symbol_0_clk"=="&clk")
  (
    &match=1
  )
  
  if (&match==1)
  (
    &clk_test=&CLK_TEST_GCC_UFS_TX_SYMBOL_0_CLK
    &clk_reg=&HWIO_GCC_UFS_TX_SYMBOL_0_CBCR_ADDR
    &clk_reg_name="GCC_UFS_TX_SYMBOL_0_CBCR"
    &clk_name="gcc_ufs_tx_symbol_0_clk"
    &clk_reg_cbcr_type="sm_cbc"
    &clk_vote_bit=-1.
    &clk_multiplier=4.

    gosub Print_Clk_Info_Line
  )

  &match=0
  &wild_head=0
  &wild_tail=0
  &clk_input_length=STRING.LENGTH("&clk")
  &clk_itr_length=STRING.LENGTH("gcc_ufs_unipro_core_clk")

  if (STRING.SCAN("&clk", "*", 0)==0)
  (
    &wild_head=1
  )
  if (STRING.SCAN("&clk", "*", 1)==(STRING.LENGTH("&clk")-1))
  (
    &wild_tail=1
  )

  if ((&wild_head==1)&&(&wild_tail==1))
  (
    if (STRING.SCAN("gcc_ufs_unipro_core_clk", STRING.MID("&clk", 1, &clk_input_length-2), 0)!=-1)
    ( 
      &match=1
    )
  )
  else if (&wild_head==1)
  (
    if (STRING.MID("gcc_ufs_unipro_core_clk", &clk_itr_length-&clk_input_length+1, &clk_input_length-1)==STRING.CUT("&clk", 1))
    ( 
      &match=1
    )
  )
  else if (&wild_tail==1)
  (
    if (STRING.MID("gcc_ufs_unipro_core_clk", 0, &clk_input_length-1)==STRING.CUT("&clk", -1))
    ( 
      &match=1
    )
  )
  else if ("gcc_ufs_unipro_core_clk"=="&clk")
  (
    &match=1
  )
  
  if (&match==1)
  (
    &clk_test=&CLK_TEST_GCC_UFS_UNIPRO_CORE_CLK
    &clk_reg=&HWIO_GCC_UFS_UNIPRO_CORE_CBCR_ADDR
    &clk_reg_name="GCC_UFS_UNIPRO_CORE_CBCR"
    &clk_name="gcc_ufs_unipro_core_clk"
    &clk_reg_cbcr_type="sm_pscbc"
    &clk_vote_bit=-1.
    &clk_multiplier=4.

    gosub Print_Clk_Info_Line
  )

  &match=0
  &wild_head=0
  &wild_tail=0
  &clk_input_length=STRING.LENGTH("&clk")
  &clk_itr_length=STRING.LENGTH("gcc_aggre1_usb3_axi_clk")

  if (STRING.SCAN("&clk", "*", 0)==0)
  (
    &wild_head=1
  )
  if (STRING.SCAN("&clk", "*", 1)==(STRING.LENGTH("&clk")-1))
  (
    &wild_tail=1
  )

  if ((&wild_head==1)&&(&wild_tail==1))
  (
    if (STRING.SCAN("gcc_aggre1_usb3_axi_clk", STRING.MID("&clk", 1, &clk_input_length-2), 0)!=-1)
    ( 
      &match=1
    )
  )
  else if (&wild_head==1)
  (
    if (STRING.MID("gcc_aggre1_usb3_axi_clk", &clk_itr_length-&clk_input_length+1, &clk_input_length-1)==STRING.CUT("&clk", 1))
    ( 
      &match=1
    )
  )
  else if (&wild_tail==1)
  (
    if (STRING.MID("gcc_aggre1_usb3_axi_clk", 0, &clk_input_length-1)==STRING.CUT("&clk", -1))
    ( 
      &match=1
    )
  )
  else if ("gcc_aggre1_usb3_axi_clk"=="&clk")
  (
    &match=1
  )
  
  if (&match==1)
  (
    &clk_test=&CLK_TEST_GCC_AGGRE1_USB3_AXI_CLK
    &clk_reg=&HWIO_GCC_AGGRE1_USB3_AXI_CBCR_ADDR
    &clk_reg_name="GCC_AGGRE1_USB3_AXI_CBCR"
    &clk_name="gcc_aggre1_usb3_axi_clk"
    &clk_reg_cbcr_type="sm_cbc"
    &clk_vote_bit=-1.
    &clk_multiplier=4.

    gosub Print_Clk_Info_Line
  )

  &match=0
  &wild_head=0
  &wild_tail=0
  &clk_input_length=STRING.LENGTH("&clk")
  &clk_itr_length=STRING.LENGTH("gcc_cfg_noc_usb3_axi_clk")

  if (STRING.SCAN("&clk", "*", 0)==0)
  (
    &wild_head=1
  )
  if (STRING.SCAN("&clk", "*", 1)==(STRING.LENGTH("&clk")-1))
  (
    &wild_tail=1
  )

  if ((&wild_head==1)&&(&wild_tail==1))
  (
    if (STRING.SCAN("gcc_cfg_noc_usb3_axi_clk", STRING.MID("&clk", 1, &clk_input_length-2), 0)!=-1)
    ( 
      &match=1
    )
  )
  else if (&wild_head==1)
  (
    if (STRING.MID("gcc_cfg_noc_usb3_axi_clk", &clk_itr_length-&clk_input_length+1, &clk_input_length-1)==STRING.CUT("&clk", 1))
    ( 
      &match=1
    )
  )
  else if (&wild_tail==1)
  (
    if (STRING.MID("gcc_cfg_noc_usb3_axi_clk", 0, &clk_input_length-1)==STRING.CUT("&clk", -1))
    ( 
      &match=1
    )
  )
  else if ("gcc_cfg_noc_usb3_axi_clk"=="&clk")
  (
    &match=1
  )
  
  if (&match==1)
  (
    &clk_test=&CLK_TEST_GCC_CFG_NOC_USB3_AXI_CLK
    &clk_reg=&HWIO_GCC_CFG_NOC_USB3_AXI_CBCR_ADDR
    &clk_reg_name="GCC_CFG_NOC_USB3_AXI_CBCR"
    &clk_name="gcc_cfg_noc_usb3_axi_clk"
    &clk_reg_cbcr_type="sm_cbc"
    &clk_vote_bit=-1.
    &clk_multiplier=4.

    gosub Print_Clk_Info_Line
  )

  &match=0
  &wild_head=0
  &wild_tail=0
  &clk_input_length=STRING.LENGTH("&clk")
  &clk_itr_length=STRING.LENGTH("gcc_cnoc_bus_timeout14_ahb_clk")

  if (STRING.SCAN("&clk", "*", 0)==0)
  (
    &wild_head=1
  )
  if (STRING.SCAN("&clk", "*", 1)==(STRING.LENGTH("&clk")-1))
  (
    &wild_tail=1
  )

  if ((&wild_head==1)&&(&wild_tail==1))
  (
    if (STRING.SCAN("gcc_cnoc_bus_timeout14_ahb_clk", STRING.MID("&clk", 1, &clk_input_length-2), 0)!=-1)
    ( 
      &match=1
    )
  )
  else if (&wild_head==1)
  (
    if (STRING.MID("gcc_cnoc_bus_timeout14_ahb_clk", &clk_itr_length-&clk_input_length+1, &clk_input_length-1)==STRING.CUT("&clk", 1))
    ( 
      &match=1
    )
  )
  else if (&wild_tail==1)
  (
    if (STRING.MID("gcc_cnoc_bus_timeout14_ahb_clk", 0, &clk_input_length-1)==STRING.CUT("&clk", -1))
    ( 
      &match=1
    )
  )
  else if ("gcc_cnoc_bus_timeout14_ahb_clk"=="&clk")
  (
    &match=1
  )
  
  if (&match==1)
  (
    &clk_test=&CLK_TEST_GCC_CNOC_BUS_TIMEOUT14_AHB_CLK
    &clk_reg=&HWIO_GCC_CNOC_BUS_TIMEOUT14_AHB_CBCR_ADDR
    &clk_reg_name="GCC_CNOC_BUS_TIMEOUT14_AHB_CBCR"
    &clk_name="gcc_cnoc_bus_timeout14_ahb_clk"
    &clk_reg_cbcr_type="sm_cbc"
    &clk_vote_bit=-1.
    &clk_multiplier=4.

    gosub Print_Clk_Info_Line
  )

  &match=0
  &wild_head=0
  &wild_tail=0
  &clk_input_length=STRING.LENGTH("&clk")
  &clk_itr_length=STRING.LENGTH("gcc_usb30_master_clk")

  if (STRING.SCAN("&clk", "*", 0)==0)
  (
    &wild_head=1
  )
  if (STRING.SCAN("&clk", "*", 1)==(STRING.LENGTH("&clk")-1))
  (
    &wild_tail=1
  )

  if ((&wild_head==1)&&(&wild_tail==1))
  (
    if (STRING.SCAN("gcc_usb30_master_clk", STRING.MID("&clk", 1, &clk_input_length-2), 0)!=-1)
    ( 
      &match=1
    )
  )
  else if (&wild_head==1)
  (
    if (STRING.MID("gcc_usb30_master_clk", &clk_itr_length-&clk_input_length+1, &clk_input_length-1)==STRING.CUT("&clk", 1))
    ( 
      &match=1
    )
  )
  else if (&wild_tail==1)
  (
    if (STRING.MID("gcc_usb30_master_clk", 0, &clk_input_length-1)==STRING.CUT("&clk", -1))
    ( 
      &match=1
    )
  )
  else if ("gcc_usb30_master_clk"=="&clk")
  (
    &match=1
  )
  
  if (&match==1)
  (
    &clk_test=&CLK_TEST_GCC_USB30_MASTER_CLK
    &clk_reg=&HWIO_GCC_USB30_MASTER_CBCR_ADDR
    &clk_reg_name="GCC_USB30_MASTER_CBCR"
    &clk_name="gcc_usb30_master_clk"
    &clk_reg_cbcr_type="sm_pscbc"
    &clk_vote_bit=-1.
    &clk_multiplier=4.

    gosub Print_Clk_Info_Line
  )

  &match=0
  &wild_head=0
  &wild_tail=0
  &clk_input_length=STRING.LENGTH("&clk")
  &clk_itr_length=STRING.LENGTH("gcc_usb30_mock_utmi_clk")

  if (STRING.SCAN("&clk", "*", 0)==0)
  (
    &wild_head=1
  )
  if (STRING.SCAN("&clk", "*", 1)==(STRING.LENGTH("&clk")-1))
  (
    &wild_tail=1
  )

  if ((&wild_head==1)&&(&wild_tail==1))
  (
    if (STRING.SCAN("gcc_usb30_mock_utmi_clk", STRING.MID("&clk", 1, &clk_input_length-2), 0)!=-1)
    ( 
      &match=1
    )
  )
  else if (&wild_head==1)
  (
    if (STRING.MID("gcc_usb30_mock_utmi_clk", &clk_itr_length-&clk_input_length+1, &clk_input_length-1)==STRING.CUT("&clk", 1))
    ( 
      &match=1
    )
  )
  else if (&wild_tail==1)
  (
    if (STRING.MID("gcc_usb30_mock_utmi_clk", 0, &clk_input_length-1)==STRING.CUT("&clk", -1))
    ( 
      &match=1
    )
  )
  else if ("gcc_usb30_mock_utmi_clk"=="&clk")
  (
    &match=1
  )
  
  if (&match==1)
  (
    &clk_test=&CLK_TEST_GCC_USB30_MOCK_UTMI_CLK
    &clk_reg=&HWIO_GCC_USB30_MOCK_UTMI_CBCR_ADDR
    &clk_reg_name="GCC_USB30_MOCK_UTMI_CBCR"
    &clk_name="gcc_usb30_mock_utmi_clk"
    &clk_reg_cbcr_type="sm_cbc"
    &clk_vote_bit=-1.
    &clk_multiplier=4.

    gosub Print_Clk_Info_Line
  )

  &match=0
  &wild_head=0
  &wild_tail=0
  &clk_input_length=STRING.LENGTH("&clk")
  &clk_itr_length=STRING.LENGTH("gcc_usb3_phy_aux_clk")

  if (STRING.SCAN("&clk", "*", 0)==0)
  (
    &wild_head=1
  )
  if (STRING.SCAN("&clk", "*", 1)==(STRING.LENGTH("&clk")-1))
  (
    &wild_tail=1
  )

  if ((&wild_head==1)&&(&wild_tail==1))
  (
    if (STRING.SCAN("gcc_usb3_phy_aux_clk", STRING.MID("&clk", 1, &clk_input_length-2), 0)!=-1)
    ( 
      &match=1
    )
  )
  else if (&wild_head==1)
  (
    if (STRING.MID("gcc_usb3_phy_aux_clk", &clk_itr_length-&clk_input_length+1, &clk_input_length-1)==STRING.CUT("&clk", 1))
    ( 
      &match=1
    )
  )
  else if (&wild_tail==1)
  (
    if (STRING.MID("gcc_usb3_phy_aux_clk", 0, &clk_input_length-1)==STRING.CUT("&clk", -1))
    ( 
      &match=1
    )
  )
  else if ("gcc_usb3_phy_aux_clk"=="&clk")
  (
    &match=1
  )
  
  if (&match==1)
  (
    &clk_test=&CLK_TEST_GCC_USB3_PHY_AUX_CLK
    &clk_reg=&HWIO_GCC_USB3_PHY_AUX_CBCR_ADDR
    &clk_reg_name="GCC_USB3_PHY_AUX_CBCR"
    &clk_name="gcc_usb3_phy_aux_clk"
    &clk_reg_cbcr_type="sm_cbc"
    &clk_vote_bit=-1.
    &clk_multiplier=4.

    gosub Print_Clk_Info_Line
  )

  &match=0
  &wild_head=0
  &wild_tail=0
  &clk_input_length=STRING.LENGTH("&clk")
  &clk_itr_length=STRING.LENGTH("gcc_usb3_phy_pipe_clk")

  if (STRING.SCAN("&clk", "*", 0)==0)
  (
    &wild_head=1
  )
  if (STRING.SCAN("&clk", "*", 1)==(STRING.LENGTH("&clk")-1))
  (
    &wild_tail=1
  )

  if ((&wild_head==1)&&(&wild_tail==1))
  (
    if (STRING.SCAN("gcc_usb3_phy_pipe_clk", STRING.MID("&clk", 1, &clk_input_length-2), 0)!=-1)
    ( 
      &match=1
    )
  )
  else if (&wild_head==1)
  (
    if (STRING.MID("gcc_usb3_phy_pipe_clk", &clk_itr_length-&clk_input_length+1, &clk_input_length-1)==STRING.CUT("&clk", 1))
    ( 
      &match=1
    )
  )
  else if (&wild_tail==1)
  (
    if (STRING.MID("gcc_usb3_phy_pipe_clk", 0, &clk_input_length-1)==STRING.CUT("&clk", -1))
    ( 
      &match=1
    )
  )
  else if ("gcc_usb3_phy_pipe_clk"=="&clk")
  (
    &match=1
  )
  
  if (&match==1)
  (
    &clk_test=&CLK_TEST_GCC_USB3_PHY_PIPE_CLK
    &clk_reg=&HWIO_GCC_USB3_PHY_PIPE_CBCR_ADDR
    &clk_reg_name="GCC_USB3_PHY_PIPE_CBCR"
    &clk_name="gcc_usb3_phy_pipe_clk"
    &clk_reg_cbcr_type="sm_cbc"
    &clk_vote_bit=-1.
    &clk_multiplier=4.

    gosub Print_Clk_Info_Line
  )

  &match=0
  &wild_head=0
  &wild_tail=0
  &clk_input_length=STRING.LENGTH("&clk")
  &clk_itr_length=STRING.LENGTH("gcc_vdda_vs_clk")

  if (STRING.SCAN("&clk", "*", 0)==0)
  (
    &wild_head=1
  )
  if (STRING.SCAN("&clk", "*", 1)==(STRING.LENGTH("&clk")-1))
  (
    &wild_tail=1
  )

  if ((&wild_head==1)&&(&wild_tail==1))
  (
    if (STRING.SCAN("gcc_vdda_vs_clk", STRING.MID("&clk", 1, &clk_input_length-2), 0)!=-1)
    ( 
      &match=1
    )
  )
  else if (&wild_head==1)
  (
    if (STRING.MID("gcc_vdda_vs_clk", &clk_itr_length-&clk_input_length+1, &clk_input_length-1)==STRING.CUT("&clk", 1))
    ( 
      &match=1
    )
  )
  else if (&wild_tail==1)
  (
    if (STRING.MID("gcc_vdda_vs_clk", 0, &clk_input_length-1)==STRING.CUT("&clk", -1))
    ( 
      &match=1
    )
  )
  else if ("gcc_vdda_vs_clk"=="&clk")
  (
    &match=1
  )
  
  if (&match==1)
  (
    &clk_test=&CLK_TEST_GCC_VDDA_VS_CLK
    &clk_reg=&HWIO_GCC_VDDA_VS_CBCR_ADDR
    &clk_reg_name="GCC_VDDA_VS_CBCR"
    &clk_name="gcc_vdda_vs_clk"
    &clk_reg_cbcr_type="sm_cbc"
    &clk_vote_bit=-1.
    &clk_multiplier=4.

    gosub Print_Clk_Info_Line
  )

  &match=0
  &wild_head=0
  &wild_tail=0
  &clk_input_length=STRING.LENGTH("&clk")
  &clk_itr_length=STRING.LENGTH("gcc_vddcx_vs_clk")

  if (STRING.SCAN("&clk", "*", 0)==0)
  (
    &wild_head=1
  )
  if (STRING.SCAN("&clk", "*", 1)==(STRING.LENGTH("&clk")-1))
  (
    &wild_tail=1
  )

  if ((&wild_head==1)&&(&wild_tail==1))
  (
    if (STRING.SCAN("gcc_vddcx_vs_clk", STRING.MID("&clk", 1, &clk_input_length-2), 0)!=-1)
    ( 
      &match=1
    )
  )
  else if (&wild_head==1)
  (
    if (STRING.MID("gcc_vddcx_vs_clk", &clk_itr_length-&clk_input_length+1, &clk_input_length-1)==STRING.CUT("&clk", 1))
    ( 
      &match=1
    )
  )
  else if (&wild_tail==1)
  (
    if (STRING.MID("gcc_vddcx_vs_clk", 0, &clk_input_length-1)==STRING.CUT("&clk", -1))
    ( 
      &match=1
    )
  )
  else if ("gcc_vddcx_vs_clk"=="&clk")
  (
    &match=1
  )
  
  if (&match==1)
  (
    &clk_test=&CLK_TEST_GCC_VDDCX_VS_CLK
    &clk_reg=&HWIO_GCC_VDDCX_VS_CBCR_ADDR
    &clk_reg_name="GCC_VDDCX_VS_CBCR"
    &clk_name="gcc_vddcx_vs_clk"
    &clk_reg_cbcr_type="sm_cbc"
    &clk_vote_bit=-1.
    &clk_multiplier=4.

    gosub Print_Clk_Info_Line
  )

  &match=0
  &wild_head=0
  &wild_tail=0
  &clk_input_length=STRING.LENGTH("&clk")
  &clk_itr_length=STRING.LENGTH("gcc_vddmx_vs_clk")

  if (STRING.SCAN("&clk", "*", 0)==0)
  (
    &wild_head=1
  )
  if (STRING.SCAN("&clk", "*", 1)==(STRING.LENGTH("&clk")-1))
  (
    &wild_tail=1
  )

  if ((&wild_head==1)&&(&wild_tail==1))
  (
    if (STRING.SCAN("gcc_vddmx_vs_clk", STRING.MID("&clk", 1, &clk_input_length-2), 0)!=-1)
    ( 
      &match=1
    )
  )
  else if (&wild_head==1)
  (
    if (STRING.MID("gcc_vddmx_vs_clk", &clk_itr_length-&clk_input_length+1, &clk_input_length-1)==STRING.CUT("&clk", 1))
    ( 
      &match=1
    )
  )
  else if (&wild_tail==1)
  (
    if (STRING.MID("gcc_vddmx_vs_clk", 0, &clk_input_length-1)==STRING.CUT("&clk", -1))
    ( 
      &match=1
    )
  )
  else if ("gcc_vddmx_vs_clk"=="&clk")
  (
    &match=1
  )
  
  if (&match==1)
  (
    &clk_test=&CLK_TEST_GCC_VDDMX_VS_CLK
    &clk_reg=&HWIO_GCC_VDDMX_VS_CBCR_ADDR
    &clk_reg_name="GCC_VDDMX_VS_CBCR"
    &clk_name="gcc_vddmx_vs_clk"
    &clk_reg_cbcr_type="sm_cbc"
    &clk_vote_bit=-1.
    &clk_multiplier=4.

    gosub Print_Clk_Info_Line
  )

  &match=0
  &wild_head=0
  &wild_tail=0
  &clk_input_length=STRING.LENGTH("&clk")
  &clk_itr_length=STRING.LENGTH("gcc_vs_ctrl_clk")

  if (STRING.SCAN("&clk", "*", 0)==0)
  (
    &wild_head=1
  )
  if (STRING.SCAN("&clk", "*", 1)==(STRING.LENGTH("&clk")-1))
  (
    &wild_tail=1
  )

  if ((&wild_head==1)&&(&wild_tail==1))
  (
    if (STRING.SCAN("gcc_vs_ctrl_clk", STRING.MID("&clk", 1, &clk_input_length-2), 0)!=-1)
    ( 
      &match=1
    )
  )
  else if (&wild_head==1)
  (
    if (STRING.MID("gcc_vs_ctrl_clk", &clk_itr_length-&clk_input_length+1, &clk_input_length-1)==STRING.CUT("&clk", 1))
    ( 
      &match=1
    )
  )
  else if (&wild_tail==1)
  (
    if (STRING.MID("gcc_vs_ctrl_clk", 0, &clk_input_length-1)==STRING.CUT("&clk", -1))
    ( 
      &match=1
    )
  )
  else if ("gcc_vs_ctrl_clk"=="&clk")
  (
    &match=1
  )
  
  if (&match==1)
  (
    &clk_test=&CLK_TEST_GCC_VS_CTRL_CLK
    &clk_reg=&HWIO_GCC_VS_CTRL_CBCR_ADDR
    &clk_reg_name="GCC_VS_CTRL_CBCR"
    &clk_name="gcc_vs_ctrl_clk"
    &clk_reg_cbcr_type="sm_cbc"
    &clk_vote_bit=-1.
    &clk_multiplier=4.

    gosub Print_Clk_Info_Line
  )

  &match=0
  &wild_head=0
  &wild_tail=0
  &clk_input_length=STRING.LENGTH("&clk")
  &clk_itr_length=STRING.LENGTH("gcc_aggre1_noc_qosgen_extref")

  if (STRING.SCAN("&clk", "*", 0)==0)
  (
    &wild_head=1
  )
  if (STRING.SCAN("&clk", "*", 1)==(STRING.LENGTH("&clk")-1))
  (
    &wild_tail=1
  )

  if ((&wild_head==1)&&(&wild_tail==1))
  (
    if (STRING.SCAN("gcc_aggre1_noc_qosgen_extref", STRING.MID("&clk", 1, &clk_input_length-2), 0)!=-1)
    ( 
      &match=1
    )
  )
  else if (&wild_head==1)
  (
    if (STRING.MID("gcc_aggre1_noc_qosgen_extref", &clk_itr_length-&clk_input_length+1, &clk_input_length-1)==STRING.CUT("&clk", 1))
    ( 
      &match=1
    )
  )
  else if (&wild_tail==1)
  (
    if (STRING.MID("gcc_aggre1_noc_qosgen_extref", 0, &clk_input_length-1)==STRING.CUT("&clk", -1))
    ( 
      &match=1
    )
  )
  else if ("gcc_aggre1_noc_qosgen_extref"=="&clk")
  (
    &match=1
  )
  
  if (&match==1)
  (
    &clk_test=&CLK_TEST_GCC_AGGRE1_NOC_QOSGEN_EXTREF
    &clk_reg=0
    &clk_reg_name="No CBCR"
    &clk_name="gcc_aggre1_noc_qosgen_extref"
    &clk_reg_cbcr_type=""
    &clk_vote_bit=-1.
    &clk_multiplier=4.

    gosub Print_Clk_Info_Line
  )

  &match=0
  &wild_head=0
  &wild_tail=0
  &clk_input_length=STRING.LENGTH("&clk")
  &clk_itr_length=STRING.LENGTH("gcc_aggre2_noc_qosgen_extref")

  if (STRING.SCAN("&clk", "*", 0)==0)
  (
    &wild_head=1
  )
  if (STRING.SCAN("&clk", "*", 1)==(STRING.LENGTH("&clk")-1))
  (
    &wild_tail=1
  )

  if ((&wild_head==1)&&(&wild_tail==1))
  (
    if (STRING.SCAN("gcc_aggre2_noc_qosgen_extref", STRING.MID("&clk", 1, &clk_input_length-2), 0)!=-1)
    ( 
      &match=1
    )
  )
  else if (&wild_head==1)
  (
    if (STRING.MID("gcc_aggre2_noc_qosgen_extref", &clk_itr_length-&clk_input_length+1, &clk_input_length-1)==STRING.CUT("&clk", 1))
    ( 
      &match=1
    )
  )
  else if (&wild_tail==1)
  (
    if (STRING.MID("gcc_aggre2_noc_qosgen_extref", 0, &clk_input_length-1)==STRING.CUT("&clk", -1))
    ( 
      &match=1
    )
  )
  else if ("gcc_aggre2_noc_qosgen_extref"=="&clk")
  (
    &match=1
  )
  
  if (&match==1)
  (
    &clk_test=&CLK_TEST_GCC_AGGRE2_NOC_QOSGEN_EXTREF
    &clk_reg=0
    &clk_reg_name="No CBCR"
    &clk_name="gcc_aggre2_noc_qosgen_extref"
    &clk_reg_cbcr_type=""
    &clk_vote_bit=-1.
    &clk_multiplier=4.

    gosub Print_Clk_Info_Line
  )

  &match=0
  &wild_head=0
  &wild_tail=0
  &clk_input_length=STRING.LENGTH("&clk")
  &clk_itr_length=STRING.LENGTH("gcc_cnoc_bus_timeout_extref")

  if (STRING.SCAN("&clk", "*", 0)==0)
  (
    &wild_head=1
  )
  if (STRING.SCAN("&clk", "*", 1)==(STRING.LENGTH("&clk")-1))
  (
    &wild_tail=1
  )

  if ((&wild_head==1)&&(&wild_tail==1))
  (
    if (STRING.SCAN("gcc_cnoc_bus_timeout_extref", STRING.MID("&clk", 1, &clk_input_length-2), 0)!=-1)
    ( 
      &match=1
    )
  )
  else if (&wild_head==1)
  (
    if (STRING.MID("gcc_cnoc_bus_timeout_extref", &clk_itr_length-&clk_input_length+1, &clk_input_length-1)==STRING.CUT("&clk", 1))
    ( 
      &match=1
    )
  )
  else if (&wild_tail==1)
  (
    if (STRING.MID("gcc_cnoc_bus_timeout_extref", 0, &clk_input_length-1)==STRING.CUT("&clk", -1))
    ( 
      &match=1
    )
  )
  else if ("gcc_cnoc_bus_timeout_extref"=="&clk")
  (
    &match=1
  )
  
  if (&match==1)
  (
    &clk_test=&CLK_TEST_GCC_CNOC_BUS_TIMEOUT_EXTREF
    &clk_reg=0
    &clk_reg_name="No CBCR"
    &clk_name="gcc_cnoc_bus_timeout_extref"
    &clk_reg_cbcr_type=""
    &clk_vote_bit=-1.
    &clk_multiplier=4.

    gosub Print_Clk_Info_Line
  )

  &match=0
  &wild_head=0
  &wild_tail=0
  &clk_input_length=STRING.LENGTH("&clk")
  &clk_itr_length=STRING.LENGTH("gcc_snoc_bus_timeout_extref")

  if (STRING.SCAN("&clk", "*", 0)==0)
  (
    &wild_head=1
  )
  if (STRING.SCAN("&clk", "*", 1)==(STRING.LENGTH("&clk")-1))
  (
    &wild_tail=1
  )

  if ((&wild_head==1)&&(&wild_tail==1))
  (
    if (STRING.SCAN("gcc_snoc_bus_timeout_extref", STRING.MID("&clk", 1, &clk_input_length-2), 0)!=-1)
    ( 
      &match=1
    )
  )
  else if (&wild_head==1)
  (
    if (STRING.MID("gcc_snoc_bus_timeout_extref", &clk_itr_length-&clk_input_length+1, &clk_input_length-1)==STRING.CUT("&clk", 1))
    ( 
      &match=1
    )
  )
  else if (&wild_tail==1)
  (
    if (STRING.MID("gcc_snoc_bus_timeout_extref", 0, &clk_input_length-1)==STRING.CUT("&clk", -1))
    ( 
      &match=1
    )
  )
  else if ("gcc_snoc_bus_timeout_extref"=="&clk")
  (
    &match=1
  )
  
  if (&match==1)
  (
    &clk_test=&CLK_TEST_GCC_SNOC_BUS_TIMEOUT_EXTREF
    &clk_reg=0
    &clk_reg_name="No CBCR"
    &clk_name="gcc_snoc_bus_timeout_extref"
    &clk_reg_cbcr_type=""
    &clk_vote_bit=-1.
    &clk_multiplier=4.

    gosub Print_Clk_Info_Line
  )

  &match=0
  &wild_head=0
  &wild_tail=0
  &clk_input_length=STRING.LENGTH("&clk")
  &clk_itr_length=STRING.LENGTH("gcc_snoc_qosgen_extref")

  if (STRING.SCAN("&clk", "*", 0)==0)
  (
    &wild_head=1
  )
  if (STRING.SCAN("&clk", "*", 1)==(STRING.LENGTH("&clk")-1))
  (
    &wild_tail=1
  )

  if ((&wild_head==1)&&(&wild_tail==1))
  (
    if (STRING.SCAN("gcc_snoc_qosgen_extref", STRING.MID("&clk", 1, &clk_input_length-2), 0)!=-1)
    ( 
      &match=1
    )
  )
  else if (&wild_head==1)
  (
    if (STRING.MID("gcc_snoc_qosgen_extref", &clk_itr_length-&clk_input_length+1, &clk_input_length-1)==STRING.CUT("&clk", 1))
    ( 
      &match=1
    )
  )
  else if (&wild_tail==1)
  (
    if (STRING.MID("gcc_snoc_qosgen_extref", 0, &clk_input_length-1)==STRING.CUT("&clk", -1))
    ( 
      &match=1
    )
  )
  else if ("gcc_snoc_qosgen_extref"=="&clk")
  (
    &match=1
  )
  
  if (&match==1)
  (
    &clk_test=&CLK_TEST_GCC_SNOC_QOSGEN_EXTREF
    &clk_reg=0
    &clk_reg_name="No CBCR"
    &clk_name="gcc_snoc_qosgen_extref"
    &clk_reg_cbcr_type=""
    &clk_vote_bit=-1.
    &clk_multiplier=4.

    gosub Print_Clk_Info_Line
  )

  &match=0
  &wild_head=0
  &wild_tail=0
  &clk_input_length=STRING.LENGTH("&clk")
  &clk_itr_length=STRING.LENGTH("gpu_gcc_dbg_clk")

  if (STRING.SCAN("&clk", "*", 0)==0)
  (
    &wild_head=1
  )
  if (STRING.SCAN("&clk", "*", 1)==(STRING.LENGTH("&clk")-1))
  (
    &wild_tail=1
  )

  if ((&wild_head==1)&&(&wild_tail==1))
  (
    if (STRING.SCAN("gpu_gcc_dbg_clk", STRING.MID("&clk", 1, &clk_input_length-2), 0)!=-1)
    ( 
      &match=1
    )
  )
  else if (&wild_head==1)
  (
    if (STRING.MID("gpu_gcc_dbg_clk", &clk_itr_length-&clk_input_length+1, &clk_input_length-1)==STRING.CUT("&clk", 1))
    ( 
      &match=1
    )
  )
  else if (&wild_tail==1)
  (
    if (STRING.MID("gpu_gcc_dbg_clk", 0, &clk_input_length-1)==STRING.CUT("&clk", -1))
    ( 
      &match=1
    )
  )
  else if ("gpu_gcc_dbg_clk"=="&clk")
  (
    &match=1
  )
  
  if (&match==1)
  (
    &clk_test=&CLK_TEST_GPU_GCC_DBG_CLK
    &clk_reg=0
    &clk_reg_name="No CBCR"
    &clk_name="gpu_gcc_dbg_clk"
    &clk_reg_cbcr_type=""
    &clk_vote_bit=-1.
    &clk_multiplier=4.

    gosub Print_Clk_Info_Line
  )

  &match=0
  &wild_head=0
  &wild_tail=0
  &clk_input_length=STRING.LENGTH("&clk")
  &clk_itr_length=STRING.LENGTH("hmss_gcc_dbg_clk")

  if (STRING.SCAN("&clk", "*", 0)==0)
  (
    &wild_head=1
  )
  if (STRING.SCAN("&clk", "*", 1)==(STRING.LENGTH("&clk")-1))
  (
    &wild_tail=1
  )

  if ((&wild_head==1)&&(&wild_tail==1))
  (
    if (STRING.SCAN("hmss_gcc_dbg_clk", STRING.MID("&clk", 1, &clk_input_length-2), 0)!=-1)
    ( 
      &match=1
    )
  )
  else if (&wild_head==1)
  (
    if (STRING.MID("hmss_gcc_dbg_clk", &clk_itr_length-&clk_input_length+1, &clk_input_length-1)==STRING.CUT("&clk", 1))
    ( 
      &match=1
    )
  )
  else if (&wild_tail==1)
  (
    if (STRING.MID("hmss_gcc_dbg_clk", 0, &clk_input_length-1)==STRING.CUT("&clk", -1))
    ( 
      &match=1
    )
  )
  else if ("hmss_gcc_dbg_clk"=="&clk")
  (
    &match=1
  )
  
  if (&match==1)
  (
    &clk_test=&CLK_TEST_HMSS_GCC_DBG_CLK
    &clk_reg=0
    &clk_reg_name="No CBCR"
    &clk_name="hmss_gcc_dbg_clk"
    &clk_reg_cbcr_type=""
    &clk_vote_bit=-1.
    &clk_multiplier=4.

    gosub Print_Clk_Info_Line
  )

  &match=0
  &wild_head=0
  &wild_tail=0
  &clk_input_length=STRING.LENGTH("&clk")
  &clk_itr_length=STRING.LENGTH("lpass_gcc_dbg_clk")

  if (STRING.SCAN("&clk", "*", 0)==0)
  (
    &wild_head=1
  )
  if (STRING.SCAN("&clk", "*", 1)==(STRING.LENGTH("&clk")-1))
  (
    &wild_tail=1
  )

  if ((&wild_head==1)&&(&wild_tail==1))
  (
    if (STRING.SCAN("lpass_gcc_dbg_clk", STRING.MID("&clk", 1, &clk_input_length-2), 0)!=-1)
    ( 
      &match=1
    )
  )
  else if (&wild_head==1)
  (
    if (STRING.MID("lpass_gcc_dbg_clk", &clk_itr_length-&clk_input_length+1, &clk_input_length-1)==STRING.CUT("&clk", 1))
    ( 
      &match=1
    )
  )
  else if (&wild_tail==1)
  (
    if (STRING.MID("lpass_gcc_dbg_clk", 0, &clk_input_length-1)==STRING.CUT("&clk", -1))
    ( 
      &match=1
    )
  )
  else if ("lpass_gcc_dbg_clk"=="&clk")
  (
    &match=1
  )
  
  if (&match==1)
  (
    &clk_test=&CLK_TEST_LPASS_GCC_DBG_CLK
    &clk_reg=0
    &clk_reg_name="No CBCR"
    &clk_name="lpass_gcc_dbg_clk"
    &clk_reg_cbcr_type=""
    &clk_vote_bit=-1.
    &clk_multiplier=4.

    gosub Print_Clk_Info_Line
  )

  &match=0
  &wild_head=0
  &wild_tail=0
  &clk_input_length=STRING.LENGTH("&clk")
  &clk_itr_length=STRING.LENGTH("mmss_gcc_dbg_clk")

  if (STRING.SCAN("&clk", "*", 0)==0)
  (
    &wild_head=1
  )
  if (STRING.SCAN("&clk", "*", 1)==(STRING.LENGTH("&clk")-1))
  (
    &wild_tail=1
  )

  if ((&wild_head==1)&&(&wild_tail==1))
  (
    if (STRING.SCAN("mmss_gcc_dbg_clk", STRING.MID("&clk", 1, &clk_input_length-2), 0)!=-1)
    ( 
      &match=1
    )
  )
  else if (&wild_head==1)
  (
    if (STRING.MID("mmss_gcc_dbg_clk", &clk_itr_length-&clk_input_length+1, &clk_input_length-1)==STRING.CUT("&clk", 1))
    ( 
      &match=1
    )
  )
  else if (&wild_tail==1)
  (
    if (STRING.MID("mmss_gcc_dbg_clk", 0, &clk_input_length-1)==STRING.CUT("&clk", -1))
    ( 
      &match=1
    )
  )
  else if ("mmss_gcc_dbg_clk"=="&clk")
  (
    &match=1
  )
  
  if (&match==1)
  (
    &clk_test=&CLK_TEST_MMSS_GCC_DBG_CLK
    &clk_reg=0
    &clk_reg_name="No CBCR"
    &clk_name="mmss_gcc_dbg_clk"
    &clk_reg_cbcr_type=""
    &clk_vote_bit=-1.
    &clk_multiplier=4.

    gosub Print_Clk_Info_Line
  )

  &match=0
  &wild_head=0
  &wild_tail=0
  &clk_input_length=STRING.LENGTH("&clk")
  &clk_itr_length=STRING.LENGTH("mpm_gcc_temp0_sensor_ringosc_clk")

  if (STRING.SCAN("&clk", "*", 0)==0)
  (
    &wild_head=1
  )
  if (STRING.SCAN("&clk", "*", 1)==(STRING.LENGTH("&clk")-1))
  (
    &wild_tail=1
  )

  if ((&wild_head==1)&&(&wild_tail==1))
  (
    if (STRING.SCAN("mpm_gcc_temp0_sensor_ringosc_clk", STRING.MID("&clk", 1, &clk_input_length-2), 0)!=-1)
    ( 
      &match=1
    )
  )
  else if (&wild_head==1)
  (
    if (STRING.MID("mpm_gcc_temp0_sensor_ringosc_clk", &clk_itr_length-&clk_input_length+1, &clk_input_length-1)==STRING.CUT("&clk", 1))
    ( 
      &match=1
    )
  )
  else if (&wild_tail==1)
  (
    if (STRING.MID("mpm_gcc_temp0_sensor_ringosc_clk", 0, &clk_input_length-1)==STRING.CUT("&clk", -1))
    ( 
      &match=1
    )
  )
  else if ("mpm_gcc_temp0_sensor_ringosc_clk"=="&clk")
  (
    &match=1
  )
  
  if (&match==1)
  (
    &clk_test=&CLK_TEST_MPM_GCC_TEMP0_SENSOR_RINGOSC_CLK
    &clk_reg=0
    &clk_reg_name="No CBCR"
    &clk_name="mpm_gcc_temp0_sensor_ringosc_clk"
    &clk_reg_cbcr_type=""
    &clk_vote_bit=-1.
    &clk_multiplier=4.

    gosub Print_Clk_Info_Line
  )

  &match=0
  &wild_head=0
  &wild_tail=0
  &clk_input_length=STRING.LENGTH("&clk")
  &clk_itr_length=STRING.LENGTH("mpm_gcc_temp1_sensor_ringosc_clk")

  if (STRING.SCAN("&clk", "*", 0)==0)
  (
    &wild_head=1
  )
  if (STRING.SCAN("&clk", "*", 1)==(STRING.LENGTH("&clk")-1))
  (
    &wild_tail=1
  )

  if ((&wild_head==1)&&(&wild_tail==1))
  (
    if (STRING.SCAN("mpm_gcc_temp1_sensor_ringosc_clk", STRING.MID("&clk", 1, &clk_input_length-2), 0)!=-1)
    ( 
      &match=1
    )
  )
  else if (&wild_head==1)
  (
    if (STRING.MID("mpm_gcc_temp1_sensor_ringosc_clk", &clk_itr_length-&clk_input_length+1, &clk_input_length-1)==STRING.CUT("&clk", 1))
    ( 
      &match=1
    )
  )
  else if (&wild_tail==1)
  (
    if (STRING.MID("mpm_gcc_temp1_sensor_ringosc_clk", 0, &clk_input_length-1)==STRING.CUT("&clk", -1))
    ( 
      &match=1
    )
  )
  else if ("mpm_gcc_temp1_sensor_ringosc_clk"=="&clk")
  (
    &match=1
  )
  
  if (&match==1)
  (
    &clk_test=&CLK_TEST_MPM_GCC_TEMP1_SENSOR_RINGOSC_CLK
    &clk_reg=0
    &clk_reg_name="No CBCR"
    &clk_name="mpm_gcc_temp1_sensor_ringosc_clk"
    &clk_reg_cbcr_type=""
    &clk_vote_bit=-1.
    &clk_multiplier=4.

    gosub Print_Clk_Info_Line
  )

  &match=0
  &wild_head=0
  &wild_tail=0
  &clk_input_length=STRING.LENGTH("&clk")
  &clk_itr_length=STRING.LENGTH("mss_gcc_dbg_clk")

  if (STRING.SCAN("&clk", "*", 0)==0)
  (
    &wild_head=1
  )
  if (STRING.SCAN("&clk", "*", 1)==(STRING.LENGTH("&clk")-1))
  (
    &wild_tail=1
  )

  if ((&wild_head==1)&&(&wild_tail==1))
  (
    if (STRING.SCAN("mss_gcc_dbg_clk", STRING.MID("&clk", 1, &clk_input_length-2), 0)!=-1)
    ( 
      &match=1
    )
  )
  else if (&wild_head==1)
  (
    if (STRING.MID("mss_gcc_dbg_clk", &clk_itr_length-&clk_input_length+1, &clk_input_length-1)==STRING.CUT("&clk", 1))
    ( 
      &match=1
    )
  )
  else if (&wild_tail==1)
  (
    if (STRING.MID("mss_gcc_dbg_clk", 0, &clk_input_length-1)==STRING.CUT("&clk", -1))
    ( 
      &match=1
    )
  )
  else if ("mss_gcc_dbg_clk"=="&clk")
  (
    &match=1
  )
  
  if (&match==1)
  (
    &clk_test=&CLK_TEST_MSS_GCC_DBG_CLK
    &clk_reg=0
    &clk_reg_name="No CBCR"
    &clk_name="mss_gcc_dbg_clk"
    &clk_reg_cbcr_type=""
    &clk_vote_bit=-1.
    &clk_multiplier=4.

    gosub Print_Clk_Info_Line
  )

  &match=0
  &wild_head=0
  &wild_tail=0
  &clk_input_length=STRING.LENGTH("&clk")
  &clk_itr_length=STRING.LENGTH("nav_gcc_dbg_clk")

  if (STRING.SCAN("&clk", "*", 0)==0)
  (
    &wild_head=1
  )
  if (STRING.SCAN("&clk", "*", 1)==(STRING.LENGTH("&clk")-1))
  (
    &wild_tail=1
  )

  if ((&wild_head==1)&&(&wild_tail==1))
  (
    if (STRING.SCAN("nav_gcc_dbg_clk", STRING.MID("&clk", 1, &clk_input_length-2), 0)!=-1)
    ( 
      &match=1
    )
  )
  else if (&wild_head==1)
  (
    if (STRING.MID("nav_gcc_dbg_clk", &clk_itr_length-&clk_input_length+1, &clk_input_length-1)==STRING.CUT("&clk", 1))
    ( 
      &match=1
    )
  )
  else if (&wild_tail==1)
  (
    if (STRING.MID("nav_gcc_dbg_clk", 0, &clk_input_length-1)==STRING.CUT("&clk", -1))
    ( 
      &match=1
    )
  )
  else if ("nav_gcc_dbg_clk"=="&clk")
  (
    &match=1
  )
  
  if (&match==1)
  (
    &clk_test=&CLK_TEST_NAV_GCC_DBG_CLK
    &clk_reg=0
    &clk_reg_name="No CBCR"
    &clk_name="nav_gcc_dbg_clk"
    &clk_reg_cbcr_type=""
    &clk_vote_bit=-1.
    &clk_multiplier=4.

    gosub Print_Clk_Info_Line
  )

  &match=0
  &wild_head=0
  &wild_tail=0
  &clk_input_length=STRING.LENGTH("&clk")
  &clk_itr_length=STRING.LENGTH("pcie_0_pipe_clk")

  if (STRING.SCAN("&clk", "*", 0)==0)
  (
    &wild_head=1
  )
  if (STRING.SCAN("&clk", "*", 1)==(STRING.LENGTH("&clk")-1))
  (
    &wild_tail=1
  )

  if ((&wild_head==1)&&(&wild_tail==1))
  (
    if (STRING.SCAN("pcie_0_pipe_clk", STRING.MID("&clk", 1, &clk_input_length-2), 0)!=-1)
    ( 
      &match=1
    )
  )
  else if (&wild_head==1)
  (
    if (STRING.MID("pcie_0_pipe_clk", &clk_itr_length-&clk_input_length+1, &clk_input_length-1)==STRING.CUT("&clk", 1))
    ( 
      &match=1
    )
  )
  else if (&wild_tail==1)
  (
    if (STRING.MID("pcie_0_pipe_clk", 0, &clk_input_length-1)==STRING.CUT("&clk", -1))
    ( 
      &match=1
    )
  )
  else if ("pcie_0_pipe_clk"=="&clk")
  (
    &match=1
  )
  
  if (&match==1)
  (
    &clk_test=&CLK_TEST_PCIE_0_PIPE_CLK
    &clk_reg=0
    &clk_reg_name="No CBCR"
    &clk_name="pcie_0_pipe_clk"
    &clk_reg_cbcr_type=""
    &clk_vote_bit=-1.
    &clk_multiplier=4.

    gosub Print_Clk_Info_Line
  )

  &match=0
  &wild_head=0
  &wild_tail=0
  &clk_input_length=STRING.LENGTH("&clk")
  &clk_itr_length=STRING.LENGTH("qusb2phy_gcc_clk_test_prim")

  if (STRING.SCAN("&clk", "*", 0)==0)
  (
    &wild_head=1
  )
  if (STRING.SCAN("&clk", "*", 1)==(STRING.LENGTH("&clk")-1))
  (
    &wild_tail=1
  )

  if ((&wild_head==1)&&(&wild_tail==1))
  (
    if (STRING.SCAN("qusb2phy_gcc_clk_test_prim", STRING.MID("&clk", 1, &clk_input_length-2), 0)!=-1)
    ( 
      &match=1
    )
  )
  else if (&wild_head==1)
  (
    if (STRING.MID("qusb2phy_gcc_clk_test_prim", &clk_itr_length-&clk_input_length+1, &clk_input_length-1)==STRING.CUT("&clk", 1))
    ( 
      &match=1
    )
  )
  else if (&wild_tail==1)
  (
    if (STRING.MID("qusb2phy_gcc_clk_test_prim", 0, &clk_input_length-1)==STRING.CUT("&clk", -1))
    ( 
      &match=1
    )
  )
  else if ("qusb2phy_gcc_clk_test_prim"=="&clk")
  (
    &match=1
  )
  
  if (&match==1)
  (
    &clk_test=&CLK_TEST_QUSB2PHY_GCC_CLK_TEST_PRIM
    &clk_reg=0
    &clk_reg_name="No CBCR"
    &clk_name="qusb2phy_gcc_clk_test_prim"
    &clk_reg_cbcr_type=""
    &clk_vote_bit=-1.
    &clk_multiplier=4.

    gosub Print_Clk_Info_Line
  )

  &match=0
  &wild_head=0
  &wild_tail=0
  &clk_input_length=STRING.LENGTH("&clk")
  &clk_itr_length=STRING.LENGTH("qusb2phy_prim_gcc_usb30_utmi_clk")

  if (STRING.SCAN("&clk", "*", 0)==0)
  (
    &wild_head=1
  )
  if (STRING.SCAN("&clk", "*", 1)==(STRING.LENGTH("&clk")-1))
  (
    &wild_tail=1
  )

  if ((&wild_head==1)&&(&wild_tail==1))
  (
    if (STRING.SCAN("qusb2phy_prim_gcc_usb30_utmi_clk", STRING.MID("&clk", 1, &clk_input_length-2), 0)!=-1)
    ( 
      &match=1
    )
  )
  else if (&wild_head==1)
  (
    if (STRING.MID("qusb2phy_prim_gcc_usb30_utmi_clk", &clk_itr_length-&clk_input_length+1, &clk_input_length-1)==STRING.CUT("&clk", 1))
    ( 
      &match=1
    )
  )
  else if (&wild_tail==1)
  (
    if (STRING.MID("qusb2phy_prim_gcc_usb30_utmi_clk", 0, &clk_input_length-1)==STRING.CUT("&clk", -1))
    ( 
      &match=1
    )
  )
  else if ("qusb2phy_prim_gcc_usb30_utmi_clk"=="&clk")
  (
    &match=1
  )
  
  if (&match==1)
  (
    &clk_test=&CLK_TEST_QUSB2PHY_PRIM_GCC_USB30_UTMI_CLK
    &clk_reg=0
    &clk_reg_name="No CBCR"
    &clk_name="qusb2phy_prim_gcc_usb30_utmi_clk"
    &clk_reg_cbcr_type=""
    &clk_vote_bit=-1.
    &clk_multiplier=4.

    gosub Print_Clk_Info_Line
  )

  &match=0
  &wild_head=0
  &wild_tail=0
  &clk_input_length=STRING.LENGTH("&clk")
  &clk_itr_length=STRING.LENGTH("spss_gcc_dbg_clk")

  if (STRING.SCAN("&clk", "*", 0)==0)
  (
    &wild_head=1
  )
  if (STRING.SCAN("&clk", "*", 1)==(STRING.LENGTH("&clk")-1))
  (
    &wild_tail=1
  )

  if ((&wild_head==1)&&(&wild_tail==1))
  (
    if (STRING.SCAN("spss_gcc_dbg_clk", STRING.MID("&clk", 1, &clk_input_length-2), 0)!=-1)
    ( 
      &match=1
    )
  )
  else if (&wild_head==1)
  (
    if (STRING.MID("spss_gcc_dbg_clk", &clk_itr_length-&clk_input_length+1, &clk_input_length-1)==STRING.CUT("&clk", 1))
    ( 
      &match=1
    )
  )
  else if (&wild_tail==1)
  (
    if (STRING.MID("spss_gcc_dbg_clk", 0, &clk_input_length-1)==STRING.CUT("&clk", -1))
    ( 
      &match=1
    )
  )
  else if ("spss_gcc_dbg_clk"=="&clk")
  (
    &match=1
  )
  
  if (&match==1)
  (
    &clk_test=&CLK_TEST_SPSS_GCC_DBG_CLK
    &clk_reg=0
    &clk_reg_name="No CBCR"
    &clk_name="spss_gcc_dbg_clk"
    &clk_reg_cbcr_type=""
    &clk_vote_bit=-1.
    &clk_multiplier=4.

    gosub Print_Clk_Info_Line
  )

  &match=0
  &wild_head=0
  &wild_tail=0
  &clk_input_length=STRING.LENGTH("&clk")
  &clk_itr_length=STRING.LENGTH("ssc_gcc_dbg_clk")

  if (STRING.SCAN("&clk", "*", 0)==0)
  (
    &wild_head=1
  )
  if (STRING.SCAN("&clk", "*", 1)==(STRING.LENGTH("&clk")-1))
  (
    &wild_tail=1
  )

  if ((&wild_head==1)&&(&wild_tail==1))
  (
    if (STRING.SCAN("ssc_gcc_dbg_clk", STRING.MID("&clk", 1, &clk_input_length-2), 0)!=-1)
    ( 
      &match=1
    )
  )
  else if (&wild_head==1)
  (
    if (STRING.MID("ssc_gcc_dbg_clk", &clk_itr_length-&clk_input_length+1, &clk_input_length-1)==STRING.CUT("&clk", 1))
    ( 
      &match=1
    )
  )
  else if (&wild_tail==1)
  (
    if (STRING.MID("ssc_gcc_dbg_clk", 0, &clk_input_length-1)==STRING.CUT("&clk", -1))
    ( 
      &match=1
    )
  )
  else if ("ssc_gcc_dbg_clk"=="&clk")
  (
    &match=1
  )
  
  if (&match==1)
  (
    &clk_test=&CLK_TEST_SSC_GCC_DBG_CLK
    &clk_reg=0
    &clk_reg_name="No CBCR"
    &clk_name="ssc_gcc_dbg_clk"
    &clk_reg_cbcr_type=""
    &clk_vote_bit=-1.
    &clk_multiplier=4.

    gosub Print_Clk_Info_Line
  )

  &match=0
  &wild_head=0
  &wild_tail=0
  &clk_input_length=STRING.LENGTH("&clk")
  &clk_itr_length=STRING.LENGTH("ufs_rx_symbol_0_clk")

  if (STRING.SCAN("&clk", "*", 0)==0)
  (
    &wild_head=1
  )
  if (STRING.SCAN("&clk", "*", 1)==(STRING.LENGTH("&clk")-1))
  (
    &wild_tail=1
  )

  if ((&wild_head==1)&&(&wild_tail==1))
  (
    if (STRING.SCAN("ufs_rx_symbol_0_clk", STRING.MID("&clk", 1, &clk_input_length-2), 0)!=-1)
    ( 
      &match=1
    )
  )
  else if (&wild_head==1)
  (
    if (STRING.MID("ufs_rx_symbol_0_clk", &clk_itr_length-&clk_input_length+1, &clk_input_length-1)==STRING.CUT("&clk", 1))
    ( 
      &match=1
    )
  )
  else if (&wild_tail==1)
  (
    if (STRING.MID("ufs_rx_symbol_0_clk", 0, &clk_input_length-1)==STRING.CUT("&clk", -1))
    ( 
      &match=1
    )
  )
  else if ("ufs_rx_symbol_0_clk"=="&clk")
  (
    &match=1
  )
  
  if (&match==1)
  (
    &clk_test=&CLK_TEST_UFS_RX_SYMBOL_0_CLK
    &clk_reg=0
    &clk_reg_name="No CBCR"
    &clk_name="ufs_rx_symbol_0_clk"
    &clk_reg_cbcr_type=""
    &clk_vote_bit=-1.
    &clk_multiplier=4.

    gosub Print_Clk_Info_Line
  )

  &match=0
  &wild_head=0
  &wild_tail=0
  &clk_input_length=STRING.LENGTH("&clk")
  &clk_itr_length=STRING.LENGTH("ufs_rx_symbol_1_clk")

  if (STRING.SCAN("&clk", "*", 0)==0)
  (
    &wild_head=1
  )
  if (STRING.SCAN("&clk", "*", 1)==(STRING.LENGTH("&clk")-1))
  (
    &wild_tail=1
  )

  if ((&wild_head==1)&&(&wild_tail==1))
  (
    if (STRING.SCAN("ufs_rx_symbol_1_clk", STRING.MID("&clk", 1, &clk_input_length-2), 0)!=-1)
    ( 
      &match=1
    )
  )
  else if (&wild_head==1)
  (
    if (STRING.MID("ufs_rx_symbol_1_clk", &clk_itr_length-&clk_input_length+1, &clk_input_length-1)==STRING.CUT("&clk", 1))
    ( 
      &match=1
    )
  )
  else if (&wild_tail==1)
  (
    if (STRING.MID("ufs_rx_symbol_1_clk", 0, &clk_input_length-1)==STRING.CUT("&clk", -1))
    ( 
      &match=1
    )
  )
  else if ("ufs_rx_symbol_1_clk"=="&clk")
  (
    &match=1
  )
  
  if (&match==1)
  (
    &clk_test=&CLK_TEST_UFS_RX_SYMBOL_1_CLK
    &clk_reg=0
    &clk_reg_name="No CBCR"
    &clk_name="ufs_rx_symbol_1_clk"
    &clk_reg_cbcr_type=""
    &clk_vote_bit=-1.
    &clk_multiplier=4.

    gosub Print_Clk_Info_Line
  )

  &match=0
  &wild_head=0
  &wild_tail=0
  &clk_input_length=STRING.LENGTH("&clk")
  &clk_itr_length=STRING.LENGTH("ufs_tx_symbol_0_clk")

  if (STRING.SCAN("&clk", "*", 0)==0)
  (
    &wild_head=1
  )
  if (STRING.SCAN("&clk", "*", 1)==(STRING.LENGTH("&clk")-1))
  (
    &wild_tail=1
  )

  if ((&wild_head==1)&&(&wild_tail==1))
  (
    if (STRING.SCAN("ufs_tx_symbol_0_clk", STRING.MID("&clk", 1, &clk_input_length-2), 0)!=-1)
    ( 
      &match=1
    )
  )
  else if (&wild_head==1)
  (
    if (STRING.MID("ufs_tx_symbol_0_clk", &clk_itr_length-&clk_input_length+1, &clk_input_length-1)==STRING.CUT("&clk", 1))
    ( 
      &match=1
    )
  )
  else if (&wild_tail==1)
  (
    if (STRING.MID("ufs_tx_symbol_0_clk", 0, &clk_input_length-1)==STRING.CUT("&clk", -1))
    ( 
      &match=1
    )
  )
  else if ("ufs_tx_symbol_0_clk"=="&clk")
  (
    &match=1
  )
  
  if (&match==1)
  (
    &clk_test=&CLK_TEST_UFS_TX_SYMBOL_0_CLK
    &clk_reg=0
    &clk_reg_name="No CBCR"
    &clk_name="ufs_tx_symbol_0_clk"
    &clk_reg_cbcr_type=""
    &clk_vote_bit=-1.
    &clk_multiplier=4.

    gosub Print_Clk_Info_Line
  )

  &match=0
  &wild_head=0
  &wild_tail=0
  &clk_input_length=STRING.LENGTH("&clk")
  &clk_itr_length=STRING.LENGTH("usb3_phy_wrapper_gcc_usb3_pipe_clk")

  if (STRING.SCAN("&clk", "*", 0)==0)
  (
    &wild_head=1
  )
  if (STRING.SCAN("&clk", "*", 1)==(STRING.LENGTH("&clk")-1))
  (
    &wild_tail=1
  )

  if ((&wild_head==1)&&(&wild_tail==1))
  (
    if (STRING.SCAN("usb3_phy_wrapper_gcc_usb3_pipe_clk", STRING.MID("&clk", 1, &clk_input_length-2), 0)!=-1)
    ( 
      &match=1
    )
  )
  else if (&wild_head==1)
  (
    if (STRING.MID("usb3_phy_wrapper_gcc_usb3_pipe_clk", &clk_itr_length-&clk_input_length+1, &clk_input_length-1)==STRING.CUT("&clk", 1))
    ( 
      &match=1
    )
  )
  else if (&wild_tail==1)
  (
    if (STRING.MID("usb3_phy_wrapper_gcc_usb3_pipe_clk", 0, &clk_input_length-1)==STRING.CUT("&clk", -1))
    ( 
      &match=1
    )
  )
  else if ("usb3_phy_wrapper_gcc_usb3_pipe_clk"=="&clk")
  (
    &match=1
  )
  
  if (&match==1)
  (
    &clk_test=&CLK_TEST_USB3_PHY_WRAPPER_GCC_USB3_PIPE_CLK
    &clk_reg=0
    &clk_reg_name="No CBCR"
    &clk_name="usb3_phy_wrapper_gcc_usb3_pipe_clk"
    &clk_reg_cbcr_type=""
    &clk_vote_bit=-1.
    &clk_multiplier=4.

    gosub Print_Clk_Info_Line
  )

  &match=0
  &wild_head=0
  &wild_tail=0
  &clk_input_length=STRING.LENGTH("&clk")
  &clk_itr_length=STRING.LENGTH("wcss_gcc_dbg_clk")

  if (STRING.SCAN("&clk", "*", 0)==0)
  (
    &wild_head=1
  )
  if (STRING.SCAN("&clk", "*", 1)==(STRING.LENGTH("&clk")-1))
  (
    &wild_tail=1
  )

  if ((&wild_head==1)&&(&wild_tail==1))
  (
    if (STRING.SCAN("wcss_gcc_dbg_clk", STRING.MID("&clk", 1, &clk_input_length-2), 0)!=-1)
    ( 
      &match=1
    )
  )
  else if (&wild_head==1)
  (
    if (STRING.MID("wcss_gcc_dbg_clk", &clk_itr_length-&clk_input_length+1, &clk_input_length-1)==STRING.CUT("&clk", 1))
    ( 
      &match=1
    )
  )
  else if (&wild_tail==1)
  (
    if (STRING.MID("wcss_gcc_dbg_clk", 0, &clk_input_length-1)==STRING.CUT("&clk", -1))
    ( 
      &match=1
    )
  )
  else if ("wcss_gcc_dbg_clk"=="&clk")
  (
    &match=1
  )
  
  if (&match==1)
  (
    &clk_test=&CLK_TEST_WCSS_GCC_DBG_CLK
    &clk_reg=0
    &clk_reg_name="No CBCR"
    &clk_name="wcss_gcc_dbg_clk"
    &clk_reg_cbcr_type=""
    &clk_vote_bit=-1.
    &clk_multiplier=4.

    gosub Print_Clk_Info_Line
  )

  &match=0
  &wild_head=0
  &wild_tail=0
  &clk_input_length=STRING.LENGTH("&clk")
  &clk_itr_length=STRING.LENGTH("clk_src_bit_coxm_mnd")

  if (STRING.SCAN("&clk", "*", 0)==0)
  (
    &wild_head=1
  )
  if (STRING.SCAN("&clk", "*", 1)==(STRING.LENGTH("&clk")-1))
  (
    &wild_tail=1
  )

  if ((&wild_head==1)&&(&wild_tail==1))
  (
    if (STRING.SCAN("clk_src_bit_coxm_mnd", STRING.MID("&clk", 1, &clk_input_length-2), 0)!=-1)
    ( 
      &match=1
    )
  )
  else if (&wild_head==1)
  (
    if (STRING.MID("clk_src_bit_coxm_mnd", &clk_itr_length-&clk_input_length+1, &clk_input_length-1)==STRING.CUT("&clk", 1))
    ( 
      &match=1
    )
  )
  else if (&wild_tail==1)
  (
    if (STRING.MID("clk_src_bit_coxm_mnd", 0, &clk_input_length-1)==STRING.CUT("&clk", -1))
    ( 
      &match=1
    )
  )
  else if ("clk_src_bit_coxm_mnd"=="&clk")
  (
    &match=1
  )
  
  if (&match==1)
  (
    &clk_test=&CLK_TEST_CLK_SRC_BIT_COXM_MND
    &clk_reg=0
    &clk_reg_name="No CBCR"
    &clk_name="clk_src_bit_coxm_mnd"
    &clk_reg_cbcr_type=""
    &clk_vote_bit=-1.
    &clk_multiplier=4.

    gosub Print_Clk_Info_Line
  )

  &match=0
  &wild_head=0
  &wild_tail=0
  &clk_input_length=STRING.LENGTH("&clk")
  &clk_itr_length=STRING.LENGTH("clk_bit_coxm")

  if (STRING.SCAN("&clk", "*", 0)==0)
  (
    &wild_head=1
  )
  if (STRING.SCAN("&clk", "*", 1)==(STRING.LENGTH("&clk")-1))
  (
    &wild_tail=1
  )

  if ((&wild_head==1)&&(&wild_tail==1))
  (
    if (STRING.SCAN("clk_bit_coxm", STRING.MID("&clk", 1, &clk_input_length-2), 0)!=-1)
    ( 
      &match=1
    )
  )
  else if (&wild_head==1)
  (
    if (STRING.MID("clk_bit_coxm", &clk_itr_length-&clk_input_length+1, &clk_input_length-1)==STRING.CUT("&clk", 1))
    ( 
      &match=1
    )
  )
  else if (&wild_tail==1)
  (
    if (STRING.MID("clk_bit_coxm", 0, &clk_input_length-1)==STRING.CUT("&clk", -1))
    ( 
      &match=1
    )
  )
  else if ("clk_bit_coxm"=="&clk")
  (
    &match=1
  )
  
  if (&match==1)
  (
    &clk_test=&CLK_TEST_CLK_BIT_COXM
    &clk_reg=&HWIO_MSS_BIT_COXM_CBCR_ADDR
    &clk_reg_name="MSS_BIT_COXM_CBCR"
    &clk_name="clk_bit_coxm"
    &clk_reg_cbcr_type="sm_cbc"
    &clk_vote_bit=-1.
    &clk_multiplier=4.

    gosub Print_Clk_Info_Line
  )

  &match=0
  &wild_head=0
  &wild_tail=0
  &clk_input_length=STRING.LENGTH("&clk")
  &clk_itr_length=STRING.LENGTH("clk_src_bus_mss_config")

  if (STRING.SCAN("&clk", "*", 0)==0)
  (
    &wild_head=1
  )
  if (STRING.SCAN("&clk", "*", 1)==(STRING.LENGTH("&clk")-1))
  (
    &wild_tail=1
  )

  if ((&wild_head==1)&&(&wild_tail==1))
  (
    if (STRING.SCAN("clk_src_bus_mss_config", STRING.MID("&clk", 1, &clk_input_length-2), 0)!=-1)
    ( 
      &match=1
    )
  )
  else if (&wild_head==1)
  (
    if (STRING.MID("clk_src_bus_mss_config", &clk_itr_length-&clk_input_length+1, &clk_input_length-1)==STRING.CUT("&clk", 1))
    ( 
      &match=1
    )
  )
  else if (&wild_tail==1)
  (
    if (STRING.MID("clk_src_bus_mss_config", 0, &clk_input_length-1)==STRING.CUT("&clk", -1))
    ( 
      &match=1
    )
  )
  else if ("clk_src_bus_mss_config"=="&clk")
  (
    &match=1
  )
  
  if (&match==1)
  (
    &clk_test=&CLK_TEST_CLK_SRC_BUS_MSS_CONFIG
    &clk_reg=0
    &clk_reg_name="No CBCR"
    &clk_name="clk_src_bus_mss_config"
    &clk_reg_cbcr_type=""
    &clk_vote_bit=-1.
    &clk_multiplier=4.

    gosub Print_Clk_Info_Line
  )

  &match=0
  &wild_head=0
  &wild_tail=0
  &clk_input_length=STRING.LENGTH("&clk")
  &clk_itr_length=STRING.LENGTH("clk_bus_config")

  if (STRING.SCAN("&clk", "*", 0)==0)
  (
    &wild_head=1
  )
  if (STRING.SCAN("&clk", "*", 1)==(STRING.LENGTH("&clk")-1))
  (
    &wild_tail=1
  )

  if ((&wild_head==1)&&(&wild_tail==1))
  (
    if (STRING.SCAN("clk_bus_config", STRING.MID("&clk", 1, &clk_input_length-2), 0)!=-1)
    ( 
      &match=1
    )
  )
  else if (&wild_head==1)
  (
    if (STRING.MID("clk_bus_config", &clk_itr_length-&clk_input_length+1, &clk_input_length-1)==STRING.CUT("&clk", 1))
    ( 
      &match=1
    )
  )
  else if (&wild_tail==1)
  (
    if (STRING.MID("clk_bus_config", 0, &clk_input_length-1)==STRING.CUT("&clk", -1))
    ( 
      &match=1
    )
  )
  else if ("clk_bus_config"=="&clk")
  (
    &match=1
  )
  
  if (&match==1)
  (
    &clk_test=&CLK_TEST_CLK_BUS_CONFIG
    &clk_reg=0
    &clk_reg_name="No CBCR"
    &clk_name="clk_bus_config"
    &clk_reg_cbcr_type=""
    &clk_vote_bit=-1.
    &clk_multiplier=4.

    gosub Print_Clk_Info_Line
  )

  &match=0
  &wild_head=0
  &wild_tail=0
  &clk_input_length=STRING.LENGTH("&clk")
  &clk_itr_length=STRING.LENGTH("clk_bus_coxm")

  if (STRING.SCAN("&clk", "*", 0)==0)
  (
    &wild_head=1
  )
  if (STRING.SCAN("&clk", "*", 1)==(STRING.LENGTH("&clk")-1))
  (
    &wild_tail=1
  )

  if ((&wild_head==1)&&(&wild_tail==1))
  (
    if (STRING.SCAN("clk_bus_coxm", STRING.MID("&clk", 1, &clk_input_length-2), 0)!=-1)
    ( 
      &match=1
    )
  )
  else if (&wild_head==1)
  (
    if (STRING.MID("clk_bus_coxm", &clk_itr_length-&clk_input_length+1, &clk_input_length-1)==STRING.CUT("&clk", 1))
    ( 
      &match=1
    )
  )
  else if (&wild_tail==1)
  (
    if (STRING.MID("clk_bus_coxm", 0, &clk_input_length-1)==STRING.CUT("&clk", -1))
    ( 
      &match=1
    )
  )
  else if ("clk_bus_coxm"=="&clk")
  (
    &match=1
  )
  
  if (&match==1)
  (
    &clk_test=&CLK_TEST_CLK_BUS_COXM
    &clk_reg=&HWIO_MSS_BUS_COXM_CBCR_ADDR
    &clk_reg_name="MSS_BUS_COXM_CBCR"
    &clk_name="clk_bus_coxm"
    &clk_reg_cbcr_type="sm_cbc"
    &clk_vote_bit=-1.
    &clk_multiplier=4.

    gosub Print_Clk_Info_Line
  )

  &match=0
  &wild_head=0
  &wild_tail=0
  &clk_input_length=STRING.LENGTH("&clk")
  &clk_itr_length=STRING.LENGTH("clk_bus_crypto")

  if (STRING.SCAN("&clk", "*", 0)==0)
  (
    &wild_head=1
  )
  if (STRING.SCAN("&clk", "*", 1)==(STRING.LENGTH("&clk")-1))
  (
    &wild_tail=1
  )

  if ((&wild_head==1)&&(&wild_tail==1))
  (
    if (STRING.SCAN("clk_bus_crypto", STRING.MID("&clk", 1, &clk_input_length-2), 0)!=-1)
    ( 
      &match=1
    )
  )
  else if (&wild_head==1)
  (
    if (STRING.MID("clk_bus_crypto", &clk_itr_length-&clk_input_length+1, &clk_input_length-1)==STRING.CUT("&clk", 1))
    ( 
      &match=1
    )
  )
  else if (&wild_tail==1)
  (
    if (STRING.MID("clk_bus_crypto", 0, &clk_input_length-1)==STRING.CUT("&clk", -1))
    ( 
      &match=1
    )
  )
  else if ("clk_bus_crypto"=="&clk")
  (
    &match=1
  )
  
  if (&match==1)
  (
    &clk_test=&CLK_TEST_CLK_BUS_CRYPTO
    &clk_reg=&HWIO_MSS_BUS_CRYPTO_CBCR_ADDR
    &clk_reg_name="MSS_BUS_CRYPTO_CBCR"
    &clk_name="clk_bus_crypto"
    &clk_reg_cbcr_type="sm_cbc"
    &clk_vote_bit=-1.
    &clk_multiplier=4.

    gosub Print_Clk_Info_Line
  )

  &match=0
  &wild_head=0
  &wild_tail=0
  &clk_input_length=STRING.LENGTH("&clk")
  &clk_itr_length=STRING.LENGTH("clk_bus_mgpi")

  if (STRING.SCAN("&clk", "*", 0)==0)
  (
    &wild_head=1
  )
  if (STRING.SCAN("&clk", "*", 1)==(STRING.LENGTH("&clk")-1))
  (
    &wild_tail=1
  )

  if ((&wild_head==1)&&(&wild_tail==1))
  (
    if (STRING.SCAN("clk_bus_mgpi", STRING.MID("&clk", 1, &clk_input_length-2), 0)!=-1)
    ( 
      &match=1
    )
  )
  else if (&wild_head==1)
  (
    if (STRING.MID("clk_bus_mgpi", &clk_itr_length-&clk_input_length+1, &clk_input_length-1)==STRING.CUT("&clk", 1))
    ( 
      &match=1
    )
  )
  else if (&wild_tail==1)
  (
    if (STRING.MID("clk_bus_mgpi", 0, &clk_input_length-1)==STRING.CUT("&clk", -1))
    ( 
      &match=1
    )
  )
  else if ("clk_bus_mgpi"=="&clk")
  (
    &match=1
  )
  
  if (&match==1)
  (
    &clk_test=&CLK_TEST_CLK_BUS_MGPI
    &clk_reg=&HWIO_MSS_BUS_MGPI_CBCR_ADDR
    &clk_reg_name="MSS_BUS_MGPI_CBCR"
    &clk_name="clk_bus_mgpi"
    &clk_reg_cbcr_type="sm_cbc"
    &clk_vote_bit=-1.
    &clk_multiplier=4.

    gosub Print_Clk_Info_Line
  )

  &match=0
  &wild_head=0
  &wild_tail=0
  &clk_input_length=STRING.LENGTH("&clk")
  &clk_itr_length=STRING.LENGTH("clk_bus_mvc")

  if (STRING.SCAN("&clk", "*", 0)==0)
  (
    &wild_head=1
  )
  if (STRING.SCAN("&clk", "*", 1)==(STRING.LENGTH("&clk")-1))
  (
    &wild_tail=1
  )

  if ((&wild_head==1)&&(&wild_tail==1))
  (
    if (STRING.SCAN("clk_bus_mvc", STRING.MID("&clk", 1, &clk_input_length-2), 0)!=-1)
    ( 
      &match=1
    )
  )
  else if (&wild_head==1)
  (
    if (STRING.MID("clk_bus_mvc", &clk_itr_length-&clk_input_length+1, &clk_input_length-1)==STRING.CUT("&clk", 1))
    ( 
      &match=1
    )
  )
  else if (&wild_tail==1)
  (
    if (STRING.MID("clk_bus_mvc", 0, &clk_input_length-1)==STRING.CUT("&clk", -1))
    ( 
      &match=1
    )
  )
  else if ("clk_bus_mvc"=="&clk")
  (
    &match=1
  )
  
  if (&match==1)
  (
    &clk_test=&CLK_TEST_CLK_BUS_MVC
    &clk_reg=0
    &clk_reg_name="No CBCR"
    &clk_name="clk_bus_mvc"
    &clk_reg_cbcr_type=""
    &clk_vote_bit=-1.
    &clk_multiplier=4.

    gosub Print_Clk_Info_Line
  )

  &match=0
  &wild_head=0
  &wild_tail=0
  &clk_input_length=STRING.LENGTH("&clk")
  &clk_itr_length=STRING.LENGTH("clk_bus_nav")

  if (STRING.SCAN("&clk", "*", 0)==0)
  (
    &wild_head=1
  )
  if (STRING.SCAN("&clk", "*", 1)==(STRING.LENGTH("&clk")-1))
  (
    &wild_tail=1
  )

  if ((&wild_head==1)&&(&wild_tail==1))
  (
    if (STRING.SCAN("clk_bus_nav", STRING.MID("&clk", 1, &clk_input_length-2), 0)!=-1)
    ( 
      &match=1
    )
  )
  else if (&wild_head==1)
  (
    if (STRING.MID("clk_bus_nav", &clk_itr_length-&clk_input_length+1, &clk_input_length-1)==STRING.CUT("&clk", 1))
    ( 
      &match=1
    )
  )
  else if (&wild_tail==1)
  (
    if (STRING.MID("clk_bus_nav", 0, &clk_input_length-1)==STRING.CUT("&clk", -1))
    ( 
      &match=1
    )
  )
  else if ("clk_bus_nav"=="&clk")
  (
    &match=1
  )
  
  if (&match==1)
  (
    &clk_test=&CLK_TEST_CLK_BUS_NAV
    &clk_reg=&HWIO_MSS_BUS_NAV_CBCR_ADDR
    &clk_reg_name="MSS_BUS_NAV_CBCR"
    &clk_name="clk_bus_nav"
    &clk_reg_cbcr_type="sm_cbc"
    &clk_vote_bit=-1.
    &clk_multiplier=4.

    gosub Print_Clk_Info_Line
  )

  &match=0
  &wild_head=0
  &wild_tail=0
  &clk_input_length=STRING.LENGTH("&clk")
  &clk_itr_length=STRING.LENGTH("clk_bus_pll_outctrl")

  if (STRING.SCAN("&clk", "*", 0)==0)
  (
    &wild_head=1
  )
  if (STRING.SCAN("&clk", "*", 1)==(STRING.LENGTH("&clk")-1))
  (
    &wild_tail=1
  )

  if ((&wild_head==1)&&(&wild_tail==1))
  (
    if (STRING.SCAN("clk_bus_pll_outctrl", STRING.MID("&clk", 1, &clk_input_length-2), 0)!=-1)
    ( 
      &match=1
    )
  )
  else if (&wild_head==1)
  (
    if (STRING.MID("clk_bus_pll_outctrl", &clk_itr_length-&clk_input_length+1, &clk_input_length-1)==STRING.CUT("&clk", 1))
    ( 
      &match=1
    )
  )
  else if (&wild_tail==1)
  (
    if (STRING.MID("clk_bus_pll_outctrl", 0, &clk_input_length-1)==STRING.CUT("&clk", -1))
    ( 
      &match=1
    )
  )
  else if ("clk_bus_pll_outctrl"=="&clk")
  (
    &match=1
  )
  
  if (&match==1)
  (
    &clk_test=&CLK_TEST_CLK_BUS_PLL_OUTCTRL
    &clk_reg=0
    &clk_reg_name="No CBCR"
    &clk_name="clk_bus_pll_outctrl"
    &clk_reg_cbcr_type=""
    &clk_vote_bit=-1.
    &clk_multiplier=4.

    gosub Print_Clk_Info_Line
  )

  &match=0
  &wild_head=0
  &wild_tail=0
  &clk_input_length=STRING.LENGTH("&clk")
  &clk_itr_length=STRING.LENGTH("clk_bus_q6")

  if (STRING.SCAN("&clk", "*", 0)==0)
  (
    &wild_head=1
  )
  if (STRING.SCAN("&clk", "*", 1)==(STRING.LENGTH("&clk")-1))
  (
    &wild_tail=1
  )

  if ((&wild_head==1)&&(&wild_tail==1))
  (
    if (STRING.SCAN("clk_bus_q6", STRING.MID("&clk", 1, &clk_input_length-2), 0)!=-1)
    ( 
      &match=1
    )
  )
  else if (&wild_head==1)
  (
    if (STRING.MID("clk_bus_q6", &clk_itr_length-&clk_input_length+1, &clk_input_length-1)==STRING.CUT("&clk", 1))
    ( 
      &match=1
    )
  )
  else if (&wild_tail==1)
  (
    if (STRING.MID("clk_bus_q6", 0, &clk_input_length-1)==STRING.CUT("&clk", -1))
    ( 
      &match=1
    )
  )
  else if ("clk_bus_q6"=="&clk")
  (
    &match=1
  )
  
  if (&match==1)
  (
    &clk_test=&CLK_TEST_CLK_BUS_Q6
    &clk_reg=0
    &clk_reg_name="No CBCR"
    &clk_name="clk_bus_q6"
    &clk_reg_cbcr_type=""
    &clk_vote_bit=-1.
    &clk_multiplier=4.

    gosub Print_Clk_Info_Line
  )

  &match=0
  &wild_head=0
  &wild_tail=0
  &clk_input_length=STRING.LENGTH("&clk")
  &clk_itr_length=STRING.LENGTH("clk_bus_rbcpr")

  if (STRING.SCAN("&clk", "*", 0)==0)
  (
    &wild_head=1
  )
  if (STRING.SCAN("&clk", "*", 1)==(STRING.LENGTH("&clk")-1))
  (
    &wild_tail=1
  )

  if ((&wild_head==1)&&(&wild_tail==1))
  (
    if (STRING.SCAN("clk_bus_rbcpr", STRING.MID("&clk", 1, &clk_input_length-2), 0)!=-1)
    ( 
      &match=1
    )
  )
  else if (&wild_head==1)
  (
    if (STRING.MID("clk_bus_rbcpr", &clk_itr_length-&clk_input_length+1, &clk_input_length-1)==STRING.CUT("&clk", 1))
    ( 
      &match=1
    )
  )
  else if (&wild_tail==1)
  (
    if (STRING.MID("clk_bus_rbcpr", 0, &clk_input_length-1)==STRING.CUT("&clk", -1))
    ( 
      &match=1
    )
  )
  else if ("clk_bus_rbcpr"=="&clk")
  (
    &match=1
  )
  
  if (&match==1)
  (
    &clk_test=&CLK_TEST_CLK_BUS_RBCPR
    &clk_reg=&HWIO_MSS_BUS_RBCPR_CBCR_ADDR
    &clk_reg_name="MSS_BUS_RBCPR_CBCR"
    &clk_name="clk_bus_rbcpr"
    &clk_reg_cbcr_type="sm_cbc"
    &clk_vote_bit=-1.
    &clk_multiplier=4.

    gosub Print_Clk_Info_Line
  )

  &match=0
  &wild_head=0
  &wild_tail=0
  &clk_input_length=STRING.LENGTH("&clk")
  &clk_itr_length=STRING.LENGTH("clk_bus_rfc")

  if (STRING.SCAN("&clk", "*", 0)==0)
  (
    &wild_head=1
  )
  if (STRING.SCAN("&clk", "*", 1)==(STRING.LENGTH("&clk")-1))
  (
    &wild_tail=1
  )

  if ((&wild_head==1)&&(&wild_tail==1))
  (
    if (STRING.SCAN("clk_bus_rfc", STRING.MID("&clk", 1, &clk_input_length-2), 0)!=-1)
    ( 
      &match=1
    )
  )
  else if (&wild_head==1)
  (
    if (STRING.MID("clk_bus_rfc", &clk_itr_length-&clk_input_length+1, &clk_input_length-1)==STRING.CUT("&clk", 1))
    ( 
      &match=1
    )
  )
  else if (&wild_tail==1)
  (
    if (STRING.MID("clk_bus_rfc", 0, &clk_input_length-1)==STRING.CUT("&clk", -1))
    ( 
      &match=1
    )
  )
  else if ("clk_bus_rfc"=="&clk")
  (
    &match=1
  )
  
  if (&match==1)
  (
    &clk_test=&CLK_TEST_CLK_BUS_RFC
    &clk_reg=&HWIO_MSS_BUS_RFC_CBCR_ADDR
    &clk_reg_name="MSS_BUS_RFC_CBCR"
    &clk_name="clk_bus_rfc"
    &clk_reg_cbcr_type="sm_cbc"
    &clk_vote_bit=-1.
    &clk_multiplier=4.

    gosub Print_Clk_Info_Line
  )

  &match=0
  &wild_head=0
  &wild_tail=0
  &clk_input_length=STRING.LENGTH("&clk")
  &clk_itr_length=STRING.LENGTH("clk_bus_slave_timeout")

  if (STRING.SCAN("&clk", "*", 0)==0)
  (
    &wild_head=1
  )
  if (STRING.SCAN("&clk", "*", 1)==(STRING.LENGTH("&clk")-1))
  (
    &wild_tail=1
  )

  if ((&wild_head==1)&&(&wild_tail==1))
  (
    if (STRING.SCAN("clk_bus_slave_timeout", STRING.MID("&clk", 1, &clk_input_length-2), 0)!=-1)
    ( 
      &match=1
    )
  )
  else if (&wild_head==1)
  (
    if (STRING.MID("clk_bus_slave_timeout", &clk_itr_length-&clk_input_length+1, &clk_input_length-1)==STRING.CUT("&clk", 1))
    ( 
      &match=1
    )
  )
  else if (&wild_tail==1)
  (
    if (STRING.MID("clk_bus_slave_timeout", 0, &clk_input_length-1)==STRING.CUT("&clk", -1))
    ( 
      &match=1
    )
  )
  else if ("clk_bus_slave_timeout"=="&clk")
  (
    &match=1
  )
  
  if (&match==1)
  (
    &clk_test=&CLK_TEST_CLK_BUS_SLAVE_TIMEOUT
    &clk_reg=&HWIO_MSS_BUS_SLAVE_TIMEOUT_CBCR_ADDR
    &clk_reg_name="MSS_BUS_SLAVE_TIMEOUT_CBCR"
    &clk_name="clk_bus_slave_timeout"
    &clk_reg_cbcr_type="sm_cbc"
    &clk_vote_bit=-1.
    &clk_multiplier=4.

    gosub Print_Clk_Info_Line
  )

  &match=0
  &wild_head=0
  &wild_tail=0
  &clk_input_length=STRING.LENGTH("&clk")
  &clk_itr_length=STRING.LENGTH("clk_bus_stmr")

  if (STRING.SCAN("&clk", "*", 0)==0)
  (
    &wild_head=1
  )
  if (STRING.SCAN("&clk", "*", 1)==(STRING.LENGTH("&clk")-1))
  (
    &wild_tail=1
  )

  if ((&wild_head==1)&&(&wild_tail==1))
  (
    if (STRING.SCAN("clk_bus_stmr", STRING.MID("&clk", 1, &clk_input_length-2), 0)!=-1)
    ( 
      &match=1
    )
  )
  else if (&wild_head==1)
  (
    if (STRING.MID("clk_bus_stmr", &clk_itr_length-&clk_input_length+1, &clk_input_length-1)==STRING.CUT("&clk", 1))
    ( 
      &match=1
    )
  )
  else if (&wild_tail==1)
  (
    if (STRING.MID("clk_bus_stmr", 0, &clk_input_length-1)==STRING.CUT("&clk", -1))
    ( 
      &match=1
    )
  )
  else if ("clk_bus_stmr"=="&clk")
  (
    &match=1
  )
  
  if (&match==1)
  (
    &clk_test=&CLK_TEST_CLK_BUS_STMR
    &clk_reg=&HWIO_MSS_BUS_STMR_CBCR_ADDR
    &clk_reg_name="MSS_BUS_STMR_CBCR"
    &clk_name="clk_bus_stmr"
    &clk_reg_cbcr_type="sm_cbc"
    &clk_vote_bit=-1.
    &clk_multiplier=4.

    gosub Print_Clk_Info_Line
  )

  &match=0
  &wild_head=0
  &wild_tail=0
  &clk_input_length=STRING.LENGTH("&clk")
  &clk_itr_length=STRING.LENGTH("clk_bus_uim0")

  if (STRING.SCAN("&clk", "*", 0)==0)
  (
    &wild_head=1
  )
  if (STRING.SCAN("&clk", "*", 1)==(STRING.LENGTH("&clk")-1))
  (
    &wild_tail=1
  )

  if ((&wild_head==1)&&(&wild_tail==1))
  (
    if (STRING.SCAN("clk_bus_uim0", STRING.MID("&clk", 1, &clk_input_length-2), 0)!=-1)
    ( 
      &match=1
    )
  )
  else if (&wild_head==1)
  (
    if (STRING.MID("clk_bus_uim0", &clk_itr_length-&clk_input_length+1, &clk_input_length-1)==STRING.CUT("&clk", 1))
    ( 
      &match=1
    )
  )
  else if (&wild_tail==1)
  (
    if (STRING.MID("clk_bus_uim0", 0, &clk_input_length-1)==STRING.CUT("&clk", -1))
    ( 
      &match=1
    )
  )
  else if ("clk_bus_uim0"=="&clk")
  (
    &match=1
  )
  
  if (&match==1)
  (
    &clk_test=&CLK_TEST_CLK_BUS_UIM0
    &clk_reg=&HWIO_MSS_BUS_UIM0_CBCR_ADDR
    &clk_reg_name="MSS_BUS_UIM0_CBCR"
    &clk_name="clk_bus_uim0"
    &clk_reg_cbcr_type="sm_cbc"
    &clk_vote_bit=-1.
    &clk_multiplier=4.

    gosub Print_Clk_Info_Line
  )

  &match=0
  &wild_head=0
  &wild_tail=0
  &clk_input_length=STRING.LENGTH("&clk")
  &clk_itr_length=STRING.LENGTH("clk_bus_uim1")

  if (STRING.SCAN("&clk", "*", 0)==0)
  (
    &wild_head=1
  )
  if (STRING.SCAN("&clk", "*", 1)==(STRING.LENGTH("&clk")-1))
  (
    &wild_tail=1
  )

  if ((&wild_head==1)&&(&wild_tail==1))
  (
    if (STRING.SCAN("clk_bus_uim1", STRING.MID("&clk", 1, &clk_input_length-2), 0)!=-1)
    ( 
      &match=1
    )
  )
  else if (&wild_head==1)
  (
    if (STRING.MID("clk_bus_uim1", &clk_itr_length-&clk_input_length+1, &clk_input_length-1)==STRING.CUT("&clk", 1))
    ( 
      &match=1
    )
  )
  else if (&wild_tail==1)
  (
    if (STRING.MID("clk_bus_uim1", 0, &clk_input_length-1)==STRING.CUT("&clk", -1))
    ( 
      &match=1
    )
  )
  else if ("clk_bus_uim1"=="&clk")
  (
    &match=1
  )
  
  if (&match==1)
  (
    &clk_test=&CLK_TEST_CLK_BUS_UIM1
    &clk_reg=&HWIO_MSS_BUS_UIM1_CBCR_ADDR
    &clk_reg_name="MSS_BUS_UIM1_CBCR"
    &clk_name="clk_bus_uim1"
    &clk_reg_cbcr_type="sm_cbc"
    &clk_vote_bit=-1.
    &clk_multiplier=4.

    gosub Print_Clk_Info_Line
  )

  &match=0
  &wild_head=0
  &wild_tail=0
  &clk_input_length=STRING.LENGTH("&clk")
  &clk_itr_length=STRING.LENGTH("clk_bus_uim2")

  if (STRING.SCAN("&clk", "*", 0)==0)
  (
    &wild_head=1
  )
  if (STRING.SCAN("&clk", "*", 1)==(STRING.LENGTH("&clk")-1))
  (
    &wild_tail=1
  )

  if ((&wild_head==1)&&(&wild_tail==1))
  (
    if (STRING.SCAN("clk_bus_uim2", STRING.MID("&clk", 1, &clk_input_length-2), 0)!=-1)
    ( 
      &match=1
    )
  )
  else if (&wild_head==1)
  (
    if (STRING.MID("clk_bus_uim2", &clk_itr_length-&clk_input_length+1, &clk_input_length-1)==STRING.CUT("&clk", 1))
    ( 
      &match=1
    )
  )
  else if (&wild_tail==1)
  (
    if (STRING.MID("clk_bus_uim2", 0, &clk_input_length-1)==STRING.CUT("&clk", -1))
    ( 
      &match=1
    )
  )
  else if ("clk_bus_uim2"=="&clk")
  (
    &match=1
  )
  
  if (&match==1)
  (
    &clk_test=&CLK_TEST_CLK_BUS_UIM2
    &clk_reg=&HWIO_MSS_BUS_UIM2_CBCR_ADDR
    &clk_reg_name="MSS_BUS_UIM2_CBCR"
    &clk_name="clk_bus_uim2"
    &clk_reg_cbcr_type="sm_cbc"
    &clk_vote_bit=-1.
    &clk_multiplier=4.

    gosub Print_Clk_Info_Line
  )

  &match=0
  &wild_head=0
  &wild_tail=0
  &clk_input_length=STRING.LENGTH("&clk")
  &clk_itr_length=STRING.LENGTH("clk_bus_uim3")

  if (STRING.SCAN("&clk", "*", 0)==0)
  (
    &wild_head=1
  )
  if (STRING.SCAN("&clk", "*", 1)==(STRING.LENGTH("&clk")-1))
  (
    &wild_tail=1
  )

  if ((&wild_head==1)&&(&wild_tail==1))
  (
    if (STRING.SCAN("clk_bus_uim3", STRING.MID("&clk", 1, &clk_input_length-2), 0)!=-1)
    ( 
      &match=1
    )
  )
  else if (&wild_head==1)
  (
    if (STRING.MID("clk_bus_uim3", &clk_itr_length-&clk_input_length+1, &clk_input_length-1)==STRING.CUT("&clk", 1))
    ( 
      &match=1
    )
  )
  else if (&wild_tail==1)
  (
    if (STRING.MID("clk_bus_uim3", 0, &clk_input_length-1)==STRING.CUT("&clk", -1))
    ( 
      &match=1
    )
  )
  else if ("clk_bus_uim3"=="&clk")
  (
    &match=1
  )
  
  if (&match==1)
  (
    &clk_test=&CLK_TEST_CLK_BUS_UIM3
    &clk_reg=&HWIO_MSS_BUS_UIM3_CBCR_ADDR
    &clk_reg_name="MSS_BUS_UIM3_CBCR"
    &clk_name="clk_bus_uim3"
    &clk_reg_cbcr_type="sm_cbc"
    &clk_vote_bit=-1.
    &clk_multiplier=4.

    gosub Print_Clk_Info_Line
  )

  &match=0
  &wild_head=0
  &wild_tail=0
  &clk_input_length=STRING.LENGTH("&clk")
  &clk_itr_length=STRING.LENGTH("mss_dgr_ahb_clk")

  if (STRING.SCAN("&clk", "*", 0)==0)
  (
    &wild_head=1
  )
  if (STRING.SCAN("&clk", "*", 1)==(STRING.LENGTH("&clk")-1))
  (
    &wild_tail=1
  )

  if ((&wild_head==1)&&(&wild_tail==1))
  (
    if (STRING.SCAN("mss_dgr_ahb_clk", STRING.MID("&clk", 1, &clk_input_length-2), 0)!=-1)
    ( 
      &match=1
    )
  )
  else if (&wild_head==1)
  (
    if (STRING.MID("mss_dgr_ahb_clk", &clk_itr_length-&clk_input_length+1, &clk_input_length-1)==STRING.CUT("&clk", 1))
    ( 
      &match=1
    )
  )
  else if (&wild_tail==1)
  (
    if (STRING.MID("mss_dgr_ahb_clk", 0, &clk_input_length-1)==STRING.CUT("&clk", -1))
    ( 
      &match=1
    )
  )
  else if ("mss_dgr_ahb_clk"=="&clk")
  (
    &match=1
  )
  
  if (&match==1)
  (
    &clk_test=&CLK_TEST_MSS_DGR_AHB_CLK
    &clk_reg=0
    &clk_reg_name="No CBCR"
    &clk_name="mss_dgr_ahb_clk"
    &clk_reg_cbcr_type=""
    &clk_vote_bit=-1.
    &clk_multiplier=4.

    gosub Print_Clk_Info_Line
  )

  &match=0
  &wild_head=0
  &wild_tail=0
  &clk_input_length=STRING.LENGTH("&clk")
  &clk_itr_length=STRING.LENGTH("mss_dgr_freerun_ahb_clk")

  if (STRING.SCAN("&clk", "*", 0)==0)
  (
    &wild_head=1
  )
  if (STRING.SCAN("&clk", "*", 1)==(STRING.LENGTH("&clk")-1))
  (
    &wild_tail=1
  )

  if ((&wild_head==1)&&(&wild_tail==1))
  (
    if (STRING.SCAN("mss_dgr_freerun_ahb_clk", STRING.MID("&clk", 1, &clk_input_length-2), 0)!=-1)
    ( 
      &match=1
    )
  )
  else if (&wild_head==1)
  (
    if (STRING.MID("mss_dgr_freerun_ahb_clk", &clk_itr_length-&clk_input_length+1, &clk_input_length-1)==STRING.CUT("&clk", 1))
    ( 
      &match=1
    )
  )
  else if (&wild_tail==1)
  (
    if (STRING.MID("mss_dgr_freerun_ahb_clk", 0, &clk_input_length-1)==STRING.CUT("&clk", -1))
    ( 
      &match=1
    )
  )
  else if ("mss_dgr_freerun_ahb_clk"=="&clk")
  (
    &match=1
  )
  
  if (&match==1)
  (
    &clk_test=0
    &clk_reg=0
    &clk_reg_name="No CBCR"
    &clk_name="mss_dgr_freerun_ahb_clk"
    &clk_reg_cbcr_type=""
    &clk_vote_bit=-1.
    &clk_multiplier=4.

    gosub Print_Clk_Info_Line
  )

  &match=0
  &wild_head=0
  &wild_tail=0
  &clk_input_length=STRING.LENGTH("&clk")
  &clk_itr_length=STRING.LENGTH("clk_src_bus_mss_config")

  if (STRING.SCAN("&clk", "*", 0)==0)
  (
    &wild_head=1
  )
  if (STRING.SCAN("&clk", "*", 1)==(STRING.LENGTH("&clk")-1))
  (
    &wild_tail=1
  )

  if ((&wild_head==1)&&(&wild_tail==1))
  (
    if (STRING.SCAN("clk_src_bus_mss_config", STRING.MID("&clk", 1, &clk_input_length-2), 0)!=-1)
    ( 
      &match=1
    )
  )
  else if (&wild_head==1)
  (
    if (STRING.MID("clk_src_bus_mss_config", &clk_itr_length-&clk_input_length+1, &clk_input_length-1)==STRING.CUT("&clk", 1))
    ( 
      &match=1
    )
  )
  else if (&wild_tail==1)
  (
    if (STRING.MID("clk_src_bus_mss_config", 0, &clk_input_length-1)==STRING.CUT("&clk", -1))
    ( 
      &match=1
    )
  )
  else if ("clk_src_bus_mss_config"=="&clk")
  (
    &match=1
  )
  
  if (&match==1)
  (
    &clk_test=&CLK_TEST_CLK_SRC_BUS_MSS_CONFIG
    &clk_reg=0
    &clk_reg_name="No CBCR"
    &clk_name="clk_src_bus_mss_config"
    &clk_reg_cbcr_type=""
    &clk_vote_bit=-1.
    &clk_multiplier=4.

    gosub Print_Clk_Info_Line
  )

  &match=0
  &wild_head=0
  &wild_tail=0
  &clk_input_length=STRING.LENGTH("&clk")
  &clk_itr_length=STRING.LENGTH("gcc_mss_mfab_axi_clk_src")

  if (STRING.SCAN("&clk", "*", 0)==0)
  (
    &wild_head=1
  )
  if (STRING.SCAN("&clk", "*", 1)==(STRING.LENGTH("&clk")-1))
  (
    &wild_tail=1
  )

  if ((&wild_head==1)&&(&wild_tail==1))
  (
    if (STRING.SCAN("gcc_mss_mfab_axi_clk_src", STRING.MID("&clk", 1, &clk_input_length-2), 0)!=-1)
    ( 
      &match=1
    )
  )
  else if (&wild_head==1)
  (
    if (STRING.MID("gcc_mss_mfab_axi_clk_src", &clk_itr_length-&clk_input_length+1, &clk_input_length-1)==STRING.CUT("&clk", 1))
    ( 
      &match=1
    )
  )
  else if (&wild_tail==1)
  (
    if (STRING.MID("gcc_mss_mfab_axi_clk_src", 0, &clk_input_length-1)==STRING.CUT("&clk", -1))
    ( 
      &match=1
    )
  )
  else if ("gcc_mss_mfab_axi_clk_src"=="&clk")
  (
    &match=1
  )
  
  if (&match==1)
  (
    &clk_test=&CLK_TEST_GCC_MSS_MFAB_AXI_CLK_SRC
    &clk_reg=0
    &clk_reg_name="No CBCR"
    &clk_name="gcc_mss_mfab_axi_clk_src"
    &clk_reg_cbcr_type=""
    &clk_vote_bit=-1.
    &clk_multiplier=4.

    gosub Print_Clk_Info_Line
  )

  &match=0
  &wild_head=0
  &wild_tail=0
  &clk_input_length=STRING.LENGTH("&clk")
  &clk_itr_length=STRING.LENGTH("clk_axi_mnoc")

  if (STRING.SCAN("&clk", "*", 0)==0)
  (
    &wild_head=1
  )
  if (STRING.SCAN("&clk", "*", 1)==(STRING.LENGTH("&clk")-1))
  (
    &wild_tail=1
  )

  if ((&wild_head==1)&&(&wild_tail==1))
  (
    if (STRING.SCAN("clk_axi_mnoc", STRING.MID("&clk", 1, &clk_input_length-2), 0)!=-1)
    ( 
      &match=1
    )
  )
  else if (&wild_head==1)
  (
    if (STRING.MID("clk_axi_mnoc", &clk_itr_length-&clk_input_length+1, &clk_input_length-1)==STRING.CUT("&clk", 1))
    ( 
      &match=1
    )
  )
  else if (&wild_tail==1)
  (
    if (STRING.MID("clk_axi_mnoc", 0, &clk_input_length-1)==STRING.CUT("&clk", -1))
    ( 
      &match=1
    )
  )
  else if ("clk_axi_mnoc"=="&clk")
  (
    &match=1
  )
  
  if (&match==1)
  (
    &clk_test=&CLK_TEST_CLK_AXI_MNOC
    &clk_reg=&HWIO_MSS_AXI_MNOC_CBCR_ADDR
    &clk_reg_name="MSS_AXI_MNOC_CBCR"
    &clk_name="clk_axi_mnoc"
    &clk_reg_cbcr_type="sm_cbc"
    &clk_vote_bit=-1.
    &clk_multiplier=4.

    gosub Print_Clk_Info_Line
  )

  &match=0
  &wild_head=0
  &wild_tail=0
  &clk_input_length=STRING.LENGTH("&clk")
  &clk_itr_length=STRING.LENGTH("clk_axi_mnoc_q6")

  if (STRING.SCAN("&clk", "*", 0)==0)
  (
    &wild_head=1
  )
  if (STRING.SCAN("&clk", "*", 1)==(STRING.LENGTH("&clk")-1))
  (
    &wild_tail=1
  )

  if ((&wild_head==1)&&(&wild_tail==1))
  (
    if (STRING.SCAN("clk_axi_mnoc_q6", STRING.MID("&clk", 1, &clk_input_length-2), 0)!=-1)
    ( 
      &match=1
    )
  )
  else if (&wild_head==1)
  (
    if (STRING.MID("clk_axi_mnoc_q6", &clk_itr_length-&clk_input_length+1, &clk_input_length-1)==STRING.CUT("&clk", 1))
    ( 
      &match=1
    )
  )
  else if (&wild_tail==1)
  (
    if (STRING.MID("clk_axi_mnoc_q6", 0, &clk_input_length-1)==STRING.CUT("&clk", -1))
    ( 
      &match=1
    )
  )
  else if ("clk_axi_mnoc_q6"=="&clk")
  (
    &match=1
  )
  
  if (&match==1)
  (
    &clk_test=&CLK_TEST_CLK_AXI_MNOC_Q6
    &clk_reg=0
    &clk_reg_name="No CBCR"
    &clk_name="clk_axi_mnoc_q6"
    &clk_reg_cbcr_type=""
    &clk_vote_bit=-1.
    &clk_multiplier=4.

    gosub Print_Clk_Info_Line
  )

  &match=0
  &wild_head=0
  &wild_tail=0
  &clk_input_length=STRING.LENGTH("&clk")
  &clk_itr_length=STRING.LENGTH("clk_axi_nav_sample")

  if (STRING.SCAN("&clk", "*", 0)==0)
  (
    &wild_head=1
  )
  if (STRING.SCAN("&clk", "*", 1)==(STRING.LENGTH("&clk")-1))
  (
    &wild_tail=1
  )

  if ((&wild_head==1)&&(&wild_tail==1))
  (
    if (STRING.SCAN("clk_axi_nav_sample", STRING.MID("&clk", 1, &clk_input_length-2), 0)!=-1)
    ( 
      &match=1
    )
  )
  else if (&wild_head==1)
  (
    if (STRING.MID("clk_axi_nav_sample", &clk_itr_length-&clk_input_length+1, &clk_input_length-1)==STRING.CUT("&clk", 1))
    ( 
      &match=1
    )
  )
  else if (&wild_tail==1)
  (
    if (STRING.MID("clk_axi_nav_sample", 0, &clk_input_length-1)==STRING.CUT("&clk", -1))
    ( 
      &match=1
    )
  )
  else if ("clk_axi_nav_sample"=="&clk")
  (
    &match=1
  )
  
  if (&match==1)
  (
    &clk_test=&CLK_TEST_CLK_AXI_NAV_SAMPLE
    &clk_reg=&HWIO_MSS_AXI_NAV_SAMPLE_CBCR_ADDR
    &clk_reg_name="MSS_AXI_NAV_SAMPLE_CBCR"
    &clk_name="clk_axi_nav_sample"
    &clk_reg_cbcr_type="sm_cbc"
    &clk_vote_bit=-1.
    &clk_multiplier=4.

    gosub Print_Clk_Info_Line
  )

  &match=0
  &wild_head=0
  &wild_tail=0
  &clk_input_length=STRING.LENGTH("&clk")
  &clk_itr_length=STRING.LENGTH("gcc_mss_nav_ce_axi_clk_src")

  if (STRING.SCAN("&clk", "*", 0)==0)
  (
    &wild_head=1
  )
  if (STRING.SCAN("&clk", "*", 1)==(STRING.LENGTH("&clk")-1))
  (
    &wild_tail=1
  )

  if ((&wild_head==1)&&(&wild_tail==1))
  (
    if (STRING.SCAN("gcc_mss_nav_ce_axi_clk_src", STRING.MID("&clk", 1, &clk_input_length-2), 0)!=-1)
    ( 
      &match=1
    )
  )
  else if (&wild_head==1)
  (
    if (STRING.MID("gcc_mss_nav_ce_axi_clk_src", &clk_itr_length-&clk_input_length+1, &clk_input_length-1)==STRING.CUT("&clk", 1))
    ( 
      &match=1
    )
  )
  else if (&wild_tail==1)
  (
    if (STRING.MID("gcc_mss_nav_ce_axi_clk_src", 0, &clk_input_length-1)==STRING.CUT("&clk", -1))
    ( 
      &match=1
    )
  )
  else if ("gcc_mss_nav_ce_axi_clk_src"=="&clk")
  (
    &match=1
  )
  
  if (&match==1)
  (
    &clk_test=&CLK_TEST_GCC_MSS_NAV_CE_AXI_CLK_SRC
    &clk_reg=0
    &clk_reg_name="No CBCR"
    &clk_name="gcc_mss_nav_ce_axi_clk_src"
    &clk_reg_cbcr_type=""
    &clk_vote_bit=-1.
    &clk_multiplier=4.

    gosub Print_Clk_Info_Line
  )

  &match=0
  &wild_head=0
  &wild_tail=0
  &clk_input_length=STRING.LENGTH("&clk")
  &clk_itr_length=STRING.LENGTH("clk_axi_nav")

  if (STRING.SCAN("&clk", "*", 0)==0)
  (
    &wild_head=1
  )
  if (STRING.SCAN("&clk", "*", 1)==(STRING.LENGTH("&clk")-1))
  (
    &wild_tail=1
  )

  if ((&wild_head==1)&&(&wild_tail==1))
  (
    if (STRING.SCAN("clk_axi_nav", STRING.MID("&clk", 1, &clk_input_length-2), 0)!=-1)
    ( 
      &match=1
    )
  )
  else if (&wild_head==1)
  (
    if (STRING.MID("clk_axi_nav", &clk_itr_length-&clk_input_length+1, &clk_input_length-1)==STRING.CUT("&clk", 1))
    ( 
      &match=1
    )
  )
  else if (&wild_tail==1)
  (
    if (STRING.MID("clk_axi_nav", 0, &clk_input_length-1)==STRING.CUT("&clk", -1))
    ( 
      &match=1
    )
  )
  else if ("clk_axi_nav"=="&clk")
  (
    &match=1
  )
  
  if (&match==1)
  (
    &clk_test=&CLK_TEST_CLK_AXI_NAV
    &clk_reg=&HWIO_MSS_AXI_NAV_CBCR_ADDR
    &clk_reg_name="MSS_AXI_NAV_CBCR"
    &clk_name="clk_axi_nav"
    &clk_reg_cbcr_type="sm_cbc"
    &clk_vote_bit=-1.
    &clk_multiplier=4.

    gosub Print_Clk_Info_Line
  )

  &match=0
  &wild_head=0
  &wild_tail=0
  &clk_input_length=STRING.LENGTH("&clk")
  &clk_itr_length=STRING.LENGTH("clk_src_rbcpr_ref")

  if (STRING.SCAN("&clk", "*", 0)==0)
  (
    &wild_head=1
  )
  if (STRING.SCAN("&clk", "*", 1)==(STRING.LENGTH("&clk")-1))
  (
    &wild_tail=1
  )

  if ((&wild_head==1)&&(&wild_tail==1))
  (
    if (STRING.SCAN("clk_src_rbcpr_ref", STRING.MID("&clk", 1, &clk_input_length-2), 0)!=-1)
    ( 
      &match=1
    )
  )
  else if (&wild_head==1)
  (
    if (STRING.MID("clk_src_rbcpr_ref", &clk_itr_length-&clk_input_length+1, &clk_input_length-1)==STRING.CUT("&clk", 1))
    ( 
      &match=1
    )
  )
  else if (&wild_tail==1)
  (
    if (STRING.MID("clk_src_rbcpr_ref", 0, &clk_input_length-1)==STRING.CUT("&clk", -1))
    ( 
      &match=1
    )
  )
  else if ("clk_src_rbcpr_ref"=="&clk")
  (
    &match=1
  )
  
  if (&match==1)
  (
    &clk_test=&CLK_TEST_CLK_SRC_RBCPR_REF
    &clk_reg=0
    &clk_reg_name="No CBCR"
    &clk_name="clk_src_rbcpr_ref"
    &clk_reg_cbcr_type=""
    &clk_vote_bit=-1.
    &clk_multiplier=4.

    gosub Print_Clk_Info_Line
  )

  &match=0
  &wild_head=0
  &wild_tail=0
  &clk_input_length=STRING.LENGTH("&clk")
  &clk_itr_length=STRING.LENGTH("clk_rbcpr_ref")

  if (STRING.SCAN("&clk", "*", 0)==0)
  (
    &wild_head=1
  )
  if (STRING.SCAN("&clk", "*", 1)==(STRING.LENGTH("&clk")-1))
  (
    &wild_tail=1
  )

  if ((&wild_head==1)&&(&wild_tail==1))
  (
    if (STRING.SCAN("clk_rbcpr_ref", STRING.MID("&clk", 1, &clk_input_length-2), 0)!=-1)
    ( 
      &match=1
    )
  )
  else if (&wild_head==1)
  (
    if (STRING.MID("clk_rbcpr_ref", &clk_itr_length-&clk_input_length+1, &clk_input_length-1)==STRING.CUT("&clk", 1))
    ( 
      &match=1
    )
  )
  else if (&wild_tail==1)
  (
    if (STRING.MID("clk_rbcpr_ref", 0, &clk_input_length-1)==STRING.CUT("&clk", -1))
    ( 
      &match=1
    )
  )
  else if ("clk_rbcpr_ref"=="&clk")
  (
    &match=1
  )
  
  if (&match==1)
  (
    &clk_test=&CLK_TEST_CLK_RBCPR_REF
    &clk_reg=&HWIO_MSS_RBCPR_REF_CBCR_ADDR
    &clk_reg_name="MSS_RBCPR_REF_CBCR"
    &clk_name="clk_rbcpr_ref"
    &clk_reg_cbcr_type="sm_cbc"
    &clk_vote_bit=-1.
    &clk_multiplier=4.

    gosub Print_Clk_Info_Line
  )

  &match=0
  &wild_head=0
  &wild_tail=0
  &clk_input_length=STRING.LENGTH("&clk")
  &clk_itr_length=STRING.LENGTH("clk_src_uim0_mnd")

  if (STRING.SCAN("&clk", "*", 0)==0)
  (
    &wild_head=1
  )
  if (STRING.SCAN("&clk", "*", 1)==(STRING.LENGTH("&clk")-1))
  (
    &wild_tail=1
  )

  if ((&wild_head==1)&&(&wild_tail==1))
  (
    if (STRING.SCAN("clk_src_uim0_mnd", STRING.MID("&clk", 1, &clk_input_length-2), 0)!=-1)
    ( 
      &match=1
    )
  )
  else if (&wild_head==1)
  (
    if (STRING.MID("clk_src_uim0_mnd", &clk_itr_length-&clk_input_length+1, &clk_input_length-1)==STRING.CUT("&clk", 1))
    ( 
      &match=1
    )
  )
  else if (&wild_tail==1)
  (
    if (STRING.MID("clk_src_uim0_mnd", 0, &clk_input_length-1)==STRING.CUT("&clk", -1))
    ( 
      &match=1
    )
  )
  else if ("clk_src_uim0_mnd"=="&clk")
  (
    &match=1
  )
  
  if (&match==1)
  (
    &clk_test=&CLK_TEST_CLK_SRC_UIM0_MND
    &clk_reg=0
    &clk_reg_name="No CBCR"
    &clk_name="clk_src_uim0_mnd"
    &clk_reg_cbcr_type=""
    &clk_vote_bit=-1.
    &clk_multiplier=4.

    gosub Print_Clk_Info_Line
  )

  &match=0
  &wild_head=0
  &wild_tail=0
  &clk_input_length=STRING.LENGTH("&clk")
  &clk_itr_length=STRING.LENGTH("clk_uart_bit_uim0")

  if (STRING.SCAN("&clk", "*", 0)==0)
  (
    &wild_head=1
  )
  if (STRING.SCAN("&clk", "*", 1)==(STRING.LENGTH("&clk")-1))
  (
    &wild_tail=1
  )

  if ((&wild_head==1)&&(&wild_tail==1))
  (
    if (STRING.SCAN("clk_uart_bit_uim0", STRING.MID("&clk", 1, &clk_input_length-2), 0)!=-1)
    ( 
      &match=1
    )
  )
  else if (&wild_head==1)
  (
    if (STRING.MID("clk_uart_bit_uim0", &clk_itr_length-&clk_input_length+1, &clk_input_length-1)==STRING.CUT("&clk", 1))
    ( 
      &match=1
    )
  )
  else if (&wild_tail==1)
  (
    if (STRING.MID("clk_uart_bit_uim0", 0, &clk_input_length-1)==STRING.CUT("&clk", -1))
    ( 
      &match=1
    )
  )
  else if ("clk_uart_bit_uim0"=="&clk")
  (
    &match=1
  )
  
  if (&match==1)
  (
    &clk_test=&CLK_TEST_CLK_UART_BIT_UIM0
    &clk_reg=&HWIO_MSS_UART_BIT_UIM0_CBCR_ADDR
    &clk_reg_name="MSS_UART_BIT_UIM0_CBCR"
    &clk_name="clk_uart_bit_uim0"
    &clk_reg_cbcr_type="sm_cbc"
    &clk_vote_bit=-1.
    &clk_multiplier=4.

    gosub Print_Clk_Info_Line
  )

  &match=0
  &wild_head=0
  &wild_tail=0
  &clk_input_length=STRING.LENGTH("&clk")
  &clk_itr_length=STRING.LENGTH("clk_src_uim1_mnd")

  if (STRING.SCAN("&clk", "*", 0)==0)
  (
    &wild_head=1
  )
  if (STRING.SCAN("&clk", "*", 1)==(STRING.LENGTH("&clk")-1))
  (
    &wild_tail=1
  )

  if ((&wild_head==1)&&(&wild_tail==1))
  (
    if (STRING.SCAN("clk_src_uim1_mnd", STRING.MID("&clk", 1, &clk_input_length-2), 0)!=-1)
    ( 
      &match=1
    )
  )
  else if (&wild_head==1)
  (
    if (STRING.MID("clk_src_uim1_mnd", &clk_itr_length-&clk_input_length+1, &clk_input_length-1)==STRING.CUT("&clk", 1))
    ( 
      &match=1
    )
  )
  else if (&wild_tail==1)
  (
    if (STRING.MID("clk_src_uim1_mnd", 0, &clk_input_length-1)==STRING.CUT("&clk", -1))
    ( 
      &match=1
    )
  )
  else if ("clk_src_uim1_mnd"=="&clk")
  (
    &match=1
  )
  
  if (&match==1)
  (
    &clk_test=&CLK_TEST_CLK_SRC_UIM1_MND
    &clk_reg=0
    &clk_reg_name="No CBCR"
    &clk_name="clk_src_uim1_mnd"
    &clk_reg_cbcr_type=""
    &clk_vote_bit=-1.
    &clk_multiplier=4.

    gosub Print_Clk_Info_Line
  )

  &match=0
  &wild_head=0
  &wild_tail=0
  &clk_input_length=STRING.LENGTH("&clk")
  &clk_itr_length=STRING.LENGTH("clk_uart_bit_uim1")

  if (STRING.SCAN("&clk", "*", 0)==0)
  (
    &wild_head=1
  )
  if (STRING.SCAN("&clk", "*", 1)==(STRING.LENGTH("&clk")-1))
  (
    &wild_tail=1
  )

  if ((&wild_head==1)&&(&wild_tail==1))
  (
    if (STRING.SCAN("clk_uart_bit_uim1", STRING.MID("&clk", 1, &clk_input_length-2), 0)!=-1)
    ( 
      &match=1
    )
  )
  else if (&wild_head==1)
  (
    if (STRING.MID("clk_uart_bit_uim1", &clk_itr_length-&clk_input_length+1, &clk_input_length-1)==STRING.CUT("&clk", 1))
    ( 
      &match=1
    )
  )
  else if (&wild_tail==1)
  (
    if (STRING.MID("clk_uart_bit_uim1", 0, &clk_input_length-1)==STRING.CUT("&clk", -1))
    ( 
      &match=1
    )
  )
  else if ("clk_uart_bit_uim1"=="&clk")
  (
    &match=1
  )
  
  if (&match==1)
  (
    &clk_test=&CLK_TEST_CLK_UART_BIT_UIM1
    &clk_reg=&HWIO_MSS_UART_BIT_UIM1_CBCR_ADDR
    &clk_reg_name="MSS_UART_BIT_UIM1_CBCR"
    &clk_name="clk_uart_bit_uim1"
    &clk_reg_cbcr_type="sm_cbc"
    &clk_vote_bit=-1.
    &clk_multiplier=4.

    gosub Print_Clk_Info_Line
  )

  &match=0
  &wild_head=0
  &wild_tail=0
  &clk_input_length=STRING.LENGTH("&clk")
  &clk_itr_length=STRING.LENGTH("clk_src_uim2_mnd")

  if (STRING.SCAN("&clk", "*", 0)==0)
  (
    &wild_head=1
  )
  if (STRING.SCAN("&clk", "*", 1)==(STRING.LENGTH("&clk")-1))
  (
    &wild_tail=1
  )

  if ((&wild_head==1)&&(&wild_tail==1))
  (
    if (STRING.SCAN("clk_src_uim2_mnd", STRING.MID("&clk", 1, &clk_input_length-2), 0)!=-1)
    ( 
      &match=1
    )
  )
  else if (&wild_head==1)
  (
    if (STRING.MID("clk_src_uim2_mnd", &clk_itr_length-&clk_input_length+1, &clk_input_length-1)==STRING.CUT("&clk", 1))
    ( 
      &match=1
    )
  )
  else if (&wild_tail==1)
  (
    if (STRING.MID("clk_src_uim2_mnd", 0, &clk_input_length-1)==STRING.CUT("&clk", -1))
    ( 
      &match=1
    )
  )
  else if ("clk_src_uim2_mnd"=="&clk")
  (
    &match=1
  )
  
  if (&match==1)
  (
    &clk_test=&CLK_TEST_CLK_SRC_UIM2_MND
    &clk_reg=0
    &clk_reg_name="No CBCR"
    &clk_name="clk_src_uim2_mnd"
    &clk_reg_cbcr_type=""
    &clk_vote_bit=-1.
    &clk_multiplier=4.

    gosub Print_Clk_Info_Line
  )

  &match=0
  &wild_head=0
  &wild_tail=0
  &clk_input_length=STRING.LENGTH("&clk")
  &clk_itr_length=STRING.LENGTH("clk_uart_bit_uim2")

  if (STRING.SCAN("&clk", "*", 0)==0)
  (
    &wild_head=1
  )
  if (STRING.SCAN("&clk", "*", 1)==(STRING.LENGTH("&clk")-1))
  (
    &wild_tail=1
  )

  if ((&wild_head==1)&&(&wild_tail==1))
  (
    if (STRING.SCAN("clk_uart_bit_uim2", STRING.MID("&clk", 1, &clk_input_length-2), 0)!=-1)
    ( 
      &match=1
    )
  )
  else if (&wild_head==1)
  (
    if (STRING.MID("clk_uart_bit_uim2", &clk_itr_length-&clk_input_length+1, &clk_input_length-1)==STRING.CUT("&clk", 1))
    ( 
      &match=1
    )
  )
  else if (&wild_tail==1)
  (
    if (STRING.MID("clk_uart_bit_uim2", 0, &clk_input_length-1)==STRING.CUT("&clk", -1))
    ( 
      &match=1
    )
  )
  else if ("clk_uart_bit_uim2"=="&clk")
  (
    &match=1
  )
  
  if (&match==1)
  (
    &clk_test=&CLK_TEST_CLK_UART_BIT_UIM2
    &clk_reg=&HWIO_MSS_UART_BIT_UIM2_CBCR_ADDR
    &clk_reg_name="MSS_UART_BIT_UIM2_CBCR"
    &clk_name="clk_uart_bit_uim2"
    &clk_reg_cbcr_type="sm_cbc"
    &clk_vote_bit=-1.
    &clk_multiplier=4.

    gosub Print_Clk_Info_Line
  )

  &match=0
  &wild_head=0
  &wild_tail=0
  &clk_input_length=STRING.LENGTH("&clk")
  &clk_itr_length=STRING.LENGTH("clk_src_uim3_mnd")

  if (STRING.SCAN("&clk", "*", 0)==0)
  (
    &wild_head=1
  )
  if (STRING.SCAN("&clk", "*", 1)==(STRING.LENGTH("&clk")-1))
  (
    &wild_tail=1
  )

  if ((&wild_head==1)&&(&wild_tail==1))
  (
    if (STRING.SCAN("clk_src_uim3_mnd", STRING.MID("&clk", 1, &clk_input_length-2), 0)!=-1)
    ( 
      &match=1
    )
  )
  else if (&wild_head==1)
  (
    if (STRING.MID("clk_src_uim3_mnd", &clk_itr_length-&clk_input_length+1, &clk_input_length-1)==STRING.CUT("&clk", 1))
    ( 
      &match=1
    )
  )
  else if (&wild_tail==1)
  (
    if (STRING.MID("clk_src_uim3_mnd", 0, &clk_input_length-1)==STRING.CUT("&clk", -1))
    ( 
      &match=1
    )
  )
  else if ("clk_src_uim3_mnd"=="&clk")
  (
    &match=1
  )
  
  if (&match==1)
  (
    &clk_test=&CLK_TEST_CLK_SRC_UIM3_MND
    &clk_reg=0
    &clk_reg_name="No CBCR"
    &clk_name="clk_src_uim3_mnd"
    &clk_reg_cbcr_type=""
    &clk_vote_bit=-1.
    &clk_multiplier=4.

    gosub Print_Clk_Info_Line
  )

  &match=0
  &wild_head=0
  &wild_tail=0
  &clk_input_length=STRING.LENGTH("&clk")
  &clk_itr_length=STRING.LENGTH("clk_uart_bit_uim3")

  if (STRING.SCAN("&clk", "*", 0)==0)
  (
    &wild_head=1
  )
  if (STRING.SCAN("&clk", "*", 1)==(STRING.LENGTH("&clk")-1))
  (
    &wild_tail=1
  )

  if ((&wild_head==1)&&(&wild_tail==1))
  (
    if (STRING.SCAN("clk_uart_bit_uim3", STRING.MID("&clk", 1, &clk_input_length-2), 0)!=-1)
    ( 
      &match=1
    )
  )
  else if (&wild_head==1)
  (
    if (STRING.MID("clk_uart_bit_uim3", &clk_itr_length-&clk_input_length+1, &clk_input_length-1)==STRING.CUT("&clk", 1))
    ( 
      &match=1
    )
  )
  else if (&wild_tail==1)
  (
    if (STRING.MID("clk_uart_bit_uim3", 0, &clk_input_length-1)==STRING.CUT("&clk", -1))
    ( 
      &match=1
    )
  )
  else if ("clk_uart_bit_uim3"=="&clk")
  (
    &match=1
  )
  
  if (&match==1)
  (
    &clk_test=&CLK_TEST_CLK_UART_BIT_UIM3
    &clk_reg=&HWIO_MSS_UART_BIT_UIM3_CBCR_ADDR
    &clk_reg_name="MSS_UART_BIT_UIM3_CBCR"
    &clk_name="clk_uart_bit_uim3"
    &clk_reg_cbcr_type="sm_cbc"
    &clk_vote_bit=-1.
    &clk_multiplier=4.

    gosub Print_Clk_Info_Line
  )

  &match=0
  &wild_head=0
  &wild_tail=0
  &clk_input_length=STRING.LENGTH("&clk")
  &clk_itr_length=STRING.LENGTH("clk_card_src_uim0")

  if (STRING.SCAN("&clk", "*", 0)==0)
  (
    &wild_head=1
  )
  if (STRING.SCAN("&clk", "*", 1)==(STRING.LENGTH("&clk")-1))
  (
    &wild_tail=1
  )

  if ((&wild_head==1)&&(&wild_tail==1))
  (
    if (STRING.SCAN("clk_card_src_uim0", STRING.MID("&clk", 1, &clk_input_length-2), 0)!=-1)
    ( 
      &match=1
    )
  )
  else if (&wild_head==1)
  (
    if (STRING.MID("clk_card_src_uim0", &clk_itr_length-&clk_input_length+1, &clk_input_length-1)==STRING.CUT("&clk", 1))
    ( 
      &match=1
    )
  )
  else if (&wild_tail==1)
  (
    if (STRING.MID("clk_card_src_uim0", 0, &clk_input_length-1)==STRING.CUT("&clk", -1))
    ( 
      &match=1
    )
  )
  else if ("clk_card_src_uim0"=="&clk")
  (
    &match=1
  )
  
  if (&match==1)
  (
    &clk_test=&CLK_TEST_CLK_CARD_SRC_UIM0
    &clk_reg=&HWIO_MSS_CARD_SRC_UIM0_CBCR_ADDR
    &clk_reg_name="MSS_CARD_SRC_UIM0_CBCR"
    &clk_name="clk_card_src_uim0"
    &clk_reg_cbcr_type="sm_cbc"
    &clk_vote_bit=-1.
    &clk_multiplier=4.

    gosub Print_Clk_Info_Line
  )

  &match=0
  &wild_head=0
  &wild_tail=0
  &clk_input_length=STRING.LENGTH("&clk")
  &clk_itr_length=STRING.LENGTH("clk_card_src_uim1")

  if (STRING.SCAN("&clk", "*", 0)==0)
  (
    &wild_head=1
  )
  if (STRING.SCAN("&clk", "*", 1)==(STRING.LENGTH("&clk")-1))
  (
    &wild_tail=1
  )

  if ((&wild_head==1)&&(&wild_tail==1))
  (
    if (STRING.SCAN("clk_card_src_uim1", STRING.MID("&clk", 1, &clk_input_length-2), 0)!=-1)
    ( 
      &match=1
    )
  )
  else if (&wild_head==1)
  (
    if (STRING.MID("clk_card_src_uim1", &clk_itr_length-&clk_input_length+1, &clk_input_length-1)==STRING.CUT("&clk", 1))
    ( 
      &match=1
    )
  )
  else if (&wild_tail==1)
  (
    if (STRING.MID("clk_card_src_uim1", 0, &clk_input_length-1)==STRING.CUT("&clk", -1))
    ( 
      &match=1
    )
  )
  else if ("clk_card_src_uim1"=="&clk")
  (
    &match=1
  )
  
  if (&match==1)
  (
    &clk_test=&CLK_TEST_CLK_CARD_SRC_UIM1
    &clk_reg=&HWIO_MSS_CARD_SRC_UIM1_CBCR_ADDR
    &clk_reg_name="MSS_CARD_SRC_UIM1_CBCR"
    &clk_name="clk_card_src_uim1"
    &clk_reg_cbcr_type="sm_cbc"
    &clk_vote_bit=-1.
    &clk_multiplier=4.

    gosub Print_Clk_Info_Line
  )

  &match=0
  &wild_head=0
  &wild_tail=0
  &clk_input_length=STRING.LENGTH("&clk")
  &clk_itr_length=STRING.LENGTH("clk_card_src_uim2")

  if (STRING.SCAN("&clk", "*", 0)==0)
  (
    &wild_head=1
  )
  if (STRING.SCAN("&clk", "*", 1)==(STRING.LENGTH("&clk")-1))
  (
    &wild_tail=1
  )

  if ((&wild_head==1)&&(&wild_tail==1))
  (
    if (STRING.SCAN("clk_card_src_uim2", STRING.MID("&clk", 1, &clk_input_length-2), 0)!=-1)
    ( 
      &match=1
    )
  )
  else if (&wild_head==1)
  (
    if (STRING.MID("clk_card_src_uim2", &clk_itr_length-&clk_input_length+1, &clk_input_length-1)==STRING.CUT("&clk", 1))
    ( 
      &match=1
    )
  )
  else if (&wild_tail==1)
  (
    if (STRING.MID("clk_card_src_uim2", 0, &clk_input_length-1)==STRING.CUT("&clk", -1))
    ( 
      &match=1
    )
  )
  else if ("clk_card_src_uim2"=="&clk")
  (
    &match=1
  )
  
  if (&match==1)
  (
    &clk_test=&CLK_TEST_CLK_CARD_SRC_UIM2
    &clk_reg=&HWIO_MSS_CARD_SRC_UIM2_CBCR_ADDR
    &clk_reg_name="MSS_CARD_SRC_UIM2_CBCR"
    &clk_name="clk_card_src_uim2"
    &clk_reg_cbcr_type="sm_cbc"
    &clk_vote_bit=-1.
    &clk_multiplier=4.

    gosub Print_Clk_Info_Line
  )

  &match=0
  &wild_head=0
  &wild_tail=0
  &clk_input_length=STRING.LENGTH("&clk")
  &clk_itr_length=STRING.LENGTH("clk_card_src_uim3")

  if (STRING.SCAN("&clk", "*", 0)==0)
  (
    &wild_head=1
  )
  if (STRING.SCAN("&clk", "*", 1)==(STRING.LENGTH("&clk")-1))
  (
    &wild_tail=1
  )

  if ((&wild_head==1)&&(&wild_tail==1))
  (
    if (STRING.SCAN("clk_card_src_uim3", STRING.MID("&clk", 1, &clk_input_length-2), 0)!=-1)
    ( 
      &match=1
    )
  )
  else if (&wild_head==1)
  (
    if (STRING.MID("clk_card_src_uim3", &clk_itr_length-&clk_input_length+1, &clk_input_length-1)==STRING.CUT("&clk", 1))
    ( 
      &match=1
    )
  )
  else if (&wild_tail==1)
  (
    if (STRING.MID("clk_card_src_uim3", 0, &clk_input_length-1)==STRING.CUT("&clk", -1))
    ( 
      &match=1
    )
  )
  else if ("clk_card_src_uim3"=="&clk")
  (
    &match=1
  )
  
  if (&match==1)
  (
    &clk_test=&CLK_TEST_CLK_CARD_SRC_UIM3
    &clk_reg=&HWIO_MSS_CARD_SRC_UIM3_CBCR_ADDR
    &clk_reg_name="MSS_CARD_SRC_UIM3_CBCR"
    &clk_name="clk_card_src_uim3"
    &clk_reg_cbcr_type="sm_cbc"
    &clk_vote_bit=-1.
    &clk_multiplier=4.

    gosub Print_Clk_Info_Line
  )

  &match=0
  &wild_head=0
  &wild_tail=0
  &clk_input_length=STRING.LENGTH("&clk")
  &clk_itr_length=STRING.LENGTH("clk_xo_mdm")

  if (STRING.SCAN("&clk", "*", 0)==0)
  (
    &wild_head=1
  )
  if (STRING.SCAN("&clk", "*", 1)==(STRING.LENGTH("&clk")-1))
  (
    &wild_tail=1
  )

  if ((&wild_head==1)&&(&wild_tail==1))
  (
    if (STRING.SCAN("clk_xo_mdm", STRING.MID("&clk", 1, &clk_input_length-2), 0)!=-1)
    ( 
      &match=1
    )
  )
  else if (&wild_head==1)
  (
    if (STRING.MID("clk_xo_mdm", &clk_itr_length-&clk_input_length+1, &clk_input_length-1)==STRING.CUT("&clk", 1))
    ( 
      &match=1
    )
  )
  else if (&wild_tail==1)
  (
    if (STRING.MID("clk_xo_mdm", 0, &clk_input_length-1)==STRING.CUT("&clk", -1))
    ( 
      &match=1
    )
  )
  else if ("clk_xo_mdm"=="&clk")
  (
    &match=1
  )
  
  if (&match==1)
  (
    &clk_test=&CLK_TEST_CLK_XO_MDM
    &clk_reg=&HWIO_MSS_XO_MDM_CBCR_ADDR
    &clk_reg_name="MSS_XO_MDM_CBCR"
    &clk_name="clk_xo_mdm"
    &clk_reg_cbcr_type="sm_cbc"
    &clk_vote_bit=-1.
    &clk_multiplier=4.

    gosub Print_Clk_Info_Line
  )

  &match=0
  &wild_head=0
  &wild_tail=0
  &clk_input_length=STRING.LENGTH("&clk")
  &clk_itr_length=STRING.LENGTH("clk_xo_nav")

  if (STRING.SCAN("&clk", "*", 0)==0)
  (
    &wild_head=1
  )
  if (STRING.SCAN("&clk", "*", 1)==(STRING.LENGTH("&clk")-1))
  (
    &wild_tail=1
  )

  if ((&wild_head==1)&&(&wild_tail==1))
  (
    if (STRING.SCAN("clk_xo_nav", STRING.MID("&clk", 1, &clk_input_length-2), 0)!=-1)
    ( 
      &match=1
    )
  )
  else if (&wild_head==1)
  (
    if (STRING.MID("clk_xo_nav", &clk_itr_length-&clk_input_length+1, &clk_input_length-1)==STRING.CUT("&clk", 1))
    ( 
      &match=1
    )
  )
  else if (&wild_tail==1)
  (
    if (STRING.MID("clk_xo_nav", 0, &clk_input_length-1)==STRING.CUT("&clk", -1))
    ( 
      &match=1
    )
  )
  else if ("clk_xo_nav"=="&clk")
  (
    &match=1
  )
  
  if (&match==1)
  (
    &clk_test=&CLK_TEST_CLK_XO_NAV
    &clk_reg=&HWIO_MSS_XO_NAV_CBCR_ADDR
    &clk_reg_name="MSS_XO_NAV_CBCR"
    &clk_name="clk_xo_nav"
    &clk_reg_cbcr_type="sm_cbc"
    &clk_vote_bit=-1.
    &clk_multiplier=4.

    gosub Print_Clk_Info_Line
  )

  &match=0
  &wild_head=0
  &wild_tail=0
  &clk_input_length=STRING.LENGTH("&clk")
  &clk_itr_length=STRING.LENGTH("clk_mdm")

  if (STRING.SCAN("&clk", "*", 0)==0)
  (
    &wild_head=1
  )
  if (STRING.SCAN("&clk", "*", 1)==(STRING.LENGTH("&clk")-1))
  (
    &wild_tail=1
  )

  if ((&wild_head==1)&&(&wild_tail==1))
  (
    if (STRING.SCAN("clk_mdm", STRING.MID("&clk", 1, &clk_input_length-2), 0)!=-1)
    ( 
      &match=1
    )
  )
  else if (&wild_head==1)
  (
    if (STRING.MID("clk_mdm", &clk_itr_length-&clk_input_length+1, &clk_input_length-1)==STRING.CUT("&clk", 1))
    ( 
      &match=1
    )
  )
  else if (&wild_tail==1)
  (
    if (STRING.MID("clk_mdm", 0, &clk_input_length-1)==STRING.CUT("&clk", -1))
    ( 
      &match=1
    )
  )
  else if ("clk_mdm"=="&clk")
  (
    &match=1
  )
  
  if (&match==1)
  (
    &clk_test=&CLK_TEST_CLK_MDM
    &clk_reg=0
    &clk_reg_name="No CBCR"
    &clk_name="clk_mdm"
    &clk_reg_cbcr_type=""
    &clk_vote_bit=-1.
    &clk_multiplier=4.

    gosub Print_Clk_Info_Line
  )

  &match=0
  &wild_head=0
  &wild_tail=0
  &clk_input_length=STRING.LENGTH("&clk")
  &clk_itr_length=STRING.LENGTH("mss_qdsp6ss_q6_core_clk")

  if (STRING.SCAN("&clk", "*", 0)==0)
  (
    &wild_head=1
  )
  if (STRING.SCAN("&clk", "*", 1)==(STRING.LENGTH("&clk")-1))
  (
    &wild_tail=1
  )

  if ((&wild_head==1)&&(&wild_tail==1))
  (
    if (STRING.SCAN("mss_qdsp6ss_q6_core_clk", STRING.MID("&clk", 1, &clk_input_length-2), 0)!=-1)
    ( 
      &match=1
    )
  )
  else if (&wild_head==1)
  (
    if (STRING.MID("mss_qdsp6ss_q6_core_clk", &clk_itr_length-&clk_input_length+1, &clk_input_length-1)==STRING.CUT("&clk", 1))
    ( 
      &match=1
    )
  )
  else if (&wild_tail==1)
  (
    if (STRING.MID("mss_qdsp6ss_q6_core_clk", 0, &clk_input_length-1)==STRING.CUT("&clk", -1))
    ( 
      &match=1
    )
  )
  else if ("mss_qdsp6ss_q6_core_clk"=="&clk")||("cpus"=="&clk")
  (
    &match=1
  )
  
  if (&match==1)
  (
    &clk_test=&CLK_TEST_MSS_QDSP6SS_Q6_CORE_CLK
    &clk_reg=0
    &clk_reg_name="No CBCR"
    &clk_name="mss_qdsp6ss_q6_core_clk"
    &clk_reg_cbcr_type=""
    &clk_vote_bit=-1.
    &clk_multiplier=4.

    gosub Print_Clk_Info_Line
  )

  &match=0
  &wild_head=0
  &wild_tail=0
  &clk_input_length=STRING.LENGTH("&clk")
  &clk_itr_length=STRING.LENGTH("mss_qdsp6ss_axi_m_clk")

  if (STRING.SCAN("&clk", "*", 0)==0)
  (
    &wild_head=1
  )
  if (STRING.SCAN("&clk", "*", 1)==(STRING.LENGTH("&clk")-1))
  (
    &wild_tail=1
  )

  if ((&wild_head==1)&&(&wild_tail==1))
  (
    if (STRING.SCAN("mss_qdsp6ss_axi_m_clk", STRING.MID("&clk", 1, &clk_input_length-2), 0)!=-1)
    ( 
      &match=1
    )
  )
  else if (&wild_head==1)
  (
    if (STRING.MID("mss_qdsp6ss_axi_m_clk", &clk_itr_length-&clk_input_length+1, &clk_input_length-1)==STRING.CUT("&clk", 1))
    ( 
      &match=1
    )
  )
  else if (&wild_tail==1)
  (
    if (STRING.MID("mss_qdsp6ss_axi_m_clk", 0, &clk_input_length-1)==STRING.CUT("&clk", -1))
    ( 
      &match=1
    )
  )
  else if ("mss_qdsp6ss_axi_m_clk"=="&clk")
  (
    &match=1
  )
  
  if (&match==1)
  (
    &clk_test=&CLK_TEST_MSS_QDSP6SS_AXI_M_CLK
    &clk_reg=0
    &clk_reg_name="No CBCR"
    &clk_name="mss_qdsp6ss_axi_m_clk"
    &clk_reg_cbcr_type=""
    &clk_vote_bit=-1.
    &clk_multiplier=4.

    gosub Print_Clk_Info_Line
  )

  &match=0
  &wild_head=0
  &wild_tail=0
  &clk_input_length=STRING.LENGTH("&clk")
  &clk_itr_length=STRING.LENGTH("mss_qdsp6ss_ldo_nmo_out")

  if (STRING.SCAN("&clk", "*", 0)==0)
  (
    &wild_head=1
  )
  if (STRING.SCAN("&clk", "*", 1)==(STRING.LENGTH("&clk")-1))
  (
    &wild_tail=1
  )

  if ((&wild_head==1)&&(&wild_tail==1))
  (
    if (STRING.SCAN("mss_qdsp6ss_ldo_nmo_out", STRING.MID("&clk", 1, &clk_input_length-2), 0)!=-1)
    ( 
      &match=1
    )
  )
  else if (&wild_head==1)
  (
    if (STRING.MID("mss_qdsp6ss_ldo_nmo_out", &clk_itr_length-&clk_input_length+1, &clk_input_length-1)==STRING.CUT("&clk", 1))
    ( 
      &match=1
    )
  )
  else if (&wild_tail==1)
  (
    if (STRING.MID("mss_qdsp6ss_ldo_nmo_out", 0, &clk_input_length-1)==STRING.CUT("&clk", -1))
    ( 
      &match=1
    )
  )
  else if ("mss_qdsp6ss_ldo_nmo_out"=="&clk")
  (
    &match=1
  )
  
  if (&match==1)
  (
    &clk_test=&CLK_TEST_MSS_QDSP6SS_LDO_NMO_OUT
    &clk_reg=0
    &clk_reg_name="No CBCR"
    &clk_name="mss_qdsp6ss_ldo_nmo_out"
    &clk_reg_cbcr_type=""
    &clk_vote_bit=-1.
    &clk_multiplier=4.

    gosub Print_Clk_Info_Line
  )

  &match=0
  &wild_head=0
  &wild_tail=0
  &clk_input_length=STRING.LENGTH("&clk")
  &clk_itr_length=STRING.LENGTH("mss_qdsp6ss_ahb_m_clk")

  if (STRING.SCAN("&clk", "*", 0)==0)
  (
    &wild_head=1
  )
  if (STRING.SCAN("&clk", "*", 1)==(STRING.LENGTH("&clk")-1))
  (
    &wild_tail=1
  )

  if ((&wild_head==1)&&(&wild_tail==1))
  (
    if (STRING.SCAN("mss_qdsp6ss_ahb_m_clk", STRING.MID("&clk", 1, &clk_input_length-2), 0)!=-1)
    ( 
      &match=1
    )
  )
  else if (&wild_head==1)
  (
    if (STRING.MID("mss_qdsp6ss_ahb_m_clk", &clk_itr_length-&clk_input_length+1, &clk_input_length-1)==STRING.CUT("&clk", 1))
    ( 
      &match=1
    )
  )
  else if (&wild_tail==1)
  (
    if (STRING.MID("mss_qdsp6ss_ahb_m_clk", 0, &clk_input_length-1)==STRING.CUT("&clk", -1))
    ( 
      &match=1
    )
  )
  else if ("mss_qdsp6ss_ahb_m_clk"=="&clk")
  (
    &match=1
  )
  
  if (&match==1)
  (
    &clk_test=&CLK_TEST_MSS_QDSP6SS_AHB_M_CLK
    &clk_reg=0
    &clk_reg_name="No CBCR"
    &clk_name="mss_qdsp6ss_ahb_m_clk"
    &clk_reg_cbcr_type=""
    &clk_vote_bit=-1.
    &clk_multiplier=4.

    gosub Print_Clk_Info_Line
  )

  &match=0
  &wild_head=0
  &wild_tail=0
  &clk_input_length=STRING.LENGTH("&clk")
  &clk_itr_length=STRING.LENGTH("mss_qdsp6ss_ahb_s_clk")

  if (STRING.SCAN("&clk", "*", 0)==0)
  (
    &wild_head=1
  )
  if (STRING.SCAN("&clk", "*", 1)==(STRING.LENGTH("&clk")-1))
  (
    &wild_tail=1
  )

  if ((&wild_head==1)&&(&wild_tail==1))
  (
    if (STRING.SCAN("mss_qdsp6ss_ahb_s_clk", STRING.MID("&clk", 1, &clk_input_length-2), 0)!=-1)
    ( 
      &match=1
    )
  )
  else if (&wild_head==1)
  (
    if (STRING.MID("mss_qdsp6ss_ahb_s_clk", &clk_itr_length-&clk_input_length+1, &clk_input_length-1)==STRING.CUT("&clk", 1))
    ( 
      &match=1
    )
  )
  else if (&wild_tail==1)
  (
    if (STRING.MID("mss_qdsp6ss_ahb_s_clk", 0, &clk_input_length-1)==STRING.CUT("&clk", -1))
    ( 
      &match=1
    )
  )
  else if ("mss_qdsp6ss_ahb_s_clk"=="&clk")
  (
    &match=1
  )
  
  if (&match==1)
  (
    &clk_test=&CLK_TEST_MSS_QDSP6SS_AHB_S_CLK
    &clk_reg=0
    &clk_reg_name="No CBCR"
    &clk_name="mss_qdsp6ss_ahb_s_clk"
    &clk_reg_cbcr_type=""
    &clk_vote_bit=-1.
    &clk_multiplier=4.

    gosub Print_Clk_Info_Line
  )

  &match=0
  &wild_head=0
  &wild_tail=0
  &clk_input_length=STRING.LENGTH("&clk")
  &clk_itr_length=STRING.LENGTH("mss_qdsp6ss_xo_clk")

  if (STRING.SCAN("&clk", "*", 0)==0)
  (
    &wild_head=1
  )
  if (STRING.SCAN("&clk", "*", 1)==(STRING.LENGTH("&clk")-1))
  (
    &wild_tail=1
  )

  if ((&wild_head==1)&&(&wild_tail==1))
  (
    if (STRING.SCAN("mss_qdsp6ss_xo_clk", STRING.MID("&clk", 1, &clk_input_length-2), 0)!=-1)
    ( 
      &match=1
    )
  )
  else if (&wild_head==1)
  (
    if (STRING.MID("mss_qdsp6ss_xo_clk", &clk_itr_length-&clk_input_length+1, &clk_input_length-1)==STRING.CUT("&clk", 1))
    ( 
      &match=1
    )
  )
  else if (&wild_tail==1)
  (
    if (STRING.MID("mss_qdsp6ss_xo_clk", 0, &clk_input_length-1)==STRING.CUT("&clk", -1))
    ( 
      &match=1
    )
  )
  else if ("mss_qdsp6ss_xo_clk"=="&clk")
  (
    &match=1
  )
  
  if (&match==1)
  (
    &clk_test=&CLK_TEST_MSS_QDSP6SS_XO_CLK
    &clk_reg=0
    &clk_reg_name="No CBCR"
    &clk_name="mss_qdsp6ss_xo_clk"
    &clk_reg_cbcr_type=""
    &clk_vote_bit=-1.
    &clk_multiplier=4.

    gosub Print_Clk_Info_Line
  )

  &match=0
  &wild_head=0
  &wild_tail=0
  &clk_input_length=STRING.LENGTH("&clk")
  &clk_itr_length=STRING.LENGTH("mss_qdsp6ss_sleep_clk")

  if (STRING.SCAN("&clk", "*", 0)==0)
  (
    &wild_head=1
  )
  if (STRING.SCAN("&clk", "*", 1)==(STRING.LENGTH("&clk")-1))
  (
    &wild_tail=1
  )

  if ((&wild_head==1)&&(&wild_tail==1))
  (
    if (STRING.SCAN("mss_qdsp6ss_sleep_clk", STRING.MID("&clk", 1, &clk_input_length-2), 0)!=-1)
    ( 
      &match=1
    )
  )
  else if (&wild_head==1)
  (
    if (STRING.MID("mss_qdsp6ss_sleep_clk", &clk_itr_length-&clk_input_length+1, &clk_input_length-1)==STRING.CUT("&clk", 1))
    ( 
      &match=1
    )
  )
  else if (&wild_tail==1)
  (
    if (STRING.MID("mss_qdsp6ss_sleep_clk", 0, &clk_input_length-1)==STRING.CUT("&clk", -1))
    ( 
      &match=1
    )
  )
  else if ("mss_qdsp6ss_sleep_clk"=="&clk")
  (
    &match=1
  )
  
  if (&match==1)
  (
    &clk_test=&CLK_TEST_MSS_QDSP6SS_SLEEP_CLK
    &clk_reg=0
    &clk_reg_name="No CBCR"
    &clk_name="mss_qdsp6ss_sleep_clk"
    &clk_reg_cbcr_type=""
    &clk_vote_bit=-1.
    &clk_multiplier=4.

    gosub Print_Clk_Info_Line
  )

  &match=0
  &wild_head=0
  &wild_tail=0
  &clk_input_length=STRING.LENGTH("&clk")
  &clk_itr_length=STRING.LENGTH("mss_qdsp6ss_jtag_tck")

  if (STRING.SCAN("&clk", "*", 0)==0)
  (
    &wild_head=1
  )
  if (STRING.SCAN("&clk", "*", 1)==(STRING.LENGTH("&clk")-1))
  (
    &wild_tail=1
  )

  if ((&wild_head==1)&&(&wild_tail==1))
  (
    if (STRING.SCAN("mss_qdsp6ss_jtag_tck", STRING.MID("&clk", 1, &clk_input_length-2), 0)!=-1)
    ( 
      &match=1
    )
  )
  else if (&wild_head==1)
  (
    if (STRING.MID("mss_qdsp6ss_jtag_tck", &clk_itr_length-&clk_input_length+1, &clk_input_length-1)==STRING.CUT("&clk", 1))
    ( 
      &match=1
    )
  )
  else if (&wild_tail==1)
  (
    if (STRING.MID("mss_qdsp6ss_jtag_tck", 0, &clk_input_length-1)==STRING.CUT("&clk", -1))
    ( 
      &match=1
    )
  )
  else if ("mss_qdsp6ss_jtag_tck"=="&clk")
  (
    &match=1
  )
  
  if (&match==1)
  (
    &clk_test=&CLK_TEST_MSS_QDSP6SS_JTAG_TCK
    &clk_reg=0
    &clk_reg_name="No CBCR"
    &clk_name="mss_qdsp6ss_jtag_tck"
    &clk_reg_cbcr_type=""
    &clk_vote_bit=-1.
    &clk_multiplier=4.

    gosub Print_Clk_Info_Line
  )

  &match=0
  &wild_head=0
  &wild_tail=0
  &clk_input_length=STRING.LENGTH("&clk")
  &clk_itr_length=STRING.LENGTH("mss_qdsp6ss_atb_clk")

  if (STRING.SCAN("&clk", "*", 0)==0)
  (
    &wild_head=1
  )
  if (STRING.SCAN("&clk", "*", 1)==(STRING.LENGTH("&clk")-1))
  (
    &wild_tail=1
  )

  if ((&wild_head==1)&&(&wild_tail==1))
  (
    if (STRING.SCAN("mss_qdsp6ss_atb_clk", STRING.MID("&clk", 1, &clk_input_length-2), 0)!=-1)
    ( 
      &match=1
    )
  )
  else if (&wild_head==1)
  (
    if (STRING.MID("mss_qdsp6ss_atb_clk", &clk_itr_length-&clk_input_length+1, &clk_input_length-1)==STRING.CUT("&clk", 1))
    ( 
      &match=1
    )
  )
  else if (&wild_tail==1)
  (
    if (STRING.MID("mss_qdsp6ss_atb_clk", 0, &clk_input_length-1)==STRING.CUT("&clk", -1))
    ( 
      &match=1
    )
  )
  else if ("mss_qdsp6ss_atb_clk"=="&clk")
  (
    &match=1
  )
  
  if (&match==1)
  (
    &clk_test=&CLK_TEST_MSS_QDSP6SS_ATB_CLK
    &clk_reg=0
    &clk_reg_name="No CBCR"
    &clk_name="mss_qdsp6ss_atb_clk"
    &clk_reg_cbcr_type=""
    &clk_vote_bit=-1.
    &clk_multiplier=4.

    gosub Print_Clk_Info_Line
  )

  &match=0
  &wild_head=0
  &wild_tail=0
  &clk_input_length=STRING.LENGTH("&clk")
  &clk_itr_length=STRING.LENGTH("mss_qdsp6ss_apb_clk")

  if (STRING.SCAN("&clk", "*", 0)==0)
  (
    &wild_head=1
  )
  if (STRING.SCAN("&clk", "*", 1)==(STRING.LENGTH("&clk")-1))
  (
    &wild_tail=1
  )

  if ((&wild_head==1)&&(&wild_tail==1))
  (
    if (STRING.SCAN("mss_qdsp6ss_apb_clk", STRING.MID("&clk", 1, &clk_input_length-2), 0)!=-1)
    ( 
      &match=1
    )
  )
  else if (&wild_head==1)
  (
    if (STRING.MID("mss_qdsp6ss_apb_clk", &clk_itr_length-&clk_input_length+1, &clk_input_length-1)==STRING.CUT("&clk", 1))
    ( 
      &match=1
    )
  )
  else if (&wild_tail==1)
  (
    if (STRING.MID("mss_qdsp6ss_apb_clk", 0, &clk_input_length-1)==STRING.CUT("&clk", -1))
    ( 
      &match=1
    )
  )
  else if ("mss_qdsp6ss_apb_clk"=="&clk")
  (
    &match=1
  )
  
  if (&match==1)
  (
    &clk_test=&CLK_TEST_MSS_QDSP6SS_APB_CLK
    &clk_reg=0
    &clk_reg_name="No CBCR"
    &clk_name="mss_qdsp6ss_apb_clk"
    &clk_reg_cbcr_type=""
    &clk_vote_bit=-1.
    &clk_multiplier=4.

    gosub Print_Clk_Info_Line
  )

  &match=0
  &wild_head=0
  &wild_tail=0
  &clk_input_length=STRING.LENGTH("&clk")
  &clk_itr_length=STRING.LENGTH("mss_qdsp6ss_timestamp_clk")

  if (STRING.SCAN("&clk", "*", 0)==0)
  (
    &wild_head=1
  )
  if (STRING.SCAN("&clk", "*", 1)==(STRING.LENGTH("&clk")-1))
  (
    &wild_tail=1
  )

  if ((&wild_head==1)&&(&wild_tail==1))
  (
    if (STRING.SCAN("mss_qdsp6ss_timestamp_clk", STRING.MID("&clk", 1, &clk_input_length-2), 0)!=-1)
    ( 
      &match=1
    )
  )
  else if (&wild_head==1)
  (
    if (STRING.MID("mss_qdsp6ss_timestamp_clk", &clk_itr_length-&clk_input_length+1, &clk_input_length-1)==STRING.CUT("&clk", 1))
    ( 
      &match=1
    )
  )
  else if (&wild_tail==1)
  (
    if (STRING.MID("mss_qdsp6ss_timestamp_clk", 0, &clk_input_length-1)==STRING.CUT("&clk", -1))
    ( 
      &match=1
    )
  )
  else if ("mss_qdsp6ss_timestamp_clk"=="&clk")
  (
    &match=1
  )
  
  if (&match==1)
  (
    &clk_test=&CLK_TEST_MSS_QDSP6SS_TIMESTAMP_CLK
    &clk_reg=0
    &clk_reg_name="No CBCR"
    &clk_name="mss_qdsp6ss_timestamp_clk"
    &clk_reg_cbcr_type=""
    &clk_vote_bit=-1.
    &clk_multiplier=4.

    gosub Print_Clk_Info_Line
  )

  &match=0
  &wild_head=0
  &wild_tail=0
  &clk_input_length=STRING.LENGTH("&clk")
  &clk_itr_length=STRING.LENGTH("clk_axi_crypto")

  if (STRING.SCAN("&clk", "*", 0)==0)
  (
    &wild_head=1
  )
  if (STRING.SCAN("&clk", "*", 1)==(STRING.LENGTH("&clk")-1))
  (
    &wild_tail=1
  )

  if ((&wild_head==1)&&(&wild_tail==1))
  (
    if (STRING.SCAN("clk_axi_crypto", STRING.MID("&clk", 1, &clk_input_length-2), 0)!=-1)
    ( 
      &match=1
    )
  )
  else if (&wild_head==1)
  (
    if (STRING.MID("clk_axi_crypto", &clk_itr_length-&clk_input_length+1, &clk_input_length-1)==STRING.CUT("&clk", 1))
    ( 
      &match=1
    )
  )
  else if (&wild_tail==1)
  (
    if (STRING.MID("clk_axi_crypto", 0, &clk_input_length-1)==STRING.CUT("&clk", -1))
    ( 
      &match=1
    )
  )
  else if ("clk_axi_crypto"=="&clk")
  (
    &match=1
  )
  
  if (&match==1)
  (
    &clk_test=&CLK_TEST_CLK_AXI_CRYPTO
    &clk_reg=0
    &clk_reg_name="No CBCR"
    &clk_name="clk_axi_crypto"
    &clk_reg_cbcr_type=""
    &clk_vote_bit=-1.
    &clk_multiplier=4.

    gosub Print_Clk_Info_Line
  )

  &match=0
  &wild_head=0
  &wild_tail=0
  &clk_input_length=STRING.LENGTH("&clk")
  &clk_itr_length=STRING.LENGTH("clk_bus_pseudo_hm_rcg")

  if (STRING.SCAN("&clk", "*", 0)==0)
  (
    &wild_head=1
  )
  if (STRING.SCAN("&clk", "*", 1)==(STRING.LENGTH("&clk")-1))
  (
    &wild_tail=1
  )

  if ((&wild_head==1)&&(&wild_tail==1))
  (
    if (STRING.SCAN("clk_bus_pseudo_hm_rcg", STRING.MID("&clk", 1, &clk_input_length-2), 0)!=-1)
    ( 
      &match=1
    )
  )
  else if (&wild_head==1)
  (
    if (STRING.MID("clk_bus_pseudo_hm_rcg", &clk_itr_length-&clk_input_length+1, &clk_input_length-1)==STRING.CUT("&clk", 1))
    ( 
      &match=1
    )
  )
  else if (&wild_tail==1)
  (
    if (STRING.MID("clk_bus_pseudo_hm_rcg", 0, &clk_input_length-1)==STRING.CUT("&clk", -1))
    ( 
      &match=1
    )
  )
  else if ("clk_bus_pseudo_hm_rcg"=="&clk")
  (
    &match=1
  )
  
  if (&match==1)
  (
    &clk_test=&CLK_TEST_CLK_BUS_PSEUDO_HM_RCG
    &clk_reg=0
    &clk_reg_name="No CBCR"
    &clk_name="clk_bus_pseudo_hm_rcg"
    &clk_reg_cbcr_type=""
    &clk_vote_bit=-1.
    &clk_multiplier=4.

    gosub Print_Clk_Info_Line
  )

  &match=0
  &wild_head=0
  &wild_tail=0
  &clk_input_length=STRING.LENGTH("&clk")
  &clk_itr_length=STRING.LENGTH("clk_timeout_slp")

  if (STRING.SCAN("&clk", "*", 0)==0)
  (
    &wild_head=1
  )
  if (STRING.SCAN("&clk", "*", 1)==(STRING.LENGTH("&clk")-1))
  (
    &wild_tail=1
  )

  if ((&wild_head==1)&&(&wild_tail==1))
  (
    if (STRING.SCAN("clk_timeout_slp", STRING.MID("&clk", 1, &clk_input_length-2), 0)!=-1)
    ( 
      &match=1
    )
  )
  else if (&wild_head==1)
  (
    if (STRING.MID("clk_timeout_slp", &clk_itr_length-&clk_input_length+1, &clk_input_length-1)==STRING.CUT("&clk", 1))
    ( 
      &match=1
    )
  )
  else if (&wild_tail==1)
  (
    if (STRING.MID("clk_timeout_slp", 0, &clk_input_length-1)==STRING.CUT("&clk", -1))
    ( 
      &match=1
    )
  )
  else if ("clk_timeout_slp"=="&clk")
  (
    &match=1
  )
  
  if (&match==1)
  (
    &clk_test=&CLK_TEST_CLK_TIMEOUT_SLP
    &clk_reg=0
    &clk_reg_name="No CBCR"
    &clk_name="clk_timeout_slp"
    &clk_reg_cbcr_type=""
    &clk_vote_bit=-1.
    &clk_multiplier=4.

    gosub Print_Clk_Info_Line
  )

  &match=0
  &wild_head=0
  &wild_tail=0
  &clk_input_length=STRING.LENGTH("&clk")
  &clk_itr_length=STRING.LENGTH("clk_xo_cx")

  if (STRING.SCAN("&clk", "*", 0)==0)
  (
    &wild_head=1
  )
  if (STRING.SCAN("&clk", "*", 1)==(STRING.LENGTH("&clk")-1))
  (
    &wild_tail=1
  )

  if ((&wild_head==1)&&(&wild_tail==1))
  (
    if (STRING.SCAN("clk_xo_cx", STRING.MID("&clk", 1, &clk_input_length-2), 0)!=-1)
    ( 
      &match=1
    )
  )
  else if (&wild_head==1)
  (
    if (STRING.MID("clk_xo_cx", &clk_itr_length-&clk_input_length+1, &clk_input_length-1)==STRING.CUT("&clk", 1))
    ( 
      &match=1
    )
  )
  else if (&wild_tail==1)
  (
    if (STRING.MID("clk_xo_cx", 0, &clk_input_length-1)==STRING.CUT("&clk", -1))
    ( 
      &match=1
    )
  )
  else if ("clk_xo_cx"=="&clk")
  (
    &match=1
  )
  
  if (&match==1)
  (
    &clk_test=&CLK_TEST_CLK_XO_CX
    &clk_reg=0
    &clk_reg_name="No CBCR"
    &clk_name="clk_xo_cx"
    &clk_reg_cbcr_type=""
    &clk_vote_bit=-1.
    &clk_multiplier=4.

    gosub Print_Clk_Info_Line
  )

  &match=0
  &wild_head=0
  &wild_tail=0
  &clk_input_length=STRING.LENGTH("&clk")
  &clk_itr_length=STRING.LENGTH("dbg_dtr_clksig")

  if (STRING.SCAN("&clk", "*", 0)==0)
  (
    &wild_head=1
  )
  if (STRING.SCAN("&clk", "*", 1)==(STRING.LENGTH("&clk")-1))
  (
    &wild_tail=1
  )

  if ((&wild_head==1)&&(&wild_tail==1))
  (
    if (STRING.SCAN("dbg_dtr_clksig", STRING.MID("&clk", 1, &clk_input_length-2), 0)!=-1)
    ( 
      &match=1
    )
  )
  else if (&wild_head==1)
  (
    if (STRING.MID("dbg_dtr_clksig", &clk_itr_length-&clk_input_length+1, &clk_input_length-1)==STRING.CUT("&clk", 1))
    ( 
      &match=1
    )
  )
  else if (&wild_tail==1)
  (
    if (STRING.MID("dbg_dtr_clksig", 0, &clk_input_length-1)==STRING.CUT("&clk", -1))
    ( 
      &match=1
    )
  )
  else if ("dbg_dtr_clksig"=="&clk")
  (
    &match=1
  )
  
  if (&match==1)
  (
    &clk_test=&CLK_TEST_DBG_DTR_CLKSIG
    &clk_reg=0
    &clk_reg_name="No CBCR"
    &clk_name="dbg_dtr_clksig"
    &clk_reg_cbcr_type=""
    &clk_vote_bit=-1.
    &clk_multiplier=4.

    gosub Print_Clk_Info_Line
  )

  &match=0
  &wild_head=0
  &wild_tail=0
  &clk_input_length=STRING.LENGTH("&clk")
  &clk_itr_length=STRING.LENGTH("dbg_modem_clksig")

  if (STRING.SCAN("&clk", "*", 0)==0)
  (
    &wild_head=1
  )
  if (STRING.SCAN("&clk", "*", 1)==(STRING.LENGTH("&clk")-1))
  (
    &wild_tail=1
  )

  if ((&wild_head==1)&&(&wild_tail==1))
  (
    if (STRING.SCAN("dbg_modem_clksig", STRING.MID("&clk", 1, &clk_input_length-2), 0)!=-1)
    ( 
      &match=1
    )
  )
  else if (&wild_head==1)
  (
    if (STRING.MID("dbg_modem_clksig", &clk_itr_length-&clk_input_length+1, &clk_input_length-1)==STRING.CUT("&clk", 1))
    ( 
      &match=1
    )
  )
  else if (&wild_tail==1)
  (
    if (STRING.MID("dbg_modem_clksig", 0, &clk_input_length-1)==STRING.CUT("&clk", -1))
    ( 
      &match=1
    )
  )
  else if ("dbg_modem_clksig"=="&clk")
  (
    &match=1
  )
  
  if (&match==1)
  (
    &clk_test=&CLK_TEST_DBG_MODEM_CLKSIG
    &clk_reg=0
    &clk_reg_name="No CBCR"
    &clk_name="dbg_modem_clksig"
    &clk_reg_cbcr_type=""
    &clk_vote_bit=-1.
    &clk_multiplier=4.

    gosub Print_Clk_Info_Line
  )

  &match=0
  &wild_head=0
  &wild_tail=0
  &clk_input_length=STRING.LENGTH("&clk")
  &clk_itr_length=STRING.LENGTH("dbg_nav_clksig")

  if (STRING.SCAN("&clk", "*", 0)==0)
  (
    &wild_head=1
  )
  if (STRING.SCAN("&clk", "*", 1)==(STRING.LENGTH("&clk")-1))
  (
    &wild_tail=1
  )

  if ((&wild_head==1)&&(&wild_tail==1))
  (
    if (STRING.SCAN("dbg_nav_clksig", STRING.MID("&clk", 1, &clk_input_length-2), 0)!=-1)
    ( 
      &match=1
    )
  )
  else if (&wild_head==1)
  (
    if (STRING.MID("dbg_nav_clksig", &clk_itr_length-&clk_input_length+1, &clk_input_length-1)==STRING.CUT("&clk", 1))
    ( 
      &match=1
    )
  )
  else if (&wild_tail==1)
  (
    if (STRING.MID("dbg_nav_clksig", 0, &clk_input_length-1)==STRING.CUT("&clk", -1))
    ( 
      &match=1
    )
  )
  else if ("dbg_nav_clksig"=="&clk")
  (
    &match=1
  )
  
  if (&match==1)
  (
    &clk_test=&CLK_TEST_DBG_NAV_CLKSIG
    &clk_reg=0
    &clk_reg_name="No CBCR"
    &clk_name="dbg_nav_clksig"
    &clk_reg_cbcr_type=""
    &clk_vote_bit=-1.
    &clk_multiplier=4.

    gosub Print_Clk_Info_Line
  )

  &match=0
  &wild_head=0
  &wild_tail=0
  &clk_input_length=STRING.LENGTH("&clk")
  &clk_itr_length=STRING.LENGTH("dbg_q6_clksig")

  if (STRING.SCAN("&clk", "*", 0)==0)
  (
    &wild_head=1
  )
  if (STRING.SCAN("&clk", "*", 1)==(STRING.LENGTH("&clk")-1))
  (
    &wild_tail=1
  )

  if ((&wild_head==1)&&(&wild_tail==1))
  (
    if (STRING.SCAN("dbg_q6_clksig", STRING.MID("&clk", 1, &clk_input_length-2), 0)!=-1)
    ( 
      &match=1
    )
  )
  else if (&wild_head==1)
  (
    if (STRING.MID("dbg_q6_clksig", &clk_itr_length-&clk_input_length+1, &clk_input_length-1)==STRING.CUT("&clk", 1))
    ( 
      &match=1
    )
  )
  else if (&wild_tail==1)
  (
    if (STRING.MID("dbg_q6_clksig", 0, &clk_input_length-1)==STRING.CUT("&clk", -1))
    ( 
      &match=1
    )
  )
  else if ("dbg_q6_clksig"=="&clk")
  (
    &match=1
  )
  
  if (&match==1)
  (
    &clk_test=&CLK_TEST_DBG_Q6_CLKSIG
    &clk_reg=0
    &clk_reg_name="No CBCR"
    &clk_name="dbg_q6_clksig"
    &clk_reg_cbcr_type=""
    &clk_vote_bit=-1.
    &clk_multiplier=4.

    gosub Print_Clk_Info_Line
  )

  &match=0
  &wild_head=0
  &wild_tail=0
  &clk_input_length=STRING.LENGTH("&clk")
  &clk_itr_length=STRING.LENGTH("dtr1_pll_dtest")

  if (STRING.SCAN("&clk", "*", 0)==0)
  (
    &wild_head=1
  )
  if (STRING.SCAN("&clk", "*", 1)==(STRING.LENGTH("&clk")-1))
  (
    &wild_tail=1
  )

  if ((&wild_head==1)&&(&wild_tail==1))
  (
    if (STRING.SCAN("dtr1_pll_dtest", STRING.MID("&clk", 1, &clk_input_length-2), 0)!=-1)
    ( 
      &match=1
    )
  )
  else if (&wild_head==1)
  (
    if (STRING.MID("dtr1_pll_dtest", &clk_itr_length-&clk_input_length+1, &clk_input_length-1)==STRING.CUT("&clk", 1))
    ( 
      &match=1
    )
  )
  else if (&wild_tail==1)
  (
    if (STRING.MID("dtr1_pll_dtest", 0, &clk_input_length-1)==STRING.CUT("&clk", -1))
    ( 
      &match=1
    )
  )
  else if ("dtr1_pll_dtest"=="&clk")
  (
    &match=1
  )
  
  if (&match==1)
  (
    &clk_test=&CLK_TEST_DTR1_PLL_DTEST
    &clk_reg=0
    &clk_reg_name="No CBCR"
    &clk_name="dtr1_pll_dtest"
    &clk_reg_cbcr_type=""
    &clk_vote_bit=-1.
    &clk_multiplier=4.

    gosub Print_Clk_Info_Line
  )

  &match=0
  &wild_head=0
  &wild_tail=0
  &clk_input_length=STRING.LENGTH("&clk")
  &clk_itr_length=STRING.LENGTH("dtr1_pll_lock_det")

  if (STRING.SCAN("&clk", "*", 0)==0)
  (
    &wild_head=1
  )
  if (STRING.SCAN("&clk", "*", 1)==(STRING.LENGTH("&clk")-1))
  (
    &wild_tail=1
  )

  if ((&wild_head==1)&&(&wild_tail==1))
  (
    if (STRING.SCAN("dtr1_pll_lock_det", STRING.MID("&clk", 1, &clk_input_length-2), 0)!=-1)
    ( 
      &match=1
    )
  )
  else if (&wild_head==1)
  (
    if (STRING.MID("dtr1_pll_lock_det", &clk_itr_length-&clk_input_length+1, &clk_input_length-1)==STRING.CUT("&clk", 1))
    ( 
      &match=1
    )
  )
  else if (&wild_tail==1)
  (
    if (STRING.MID("dtr1_pll_lock_det", 0, &clk_input_length-1)==STRING.CUT("&clk", -1))
    ( 
      &match=1
    )
  )
  else if ("dtr1_pll_lock_det"=="&clk")
  (
    &match=1
  )
  
  if (&match==1)
  (
    &clk_test=&CLK_TEST_DTR1_PLL_LOCK_DET
    &clk_reg=0
    &clk_reg_name="No CBCR"
    &clk_name="dtr1_pll_lock_det"
    &clk_reg_cbcr_type=""
    &clk_vote_bit=-1.
    &clk_multiplier=4.

    gosub Print_Clk_Info_Line
  )

  &match=0
  &wild_head=0
  &wild_tail=0
  &clk_input_length=STRING.LENGTH("&clk")
  &clk_itr_length=STRING.LENGTH("dtr2_pll_dtest")

  if (STRING.SCAN("&clk", "*", 0)==0)
  (
    &wild_head=1
  )
  if (STRING.SCAN("&clk", "*", 1)==(STRING.LENGTH("&clk")-1))
  (
    &wild_tail=1
  )

  if ((&wild_head==1)&&(&wild_tail==1))
  (
    if (STRING.SCAN("dtr2_pll_dtest", STRING.MID("&clk", 1, &clk_input_length-2), 0)!=-1)
    ( 
      &match=1
    )
  )
  else if (&wild_head==1)
  (
    if (STRING.MID("dtr2_pll_dtest", &clk_itr_length-&clk_input_length+1, &clk_input_length-1)==STRING.CUT("&clk", 1))
    ( 
      &match=1
    )
  )
  else if (&wild_tail==1)
  (
    if (STRING.MID("dtr2_pll_dtest", 0, &clk_input_length-1)==STRING.CUT("&clk", -1))
    ( 
      &match=1
    )
  )
  else if ("dtr2_pll_dtest"=="&clk")
  (
    &match=1
  )
  
  if (&match==1)
  (
    &clk_test=&CLK_TEST_DTR2_PLL_DTEST
    &clk_reg=0
    &clk_reg_name="No CBCR"
    &clk_name="dtr2_pll_dtest"
    &clk_reg_cbcr_type=""
    &clk_vote_bit=-1.
    &clk_multiplier=4.

    gosub Print_Clk_Info_Line
  )

  &match=0
  &wild_head=0
  &wild_tail=0
  &clk_input_length=STRING.LENGTH("&clk")
  &clk_itr_length=STRING.LENGTH("dtr2_pll_lock_det")

  if (STRING.SCAN("&clk", "*", 0)==0)
  (
    &wild_head=1
  )
  if (STRING.SCAN("&clk", "*", 1)==(STRING.LENGTH("&clk")-1))
  (
    &wild_tail=1
  )

  if ((&wild_head==1)&&(&wild_tail==1))
  (
    if (STRING.SCAN("dtr2_pll_lock_det", STRING.MID("&clk", 1, &clk_input_length-2), 0)!=-1)
    ( 
      &match=1
    )
  )
  else if (&wild_head==1)
  (
    if (STRING.MID("dtr2_pll_lock_det", &clk_itr_length-&clk_input_length+1, &clk_input_length-1)==STRING.CUT("&clk", 1))
    ( 
      &match=1
    )
  )
  else if (&wild_tail==1)
  (
    if (STRING.MID("dtr2_pll_lock_det", 0, &clk_input_length-1)==STRING.CUT("&clk", -1))
    ( 
      &match=1
    )
  )
  else if ("dtr2_pll_lock_det"=="&clk")
  (
    &match=1
  )
  
  if (&match==1)
  (
    &clk_test=&CLK_TEST_DTR2_PLL_LOCK_DET
    &clk_reg=0
    &clk_reg_name="No CBCR"
    &clk_name="dtr2_pll_lock_det"
    &clk_reg_cbcr_type=""
    &clk_vote_bit=-1.
    &clk_multiplier=4.

    gosub Print_Clk_Info_Line
  )

  &match=0
  &wild_head=0
  &wild_tail=0
  &clk_input_length=STRING.LENGTH("&clk")
  &clk_itr_length=STRING.LENGTH("gcc_mss_mfab_axi_clk_src")

  if (STRING.SCAN("&clk", "*", 0)==0)
  (
    &wild_head=1
  )
  if (STRING.SCAN("&clk", "*", 1)==(STRING.LENGTH("&clk")-1))
  (
    &wild_tail=1
  )

  if ((&wild_head==1)&&(&wild_tail==1))
  (
    if (STRING.SCAN("gcc_mss_mfab_axi_clk_src", STRING.MID("&clk", 1, &clk_input_length-2), 0)!=-1)
    ( 
      &match=1
    )
  )
  else if (&wild_head==1)
  (
    if (STRING.MID("gcc_mss_mfab_axi_clk_src", &clk_itr_length-&clk_input_length+1, &clk_input_length-1)==STRING.CUT("&clk", 1))
    ( 
      &match=1
    )
  )
  else if (&wild_tail==1)
  (
    if (STRING.MID("gcc_mss_mfab_axi_clk_src", 0, &clk_input_length-1)==STRING.CUT("&clk", -1))
    ( 
      &match=1
    )
  )
  else if ("gcc_mss_mfab_axi_clk_src"=="&clk")
  (
    &match=1
  )
  
  if (&match==1)
  (
    &clk_test=&CLK_TEST_GCC_MSS_MFAB_AXI_CLK_SRC
    &clk_reg=0
    &clk_reg_name="No CBCR"
    &clk_name="gcc_mss_mfab_axi_clk_src"
    &clk_reg_cbcr_type=""
    &clk_vote_bit=-1.
    &clk_multiplier=4.

    gosub Print_Clk_Info_Line
  )

  &match=0
  &wild_head=0
  &wild_tail=0
  &clk_input_length=STRING.LENGTH("&clk")
  &clk_itr_length=STRING.LENGTH("gcc_mss_nav_ce_axi_clk_src")

  if (STRING.SCAN("&clk", "*", 0)==0)
  (
    &wild_head=1
  )
  if (STRING.SCAN("&clk", "*", 1)==(STRING.LENGTH("&clk")-1))
  (
    &wild_tail=1
  )

  if ((&wild_head==1)&&(&wild_tail==1))
  (
    if (STRING.SCAN("gcc_mss_nav_ce_axi_clk_src", STRING.MID("&clk", 1, &clk_input_length-2), 0)!=-1)
    ( 
      &match=1
    )
  )
  else if (&wild_head==1)
  (
    if (STRING.MID("gcc_mss_nav_ce_axi_clk_src", &clk_itr_length-&clk_input_length+1, &clk_input_length-1)==STRING.CUT("&clk", 1))
    ( 
      &match=1
    )
  )
  else if (&wild_tail==1)
  (
    if (STRING.MID("gcc_mss_nav_ce_axi_clk_src", 0, &clk_input_length-1)==STRING.CUT("&clk", -1))
    ( 
      &match=1
    )
  )
  else if ("gcc_mss_nav_ce_axi_clk_src"=="&clk")
  (
    &match=1
  )
  
  if (&match==1)
  (
    &clk_test=&CLK_TEST_GCC_MSS_NAV_CE_AXI_CLK_SRC
    &clk_reg=0
    &clk_reg_name="No CBCR"
    &clk_name="gcc_mss_nav_ce_axi_clk_src"
    &clk_reg_cbcr_type=""
    &clk_vote_bit=-1.
    &clk_multiplier=4.

    gosub Print_Clk_Info_Line
  )

  &match=0
  &wild_head=0
  &wild_tail=0
  &clk_input_length=STRING.LENGTH("&clk")
  &clk_itr_length=STRING.LENGTH("modem_offline_pll_dtest")

  if (STRING.SCAN("&clk", "*", 0)==0)
  (
    &wild_head=1
  )
  if (STRING.SCAN("&clk", "*", 1)==(STRING.LENGTH("&clk")-1))
  (
    &wild_tail=1
  )

  if ((&wild_head==1)&&(&wild_tail==1))
  (
    if (STRING.SCAN("modem_offline_pll_dtest", STRING.MID("&clk", 1, &clk_input_length-2), 0)!=-1)
    ( 
      &match=1
    )
  )
  else if (&wild_head==1)
  (
    if (STRING.MID("modem_offline_pll_dtest", &clk_itr_length-&clk_input_length+1, &clk_input_length-1)==STRING.CUT("&clk", 1))
    ( 
      &match=1
    )
  )
  else if (&wild_tail==1)
  (
    if (STRING.MID("modem_offline_pll_dtest", 0, &clk_input_length-1)==STRING.CUT("&clk", -1))
    ( 
      &match=1
    )
  )
  else if ("modem_offline_pll_dtest"=="&clk")
  (
    &match=1
  )
  
  if (&match==1)
  (
    &clk_test=&CLK_TEST_MODEM_OFFLINE_PLL_DTEST
    &clk_reg=0
    &clk_reg_name="No CBCR"
    &clk_name="modem_offline_pll_dtest"
    &clk_reg_cbcr_type=""
    &clk_vote_bit=-1.
    &clk_multiplier=4.

    gosub Print_Clk_Info_Line
  )

  &match=0
  &wild_head=0
  &wild_tail=0
  &clk_input_length=STRING.LENGTH("&clk")
  &clk_itr_length=STRING.LENGTH("mss_dgr_axi_clk")

  if (STRING.SCAN("&clk", "*", 0)==0)
  (
    &wild_head=1
  )
  if (STRING.SCAN("&clk", "*", 1)==(STRING.LENGTH("&clk")-1))
  (
    &wild_tail=1
  )

  if ((&wild_head==1)&&(&wild_tail==1))
  (
    if (STRING.SCAN("mss_dgr_axi_clk", STRING.MID("&clk", 1, &clk_input_length-2), 0)!=-1)
    ( 
      &match=1
    )
  )
  else if (&wild_head==1)
  (
    if (STRING.MID("mss_dgr_axi_clk", &clk_itr_length-&clk_input_length+1, &clk_input_length-1)==STRING.CUT("&clk", 1))
    ( 
      &match=1
    )
  )
  else if (&wild_tail==1)
  (
    if (STRING.MID("mss_dgr_axi_clk", 0, &clk_input_length-1)==STRING.CUT("&clk", -1))
    ( 
      &match=1
    )
  )
  else if ("mss_dgr_axi_clk"=="&clk")
  (
    &match=1
  )
  
  if (&match==1)
  (
    &clk_test=&CLK_TEST_MSS_DGR_AXI_CLK
    &clk_reg=0
    &clk_reg_name="No CBCR"
    &clk_name="mss_dgr_axi_clk"
    &clk_reg_cbcr_type=""
    &clk_vote_bit=-1.
    &clk_multiplier=4.

    gosub Print_Clk_Info_Line
  )

  &match=0
  &wild_head=0
  &wild_tail=0
  &clk_input_length=STRING.LENGTH("&clk")
  &clk_itr_length=STRING.LENGTH("mss_offline_pll_lock_det")

  if (STRING.SCAN("&clk", "*", 0)==0)
  (
    &wild_head=1
  )
  if (STRING.SCAN("&clk", "*", 1)==(STRING.LENGTH("&clk")-1))
  (
    &wild_tail=1
  )

  if ((&wild_head==1)&&(&wild_tail==1))
  (
    if (STRING.SCAN("mss_offline_pll_lock_det", STRING.MID("&clk", 1, &clk_input_length-2), 0)!=-1)
    ( 
      &match=1
    )
  )
  else if (&wild_head==1)
  (
    if (STRING.MID("mss_offline_pll_lock_det", &clk_itr_length-&clk_input_length+1, &clk_input_length-1)==STRING.CUT("&clk", 1))
    ( 
      &match=1
    )
  )
  else if (&wild_tail==1)
  (
    if (STRING.MID("mss_offline_pll_lock_det", 0, &clk_input_length-1)==STRING.CUT("&clk", -1))
    ( 
      &match=1
    )
  )
  else if ("mss_offline_pll_lock_det"=="&clk")
  (
    &match=1
  )
  
  if (&match==1)
  (
    &clk_test=&CLK_TEST_MSS_OFFLINE_PLL_LOCK_DET
    &clk_reg=0
    &clk_reg_name="No CBCR"
    &clk_name="mss_offline_pll_lock_det"
    &clk_reg_cbcr_type=""
    &clk_vote_bit=-1.
    &clk_multiplier=4.

    gosub Print_Clk_Info_Line
  )

  &match=0
  &wild_head=0
  &wild_tail=0
  &clk_input_length=STRING.LENGTH("&clk")
  &clk_itr_length=STRING.LENGTH("nav_pll_dtest")

  if (STRING.SCAN("&clk", "*", 0)==0)
  (
    &wild_head=1
  )
  if (STRING.SCAN("&clk", "*", 1)==(STRING.LENGTH("&clk")-1))
  (
    &wild_tail=1
  )

  if ((&wild_head==1)&&(&wild_tail==1))
  (
    if (STRING.SCAN("nav_pll_dtest", STRING.MID("&clk", 1, &clk_input_length-2), 0)!=-1)
    ( 
      &match=1
    )
  )
  else if (&wild_head==1)
  (
    if (STRING.MID("nav_pll_dtest", &clk_itr_length-&clk_input_length+1, &clk_input_length-1)==STRING.CUT("&clk", 1))
    ( 
      &match=1
    )
  )
  else if (&wild_tail==1)
  (
    if (STRING.MID("nav_pll_dtest", 0, &clk_input_length-1)==STRING.CUT("&clk", -1))
    ( 
      &match=1
    )
  )
  else if ("nav_pll_dtest"=="&clk")
  (
    &match=1
  )
  
  if (&match==1)
  (
    &clk_test=&CLK_TEST_NAV_PLL_DTEST
    &clk_reg=0
    &clk_reg_name="No CBCR"
    &clk_name="nav_pll_dtest"
    &clk_reg_cbcr_type=""
    &clk_vote_bit=-1.
    &clk_multiplier=4.

    gosub Print_Clk_Info_Line
  )

  &match=0
  &wild_head=0
  &wild_tail=0
  &clk_input_length=STRING.LENGTH("&clk")
  &clk_itr_length=STRING.LENGTH("nav_pll_lock_det")

  if (STRING.SCAN("&clk", "*", 0)==0)
  (
    &wild_head=1
  )
  if (STRING.SCAN("&clk", "*", 1)==(STRING.LENGTH("&clk")-1))
  (
    &wild_tail=1
  )

  if ((&wild_head==1)&&(&wild_tail==1))
  (
    if (STRING.SCAN("nav_pll_lock_det", STRING.MID("&clk", 1, &clk_input_length-2), 0)!=-1)
    ( 
      &match=1
    )
  )
  else if (&wild_head==1)
  (
    if (STRING.MID("nav_pll_lock_det", &clk_itr_length-&clk_input_length+1, &clk_input_length-1)==STRING.CUT("&clk", 1))
    ( 
      &match=1
    )
  )
  else if (&wild_tail==1)
  (
    if (STRING.MID("nav_pll_lock_det", 0, &clk_input_length-1)==STRING.CUT("&clk", -1))
    ( 
      &match=1
    )
  )
  else if ("nav_pll_lock_det"=="&clk")
  (
    &match=1
  )
  
  if (&match==1)
  (
    &clk_test=&CLK_TEST_NAV_PLL_LOCK_DET
    &clk_reg=0
    &clk_reg_name="No CBCR"
    &clk_name="nav_pll_lock_det"
    &clk_reg_cbcr_type=""
    &clk_vote_bit=-1.
    &clk_multiplier=4.

    gosub Print_Clk_Info_Line
  )

  &match=0
  &wild_head=0
  &wild_tail=0
  &clk_input_length=STRING.LENGTH("&clk")
  &clk_itr_length=STRING.LENGTH("q6_pll_dtest")

  if (STRING.SCAN("&clk", "*", 0)==0)
  (
    &wild_head=1
  )
  if (STRING.SCAN("&clk", "*", 1)==(STRING.LENGTH("&clk")-1))
  (
    &wild_tail=1
  )

  if ((&wild_head==1)&&(&wild_tail==1))
  (
    if (STRING.SCAN("q6_pll_dtest", STRING.MID("&clk", 1, &clk_input_length-2), 0)!=-1)
    ( 
      &match=1
    )
  )
  else if (&wild_head==1)
  (
    if (STRING.MID("q6_pll_dtest", &clk_itr_length-&clk_input_length+1, &clk_input_length-1)==STRING.CUT("&clk", 1))
    ( 
      &match=1
    )
  )
  else if (&wild_tail==1)
  (
    if (STRING.MID("q6_pll_dtest", 0, &clk_input_length-1)==STRING.CUT("&clk", -1))
    ( 
      &match=1
    )
  )
  else if ("q6_pll_dtest"=="&clk")
  (
    &match=1
  )
  
  if (&match==1)
  (
    &clk_test=&CLK_TEST_Q6_PLL_DTEST
    &clk_reg=0
    &clk_reg_name="No CBCR"
    &clk_name="q6_pll_dtest"
    &clk_reg_cbcr_type=""
    &clk_vote_bit=-1.
    &clk_multiplier=4.

    gosub Print_Clk_Info_Line
  )

  &match=0
  &wild_head=0
  &wild_tail=0
  &clk_input_length=STRING.LENGTH("&clk")
  &clk_itr_length=STRING.LENGTH("q6_pll_lock_det")

  if (STRING.SCAN("&clk", "*", 0)==0)
  (
    &wild_head=1
  )
  if (STRING.SCAN("&clk", "*", 1)==(STRING.LENGTH("&clk")-1))
  (
    &wild_tail=1
  )

  if ((&wild_head==1)&&(&wild_tail==1))
  (
    if (STRING.SCAN("q6_pll_lock_det", STRING.MID("&clk", 1, &clk_input_length-2), 0)!=-1)
    ( 
      &match=1
    )
  )
  else if (&wild_head==1)
  (
    if (STRING.MID("q6_pll_lock_det", &clk_itr_length-&clk_input_length+1, &clk_input_length-1)==STRING.CUT("&clk", 1))
    ( 
      &match=1
    )
  )
  else if (&wild_tail==1)
  (
    if (STRING.MID("q6_pll_lock_det", 0, &clk_input_length-1)==STRING.CUT("&clk", -1))
    ( 
      &match=1
    )
  )
  else if ("q6_pll_lock_det"=="&clk")
  (
    &match=1
  )
  
  if (&match==1)
  (
    &clk_test=&CLK_TEST_Q6_PLL_LOCK_DET
    &clk_reg=0
    &clk_reg_name="No CBCR"
    &clk_name="q6_pll_lock_det"
    &clk_reg_cbcr_type=""
    &clk_vote_bit=-1.
    &clk_multiplier=4.

    gosub Print_Clk_Info_Line
  )

  &match=0
  &wild_head=0
  &wild_tail=0
  &clk_input_length=STRING.LENGTH("&clk")
  &clk_itr_length=STRING.LENGTH("bb_core_clk")

  if (STRING.SCAN("&clk", "*", 0)==0)
  (
    &wild_head=1
  )
  if (STRING.SCAN("&clk", "*", 1)==(STRING.LENGTH("&clk")-1))
  (
    &wild_tail=1
  )

  if ((&wild_head==1)&&(&wild_tail==1))
  (
    if (STRING.SCAN("bb_core_clk", STRING.MID("&clk", 1, &clk_input_length-2), 0)!=-1)
    ( 
      &match=1
    )
  )
  else if (&wild_head==1)
  (
    if (STRING.MID("bb_core_clk", &clk_itr_length-&clk_input_length+1, &clk_input_length-1)==STRING.CUT("&clk", 1))
    ( 
      &match=1
    )
  )
  else if (&wild_tail==1)
  (
    if (STRING.MID("bb_core_clk", 0, &clk_input_length-1)==STRING.CUT("&clk", -1))
    ( 
      &match=1
    )
  )
  else if ("bb_core_clk"=="&clk")
  (
    &match=1
  )
  
  if (&match==1)
  (
    &clk_test=0
    &clk_reg=0
    &clk_reg_name="No CBCR"
    &clk_name="bb_core_clk"
    &clk_reg_cbcr_type=""
    &clk_vote_bit=-1.
    &clk_multiplier=1.

    gosub Print_Clk_Info_Line
  )

  &match=0
  &wild_head=0
  &wild_tail=0
  &clk_input_length=STRING.LENGTH("&clk")
  &clk_itr_length=STRING.LENGTH("bb_qlink_clk")

  if (STRING.SCAN("&clk", "*", 0)==0)
  (
    &wild_head=1
  )
  if (STRING.SCAN("&clk", "*", 1)==(STRING.LENGTH("&clk")-1))
  (
    &wild_tail=1
  )

  if ((&wild_head==1)&&(&wild_tail==1))
  (
    if (STRING.SCAN("bb_qlink_clk", STRING.MID("&clk", 1, &clk_input_length-2), 0)!=-1)
    ( 
      &match=1
    )
  )
  else if (&wild_head==1)
  (
    if (STRING.MID("bb_qlink_clk", &clk_itr_length-&clk_input_length+1, &clk_input_length-1)==STRING.CUT("&clk", 1))
    ( 
      &match=1
    )
  )
  else if (&wild_tail==1)
  (
    if (STRING.MID("bb_qlink_clk", 0, &clk_input_length-1)==STRING.CUT("&clk", -1))
    ( 
      &match=1
    )
  )
  else if ("bb_qlink_clk"=="&clk")
  (
    &match=1
  )
  
  if (&match==1)
  (
    &clk_test=0
    &clk_reg=0
    &clk_reg_name="No CBCR"
    &clk_name="bb_qlink_clk"
    &clk_reg_cbcr_type=""
    &clk_vote_bit=-1.
    &clk_multiplier=1.

    gosub Print_Clk_Info_Line
  )

  &match=0
  &wild_head=0
  &wild_tail=0
  &clk_input_length=STRING.LENGTH("&clk")
  &clk_itr_length=STRING.LENGTH("cp_clk")

  if (STRING.SCAN("&clk", "*", 0)==0)
  (
    &wild_head=1
  )
  if (STRING.SCAN("&clk", "*", 1)==(STRING.LENGTH("&clk")-1))
  (
    &wild_tail=1
  )

  if ((&wild_head==1)&&(&wild_tail==1))
  (
    if (STRING.SCAN("cp_clk", STRING.MID("&clk", 1, &clk_input_length-2), 0)!=-1)
    ( 
      &match=1
    )
  )
  else if (&wild_head==1)
  (
    if (STRING.MID("cp_clk", &clk_itr_length-&clk_input_length+1, &clk_input_length-1)==STRING.CUT("&clk", 1))
    ( 
      &match=1
    )
  )
  else if (&wild_tail==1)
  (
    if (STRING.MID("cp_clk", 0, &clk_input_length-1)==STRING.CUT("&clk", -1))
    ( 
      &match=1
    )
  )
  else if ("cp_clk"=="&clk")
  (
    &match=1
  )
  
  if (&match==1)
  (
    &clk_test=0
    &clk_reg=0
    &clk_reg_name="No CBCR"
    &clk_name="cp_clk"
    &clk_reg_cbcr_type=""
    &clk_vote_bit=-1.
    &clk_multiplier=1.

    gosub Print_Clk_Info_Line
  )

  &match=0
  &wild_head=0
  &wild_tail=0
  &clk_input_length=STRING.LENGTH("&clk")
  &clk_itr_length=STRING.LENGTH("dma_clk")

  if (STRING.SCAN("&clk", "*", 0)==0)
  (
    &wild_head=1
  )
  if (STRING.SCAN("&clk", "*", 1)==(STRING.LENGTH("&clk")-1))
  (
    &wild_tail=1
  )

  if ((&wild_head==1)&&(&wild_tail==1))
  (
    if (STRING.SCAN("dma_clk", STRING.MID("&clk", 1, &clk_input_length-2), 0)!=-1)
    ( 
      &match=1
    )
  )
  else if (&wild_head==1)
  (
    if (STRING.MID("dma_clk", &clk_itr_length-&clk_input_length+1, &clk_input_length-1)==STRING.CUT("&clk", 1))
    ( 
      &match=1
    )
  )
  else if (&wild_tail==1)
  (
    if (STRING.MID("dma_clk", 0, &clk_input_length-1)==STRING.CUT("&clk", -1))
    ( 
      &match=1
    )
  )
  else if ("dma_clk"=="&clk")
  (
    &match=1
  )
  
  if (&match==1)
  (
    &clk_test=0
    &clk_reg=0
    &clk_reg_name="No CBCR"
    &clk_name="dma_clk"
    &clk_reg_cbcr_type=""
    &clk_vote_bit=-1.
    &clk_multiplier=1.

    gosub Print_Clk_Info_Line
  )

  &match=0
  &wild_head=0
  &wild_tail=0
  &clk_input_length=STRING.LENGTH("&clk")
  &clk_itr_length=STRING.LENGTH("dp_clk")

  if (STRING.SCAN("&clk", "*", 0)==0)
  (
    &wild_head=1
  )
  if (STRING.SCAN("&clk", "*", 1)==(STRING.LENGTH("&clk")-1))
  (
    &wild_tail=1
  )

  if ((&wild_head==1)&&(&wild_tail==1))
  (
    if (STRING.SCAN("dp_clk", STRING.MID("&clk", 1, &clk_input_length-2), 0)!=-1)
    ( 
      &match=1
    )
  )
  else if (&wild_head==1)
  (
    if (STRING.MID("dp_clk", &clk_itr_length-&clk_input_length+1, &clk_input_length-1)==STRING.CUT("&clk", 1))
    ( 
      &match=1
    )
  )
  else if (&wild_tail==1)
  (
    if (STRING.MID("dp_clk", 0, &clk_input_length-1)==STRING.CUT("&clk", -1))
    ( 
      &match=1
    )
  )
  else if ("dp_clk"=="&clk")
  (
    &match=1
  )
  
  if (&match==1)
  (
    &clk_test=0
    &clk_reg=0
    &clk_reg_name="No CBCR"
    &clk_name="dp_clk"
    &clk_reg_cbcr_type=""
    &clk_vote_bit=-1.
    &clk_multiplier=1.

    gosub Print_Clk_Info_Line
  )

  &match=0
  &wild_head=0
  &wild_tail=0
  &clk_input_length=STRING.LENGTH("&clk")
  &clk_itr_length=STRING.LENGTH("gnss_adc_ret_clk")

  if (STRING.SCAN("&clk", "*", 0)==0)
  (
    &wild_head=1
  )
  if (STRING.SCAN("&clk", "*", 1)==(STRING.LENGTH("&clk")-1))
  (
    &wild_tail=1
  )

  if ((&wild_head==1)&&(&wild_tail==1))
  (
    if (STRING.SCAN("gnss_adc_ret_clk", STRING.MID("&clk", 1, &clk_input_length-2), 0)!=-1)
    ( 
      &match=1
    )
  )
  else if (&wild_head==1)
  (
    if (STRING.MID("gnss_adc_ret_clk", &clk_itr_length-&clk_input_length+1, &clk_input_length-1)==STRING.CUT("&clk", 1))
    ( 
      &match=1
    )
  )
  else if (&wild_tail==1)
  (
    if (STRING.MID("gnss_adc_ret_clk", 0, &clk_input_length-1)==STRING.CUT("&clk", -1))
    ( 
      &match=1
    )
  )
  else if ("gnss_adc_ret_clk"=="&clk")
  (
    &match=1
  )
  
  if (&match==1)
  (
    &clk_test=0
    &clk_reg=0
    &clk_reg_name="No CBCR"
    &clk_name="gnss_adc_ret_clk"
    &clk_reg_cbcr_type=""
    &clk_vote_bit=-1.
    &clk_multiplier=1.

    gosub Print_Clk_Info_Line
  )

  &match=0
  &wild_head=0
  &wild_tail=0
  &clk_input_length=STRING.LENGTH("&clk")
  &clk_itr_length=STRING.LENGTH("adc1_clk")

  if (STRING.SCAN("&clk", "*", 0)==0)
  (
    &wild_head=1
  )
  if (STRING.SCAN("&clk", "*", 1)==(STRING.LENGTH("&clk")-1))
  (
    &wild_tail=1
  )

  if ((&wild_head==1)&&(&wild_tail==1))
  (
    if (STRING.SCAN("adc1_clk", STRING.MID("&clk", 1, &clk_input_length-2), 0)!=-1)
    ( 
      &match=1
    )
  )
  else if (&wild_head==1)
  (
    if (STRING.MID("adc1_clk", &clk_itr_length-&clk_input_length+1, &clk_input_length-1)==STRING.CUT("&clk", 1))
    ( 
      &match=1
    )
  )
  else if (&wild_tail==1)
  (
    if (STRING.MID("adc1_clk", 0, &clk_input_length-1)==STRING.CUT("&clk", -1))
    ( 
      &match=1
    )
  )
  else if ("adc1_clk"=="&clk")
  (
    &match=1
  )
  
  if (&match==1)
  (
    &clk_test=0
    &clk_reg=0
    &clk_reg_name="No CBCR"
    &clk_name="adc1_clk"
    &clk_reg_cbcr_type=""
    &clk_vote_bit=-1.
    &clk_multiplier=1.

    gosub Print_Clk_Info_Line
  )

  &match=0
  &wild_head=0
  &wild_tail=0
  &clk_input_length=STRING.LENGTH("&clk")
  &clk_itr_length=STRING.LENGTH("bp1_src_clk")

  if (STRING.SCAN("&clk", "*", 0)==0)
  (
    &wild_head=1
  )
  if (STRING.SCAN("&clk", "*", 1)==(STRING.LENGTH("&clk")-1))
  (
    &wild_tail=1
  )

  if ((&wild_head==1)&&(&wild_tail==1))
  (
    if (STRING.SCAN("bp1_src_clk", STRING.MID("&clk", 1, &clk_input_length-2), 0)!=-1)
    ( 
      &match=1
    )
  )
  else if (&wild_head==1)
  (
    if (STRING.MID("bp1_src_clk", &clk_itr_length-&clk_input_length+1, &clk_input_length-1)==STRING.CUT("&clk", 1))
    ( 
      &match=1
    )
  )
  else if (&wild_tail==1)
  (
    if (STRING.MID("bp1_src_clk", 0, &clk_input_length-1)==STRING.CUT("&clk", -1))
    ( 
      &match=1
    )
  )
  else if ("bp1_src_clk"=="&clk")
  (
    &match=1
  )
  
  if (&match==1)
  (
    &clk_test=0
    &clk_reg=0
    &clk_reg_name="No CBCR"
    &clk_name="bp1_src_clk"
    &clk_reg_cbcr_type=""
    &clk_vote_bit=-1.
    &clk_multiplier=1.

    gosub Print_Clk_Info_Line
  )

  &match=0
  &wild_head=0
  &wild_tail=0
  &clk_input_length=STRING.LENGTH("&clk")
  &clk_itr_length=STRING.LENGTH("bp2_src_clk")

  if (STRING.SCAN("&clk", "*", 0)==0)
  (
    &wild_head=1
  )
  if (STRING.SCAN("&clk", "*", 1)==(STRING.LENGTH("&clk")-1))
  (
    &wild_tail=1
  )

  if ((&wild_head==1)&&(&wild_tail==1))
  (
    if (STRING.SCAN("bp2_src_clk", STRING.MID("&clk", 1, &clk_input_length-2), 0)!=-1)
    ( 
      &match=1
    )
  )
  else if (&wild_head==1)
  (
    if (STRING.MID("bp2_src_clk", &clk_itr_length-&clk_input_length+1, &clk_input_length-1)==STRING.CUT("&clk", 1))
    ( 
      &match=1
    )
  )
  else if (&wild_tail==1)
  (
    if (STRING.MID("bp2_src_clk", 0, &clk_input_length-1)==STRING.CUT("&clk", -1))
    ( 
      &match=1
    )
  )
  else if ("bp2_src_clk"=="&clk")
  (
    &match=1
  )
  
  if (&match==1)
  (
    &clk_test=0
    &clk_reg=0
    &clk_reg_name="No CBCR"
    &clk_name="bp2_src_clk"
    &clk_reg_cbcr_type=""
    &clk_vote_bit=-1.
    &clk_multiplier=1.

    gosub Print_Clk_Info_Line
  )

  &match=0
  &wild_head=0
  &wild_tail=0
  &clk_input_length=STRING.LENGTH("&clk")
  &clk_itr_length=STRING.LENGTH("bp3_src_clk")

  if (STRING.SCAN("&clk", "*", 0)==0)
  (
    &wild_head=1
  )
  if (STRING.SCAN("&clk", "*", 1)==(STRING.LENGTH("&clk")-1))
  (
    &wild_tail=1
  )

  if ((&wild_head==1)&&(&wild_tail==1))
  (
    if (STRING.SCAN("bp3_src_clk", STRING.MID("&clk", 1, &clk_input_length-2), 0)!=-1)
    ( 
      &match=1
    )
  )
  else if (&wild_head==1)
  (
    if (STRING.MID("bp3_src_clk", &clk_itr_length-&clk_input_length+1, &clk_input_length-1)==STRING.CUT("&clk", 1))
    ( 
      &match=1
    )
  )
  else if (&wild_tail==1)
  (
    if (STRING.MID("bp3_src_clk", 0, &clk_input_length-1)==STRING.CUT("&clk", -1))
    ( 
      &match=1
    )
  )
  else if ("bp3_src_clk"=="&clk")
  (
    &match=1
  )
  
  if (&match==1)
  (
    &clk_test=0
    &clk_reg=0
    &clk_reg_name="No CBCR"
    &clk_name="bp3_src_clk"
    &clk_reg_cbcr_type=""
    &clk_vote_bit=-1.
    &clk_multiplier=1.

    gosub Print_Clk_Info_Line
  )

  &match=0
  &wild_head=0
  &wild_tail=0
  &clk_input_length=STRING.LENGTH("&clk")
  &clk_itr_length=STRING.LENGTH("bp_mbs_src_clk")

  if (STRING.SCAN("&clk", "*", 0)==0)
  (
    &wild_head=1
  )
  if (STRING.SCAN("&clk", "*", 1)==(STRING.LENGTH("&clk")-1))
  (
    &wild_tail=1
  )

  if ((&wild_head==1)&&(&wild_tail==1))
  (
    if (STRING.SCAN("bp_mbs_src_clk", STRING.MID("&clk", 1, &clk_input_length-2), 0)!=-1)
    ( 
      &match=1
    )
  )
  else if (&wild_head==1)
  (
    if (STRING.MID("bp_mbs_src_clk", &clk_itr_length-&clk_input_length+1, &clk_input_length-1)==STRING.CUT("&clk", 1))
    ( 
      &match=1
    )
  )
  else if (&wild_tail==1)
  (
    if (STRING.MID("bp_mbs_src_clk", 0, &clk_input_length-1)==STRING.CUT("&clk", -1))
    ( 
      &match=1
    )
  )
  else if ("bp_mbs_src_clk"=="&clk")
  (
    &match=1
  )
  
  if (&match==1)
  (
    &clk_test=0
    &clk_reg=0
    &clk_reg_name="No CBCR"
    &clk_name="bp_mbs_src_clk"
    &clk_reg_cbcr_type=""
    &clk_vote_bit=-1.
    &clk_multiplier=1.

    gosub Print_Clk_Info_Line
  )

  &match=0
  &wild_head=0
  &wild_tail=0
  &clk_input_length=STRING.LENGTH("&clk")
  &clk_itr_length=STRING.LENGTH("wtr_core_clk")

  if (STRING.SCAN("&clk", "*", 0)==0)
  (
    &wild_head=1
  )
  if (STRING.SCAN("&clk", "*", 1)==(STRING.LENGTH("&clk")-1))
  (
    &wild_tail=1
  )

  if ((&wild_head==1)&&(&wild_tail==1))
  (
    if (STRING.SCAN("wtr_core_clk", STRING.MID("&clk", 1, &clk_input_length-2), 0)!=-1)
    ( 
      &match=1
    )
  )
  else if (&wild_head==1)
  (
    if (STRING.MID("wtr_core_clk", &clk_itr_length-&clk_input_length+1, &clk_input_length-1)==STRING.CUT("&clk", 1))
    ( 
      &match=1
    )
  )
  else if (&wild_tail==1)
  (
    if (STRING.MID("wtr_core_clk", 0, &clk_input_length-1)==STRING.CUT("&clk", -1))
    ( 
      &match=1
    )
  )
  else if ("wtr_core_clk"=="&clk")
  (
    &match=1
  )
  
  if (&match==1)
  (
    &clk_test=0
    &clk_reg=0
    &clk_reg_name="No CBCR"
    &clk_name="wtr_core_clk"
    &clk_reg_cbcr_type=""
    &clk_vote_bit=-1.
    &clk_multiplier=1.

    gosub Print_Clk_Info_Line
  )

  &match=0
  &wild_head=0
  &wild_tail=0
  &clk_input_length=STRING.LENGTH("&clk")
  &clk_itr_length=STRING.LENGTH("stmr_xo_clk")

  if (STRING.SCAN("&clk", "*", 0)==0)
  (
    &wild_head=1
  )
  if (STRING.SCAN("&clk", "*", 1)==(STRING.LENGTH("&clk")-1))
  (
    &wild_tail=1
  )

  if ((&wild_head==1)&&(&wild_tail==1))
  (
    if (STRING.SCAN("stmr_xo_clk", STRING.MID("&clk", 1, &clk_input_length-2), 0)!=-1)
    ( 
      &match=1
    )
  )
  else if (&wild_head==1)
  (
    if (STRING.MID("stmr_xo_clk", &clk_itr_length-&clk_input_length+1, &clk_input_length-1)==STRING.CUT("&clk", 1))
    ( 
      &match=1
    )
  )
  else if (&wild_tail==1)
  (
    if (STRING.MID("stmr_xo_clk", 0, &clk_input_length-1)==STRING.CUT("&clk", -1))
    ( 
      &match=1
    )
  )
  else if ("stmr_xo_clk"=="&clk")
  (
    &match=1
  )
  
  if (&match==1)
  (
    &clk_test=0
    &clk_reg=0
    &clk_reg_name="No CBCR"
    &clk_name="stmr_xo_clk"
    &clk_reg_cbcr_type=""
    &clk_vote_bit=-1.
    &clk_multiplier=1.

    gosub Print_Clk_Info_Line
  )

  &match=0
  &wild_head=0
  &wild_tail=0
  &clk_input_length=STRING.LENGTH("&clk")
  &clk_itr_length=STRING.LENGTH("xo_gdsc_clk")

  if (STRING.SCAN("&clk", "*", 0)==0)
  (
    &wild_head=1
  )
  if (STRING.SCAN("&clk", "*", 1)==(STRING.LENGTH("&clk")-1))
  (
    &wild_tail=1
  )

  if ((&wild_head==1)&&(&wild_tail==1))
  (
    if (STRING.SCAN("xo_gdsc_clk", STRING.MID("&clk", 1, &clk_input_length-2), 0)!=-1)
    ( 
      &match=1
    )
  )
  else if (&wild_head==1)
  (
    if (STRING.MID("xo_gdsc_clk", &clk_itr_length-&clk_input_length+1, &clk_input_length-1)==STRING.CUT("&clk", 1))
    ( 
      &match=1
    )
  )
  else if (&wild_tail==1)
  (
    if (STRING.MID("xo_gdsc_clk", 0, &clk_input_length-1)==STRING.CUT("&clk", -1))
    ( 
      &match=1
    )
  )
  else if ("xo_gdsc_clk"=="&clk")
  (
    &match=1
  )
  
  if (&match==1)
  (
    &clk_test=0
    &clk_reg=0
    &clk_reg_name="No CBCR"
    &clk_name="xo_gdsc_clk"
    &clk_reg_cbcr_type=""
    &clk_vote_bit=-1.
    &clk_multiplier=1.

    gosub Print_Clk_Info_Line
  )

  &match=0
  &wild_head=0
  &wild_tail=0
  &clk_input_length=STRING.LENGTH("&clk")
  &clk_itr_length=STRING.LENGTH("wcss_dbg_apb_clk")

  if (STRING.SCAN("&clk", "*", 0)==0)
  (
    &wild_head=1
  )
  if (STRING.SCAN("&clk", "*", 1)==(STRING.LENGTH("&clk")-1))
  (
    &wild_tail=1
  )

  if ((&wild_head==1)&&(&wild_tail==1))
  (
    if (STRING.SCAN("wcss_dbg_apb_clk", STRING.MID("&clk", 1, &clk_input_length-2), 0)!=-1)
    ( 
      &match=1
    )
  )
  else if (&wild_head==1)
  (
    if (STRING.MID("wcss_dbg_apb_clk", &clk_itr_length-&clk_input_length+1, &clk_input_length-1)==STRING.CUT("&clk", 1))
    ( 
      &match=1
    )
  )
  else if (&wild_tail==1)
  (
    if (STRING.MID("wcss_dbg_apb_clk", 0, &clk_input_length-1)==STRING.CUT("&clk", -1))
    ( 
      &match=1
    )
  )
  else if ("wcss_dbg_apb_clk"=="&clk")
  (
    &match=1
  )
  
  if (&match==1)
  (
    &clk_test=&CLK_TEST_WCSS_DBG_APB_CLK
    &clk_reg=&HWIO_WCSS_HM_A_WCSS_CLK_CTL_WCSS_DBG_APB_CBCR_ADDR
    &clk_reg_name="WCSS_HM_A_WCSS_CLK_CTL_WCSS_DBG_APB_CBCR"
    &clk_name="wcss_dbg_apb_clk"
    &clk_reg_cbcr_type="sm_cbc"
    &clk_vote_bit=-1.
    &clk_multiplier=4.

    gosub Print_Clk_Info_Line
  )

  &match=0
  &wild_head=0
  &wild_tail=0
  &clk_input_length=STRING.LENGTH("&clk")
  &clk_itr_length=STRING.LENGTH("wcss_dbg_atb_clk")

  if (STRING.SCAN("&clk", "*", 0)==0)
  (
    &wild_head=1
  )
  if (STRING.SCAN("&clk", "*", 1)==(STRING.LENGTH("&clk")-1))
  (
    &wild_tail=1
  )

  if ((&wild_head==1)&&(&wild_tail==1))
  (
    if (STRING.SCAN("wcss_dbg_atb_clk", STRING.MID("&clk", 1, &clk_input_length-2), 0)!=-1)
    ( 
      &match=1
    )
  )
  else if (&wild_head==1)
  (
    if (STRING.MID("wcss_dbg_atb_clk", &clk_itr_length-&clk_input_length+1, &clk_input_length-1)==STRING.CUT("&clk", 1))
    ( 
      &match=1
    )
  )
  else if (&wild_tail==1)
  (
    if (STRING.MID("wcss_dbg_atb_clk", 0, &clk_input_length-1)==STRING.CUT("&clk", -1))
    ( 
      &match=1
    )
  )
  else if ("wcss_dbg_atb_clk"=="&clk")
  (
    &match=1
  )
  
  if (&match==1)
  (
    &clk_test=&CLK_TEST_WCSS_DBG_ATB_CLK
    &clk_reg=&HWIO_WCSS_HM_A_WCSS_CLK_CTL_WCSS_DBG_ATB_CBCR_ADDR
    &clk_reg_name="WCSS_HM_A_WCSS_CLK_CTL_WCSS_DBG_ATB_CBCR"
    &clk_name="wcss_dbg_atb_clk"
    &clk_reg_cbcr_type="sm_pscbc"
    &clk_vote_bit=-1.
    &clk_multiplier=4.

    gosub Print_Clk_Info_Line
  )

  &match=0
  &wild_head=0
  &wild_tail=0
  &clk_input_length=STRING.LENGTH("&clk")
  &clk_itr_length=STRING.LENGTH("wcss_dbg_css_apb_clk")

  if (STRING.SCAN("&clk", "*", 0)==0)
  (
    &wild_head=1
  )
  if (STRING.SCAN("&clk", "*", 1)==(STRING.LENGTH("&clk")-1))
  (
    &wild_tail=1
  )

  if ((&wild_head==1)&&(&wild_tail==1))
  (
    if (STRING.SCAN("wcss_dbg_css_apb_clk", STRING.MID("&clk", 1, &clk_input_length-2), 0)!=-1)
    ( 
      &match=1
    )
  )
  else if (&wild_head==1)
  (
    if (STRING.MID("wcss_dbg_css_apb_clk", &clk_itr_length-&clk_input_length+1, &clk_input_length-1)==STRING.CUT("&clk", 1))
    ( 
      &match=1
    )
  )
  else if (&wild_tail==1)
  (
    if (STRING.MID("wcss_dbg_css_apb_clk", 0, &clk_input_length-1)==STRING.CUT("&clk", -1))
    ( 
      &match=1
    )
  )
  else if ("wcss_dbg_css_apb_clk"=="&clk")
  (
    &match=1
  )
  
  if (&match==1)
  (
    &clk_test=&CLK_TEST_WCSS_DBG_CSS_APB_CLK
    &clk_reg=&HWIO_WCSS_HM_A_WCSS_CLK_CTL_WCSS_DBG_CSS_APB_CBCR_ADDR
    &clk_reg_name="WCSS_HM_A_WCSS_CLK_CTL_WCSS_DBG_CSS_APB_CBCR"
    &clk_name="wcss_dbg_css_apb_clk"
    &clk_reg_cbcr_type="sm_cbc"
    &clk_vote_bit=-1.
    &clk_multiplier=4.

    gosub Print_Clk_Info_Line
  )

  &match=0
  &wild_head=0
  &wild_tail=0
  &clk_input_length=STRING.LENGTH("&clk")
  &clk_itr_length=STRING.LENGTH("wcss_dbg_css_atb_clk")

  if (STRING.SCAN("&clk", "*", 0)==0)
  (
    &wild_head=1
  )
  if (STRING.SCAN("&clk", "*", 1)==(STRING.LENGTH("&clk")-1))
  (
    &wild_tail=1
  )

  if ((&wild_head==1)&&(&wild_tail==1))
  (
    if (STRING.SCAN("wcss_dbg_css_atb_clk", STRING.MID("&clk", 1, &clk_input_length-2), 0)!=-1)
    ( 
      &match=1
    )
  )
  else if (&wild_head==1)
  (
    if (STRING.MID("wcss_dbg_css_atb_clk", &clk_itr_length-&clk_input_length+1, &clk_input_length-1)==STRING.CUT("&clk", 1))
    ( 
      &match=1
    )
  )
  else if (&wild_tail==1)
  (
    if (STRING.MID("wcss_dbg_css_atb_clk", 0, &clk_input_length-1)==STRING.CUT("&clk", -1))
    ( 
      &match=1
    )
  )
  else if ("wcss_dbg_css_atb_clk"=="&clk")
  (
    &match=1
  )
  
  if (&match==1)
  (
    &clk_test=&CLK_TEST_WCSS_DBG_CSS_ATB_CLK
    &clk_reg=&HWIO_WCSS_HM_A_WCSS_CLK_CTL_WCSS_DBG_CSS_ATB_CBCR_ADDR
    &clk_reg_name="WCSS_HM_A_WCSS_CLK_CTL_WCSS_DBG_CSS_ATB_CBCR"
    &clk_name="wcss_dbg_css_atb_clk"
    &clk_reg_cbcr_type="sm_cbc"
    &clk_vote_bit=-1.
    &clk_multiplier=4.

    gosub Print_Clk_Info_Line
  )

  &match=0
  &wild_head=0
  &wild_tail=0
  &clk_input_length=STRING.LENGTH("&clk")
  &clk_itr_length=STRING.LENGTH("wcss_dbg_css_ts_clk")

  if (STRING.SCAN("&clk", "*", 0)==0)
  (
    &wild_head=1
  )
  if (STRING.SCAN("&clk", "*", 1)==(STRING.LENGTH("&clk")-1))
  (
    &wild_tail=1
  )

  if ((&wild_head==1)&&(&wild_tail==1))
  (
    if (STRING.SCAN("wcss_dbg_css_ts_clk", STRING.MID("&clk", 1, &clk_input_length-2), 0)!=-1)
    ( 
      &match=1
    )
  )
  else if (&wild_head==1)
  (
    if (STRING.MID("wcss_dbg_css_ts_clk", &clk_itr_length-&clk_input_length+1, &clk_input_length-1)==STRING.CUT("&clk", 1))
    ( 
      &match=1
    )
  )
  else if (&wild_tail==1)
  (
    if (STRING.MID("wcss_dbg_css_ts_clk", 0, &clk_input_length-1)==STRING.CUT("&clk", -1))
    ( 
      &match=1
    )
  )
  else if ("wcss_dbg_css_ts_clk"=="&clk")
  (
    &match=1
  )
  
  if (&match==1)
  (
    &clk_test=&CLK_TEST_WCSS_DBG_CSS_TS_CLK
    &clk_reg=&HWIO_WCSS_HM_A_WCSS_CLK_CTL_WCSS_DBG_CSS_TS_CBCR_ADDR
    &clk_reg_name="WCSS_HM_A_WCSS_CLK_CTL_WCSS_DBG_CSS_TS_CBCR"
    &clk_name="wcss_dbg_css_ts_clk"
    &clk_reg_cbcr_type="sm_cbc"
    &clk_vote_bit=-1.
    &clk_multiplier=4.

    gosub Print_Clk_Info_Line
  )

  &match=0
  &wild_head=0
  &wild_tail=0
  &clk_input_length=STRING.LENGTH("&clk")
  &clk_itr_length=STRING.LENGTH("wcss_dbg_ts_clk")

  if (STRING.SCAN("&clk", "*", 0)==0)
  (
    &wild_head=1
  )
  if (STRING.SCAN("&clk", "*", 1)==(STRING.LENGTH("&clk")-1))
  (
    &wild_tail=1
  )

  if ((&wild_head==1)&&(&wild_tail==1))
  (
    if (STRING.SCAN("wcss_dbg_ts_clk", STRING.MID("&clk", 1, &clk_input_length-2), 0)!=-1)
    ( 
      &match=1
    )
  )
  else if (&wild_head==1)
  (
    if (STRING.MID("wcss_dbg_ts_clk", &clk_itr_length-&clk_input_length+1, &clk_input_length-1)==STRING.CUT("&clk", 1))
    ( 
      &match=1
    )
  )
  else if (&wild_tail==1)
  (
    if (STRING.MID("wcss_dbg_ts_clk", 0, &clk_input_length-1)==STRING.CUT("&clk", -1))
    ( 
      &match=1
    )
  )
  else if ("wcss_dbg_ts_clk"=="&clk")
  (
    &match=1
  )
  
  if (&match==1)
  (
    &clk_test=&CLK_TEST_WCSS_DBG_TS_CLK
    &clk_reg=&HWIO_WCSS_HM_A_WCSS_CLK_CTL_WCSS_DBG_TS_CBCR_ADDR
    &clk_reg_name="WCSS_HM_A_WCSS_CLK_CTL_WCSS_DBG_TS_CBCR"
    &clk_name="wcss_dbg_ts_clk"
    &clk_reg_cbcr_type="sm_cbc"
    &clk_vote_bit=-1.
    &clk_multiplier=4.

    gosub Print_Clk_Info_Line
  )

  &match=0
  &wild_head=0
  &wild_tail=0
  &clk_input_length=STRING.LENGTH("&clk")
  &clk_itr_length=STRING.LENGTH("wcss_ahb_tslv_clk")

  if (STRING.SCAN("&clk", "*", 0)==0)
  (
    &wild_head=1
  )
  if (STRING.SCAN("&clk", "*", 1)==(STRING.LENGTH("&clk")-1))
  (
    &wild_tail=1
  )

  if ((&wild_head==1)&&(&wild_tail==1))
  (
    if (STRING.SCAN("wcss_ahb_tslv_clk", STRING.MID("&clk", 1, &clk_input_length-2), 0)!=-1)
    ( 
      &match=1
    )
  )
  else if (&wild_head==1)
  (
    if (STRING.MID("wcss_ahb_tslv_clk", &clk_itr_length-&clk_input_length+1, &clk_input_length-1)==STRING.CUT("&clk", 1))
    ( 
      &match=1
    )
  )
  else if (&wild_tail==1)
  (
    if (STRING.MID("wcss_ahb_tslv_clk", 0, &clk_input_length-1)==STRING.CUT("&clk", -1))
    ( 
      &match=1
    )
  )
  else if ("wcss_ahb_tslv_clk"=="&clk")
  (
    &match=1
  )
  
  if (&match==1)
  (
    &clk_test=&CLK_TEST_WCSS_AHB_TSLV_CLK
    &clk_reg=&HWIO_WCSS_HM_A_WCSS_CLK_CTL_WCSS_AHB_TSLV_CBCR_ADDR
    &clk_reg_name="WCSS_HM_A_WCSS_CLK_CTL_WCSS_AHB_TSLV_CBCR"
    &clk_name="wcss_ahb_tslv_clk"
    &clk_reg_cbcr_type="sm_cbc"
    &clk_vote_bit=-1.
    &clk_multiplier=4.

    gosub Print_Clk_Info_Line
  )

  &match=0
  &wild_head=0
  &wild_tail=0
  &clk_input_length=STRING.LENGTH("&clk")
  &clk_itr_length=STRING.LENGTH("wcss_css_apb_clk")

  if (STRING.SCAN("&clk", "*", 0)==0)
  (
    &wild_head=1
  )
  if (STRING.SCAN("&clk", "*", 1)==(STRING.LENGTH("&clk")-1))
  (
    &wild_tail=1
  )

  if ((&wild_head==1)&&(&wild_tail==1))
  (
    if (STRING.SCAN("wcss_css_apb_clk", STRING.MID("&clk", 1, &clk_input_length-2), 0)!=-1)
    ( 
      &match=1
    )
  )
  else if (&wild_head==1)
  (
    if (STRING.MID("wcss_css_apb_clk", &clk_itr_length-&clk_input_length+1, &clk_input_length-1)==STRING.CUT("&clk", 1))
    ( 
      &match=1
    )
  )
  else if (&wild_tail==1)
  (
    if (STRING.MID("wcss_css_apb_clk", 0, &clk_input_length-1)==STRING.CUT("&clk", -1))
    ( 
      &match=1
    )
  )
  else if ("wcss_css_apb_clk"=="&clk")
  (
    &match=1
  )
  
  if (&match==1)
  (
    &clk_test=&CLK_TEST_WCSS_CSS_APB_CLK
    &clk_reg=&HWIO_WCSS_HM_A_WCSS_CLK_CTL_WCSS_CSS_APB_CBCR_ADDR
    &clk_reg_name="WCSS_HM_A_WCSS_CLK_CTL_WCSS_CSS_APB_CBCR"
    &clk_name="wcss_css_apb_clk"
    &clk_reg_cbcr_type="sm_pscbc"
    &clk_vote_bit=-1.
    &clk_multiplier=4.

    gosub Print_Clk_Info_Line
  )

  &match=0
  &wild_head=0
  &wild_tail=0
  &clk_input_length=STRING.LENGTH("&clk")
  &clk_itr_length=STRING.LENGTH("wcss_css_noc_clk")

  if (STRING.SCAN("&clk", "*", 0)==0)
  (
    &wild_head=1
  )
  if (STRING.SCAN("&clk", "*", 1)==(STRING.LENGTH("&clk")-1))
  (
    &wild_tail=1
  )

  if ((&wild_head==1)&&(&wild_tail==1))
  (
    if (STRING.SCAN("wcss_css_noc_clk", STRING.MID("&clk", 1, &clk_input_length-2), 0)!=-1)
    ( 
      &match=1
    )
  )
  else if (&wild_head==1)
  (
    if (STRING.MID("wcss_css_noc_clk", &clk_itr_length-&clk_input_length+1, &clk_input_length-1)==STRING.CUT("&clk", 1))
    ( 
      &match=1
    )
  )
  else if (&wild_tail==1)
  (
    if (STRING.MID("wcss_css_noc_clk", 0, &clk_input_length-1)==STRING.CUT("&clk", -1))
    ( 
      &match=1
    )
  )
  else if ("wcss_css_noc_clk"=="&clk")
  (
    &match=1
  )
  
  if (&match==1)
  (
    &clk_test=&CLK_TEST_WCSS_CSS_NOC_CLK
    &clk_reg=&HWIO_WCSS_HM_A_WCSS_CLK_CTL_WCSS_CSS_NOC_CBCR_ADDR
    &clk_reg_name="WCSS_HM_A_WCSS_CLK_CTL_WCSS_CSS_NOC_CBCR"
    &clk_name="wcss_css_noc_clk"
    &clk_reg_cbcr_type="sm_pscbc"
    &clk_vote_bit=-1.
    &clk_multiplier=4.

    gosub Print_Clk_Info_Line
  )

  &match=0
  &wild_head=0
  &wild_tail=0
  &clk_input_length=STRING.LENGTH("&clk")
  &clk_itr_length=STRING.LENGTH("wcss_phy1_apb_clk")

  if (STRING.SCAN("&clk", "*", 0)==0)
  (
    &wild_head=1
  )
  if (STRING.SCAN("&clk", "*", 1)==(STRING.LENGTH("&clk")-1))
  (
    &wild_tail=1
  )

  if ((&wild_head==1)&&(&wild_tail==1))
  (
    if (STRING.SCAN("wcss_phy1_apb_clk", STRING.MID("&clk", 1, &clk_input_length-2), 0)!=-1)
    ( 
      &match=1
    )
  )
  else if (&wild_head==1)
  (
    if (STRING.MID("wcss_phy1_apb_clk", &clk_itr_length-&clk_input_length+1, &clk_input_length-1)==STRING.CUT("&clk", 1))
    ( 
      &match=1
    )
  )
  else if (&wild_tail==1)
  (
    if (STRING.MID("wcss_phy1_apb_clk", 0, &clk_input_length-1)==STRING.CUT("&clk", -1))
    ( 
      &match=1
    )
  )
  else if ("wcss_phy1_apb_clk"=="&clk")
  (
    &match=1
  )
  
  if (&match==1)
  (
    &clk_test=&CLK_TEST_WCSS_PHY1_APB_CLK
    &clk_reg=&HWIO_WCSS_HM_A_WCSS_CLK_CTL_WCSS_PHY1_APB_CBCR_ADDR
    &clk_reg_name="WCSS_HM_A_WCSS_CLK_CTL_WCSS_PHY1_APB_CBCR"
    &clk_name="wcss_phy1_apb_clk"
    &clk_reg_cbcr_type="sm_cbc"
    &clk_vote_bit=-1.
    &clk_multiplier=4.

    gosub Print_Clk_Info_Line
  )

  &match=0
  &wild_head=0
  &wild_tail=0
  &clk_input_length=STRING.LENGTH("&clk")
  &clk_itr_length=STRING.LENGTH("wcss_phy2_apb_clk")

  if (STRING.SCAN("&clk", "*", 0)==0)
  (
    &wild_head=1
  )
  if (STRING.SCAN("&clk", "*", 1)==(STRING.LENGTH("&clk")-1))
  (
    &wild_tail=1
  )

  if ((&wild_head==1)&&(&wild_tail==1))
  (
    if (STRING.SCAN("wcss_phy2_apb_clk", STRING.MID("&clk", 1, &clk_input_length-2), 0)!=-1)
    ( 
      &match=1
    )
  )
  else if (&wild_head==1)
  (
    if (STRING.MID("wcss_phy2_apb_clk", &clk_itr_length-&clk_input_length+1, &clk_input_length-1)==STRING.CUT("&clk", 1))
    ( 
      &match=1
    )
  )
  else if (&wild_tail==1)
  (
    if (STRING.MID("wcss_phy2_apb_clk", 0, &clk_input_length-1)==STRING.CUT("&clk", -1))
    ( 
      &match=1
    )
  )
  else if ("wcss_phy2_apb_clk"=="&clk")
  (
    &match=1
  )
  
  if (&match==1)
  (
    &clk_test=&CLK_TEST_WCSS_PHY2_APB_CLK
    &clk_reg=&HWIO_WCSS_HM_A_WCSS_CLK_CTL_WCSS_PHY2_APB_CBCR_ADDR
    &clk_reg_name="WCSS_HM_A_WCSS_CLK_CTL_WCSS_PHY2_APB_CBCR"
    &clk_name="wcss_phy2_apb_clk"
    &clk_reg_cbcr_type="sm_cbc"
    &clk_vote_bit=-1.
    &clk_multiplier=4.

    gosub Print_Clk_Info_Line
  )

  &match=0
  &wild_head=0
  &wild_tail=0
  &clk_input_length=STRING.LENGTH("&clk")
  &clk_itr_length=STRING.LENGTH("wcss_rfactrl_apb_clk")

  if (STRING.SCAN("&clk", "*", 0)==0)
  (
    &wild_head=1
  )
  if (STRING.SCAN("&clk", "*", 1)==(STRING.LENGTH("&clk")-1))
  (
    &wild_tail=1
  )

  if ((&wild_head==1)&&(&wild_tail==1))
  (
    if (STRING.SCAN("wcss_rfactrl_apb_clk", STRING.MID("&clk", 1, &clk_input_length-2), 0)!=-1)
    ( 
      &match=1
    )
  )
  else if (&wild_head==1)
  (
    if (STRING.MID("wcss_rfactrl_apb_clk", &clk_itr_length-&clk_input_length+1, &clk_input_length-1)==STRING.CUT("&clk", 1))
    ( 
      &match=1
    )
  )
  else if (&wild_tail==1)
  (
    if (STRING.MID("wcss_rfactrl_apb_clk", 0, &clk_input_length-1)==STRING.CUT("&clk", -1))
    ( 
      &match=1
    )
  )
  else if ("wcss_rfactrl_apb_clk"=="&clk")
  (
    &match=1
  )
  
  if (&match==1)
  (
    &clk_test=&CLK_TEST_WCSS_RFACTRL_APB_CLK
    &clk_reg=&HWIO_WCSS_HM_A_WCSS_CLK_CTL_WCSS_RFACTRL_APB_CBCR_ADDR
    &clk_reg_name="WCSS_HM_A_WCSS_CLK_CTL_WCSS_RFACTRL_APB_CBCR"
    &clk_name="wcss_rfactrl_apb_clk"
    &clk_reg_cbcr_type="sm_cbc"
    &clk_vote_bit=-1.
    &clk_multiplier=4.

    gosub Print_Clk_Info_Line
  )

  &match=0
  &wild_head=0
  &wild_tail=0
  &clk_input_length=STRING.LENGTH("&clk")
  &clk_itr_length=STRING.LENGTH("wcss_rfactrl_dac_apb_clk")

  if (STRING.SCAN("&clk", "*", 0)==0)
  (
    &wild_head=1
  )
  if (STRING.SCAN("&clk", "*", 1)==(STRING.LENGTH("&clk")-1))
  (
    &wild_tail=1
  )

  if ((&wild_head==1)&&(&wild_tail==1))
  (
    if (STRING.SCAN("wcss_rfactrl_dac_apb_clk", STRING.MID("&clk", 1, &clk_input_length-2), 0)!=-1)
    ( 
      &match=1
    )
  )
  else if (&wild_head==1)
  (
    if (STRING.MID("wcss_rfactrl_dac_apb_clk", &clk_itr_length-&clk_input_length+1, &clk_input_length-1)==STRING.CUT("&clk", 1))
    ( 
      &match=1
    )
  )
  else if (&wild_tail==1)
  (
    if (STRING.MID("wcss_rfactrl_dac_apb_clk", 0, &clk_input_length-1)==STRING.CUT("&clk", -1))
    ( 
      &match=1
    )
  )
  else if ("wcss_rfactrl_dac_apb_clk"=="&clk")
  (
    &match=1
  )
  
  if (&match==1)
  (
    &clk_test=&CLK_TEST_WCSS_RFACTRL_DAC_APB_CLK
    &clk_reg=&HWIO_WCSS_HM_A_WCSS_CLK_CTL_WCSS_RFACTRL_DAC_APB_CBCR_ADDR
    &clk_reg_name="WCSS_HM_A_WCSS_CLK_CTL_WCSS_RFACTRL_DAC_APB_CBCR"
    &clk_name="wcss_rfactrl_dac_apb_clk"
    &clk_reg_cbcr_type="sm_cbc"
    &clk_vote_bit=-1.
    &clk_multiplier=4.

    gosub Print_Clk_Info_Line
  )

  &match=0
  &wild_head=0
  &wild_tail=0
  &clk_input_length=STRING.LENGTH("&clk")
  &clk_itr_length=STRING.LENGTH("wcss_top_ahb_clk")

  if (STRING.SCAN("&clk", "*", 0)==0)
  (
    &wild_head=1
  )
  if (STRING.SCAN("&clk", "*", 1)==(STRING.LENGTH("&clk")-1))
  (
    &wild_tail=1
  )

  if ((&wild_head==1)&&(&wild_tail==1))
  (
    if (STRING.SCAN("wcss_top_ahb_clk", STRING.MID("&clk", 1, &clk_input_length-2), 0)!=-1)
    ( 
      &match=1
    )
  )
  else if (&wild_head==1)
  (
    if (STRING.MID("wcss_top_ahb_clk", &clk_itr_length-&clk_input_length+1, &clk_input_length-1)==STRING.CUT("&clk", 1))
    ( 
      &match=1
    )
  )
  else if (&wild_tail==1)
  (
    if (STRING.MID("wcss_top_ahb_clk", 0, &clk_input_length-1)==STRING.CUT("&clk", -1))
    ( 
      &match=1
    )
  )
  else if ("wcss_top_ahb_clk"=="&clk")
  (
    &match=1
  )
  
  if (&match==1)
  (
    &clk_test=&CLK_TEST_WCSS_TOP_AHB_CLK
    &clk_reg=&HWIO_WCSS_HM_A_WCSS_CLK_CTL_WCSS_TOP_AHB_CBCR_ADDR
    &clk_reg_name="WCSS_HM_A_WCSS_CLK_CTL_WCSS_TOP_AHB_CBCR"
    &clk_name="wcss_top_ahb_clk"
    &clk_reg_cbcr_type="sm_cbc"
    &clk_vote_bit=-1.
    &clk_multiplier=4.

    gosub Print_Clk_Info_Line
  )

  &match=0
  &wild_head=0
  &wild_tail=0
  &clk_input_length=STRING.LENGTH("&clk")
  &clk_itr_length=STRING.LENGTH("wcss_top_axi_clk")

  if (STRING.SCAN("&clk", "*", 0)==0)
  (
    &wild_head=1
  )
  if (STRING.SCAN("&clk", "*", 1)==(STRING.LENGTH("&clk")-1))
  (
    &wild_tail=1
  )

  if ((&wild_head==1)&&(&wild_tail==1))
  (
    if (STRING.SCAN("wcss_top_axi_clk", STRING.MID("&clk", 1, &clk_input_length-2), 0)!=-1)
    ( 
      &match=1
    )
  )
  else if (&wild_head==1)
  (
    if (STRING.MID("wcss_top_axi_clk", &clk_itr_length-&clk_input_length+1, &clk_input_length-1)==STRING.CUT("&clk", 1))
    ( 
      &match=1
    )
  )
  else if (&wild_tail==1)
  (
    if (STRING.MID("wcss_top_axi_clk", 0, &clk_input_length-1)==STRING.CUT("&clk", -1))
    ( 
      &match=1
    )
  )
  else if ("wcss_top_axi_clk"=="&clk")
  (
    &match=1
  )
  
  if (&match==1)
  (
    &clk_test=&CLK_TEST_WCSS_TOP_AXI_CLK
    &clk_reg=&HWIO_WCSS_HM_A_WCSS_CLK_CTL_WCSS_TOP_AXI_CBCR_ADDR
    &clk_reg_name="WCSS_HM_A_WCSS_CLK_CTL_WCSS_TOP_AXI_CBCR"
    &clk_name="wcss_top_axi_clk"
    &clk_reg_cbcr_type="sm_cbc"
    &clk_vote_bit=-1.
    &clk_multiplier=4.

    gosub Print_Clk_Info_Line
  )

  &match=0
  &wild_head=0
  &wild_tail=0
  &clk_input_length=STRING.LENGTH("&clk")
  &clk_itr_length=STRING.LENGTH("wcss_top_dac_apb_clk")

  if (STRING.SCAN("&clk", "*", 0)==0)
  (
    &wild_head=1
  )
  if (STRING.SCAN("&clk", "*", 1)==(STRING.LENGTH("&clk")-1))
  (
    &wild_tail=1
  )

  if ((&wild_head==1)&&(&wild_tail==1))
  (
    if (STRING.SCAN("wcss_top_dac_apb_clk", STRING.MID("&clk", 1, &clk_input_length-2), 0)!=-1)
    ( 
      &match=1
    )
  )
  else if (&wild_head==1)
  (
    if (STRING.MID("wcss_top_dac_apb_clk", &clk_itr_length-&clk_input_length+1, &clk_input_length-1)==STRING.CUT("&clk", 1))
    ( 
      &match=1
    )
  )
  else if (&wild_tail==1)
  (
    if (STRING.MID("wcss_top_dac_apb_clk", 0, &clk_input_length-1)==STRING.CUT("&clk", -1))
    ( 
      &match=1
    )
  )
  else if ("wcss_top_dac_apb_clk"=="&clk")
  (
    &match=1
  )
  
  if (&match==1)
  (
    &clk_test=&CLK_TEST_WCSS_TOP_DAC_APB_CLK
    &clk_reg=&HWIO_WCSS_HM_A_WCSS_CLK_CTL_WCSS_TOP_DAC_APB_CBCR_ADDR
    &clk_reg_name="WCSS_HM_A_WCSS_CLK_CTL_WCSS_TOP_DAC_APB_CBCR"
    &clk_name="wcss_top_dac_apb_clk"
    &clk_reg_cbcr_type="sm_cbc"
    &clk_vote_bit=-1.
    &clk_multiplier=4.

    gosub Print_Clk_Info_Line
  )

  &match=0
  &wild_head=0
  &wild_tail=0
  &clk_input_length=STRING.LENGTH("&clk")
  &clk_itr_length=STRING.LENGTH("wcss_wcssdbg_cfg_apb_clk")

  if (STRING.SCAN("&clk", "*", 0)==0)
  (
    &wild_head=1
  )
  if (STRING.SCAN("&clk", "*", 1)==(STRING.LENGTH("&clk")-1))
  (
    &wild_tail=1
  )

  if ((&wild_head==1)&&(&wild_tail==1))
  (
    if (STRING.SCAN("wcss_wcssdbg_cfg_apb_clk", STRING.MID("&clk", 1, &clk_input_length-2), 0)!=-1)
    ( 
      &match=1
    )
  )
  else if (&wild_head==1)
  (
    if (STRING.MID("wcss_wcssdbg_cfg_apb_clk", &clk_itr_length-&clk_input_length+1, &clk_input_length-1)==STRING.CUT("&clk", 1))
    ( 
      &match=1
    )
  )
  else if (&wild_tail==1)
  (
    if (STRING.MID("wcss_wcssdbg_cfg_apb_clk", 0, &clk_input_length-1)==STRING.CUT("&clk", -1))
    ( 
      &match=1
    )
  )
  else if ("wcss_wcssdbg_cfg_apb_clk"=="&clk")
  (
    &match=1
  )
  
  if (&match==1)
  (
    &clk_test=&CLK_TEST_WCSS_WCSSDBG_CFG_APB_CLK
    &clk_reg=&HWIO_WCSS_HM_A_WCSS_CLK_CTL_WCSS_WCSSDBG_CFG_APB_CBCR_ADDR
    &clk_reg_name="WCSS_HM_A_WCSS_CLK_CTL_WCSS_WCSSDBG_CFG_APB_CBCR"
    &clk_name="wcss_wcssdbg_cfg_apb_clk"
    &clk_reg_cbcr_type="sm_cbc"
    &clk_vote_bit=-1.
    &clk_multiplier=4.

    gosub Print_Clk_Info_Line
  )

  &match=0
  &wild_head=0
  &wild_tail=0
  &clk_input_length=STRING.LENGTH("&clk")
  &clk_itr_length=STRING.LENGTH("wcss_wcssdbg_trc_clk")

  if (STRING.SCAN("&clk", "*", 0)==0)
  (
    &wild_head=1
  )
  if (STRING.SCAN("&clk", "*", 1)==(STRING.LENGTH("&clk")-1))
  (
    &wild_tail=1
  )

  if ((&wild_head==1)&&(&wild_tail==1))
  (
    if (STRING.SCAN("wcss_wcssdbg_trc_clk", STRING.MID("&clk", 1, &clk_input_length-2), 0)!=-1)
    ( 
      &match=1
    )
  )
  else if (&wild_head==1)
  (
    if (STRING.MID("wcss_wcssdbg_trc_clk", &clk_itr_length-&clk_input_length+1, &clk_input_length-1)==STRING.CUT("&clk", 1))
    ( 
      &match=1
    )
  )
  else if (&wild_tail==1)
  (
    if (STRING.MID("wcss_wcssdbg_trc_clk", 0, &clk_input_length-1)==STRING.CUT("&clk", -1))
    ( 
      &match=1
    )
  )
  else if ("wcss_wcssdbg_trc_clk"=="&clk")
  (
    &match=1
  )
  
  if (&match==1)
  (
    &clk_test=0
    &clk_reg=&HWIO_WCSS_HM_A_WCSS_CLK_CTL_WCSS_WCSSDBG_TRC_CBCR_ADDR
    &clk_reg_name="WCSS_HM_A_WCSS_CLK_CTL_WCSS_WCSSDBG_TRC_CBCR"
    &clk_name="wcss_wcssdbg_trc_clk"
    &clk_reg_cbcr_type="sm_cbc"
    &clk_vote_bit=-1.
    &clk_multiplier=4.

    gosub Print_Clk_Info_Line
  )

  &match=0
  &wild_head=0
  &wild_tail=0
  &clk_input_length=STRING.LENGTH("&clk")
  &clk_itr_length=STRING.LENGTH("wcss_wmac1_apb_clk")

  if (STRING.SCAN("&clk", "*", 0)==0)
  (
    &wild_head=1
  )
  if (STRING.SCAN("&clk", "*", 1)==(STRING.LENGTH("&clk")-1))
  (
    &wild_tail=1
  )

  if ((&wild_head==1)&&(&wild_tail==1))
  (
    if (STRING.SCAN("wcss_wmac1_apb_clk", STRING.MID("&clk", 1, &clk_input_length-2), 0)!=-1)
    ( 
      &match=1
    )
  )
  else if (&wild_head==1)
  (
    if (STRING.MID("wcss_wmac1_apb_clk", &clk_itr_length-&clk_input_length+1, &clk_input_length-1)==STRING.CUT("&clk", 1))
    ( 
      &match=1
    )
  )
  else if (&wild_tail==1)
  (
    if (STRING.MID("wcss_wmac1_apb_clk", 0, &clk_input_length-1)==STRING.CUT("&clk", -1))
    ( 
      &match=1
    )
  )
  else if ("wcss_wmac1_apb_clk"=="&clk")
  (
    &match=1
  )
  
  if (&match==1)
  (
    &clk_test=&CLK_TEST_WCSS_WMAC1_APB_CLK
    &clk_reg=&HWIO_WCSS_HM_A_WCSS_CLK_CTL_WCSS_WMAC1_APB_CBCR_ADDR
    &clk_reg_name="WCSS_HM_A_WCSS_CLK_CTL_WCSS_WMAC1_APB_CBCR"
    &clk_name="wcss_wmac1_apb_clk"
    &clk_reg_cbcr_type="sm_cbc"
    &clk_vote_bit=-1.
    &clk_multiplier=4.

    gosub Print_Clk_Info_Line
  )

  &match=0
  &wild_head=0
  &wild_tail=0
  &clk_input_length=STRING.LENGTH("&clk")
  &clk_itr_length=STRING.LENGTH("wcss_wmac2_apb_clk")

  if (STRING.SCAN("&clk", "*", 0)==0)
  (
    &wild_head=1
  )
  if (STRING.SCAN("&clk", "*", 1)==(STRING.LENGTH("&clk")-1))
  (
    &wild_tail=1
  )

  if ((&wild_head==1)&&(&wild_tail==1))
  (
    if (STRING.SCAN("wcss_wmac2_apb_clk", STRING.MID("&clk", 1, &clk_input_length-2), 0)!=-1)
    ( 
      &match=1
    )
  )
  else if (&wild_head==1)
  (
    if (STRING.MID("wcss_wmac2_apb_clk", &clk_itr_length-&clk_input_length+1, &clk_input_length-1)==STRING.CUT("&clk", 1))
    ( 
      &match=1
    )
  )
  else if (&wild_tail==1)
  (
    if (STRING.MID("wcss_wmac2_apb_clk", 0, &clk_input_length-1)==STRING.CUT("&clk", -1))
    ( 
      &match=1
    )
  )
  else if ("wcss_wmac2_apb_clk"=="&clk")
  (
    &match=1
  )
  
  if (&match==1)
  (
    &clk_test=&CLK_TEST_WCSS_WMAC2_APB_CLK
    &clk_reg=&HWIO_WCSS_HM_A_WCSS_CLK_CTL_WCSS_WMAC2_APB_CBCR_ADDR
    &clk_reg_name="WCSS_HM_A_WCSS_CLK_CTL_WCSS_WMAC2_APB_CBCR"
    &clk_name="wcss_wmac2_apb_clk"
    &clk_reg_cbcr_type="sm_cbc"
    &clk_vote_bit=-1.
    &clk_multiplier=4.

    gosub Print_Clk_Info_Line
  )

  &match=0
  &wild_head=0
  &wild_tail=0
  &clk_input_length=STRING.LENGTH("&clk")
  &clk_itr_length=STRING.LENGTH("wcss_css_phy1_t240_clk")

  if (STRING.SCAN("&clk", "*", 0)==0)
  (
    &wild_head=1
  )
  if (STRING.SCAN("&clk", "*", 1)==(STRING.LENGTH("&clk")-1))
  (
    &wild_tail=1
  )

  if ((&wild_head==1)&&(&wild_tail==1))
  (
    if (STRING.SCAN("wcss_css_phy1_t240_clk", STRING.MID("&clk", 1, &clk_input_length-2), 0)!=-1)
    ( 
      &match=1
    )
  )
  else if (&wild_head==1)
  (
    if (STRING.MID("wcss_css_phy1_t240_clk", &clk_itr_length-&clk_input_length+1, &clk_input_length-1)==STRING.CUT("&clk", 1))
    ( 
      &match=1
    )
  )
  else if (&wild_tail==1)
  (
    if (STRING.MID("wcss_css_phy1_t240_clk", 0, &clk_input_length-1)==STRING.CUT("&clk", -1))
    ( 
      &match=1
    )
  )
  else if ("wcss_css_phy1_t240_clk"=="&clk")
  (
    &match=1
  )
  
  if (&match==1)
  (
    &clk_test=0
    &clk_reg=&HWIO_WCSS_HM_A_WCSS_CLK_CTL_WCSS_CSS_PHY1_T240_CBCR_ADDR
    &clk_reg_name="WCSS_HM_A_WCSS_CLK_CTL_WCSS_CSS_PHY1_T240_CBCR"
    &clk_name="wcss_css_phy1_t240_clk"
    &clk_reg_cbcr_type="sm_cbc"
    &clk_vote_bit=-1.
    &clk_multiplier=4.

    gosub Print_Clk_Info_Line
  )

  &match=0
  &wild_head=0
  &wild_tail=0
  &clk_input_length=STRING.LENGTH("&clk")
  &clk_itr_length=STRING.LENGTH("wcss_phy1_160_clk")

  if (STRING.SCAN("&clk", "*", 0)==0)
  (
    &wild_head=1
  )
  if (STRING.SCAN("&clk", "*", 1)==(STRING.LENGTH("&clk")-1))
  (
    &wild_tail=1
  )

  if ((&wild_head==1)&&(&wild_tail==1))
  (
    if (STRING.SCAN("wcss_phy1_160_clk", STRING.MID("&clk", 1, &clk_input_length-2), 0)!=-1)
    ( 
      &match=1
    )
  )
  else if (&wild_head==1)
  (
    if (STRING.MID("wcss_phy1_160_clk", &clk_itr_length-&clk_input_length+1, &clk_input_length-1)==STRING.CUT("&clk", 1))
    ( 
      &match=1
    )
  )
  else if (&wild_tail==1)
  (
    if (STRING.MID("wcss_phy1_160_clk", 0, &clk_input_length-1)==STRING.CUT("&clk", -1))
    ( 
      &match=1
    )
  )
  else if ("wcss_phy1_160_clk"=="&clk")
  (
    &match=1
  )
  
  if (&match==1)
  (
    &clk_test=&CLK_TEST_WCSS_PHY1_160_CLK
    &clk_reg=&HWIO_WCSS_HM_A_WCSS_CLK_CTL_WCSS_PHY1_160_CBCR_ADDR
    &clk_reg_name="WCSS_HM_A_WCSS_CLK_CTL_WCSS_PHY1_160_CBCR"
    &clk_name="wcss_phy1_160_clk"
    &clk_reg_cbcr_type="sm_sreg_pscbc"
    &clk_vote_bit=-1.
    &clk_multiplier=4.

    gosub Print_Clk_Info_Line
  )

  &match=0
  &wild_head=0
  &wild_tail=0
  &clk_input_length=STRING.LENGTH("&clk")
  &clk_itr_length=STRING.LENGTH("wcss_phy1_20_clk")

  if (STRING.SCAN("&clk", "*", 0)==0)
  (
    &wild_head=1
  )
  if (STRING.SCAN("&clk", "*", 1)==(STRING.LENGTH("&clk")-1))
  (
    &wild_tail=1
  )

  if ((&wild_head==1)&&(&wild_tail==1))
  (
    if (STRING.SCAN("wcss_phy1_20_clk", STRING.MID("&clk", 1, &clk_input_length-2), 0)!=-1)
    ( 
      &match=1
    )
  )
  else if (&wild_head==1)
  (
    if (STRING.MID("wcss_phy1_20_clk", &clk_itr_length-&clk_input_length+1, &clk_input_length-1)==STRING.CUT("&clk", 1))
    ( 
      &match=1
    )
  )
  else if (&wild_tail==1)
  (
    if (STRING.MID("wcss_phy1_20_clk", 0, &clk_input_length-1)==STRING.CUT("&clk", -1))
    ( 
      &match=1
    )
  )
  else if ("wcss_phy1_20_clk"=="&clk")
  (
    &match=1
  )
  
  if (&match==1)
  (
    &clk_test=&CLK_TEST_WCSS_PHY1_20_CLK
    &clk_reg=&HWIO_WCSS_HM_A_WCSS_CLK_CTL_WCSS_PHY1_20_CBCR_ADDR
    &clk_reg_name="WCSS_HM_A_WCSS_CLK_CTL_WCSS_PHY1_20_CBCR"
    &clk_name="wcss_phy1_20_clk"
    &clk_reg_cbcr_type="sm_sreg_pscbc"
    &clk_vote_bit=-1.
    &clk_multiplier=4.

    gosub Print_Clk_Info_Line
  )

  &match=0
  &wild_head=0
  &wild_tail=0
  &clk_input_length=STRING.LENGTH("&clk")
  &clk_itr_length=STRING.LENGTH("wcss_phy1_30_clk")

  if (STRING.SCAN("&clk", "*", 0)==0)
  (
    &wild_head=1
  )
  if (STRING.SCAN("&clk", "*", 1)==(STRING.LENGTH("&clk")-1))
  (
    &wild_tail=1
  )

  if ((&wild_head==1)&&(&wild_tail==1))
  (
    if (STRING.SCAN("wcss_phy1_30_clk", STRING.MID("&clk", 1, &clk_input_length-2), 0)!=-1)
    ( 
      &match=1
    )
  )
  else if (&wild_head==1)
  (
    if (STRING.MID("wcss_phy1_30_clk", &clk_itr_length-&clk_input_length+1, &clk_input_length-1)==STRING.CUT("&clk", 1))
    ( 
      &match=1
    )
  )
  else if (&wild_tail==1)
  (
    if (STRING.MID("wcss_phy1_30_clk", 0, &clk_input_length-1)==STRING.CUT("&clk", -1))
    ( 
      &match=1
    )
  )
  else if ("wcss_phy1_30_clk"=="&clk")
  (
    &match=1
  )
  
  if (&match==1)
  (
    &clk_test=&CLK_TEST_WCSS_PHY1_30_CLK
    &clk_reg=&HWIO_WCSS_HM_A_WCSS_CLK_CTL_WCSS_PHY1_30_CBCR_ADDR
    &clk_reg_name="WCSS_HM_A_WCSS_CLK_CTL_WCSS_PHY1_30_CBCR"
    &clk_name="wcss_phy1_30_clk"
    &clk_reg_cbcr_type="sm_cbc"
    &clk_vote_bit=-1.
    &clk_multiplier=4.

    gosub Print_Clk_Info_Line
  )

  &match=0
  &wild_head=0
  &wild_tail=0
  &clk_input_length=STRING.LENGTH("&clk")
  &clk_itr_length=STRING.LENGTH("wcss_phy1_320_clk")

  if (STRING.SCAN("&clk", "*", 0)==0)
  (
    &wild_head=1
  )
  if (STRING.SCAN("&clk", "*", 1)==(STRING.LENGTH("&clk")-1))
  (
    &wild_tail=1
  )

  if ((&wild_head==1)&&(&wild_tail==1))
  (
    if (STRING.SCAN("wcss_phy1_320_clk", STRING.MID("&clk", 1, &clk_input_length-2), 0)!=-1)
    ( 
      &match=1
    )
  )
  else if (&wild_head==1)
  (
    if (STRING.MID("wcss_phy1_320_clk", &clk_itr_length-&clk_input_length+1, &clk_input_length-1)==STRING.CUT("&clk", 1))
    ( 
      &match=1
    )
  )
  else if (&wild_tail==1)
  (
    if (STRING.MID("wcss_phy1_320_clk", 0, &clk_input_length-1)==STRING.CUT("&clk", -1))
    ( 
      &match=1
    )
  )
  else if ("wcss_phy1_320_clk"=="&clk")
  (
    &match=1
  )
  
  if (&match==1)
  (
    &clk_test=&CLK_TEST_WCSS_PHY1_320_CLK
    &clk_reg=&HWIO_WCSS_HM_A_WCSS_CLK_CTL_WCSS_PHY1_320_CBCR_ADDR
    &clk_reg_name="WCSS_HM_A_WCSS_CLK_CTL_WCSS_PHY1_320_CBCR"
    &clk_name="wcss_phy1_320_clk"
    &clk_reg_cbcr_type="sm_sreg_pscbc"
    &clk_vote_bit=-1.
    &clk_multiplier=4.

    gosub Print_Clk_Info_Line
  )

  &match=0
  &wild_head=0
  &wild_tail=0
  &clk_input_length=STRING.LENGTH("&clk")
  &clk_itr_length=STRING.LENGTH("wcss_phy1_40_clk")

  if (STRING.SCAN("&clk", "*", 0)==0)
  (
    &wild_head=1
  )
  if (STRING.SCAN("&clk", "*", 1)==(STRING.LENGTH("&clk")-1))
  (
    &wild_tail=1
  )

  if ((&wild_head==1)&&(&wild_tail==1))
  (
    if (STRING.SCAN("wcss_phy1_40_clk", STRING.MID("&clk", 1, &clk_input_length-2), 0)!=-1)
    ( 
      &match=1
    )
  )
  else if (&wild_head==1)
  (
    if (STRING.MID("wcss_phy1_40_clk", &clk_itr_length-&clk_input_length+1, &clk_input_length-1)==STRING.CUT("&clk", 1))
    ( 
      &match=1
    )
  )
  else if (&wild_tail==1)
  (
    if (STRING.MID("wcss_phy1_40_clk", 0, &clk_input_length-1)==STRING.CUT("&clk", -1))
    ( 
      &match=1
    )
  )
  else if ("wcss_phy1_40_clk"=="&clk")
  (
    &match=1
  )
  
  if (&match==1)
  (
    &clk_test=&CLK_TEST_WCSS_PHY1_40_CLK
    &clk_reg=&HWIO_WCSS_HM_A_WCSS_CLK_CTL_WCSS_PHY1_40_CBCR_ADDR
    &clk_reg_name="WCSS_HM_A_WCSS_CLK_CTL_WCSS_PHY1_40_CBCR"
    &clk_name="wcss_phy1_40_clk"
    &clk_reg_cbcr_type="sm_sreg_pscbc"
    &clk_vote_bit=-1.
    &clk_multiplier=4.

    gosub Print_Clk_Info_Line
  )

  &match=0
  &wild_head=0
  &wild_tail=0
  &clk_input_length=STRING.LENGTH("&clk")
  &clk_itr_length=STRING.LENGTH("wcss_phy1_80_clk")

  if (STRING.SCAN("&clk", "*", 0)==0)
  (
    &wild_head=1
  )
  if (STRING.SCAN("&clk", "*", 1)==(STRING.LENGTH("&clk")-1))
  (
    &wild_tail=1
  )

  if ((&wild_head==1)&&(&wild_tail==1))
  (
    if (STRING.SCAN("wcss_phy1_80_clk", STRING.MID("&clk", 1, &clk_input_length-2), 0)!=-1)
    ( 
      &match=1
    )
  )
  else if (&wild_head==1)
  (
    if (STRING.MID("wcss_phy1_80_clk", &clk_itr_length-&clk_input_length+1, &clk_input_length-1)==STRING.CUT("&clk", 1))
    ( 
      &match=1
    )
  )
  else if (&wild_tail==1)
  (
    if (STRING.MID("wcss_phy1_80_clk", 0, &clk_input_length-1)==STRING.CUT("&clk", -1))
    ( 
      &match=1
    )
  )
  else if ("wcss_phy1_80_clk"=="&clk")
  (
    &match=1
  )
  
  if (&match==1)
  (
    &clk_test=&CLK_TEST_WCSS_PHY1_80_CLK
    &clk_reg=&HWIO_WCSS_HM_A_WCSS_CLK_CTL_WCSS_PHY1_80_CBCR_ADDR
    &clk_reg_name="WCSS_HM_A_WCSS_CLK_CTL_WCSS_PHY1_80_CBCR"
    &clk_name="wcss_phy1_80_clk"
    &clk_reg_cbcr_type="sm_sreg_pscbc"
    &clk_vote_bit=-1.
    &clk_multiplier=4.

    gosub Print_Clk_Info_Line
  )

  &match=0
  &wild_head=0
  &wild_tail=0
  &clk_input_length=STRING.LENGTH("&clk")
  &clk_itr_length=STRING.LENGTH("wcss_phy1_bw_clk")

  if (STRING.SCAN("&clk", "*", 0)==0)
  (
    &wild_head=1
  )
  if (STRING.SCAN("&clk", "*", 1)==(STRING.LENGTH("&clk")-1))
  (
    &wild_tail=1
  )

  if ((&wild_head==1)&&(&wild_tail==1))
  (
    if (STRING.SCAN("wcss_phy1_bw_clk", STRING.MID("&clk", 1, &clk_input_length-2), 0)!=-1)
    ( 
      &match=1
    )
  )
  else if (&wild_head==1)
  (
    if (STRING.MID("wcss_phy1_bw_clk", &clk_itr_length-&clk_input_length+1, &clk_input_length-1)==STRING.CUT("&clk", 1))
    ( 
      &match=1
    )
  )
  else if (&wild_tail==1)
  (
    if (STRING.MID("wcss_phy1_bw_clk", 0, &clk_input_length-1)==STRING.CUT("&clk", -1))
    ( 
      &match=1
    )
  )
  else if ("wcss_phy1_bw_clk"=="&clk")
  (
    &match=1
  )
  
  if (&match==1)
  (
    &clk_test=&CLK_TEST_WCSS_PHY1_BW_CLK
    &clk_reg=&HWIO_WCSS_HM_A_WCSS_CLK_CTL_WCSS_PHY1_BW_CBCR_ADDR
    &clk_reg_name="WCSS_HM_A_WCSS_CLK_CTL_WCSS_PHY1_BW_CBCR"
    &clk_name="wcss_phy1_bw_clk"
    &clk_reg_cbcr_type="sm_sreg_pscbc"
    &clk_vote_bit=-1.
    &clk_multiplier=4.

    gosub Print_Clk_Info_Line
  )

  &match=0
  &wild_head=0
  &wild_tail=0
  &clk_input_length=STRING.LENGTH("&clk")
  &clk_itr_length=STRING.LENGTH("wcss_phy1_bwx2_clk")

  if (STRING.SCAN("&clk", "*", 0)==0)
  (
    &wild_head=1
  )
  if (STRING.SCAN("&clk", "*", 1)==(STRING.LENGTH("&clk")-1))
  (
    &wild_tail=1
  )

  if ((&wild_head==1)&&(&wild_tail==1))
  (
    if (STRING.SCAN("wcss_phy1_bwx2_clk", STRING.MID("&clk", 1, &clk_input_length-2), 0)!=-1)
    ( 
      &match=1
    )
  )
  else if (&wild_head==1)
  (
    if (STRING.MID("wcss_phy1_bwx2_clk", &clk_itr_length-&clk_input_length+1, &clk_input_length-1)==STRING.CUT("&clk", 1))
    ( 
      &match=1
    )
  )
  else if (&wild_tail==1)
  (
    if (STRING.MID("wcss_phy1_bwx2_clk", 0, &clk_input_length-1)==STRING.CUT("&clk", -1))
    ( 
      &match=1
    )
  )
  else if ("wcss_phy1_bwx2_clk"=="&clk")
  (
    &match=1
  )
  
  if (&match==1)
  (
    &clk_test=&CLK_TEST_WCSS_PHY1_BWX2_CLK
    &clk_reg=&HWIO_WCSS_HM_A_WCSS_CLK_CTL_WCSS_PHY1_BWX2_CBCR_ADDR
    &clk_reg_name="WCSS_HM_A_WCSS_CLK_CTL_WCSS_PHY1_BWX2_CBCR"
    &clk_name="wcss_phy1_bwx2_clk"
    &clk_reg_cbcr_type="sm_cbc"
    &clk_vote_bit=-1.
    &clk_multiplier=4.

    gosub Print_Clk_Info_Line
  )

  &match=0
  &wild_head=0
  &wild_tail=0
  &clk_input_length=STRING.LENGTH("&clk")
  &clk_itr_length=STRING.LENGTH("wcss_phy1_clk")

  if (STRING.SCAN("&clk", "*", 0)==0)
  (
    &wild_head=1
  )
  if (STRING.SCAN("&clk", "*", 1)==(STRING.LENGTH("&clk")-1))
  (
    &wild_tail=1
  )

  if ((&wild_head==1)&&(&wild_tail==1))
  (
    if (STRING.SCAN("wcss_phy1_clk", STRING.MID("&clk", 1, &clk_input_length-2), 0)!=-1)
    ( 
      &match=1
    )
  )
  else if (&wild_head==1)
  (
    if (STRING.MID("wcss_phy1_clk", &clk_itr_length-&clk_input_length+1, &clk_input_length-1)==STRING.CUT("&clk", 1))
    ( 
      &match=1
    )
  )
  else if (&wild_tail==1)
  (
    if (STRING.MID("wcss_phy1_clk", 0, &clk_input_length-1)==STRING.CUT("&clk", -1))
    ( 
      &match=1
    )
  )
  else if ("wcss_phy1_clk"=="&clk")
  (
    &match=1
  )
  
  if (&match==1)
  (
    &clk_test=&CLK_TEST_WCSS_PHY1_CLK
    &clk_reg=&HWIO_WCSS_HM_A_WCSS_CLK_CTL_WCSS_PHY1_CBCR_ADDR
    &clk_reg_name="WCSS_HM_A_WCSS_CLK_CTL_WCSS_PHY1_CBCR"
    &clk_name="wcss_phy1_clk"
    &clk_reg_cbcr_type="sm_sreg_pscbc"
    &clk_vote_bit=-1.
    &clk_multiplier=4.

    gosub Print_Clk_Info_Line
  )

  &match=0
  &wild_head=0
  &wild_tail=0
  &clk_input_length=STRING.LENGTH("&clk")
  &clk_itr_length=STRING.LENGTH("wcss_phy1_dfs_clk")

  if (STRING.SCAN("&clk", "*", 0)==0)
  (
    &wild_head=1
  )
  if (STRING.SCAN("&clk", "*", 1)==(STRING.LENGTH("&clk")-1))
  (
    &wild_tail=1
  )

  if ((&wild_head==1)&&(&wild_tail==1))
  (
    if (STRING.SCAN("wcss_phy1_dfs_clk", STRING.MID("&clk", 1, &clk_input_length-2), 0)!=-1)
    ( 
      &match=1
    )
  )
  else if (&wild_head==1)
  (
    if (STRING.MID("wcss_phy1_dfs_clk", &clk_itr_length-&clk_input_length+1, &clk_input_length-1)==STRING.CUT("&clk", 1))
    ( 
      &match=1
    )
  )
  else if (&wild_tail==1)
  (
    if (STRING.MID("wcss_phy1_dfs_clk", 0, &clk_input_length-1)==STRING.CUT("&clk", -1))
    ( 
      &match=1
    )
  )
  else if ("wcss_phy1_dfs_clk"=="&clk")
  (
    &match=1
  )
  
  if (&match==1)
  (
    &clk_test=&CLK_TEST_WCSS_PHY1_DFS_CLK
    &clk_reg=&HWIO_WCSS_HM_A_WCSS_CLK_CTL_WCSS_PHY1_DFS_CBCR_ADDR
    &clk_reg_name="WCSS_HM_A_WCSS_CLK_CTL_WCSS_PHY1_DFS_CBCR"
    &clk_name="wcss_phy1_dfs_clk"
    &clk_reg_cbcr_type="sm_sreg_pscbc"
    &clk_vote_bit=-1.
    &clk_multiplier=4.

    gosub Print_Clk_Info_Line
  )

  &match=0
  &wild_head=0
  &wild_tail=0
  &clk_input_length=STRING.LENGTH("&clk")
  &clk_itr_length=STRING.LENGTH("wcss_phy1_t240_clk")

  if (STRING.SCAN("&clk", "*", 0)==0)
  (
    &wild_head=1
  )
  if (STRING.SCAN("&clk", "*", 1)==(STRING.LENGTH("&clk")-1))
  (
    &wild_tail=1
  )

  if ((&wild_head==1)&&(&wild_tail==1))
  (
    if (STRING.SCAN("wcss_phy1_t240_clk", STRING.MID("&clk", 1, &clk_input_length-2), 0)!=-1)
    ( 
      &match=1
    )
  )
  else if (&wild_head==1)
  (
    if (STRING.MID("wcss_phy1_t240_clk", &clk_itr_length-&clk_input_length+1, &clk_input_length-1)==STRING.CUT("&clk", 1))
    ( 
      &match=1
    )
  )
  else if (&wild_tail==1)
  (
    if (STRING.MID("wcss_phy1_t240_clk", 0, &clk_input_length-1)==STRING.CUT("&clk", -1))
    ( 
      &match=1
    )
  )
  else if ("wcss_phy1_t240_clk"=="&clk")
  (
    &match=1
  )
  
  if (&match==1)
  (
    &clk_test=&CLK_TEST_WCSS_PHY1_T240_CLK
    &clk_reg=&HWIO_WCSS_HM_A_WCSS_CLK_CTL_WCSS_PHY1_T240_CBCR_ADDR
    &clk_reg_name="WCSS_HM_A_WCSS_CLK_CTL_WCSS_PHY1_T240_CBCR"
    &clk_name="wcss_phy1_t240_clk"
    &clk_reg_cbcr_type="sm_cbc"
    &clk_vote_bit=-1.
    &clk_multiplier=4.

    gosub Print_Clk_Info_Line
  )

  &match=0
  &wild_head=0
  &wild_tail=0
  &clk_input_length=STRING.LENGTH("&clk")
  &clk_itr_length=STRING.LENGTH("wcss_phy1_tadc_clk")

  if (STRING.SCAN("&clk", "*", 0)==0)
  (
    &wild_head=1
  )
  if (STRING.SCAN("&clk", "*", 1)==(STRING.LENGTH("&clk")-1))
  (
    &wild_tail=1
  )

  if ((&wild_head==1)&&(&wild_tail==1))
  (
    if (STRING.SCAN("wcss_phy1_tadc_clk", STRING.MID("&clk", 1, &clk_input_length-2), 0)!=-1)
    ( 
      &match=1
    )
  )
  else if (&wild_head==1)
  (
    if (STRING.MID("wcss_phy1_tadc_clk", &clk_itr_length-&clk_input_length+1, &clk_input_length-1)==STRING.CUT("&clk", 1))
    ( 
      &match=1
    )
  )
  else if (&wild_tail==1)
  (
    if (STRING.MID("wcss_phy1_tadc_clk", 0, &clk_input_length-1)==STRING.CUT("&clk", -1))
    ( 
      &match=1
    )
  )
  else if ("wcss_phy1_tadc_clk"=="&clk")
  (
    &match=1
  )
  
  if (&match==1)
  (
    &clk_test=&CLK_TEST_WCSS_PHY1_TADC_CLK
    &clk_reg=&HWIO_WCSS_HM_A_WCSS_CLK_CTL_WCSS_PHY1_TADC_CBCR_ADDR
    &clk_reg_name="WCSS_HM_A_WCSS_CLK_CTL_WCSS_PHY1_TADC_CBCR"
    &clk_name="wcss_phy1_tadc_clk"
    &clk_reg_cbcr_type="sm_cbc"
    &clk_vote_bit=-1.
    &clk_multiplier=4.

    gosub Print_Clk_Info_Line
  )

  &match=0
  &wild_head=0
  &wild_tail=0
  &clk_input_length=STRING.LENGTH("&clk")
  &clk_itr_length=STRING.LENGTH("wcss_phy1_tdac_clk")

  if (STRING.SCAN("&clk", "*", 0)==0)
  (
    &wild_head=1
  )
  if (STRING.SCAN("&clk", "*", 1)==(STRING.LENGTH("&clk")-1))
  (
    &wild_tail=1
  )

  if ((&wild_head==1)&&(&wild_tail==1))
  (
    if (STRING.SCAN("wcss_phy1_tdac_clk", STRING.MID("&clk", 1, &clk_input_length-2), 0)!=-1)
    ( 
      &match=1
    )
  )
  else if (&wild_head==1)
  (
    if (STRING.MID("wcss_phy1_tdac_clk", &clk_itr_length-&clk_input_length+1, &clk_input_length-1)==STRING.CUT("&clk", 1))
    ( 
      &match=1
    )
  )
  else if (&wild_tail==1)
  (
    if (STRING.MID("wcss_phy1_tdac_clk", 0, &clk_input_length-1)==STRING.CUT("&clk", -1))
    ( 
      &match=1
    )
  )
  else if ("wcss_phy1_tdac_clk"=="&clk")
  (
    &match=1
  )
  
  if (&match==1)
  (
    &clk_test=&CLK_TEST_WCSS_PHY1_TDAC_CLK
    &clk_reg=&HWIO_WCSS_HM_A_WCSS_CLK_CTL_WCSS_PHY1_TDAC_CBCR_ADDR
    &clk_reg_name="WCSS_HM_A_WCSS_CLK_CTL_WCSS_PHY1_TDAC_CBCR"
    &clk_name="wcss_phy1_tdac_clk"
    &clk_reg_cbcr_type="sm_sreg_pscbc"
    &clk_vote_bit=-1.
    &clk_multiplier=4.

    gosub Print_Clk_Info_Line
  )

  &match=0
  &wild_head=0
  &wild_tail=0
  &clk_input_length=STRING.LENGTH("&clk")
  &clk_itr_length=STRING.LENGTH("wcss_phy1_x2_clk")

  if (STRING.SCAN("&clk", "*", 0)==0)
  (
    &wild_head=1
  )
  if (STRING.SCAN("&clk", "*", 1)==(STRING.LENGTH("&clk")-1))
  (
    &wild_tail=1
  )

  if ((&wild_head==1)&&(&wild_tail==1))
  (
    if (STRING.SCAN("wcss_phy1_x2_clk", STRING.MID("&clk", 1, &clk_input_length-2), 0)!=-1)
    ( 
      &match=1
    )
  )
  else if (&wild_head==1)
  (
    if (STRING.MID("wcss_phy1_x2_clk", &clk_itr_length-&clk_input_length+1, &clk_input_length-1)==STRING.CUT("&clk", 1))
    ( 
      &match=1
    )
  )
  else if (&wild_tail==1)
  (
    if (STRING.MID("wcss_phy1_x2_clk", 0, &clk_input_length-1)==STRING.CUT("&clk", -1))
    ( 
      &match=1
    )
  )
  else if ("wcss_phy1_x2_clk"=="&clk")
  (
    &match=1
  )
  
  if (&match==1)
  (
    &clk_test=&CLK_TEST_WCSS_PHY1_X2_CLK
    &clk_reg=&HWIO_WCSS_HM_A_WCSS_CLK_CTL_WCSS_PHY1_X2_CBCR_ADDR
    &clk_reg_name="WCSS_HM_A_WCSS_CLK_CTL_WCSS_PHY1_X2_CBCR"
    &clk_name="wcss_phy1_x2_clk"
    &clk_reg_cbcr_type="sm_cbc"
    &clk_vote_bit=-1.
    &clk_multiplier=4.

    gosub Print_Clk_Info_Line
  )

  &match=0
  &wild_head=0
  &wild_tail=0
  &clk_input_length=STRING.LENGTH("&clk")
  &clk_itr_length=STRING.LENGTH("wcss_rfactrl_phy1_80_clk")

  if (STRING.SCAN("&clk", "*", 0)==0)
  (
    &wild_head=1
  )
  if (STRING.SCAN("&clk", "*", 1)==(STRING.LENGTH("&clk")-1))
  (
    &wild_tail=1
  )

  if ((&wild_head==1)&&(&wild_tail==1))
  (
    if (STRING.SCAN("wcss_rfactrl_phy1_80_clk", STRING.MID("&clk", 1, &clk_input_length-2), 0)!=-1)
    ( 
      &match=1
    )
  )
  else if (&wild_head==1)
  (
    if (STRING.MID("wcss_rfactrl_phy1_80_clk", &clk_itr_length-&clk_input_length+1, &clk_input_length-1)==STRING.CUT("&clk", 1))
    ( 
      &match=1
    )
  )
  else if (&wild_tail==1)
  (
    if (STRING.MID("wcss_rfactrl_phy1_80_clk", 0, &clk_input_length-1)==STRING.CUT("&clk", -1))
    ( 
      &match=1
    )
  )
  else if ("wcss_rfactrl_phy1_80_clk"=="&clk")
  (
    &match=1
  )
  
  if (&match==1)
  (
    &clk_test=&CLK_TEST_WCSS_RFACTRL_PHY1_80_CLK
    &clk_reg=&HWIO_WCSS_HM_A_WCSS_CLK_CTL_WCSS_RFACTRL_PHY1_80_CBCR_ADDR
    &clk_reg_name="WCSS_HM_A_WCSS_CLK_CTL_WCSS_RFACTRL_PHY1_80_CBCR"
    &clk_name="wcss_rfactrl_phy1_80_clk"
    &clk_reg_cbcr_type="sm_cbc"
    &clk_vote_bit=-1.
    &clk_multiplier=4.

    gosub Print_Clk_Info_Line
  )

  &match=0
  &wild_head=0
  &wild_tail=0
  &clk_input_length=STRING.LENGTH("&clk")
  &clk_itr_length=STRING.LENGTH("phy1_11ac_radio_adc_0_clk")

  if (STRING.SCAN("&clk", "*", 0)==0)
  (
    &wild_head=1
  )
  if (STRING.SCAN("&clk", "*", 1)==(STRING.LENGTH("&clk")-1))
  (
    &wild_tail=1
  )

  if ((&wild_head==1)&&(&wild_tail==1))
  (
    if (STRING.SCAN("phy1_11ac_radio_adc_0_clk", STRING.MID("&clk", 1, &clk_input_length-2), 0)!=-1)
    ( 
      &match=1
    )
  )
  else if (&wild_head==1)
  (
    if (STRING.MID("phy1_11ac_radio_adc_0_clk", &clk_itr_length-&clk_input_length+1, &clk_input_length-1)==STRING.CUT("&clk", 1))
    ( 
      &match=1
    )
  )
  else if (&wild_tail==1)
  (
    if (STRING.MID("phy1_11ac_radio_adc_0_clk", 0, &clk_input_length-1)==STRING.CUT("&clk", -1))
    ( 
      &match=1
    )
  )
  else if ("phy1_11ac_radio_adc_0_clk"=="&clk")
  (
    &match=1
  )
  
  if (&match==1)
  (
    &clk_test=&CLK_TEST_PHY1_11AC_RADIO_ADC_0_CLK
    &clk_reg=&HWIO_WCSS_HM_A_WCSS_CLK_CTL_PHY1_11AC_RADIO_ADC_0_CBCR_ADDR
    &clk_reg_name="WCSS_HM_A_WCSS_CLK_CTL_PHY1_11AC_RADIO_ADC_0_CBCR"
    &clk_name="phy1_11ac_radio_adc_0_clk"
    &clk_reg_cbcr_type="sm_cbc"
    &clk_vote_bit=-1.
    &clk_multiplier=4.

    gosub Print_Clk_Info_Line
  )

  &match=0
  &wild_head=0
  &wild_tail=0
  &clk_input_length=STRING.LENGTH("&clk")
  &clk_itr_length=STRING.LENGTH("wcss_rfactrl_phy1_11ac_radio_adc_0_clk")

  if (STRING.SCAN("&clk", "*", 0)==0)
  (
    &wild_head=1
  )
  if (STRING.SCAN("&clk", "*", 1)==(STRING.LENGTH("&clk")-1))
  (
    &wild_tail=1
  )

  if ((&wild_head==1)&&(&wild_tail==1))
  (
    if (STRING.SCAN("wcss_rfactrl_phy1_11ac_radio_adc_0_clk", STRING.MID("&clk", 1, &clk_input_length-2), 0)!=-1)
    ( 
      &match=1
    )
  )
  else if (&wild_head==1)
  (
    if (STRING.MID("wcss_rfactrl_phy1_11ac_radio_adc_0_clk", &clk_itr_length-&clk_input_length+1, &clk_input_length-1)==STRING.CUT("&clk", 1))
    ( 
      &match=1
    )
  )
  else if (&wild_tail==1)
  (
    if (STRING.MID("wcss_rfactrl_phy1_11ac_radio_adc_0_clk", 0, &clk_input_length-1)==STRING.CUT("&clk", -1))
    ( 
      &match=1
    )
  )
  else if ("wcss_rfactrl_phy1_11ac_radio_adc_0_clk"=="&clk")
  (
    &match=1
  )
  
  if (&match==1)
  (
    &clk_test=&CLK_TEST_WCSS_RFACTRL_PHY1_11AC_RADIO_ADC_0_CLK
    &clk_reg=&MACRO_TOO_LONG_4
    &clk_reg_name="WCSS_HM_A_WCSS_CLK_CTL_WCSS_RFACTRL_PHY1_11AC_RADIO_ADC_0_CBCR"
    &clk_name="wcss_rfactrl_phy1_11ac_radio_adc_0_clk"
    &clk_reg_cbcr_type="sm_cbc"
    &clk_vote_bit=-1.
    &clk_multiplier=4.

    gosub Print_Clk_Info_Line
  )

  &match=0
  &wild_head=0
  &wild_tail=0
  &clk_input_length=STRING.LENGTH("&clk")
  &clk_itr_length=STRING.LENGTH("wcss_css_phy1_t240_clk")

  if (STRING.SCAN("&clk", "*", 0)==0)
  (
    &wild_head=1
  )
  if (STRING.SCAN("&clk", "*", 1)==(STRING.LENGTH("&clk")-1))
  (
    &wild_tail=1
  )

  if ((&wild_head==1)&&(&wild_tail==1))
  (
    if (STRING.SCAN("wcss_css_phy1_t240_clk", STRING.MID("&clk", 1, &clk_input_length-2), 0)!=-1)
    ( 
      &match=1
    )
  )
  else if (&wild_head==1)
  (
    if (STRING.MID("wcss_css_phy1_t240_clk", &clk_itr_length-&clk_input_length+1, &clk_input_length-1)==STRING.CUT("&clk", 1))
    ( 
      &match=1
    )
  )
  else if (&wild_tail==1)
  (
    if (STRING.MID("wcss_css_phy1_t240_clk", 0, &clk_input_length-1)==STRING.CUT("&clk", -1))
    ( 
      &match=1
    )
  )
  else if ("wcss_css_phy1_t240_clk"=="&clk")
  (
    &match=1
  )
  
  if (&match==1)
  (
    &clk_test=0
    &clk_reg=&HWIO_WCSS_HM_A_WCSS_CLK_CTL_WCSS_CSS_PHY1_T240_CBCR_ADDR
    &clk_reg_name="WCSS_HM_A_WCSS_CLK_CTL_WCSS_CSS_PHY1_T240_CBCR"
    &clk_name="wcss_css_phy1_t240_clk"
    &clk_reg_cbcr_type="sm_cbc"
    &clk_vote_bit=-1.
    &clk_multiplier=4.

    gosub Print_Clk_Info_Line
  )

  &match=0
  &wild_head=0
  &wild_tail=0
  &clk_input_length=STRING.LENGTH("&clk")
  &clk_itr_length=STRING.LENGTH("wcss_phy1_160_clk")

  if (STRING.SCAN("&clk", "*", 0)==0)
  (
    &wild_head=1
  )
  if (STRING.SCAN("&clk", "*", 1)==(STRING.LENGTH("&clk")-1))
  (
    &wild_tail=1
  )

  if ((&wild_head==1)&&(&wild_tail==1))
  (
    if (STRING.SCAN("wcss_phy1_160_clk", STRING.MID("&clk", 1, &clk_input_length-2), 0)!=-1)
    ( 
      &match=1
    )
  )
  else if (&wild_head==1)
  (
    if (STRING.MID("wcss_phy1_160_clk", &clk_itr_length-&clk_input_length+1, &clk_input_length-1)==STRING.CUT("&clk", 1))
    ( 
      &match=1
    )
  )
  else if (&wild_tail==1)
  (
    if (STRING.MID("wcss_phy1_160_clk", 0, &clk_input_length-1)==STRING.CUT("&clk", -1))
    ( 
      &match=1
    )
  )
  else if ("wcss_phy1_160_clk"=="&clk")
  (
    &match=1
  )
  
  if (&match==1)
  (
    &clk_test=&CLK_TEST_WCSS_PHY1_160_CLK
    &clk_reg=&HWIO_WCSS_HM_A_WCSS_CLK_CTL_WCSS_PHY1_160_CBCR_ADDR
    &clk_reg_name="WCSS_HM_A_WCSS_CLK_CTL_WCSS_PHY1_160_CBCR"
    &clk_name="wcss_phy1_160_clk"
    &clk_reg_cbcr_type="sm_sreg_pscbc"
    &clk_vote_bit=-1.
    &clk_multiplier=4.

    gosub Print_Clk_Info_Line
  )

  &match=0
  &wild_head=0
  &wild_tail=0
  &clk_input_length=STRING.LENGTH("&clk")
  &clk_itr_length=STRING.LENGTH("wcss_phy1_20_clk")

  if (STRING.SCAN("&clk", "*", 0)==0)
  (
    &wild_head=1
  )
  if (STRING.SCAN("&clk", "*", 1)==(STRING.LENGTH("&clk")-1))
  (
    &wild_tail=1
  )

  if ((&wild_head==1)&&(&wild_tail==1))
  (
    if (STRING.SCAN("wcss_phy1_20_clk", STRING.MID("&clk", 1, &clk_input_length-2), 0)!=-1)
    ( 
      &match=1
    )
  )
  else if (&wild_head==1)
  (
    if (STRING.MID("wcss_phy1_20_clk", &clk_itr_length-&clk_input_length+1, &clk_input_length-1)==STRING.CUT("&clk", 1))
    ( 
      &match=1
    )
  )
  else if (&wild_tail==1)
  (
    if (STRING.MID("wcss_phy1_20_clk", 0, &clk_input_length-1)==STRING.CUT("&clk", -1))
    ( 
      &match=1
    )
  )
  else if ("wcss_phy1_20_clk"=="&clk")
  (
    &match=1
  )
  
  if (&match==1)
  (
    &clk_test=&CLK_TEST_WCSS_PHY1_20_CLK
    &clk_reg=&HWIO_WCSS_HM_A_WCSS_CLK_CTL_WCSS_PHY1_20_CBCR_ADDR
    &clk_reg_name="WCSS_HM_A_WCSS_CLK_CTL_WCSS_PHY1_20_CBCR"
    &clk_name="wcss_phy1_20_clk"
    &clk_reg_cbcr_type="sm_sreg_pscbc"
    &clk_vote_bit=-1.
    &clk_multiplier=4.

    gosub Print_Clk_Info_Line
  )

  &match=0
  &wild_head=0
  &wild_tail=0
  &clk_input_length=STRING.LENGTH("&clk")
  &clk_itr_length=STRING.LENGTH("wcss_phy1_30_clk")

  if (STRING.SCAN("&clk", "*", 0)==0)
  (
    &wild_head=1
  )
  if (STRING.SCAN("&clk", "*", 1)==(STRING.LENGTH("&clk")-1))
  (
    &wild_tail=1
  )

  if ((&wild_head==1)&&(&wild_tail==1))
  (
    if (STRING.SCAN("wcss_phy1_30_clk", STRING.MID("&clk", 1, &clk_input_length-2), 0)!=-1)
    ( 
      &match=1
    )
  )
  else if (&wild_head==1)
  (
    if (STRING.MID("wcss_phy1_30_clk", &clk_itr_length-&clk_input_length+1, &clk_input_length-1)==STRING.CUT("&clk", 1))
    ( 
      &match=1
    )
  )
  else if (&wild_tail==1)
  (
    if (STRING.MID("wcss_phy1_30_clk", 0, &clk_input_length-1)==STRING.CUT("&clk", -1))
    ( 
      &match=1
    )
  )
  else if ("wcss_phy1_30_clk"=="&clk")
  (
    &match=1
  )
  
  if (&match==1)
  (
    &clk_test=&CLK_TEST_WCSS_PHY1_30_CLK
    &clk_reg=&HWIO_WCSS_HM_A_WCSS_CLK_CTL_WCSS_PHY1_30_CBCR_ADDR
    &clk_reg_name="WCSS_HM_A_WCSS_CLK_CTL_WCSS_PHY1_30_CBCR"
    &clk_name="wcss_phy1_30_clk"
    &clk_reg_cbcr_type="sm_cbc"
    &clk_vote_bit=-1.
    &clk_multiplier=4.

    gosub Print_Clk_Info_Line
  )

  &match=0
  &wild_head=0
  &wild_tail=0
  &clk_input_length=STRING.LENGTH("&clk")
  &clk_itr_length=STRING.LENGTH("wcss_phy1_320_clk")

  if (STRING.SCAN("&clk", "*", 0)==0)
  (
    &wild_head=1
  )
  if (STRING.SCAN("&clk", "*", 1)==(STRING.LENGTH("&clk")-1))
  (
    &wild_tail=1
  )

  if ((&wild_head==1)&&(&wild_tail==1))
  (
    if (STRING.SCAN("wcss_phy1_320_clk", STRING.MID("&clk", 1, &clk_input_length-2), 0)!=-1)
    ( 
      &match=1
    )
  )
  else if (&wild_head==1)
  (
    if (STRING.MID("wcss_phy1_320_clk", &clk_itr_length-&clk_input_length+1, &clk_input_length-1)==STRING.CUT("&clk", 1))
    ( 
      &match=1
    )
  )
  else if (&wild_tail==1)
  (
    if (STRING.MID("wcss_phy1_320_clk", 0, &clk_input_length-1)==STRING.CUT("&clk", -1))
    ( 
      &match=1
    )
  )
  else if ("wcss_phy1_320_clk"=="&clk")
  (
    &match=1
  )
  
  if (&match==1)
  (
    &clk_test=&CLK_TEST_WCSS_PHY1_320_CLK
    &clk_reg=&HWIO_WCSS_HM_A_WCSS_CLK_CTL_WCSS_PHY1_320_CBCR_ADDR
    &clk_reg_name="WCSS_HM_A_WCSS_CLK_CTL_WCSS_PHY1_320_CBCR"
    &clk_name="wcss_phy1_320_clk"
    &clk_reg_cbcr_type="sm_sreg_pscbc"
    &clk_vote_bit=-1.
    &clk_multiplier=4.

    gosub Print_Clk_Info_Line
  )

  &match=0
  &wild_head=0
  &wild_tail=0
  &clk_input_length=STRING.LENGTH("&clk")
  &clk_itr_length=STRING.LENGTH("wcss_phy1_40_clk")

  if (STRING.SCAN("&clk", "*", 0)==0)
  (
    &wild_head=1
  )
  if (STRING.SCAN("&clk", "*", 1)==(STRING.LENGTH("&clk")-1))
  (
    &wild_tail=1
  )

  if ((&wild_head==1)&&(&wild_tail==1))
  (
    if (STRING.SCAN("wcss_phy1_40_clk", STRING.MID("&clk", 1, &clk_input_length-2), 0)!=-1)
    ( 
      &match=1
    )
  )
  else if (&wild_head==1)
  (
    if (STRING.MID("wcss_phy1_40_clk", &clk_itr_length-&clk_input_length+1, &clk_input_length-1)==STRING.CUT("&clk", 1))
    ( 
      &match=1
    )
  )
  else if (&wild_tail==1)
  (
    if (STRING.MID("wcss_phy1_40_clk", 0, &clk_input_length-1)==STRING.CUT("&clk", -1))
    ( 
      &match=1
    )
  )
  else if ("wcss_phy1_40_clk"=="&clk")
  (
    &match=1
  )
  
  if (&match==1)
  (
    &clk_test=&CLK_TEST_WCSS_PHY1_40_CLK
    &clk_reg=&HWIO_WCSS_HM_A_WCSS_CLK_CTL_WCSS_PHY1_40_CBCR_ADDR
    &clk_reg_name="WCSS_HM_A_WCSS_CLK_CTL_WCSS_PHY1_40_CBCR"
    &clk_name="wcss_phy1_40_clk"
    &clk_reg_cbcr_type="sm_sreg_pscbc"
    &clk_vote_bit=-1.
    &clk_multiplier=4.

    gosub Print_Clk_Info_Line
  )

  &match=0
  &wild_head=0
  &wild_tail=0
  &clk_input_length=STRING.LENGTH("&clk")
  &clk_itr_length=STRING.LENGTH("wcss_phy1_80_clk")

  if (STRING.SCAN("&clk", "*", 0)==0)
  (
    &wild_head=1
  )
  if (STRING.SCAN("&clk", "*", 1)==(STRING.LENGTH("&clk")-1))
  (
    &wild_tail=1
  )

  if ((&wild_head==1)&&(&wild_tail==1))
  (
    if (STRING.SCAN("wcss_phy1_80_clk", STRING.MID("&clk", 1, &clk_input_length-2), 0)!=-1)
    ( 
      &match=1
    )
  )
  else if (&wild_head==1)
  (
    if (STRING.MID("wcss_phy1_80_clk", &clk_itr_length-&clk_input_length+1, &clk_input_length-1)==STRING.CUT("&clk", 1))
    ( 
      &match=1
    )
  )
  else if (&wild_tail==1)
  (
    if (STRING.MID("wcss_phy1_80_clk", 0, &clk_input_length-1)==STRING.CUT("&clk", -1))
    ( 
      &match=1
    )
  )
  else if ("wcss_phy1_80_clk"=="&clk")
  (
    &match=1
  )
  
  if (&match==1)
  (
    &clk_test=&CLK_TEST_WCSS_PHY1_80_CLK
    &clk_reg=&HWIO_WCSS_HM_A_WCSS_CLK_CTL_WCSS_PHY1_80_CBCR_ADDR
    &clk_reg_name="WCSS_HM_A_WCSS_CLK_CTL_WCSS_PHY1_80_CBCR"
    &clk_name="wcss_phy1_80_clk"
    &clk_reg_cbcr_type="sm_sreg_pscbc"
    &clk_vote_bit=-1.
    &clk_multiplier=4.

    gosub Print_Clk_Info_Line
  )

  &match=0
  &wild_head=0
  &wild_tail=0
  &clk_input_length=STRING.LENGTH("&clk")
  &clk_itr_length=STRING.LENGTH("wcss_phy1_bw_clk")

  if (STRING.SCAN("&clk", "*", 0)==0)
  (
    &wild_head=1
  )
  if (STRING.SCAN("&clk", "*", 1)==(STRING.LENGTH("&clk")-1))
  (
    &wild_tail=1
  )

  if ((&wild_head==1)&&(&wild_tail==1))
  (
    if (STRING.SCAN("wcss_phy1_bw_clk", STRING.MID("&clk", 1, &clk_input_length-2), 0)!=-1)
    ( 
      &match=1
    )
  )
  else if (&wild_head==1)
  (
    if (STRING.MID("wcss_phy1_bw_clk", &clk_itr_length-&clk_input_length+1, &clk_input_length-1)==STRING.CUT("&clk", 1))
    ( 
      &match=1
    )
  )
  else if (&wild_tail==1)
  (
    if (STRING.MID("wcss_phy1_bw_clk", 0, &clk_input_length-1)==STRING.CUT("&clk", -1))
    ( 
      &match=1
    )
  )
  else if ("wcss_phy1_bw_clk"=="&clk")
  (
    &match=1
  )
  
  if (&match==1)
  (
    &clk_test=&CLK_TEST_WCSS_PHY1_BW_CLK
    &clk_reg=&HWIO_WCSS_HM_A_WCSS_CLK_CTL_WCSS_PHY1_BW_CBCR_ADDR
    &clk_reg_name="WCSS_HM_A_WCSS_CLK_CTL_WCSS_PHY1_BW_CBCR"
    &clk_name="wcss_phy1_bw_clk"
    &clk_reg_cbcr_type="sm_sreg_pscbc"
    &clk_vote_bit=-1.
    &clk_multiplier=4.

    gosub Print_Clk_Info_Line
  )

  &match=0
  &wild_head=0
  &wild_tail=0
  &clk_input_length=STRING.LENGTH("&clk")
  &clk_itr_length=STRING.LENGTH("wcss_phy1_bwx2_clk")

  if (STRING.SCAN("&clk", "*", 0)==0)
  (
    &wild_head=1
  )
  if (STRING.SCAN("&clk", "*", 1)==(STRING.LENGTH("&clk")-1))
  (
    &wild_tail=1
  )

  if ((&wild_head==1)&&(&wild_tail==1))
  (
    if (STRING.SCAN("wcss_phy1_bwx2_clk", STRING.MID("&clk", 1, &clk_input_length-2), 0)!=-1)
    ( 
      &match=1
    )
  )
  else if (&wild_head==1)
  (
    if (STRING.MID("wcss_phy1_bwx2_clk", &clk_itr_length-&clk_input_length+1, &clk_input_length-1)==STRING.CUT("&clk", 1))
    ( 
      &match=1
    )
  )
  else if (&wild_tail==1)
  (
    if (STRING.MID("wcss_phy1_bwx2_clk", 0, &clk_input_length-1)==STRING.CUT("&clk", -1))
    ( 
      &match=1
    )
  )
  else if ("wcss_phy1_bwx2_clk"=="&clk")
  (
    &match=1
  )
  
  if (&match==1)
  (
    &clk_test=&CLK_TEST_WCSS_PHY1_BWX2_CLK
    &clk_reg=&HWIO_WCSS_HM_A_WCSS_CLK_CTL_WCSS_PHY1_BWX2_CBCR_ADDR
    &clk_reg_name="WCSS_HM_A_WCSS_CLK_CTL_WCSS_PHY1_BWX2_CBCR"
    &clk_name="wcss_phy1_bwx2_clk"
    &clk_reg_cbcr_type="sm_cbc"
    &clk_vote_bit=-1.
    &clk_multiplier=4.

    gosub Print_Clk_Info_Line
  )

  &match=0
  &wild_head=0
  &wild_tail=0
  &clk_input_length=STRING.LENGTH("&clk")
  &clk_itr_length=STRING.LENGTH("wcss_phy1_clk")

  if (STRING.SCAN("&clk", "*", 0)==0)
  (
    &wild_head=1
  )
  if (STRING.SCAN("&clk", "*", 1)==(STRING.LENGTH("&clk")-1))
  (
    &wild_tail=1
  )

  if ((&wild_head==1)&&(&wild_tail==1))
  (
    if (STRING.SCAN("wcss_phy1_clk", STRING.MID("&clk", 1, &clk_input_length-2), 0)!=-1)
    ( 
      &match=1
    )
  )
  else if (&wild_head==1)
  (
    if (STRING.MID("wcss_phy1_clk", &clk_itr_length-&clk_input_length+1, &clk_input_length-1)==STRING.CUT("&clk", 1))
    ( 
      &match=1
    )
  )
  else if (&wild_tail==1)
  (
    if (STRING.MID("wcss_phy1_clk", 0, &clk_input_length-1)==STRING.CUT("&clk", -1))
    ( 
      &match=1
    )
  )
  else if ("wcss_phy1_clk"=="&clk")
  (
    &match=1
  )
  
  if (&match==1)
  (
    &clk_test=&CLK_TEST_WCSS_PHY1_CLK
    &clk_reg=&HWIO_WCSS_HM_A_WCSS_CLK_CTL_WCSS_PHY1_CBCR_ADDR
    &clk_reg_name="WCSS_HM_A_WCSS_CLK_CTL_WCSS_PHY1_CBCR"
    &clk_name="wcss_phy1_clk"
    &clk_reg_cbcr_type="sm_sreg_pscbc"
    &clk_vote_bit=-1.
    &clk_multiplier=4.

    gosub Print_Clk_Info_Line
  )

  &match=0
  &wild_head=0
  &wild_tail=0
  &clk_input_length=STRING.LENGTH("&clk")
  &clk_itr_length=STRING.LENGTH("wcss_phy1_dfs_clk")

  if (STRING.SCAN("&clk", "*", 0)==0)
  (
    &wild_head=1
  )
  if (STRING.SCAN("&clk", "*", 1)==(STRING.LENGTH("&clk")-1))
  (
    &wild_tail=1
  )

  if ((&wild_head==1)&&(&wild_tail==1))
  (
    if (STRING.SCAN("wcss_phy1_dfs_clk", STRING.MID("&clk", 1, &clk_input_length-2), 0)!=-1)
    ( 
      &match=1
    )
  )
  else if (&wild_head==1)
  (
    if (STRING.MID("wcss_phy1_dfs_clk", &clk_itr_length-&clk_input_length+1, &clk_input_length-1)==STRING.CUT("&clk", 1))
    ( 
      &match=1
    )
  )
  else if (&wild_tail==1)
  (
    if (STRING.MID("wcss_phy1_dfs_clk", 0, &clk_input_length-1)==STRING.CUT("&clk", -1))
    ( 
      &match=1
    )
  )
  else if ("wcss_phy1_dfs_clk"=="&clk")
  (
    &match=1
  )
  
  if (&match==1)
  (
    &clk_test=&CLK_TEST_WCSS_PHY1_DFS_CLK
    &clk_reg=&HWIO_WCSS_HM_A_WCSS_CLK_CTL_WCSS_PHY1_DFS_CBCR_ADDR
    &clk_reg_name="WCSS_HM_A_WCSS_CLK_CTL_WCSS_PHY1_DFS_CBCR"
    &clk_name="wcss_phy1_dfs_clk"
    &clk_reg_cbcr_type="sm_sreg_pscbc"
    &clk_vote_bit=-1.
    &clk_multiplier=4.

    gosub Print_Clk_Info_Line
  )

  &match=0
  &wild_head=0
  &wild_tail=0
  &clk_input_length=STRING.LENGTH("&clk")
  &clk_itr_length=STRING.LENGTH("wcss_phy1_t240_clk")

  if (STRING.SCAN("&clk", "*", 0)==0)
  (
    &wild_head=1
  )
  if (STRING.SCAN("&clk", "*", 1)==(STRING.LENGTH("&clk")-1))
  (
    &wild_tail=1
  )

  if ((&wild_head==1)&&(&wild_tail==1))
  (
    if (STRING.SCAN("wcss_phy1_t240_clk", STRING.MID("&clk", 1, &clk_input_length-2), 0)!=-1)
    ( 
      &match=1
    )
  )
  else if (&wild_head==1)
  (
    if (STRING.MID("wcss_phy1_t240_clk", &clk_itr_length-&clk_input_length+1, &clk_input_length-1)==STRING.CUT("&clk", 1))
    ( 
      &match=1
    )
  )
  else if (&wild_tail==1)
  (
    if (STRING.MID("wcss_phy1_t240_clk", 0, &clk_input_length-1)==STRING.CUT("&clk", -1))
    ( 
      &match=1
    )
  )
  else if ("wcss_phy1_t240_clk"=="&clk")
  (
    &match=1
  )
  
  if (&match==1)
  (
    &clk_test=&CLK_TEST_WCSS_PHY1_T240_CLK
    &clk_reg=&HWIO_WCSS_HM_A_WCSS_CLK_CTL_WCSS_PHY1_T240_CBCR_ADDR
    &clk_reg_name="WCSS_HM_A_WCSS_CLK_CTL_WCSS_PHY1_T240_CBCR"
    &clk_name="wcss_phy1_t240_clk"
    &clk_reg_cbcr_type="sm_cbc"
    &clk_vote_bit=-1.
    &clk_multiplier=4.

    gosub Print_Clk_Info_Line
  )

  &match=0
  &wild_head=0
  &wild_tail=0
  &clk_input_length=STRING.LENGTH("&clk")
  &clk_itr_length=STRING.LENGTH("wcss_phy1_tadc_clk")

  if (STRING.SCAN("&clk", "*", 0)==0)
  (
    &wild_head=1
  )
  if (STRING.SCAN("&clk", "*", 1)==(STRING.LENGTH("&clk")-1))
  (
    &wild_tail=1
  )

  if ((&wild_head==1)&&(&wild_tail==1))
  (
    if (STRING.SCAN("wcss_phy1_tadc_clk", STRING.MID("&clk", 1, &clk_input_length-2), 0)!=-1)
    ( 
      &match=1
    )
  )
  else if (&wild_head==1)
  (
    if (STRING.MID("wcss_phy1_tadc_clk", &clk_itr_length-&clk_input_length+1, &clk_input_length-1)==STRING.CUT("&clk", 1))
    ( 
      &match=1
    )
  )
  else if (&wild_tail==1)
  (
    if (STRING.MID("wcss_phy1_tadc_clk", 0, &clk_input_length-1)==STRING.CUT("&clk", -1))
    ( 
      &match=1
    )
  )
  else if ("wcss_phy1_tadc_clk"=="&clk")
  (
    &match=1
  )
  
  if (&match==1)
  (
    &clk_test=&CLK_TEST_WCSS_PHY1_TADC_CLK
    &clk_reg=&HWIO_WCSS_HM_A_WCSS_CLK_CTL_WCSS_PHY1_TADC_CBCR_ADDR
    &clk_reg_name="WCSS_HM_A_WCSS_CLK_CTL_WCSS_PHY1_TADC_CBCR"
    &clk_name="wcss_phy1_tadc_clk"
    &clk_reg_cbcr_type="sm_cbc"
    &clk_vote_bit=-1.
    &clk_multiplier=4.

    gosub Print_Clk_Info_Line
  )

  &match=0
  &wild_head=0
  &wild_tail=0
  &clk_input_length=STRING.LENGTH("&clk")
  &clk_itr_length=STRING.LENGTH("wcss_phy1_tdac_clk")

  if (STRING.SCAN("&clk", "*", 0)==0)
  (
    &wild_head=1
  )
  if (STRING.SCAN("&clk", "*", 1)==(STRING.LENGTH("&clk")-1))
  (
    &wild_tail=1
  )

  if ((&wild_head==1)&&(&wild_tail==1))
  (
    if (STRING.SCAN("wcss_phy1_tdac_clk", STRING.MID("&clk", 1, &clk_input_length-2), 0)!=-1)
    ( 
      &match=1
    )
  )
  else if (&wild_head==1)
  (
    if (STRING.MID("wcss_phy1_tdac_clk", &clk_itr_length-&clk_input_length+1, &clk_input_length-1)==STRING.CUT("&clk", 1))
    ( 
      &match=1
    )
  )
  else if (&wild_tail==1)
  (
    if (STRING.MID("wcss_phy1_tdac_clk", 0, &clk_input_length-1)==STRING.CUT("&clk", -1))
    ( 
      &match=1
    )
  )
  else if ("wcss_phy1_tdac_clk"=="&clk")
  (
    &match=1
  )
  
  if (&match==1)
  (
    &clk_test=&CLK_TEST_WCSS_PHY1_TDAC_CLK
    &clk_reg=&HWIO_WCSS_HM_A_WCSS_CLK_CTL_WCSS_PHY1_TDAC_CBCR_ADDR
    &clk_reg_name="WCSS_HM_A_WCSS_CLK_CTL_WCSS_PHY1_TDAC_CBCR"
    &clk_name="wcss_phy1_tdac_clk"
    &clk_reg_cbcr_type="sm_sreg_pscbc"
    &clk_vote_bit=-1.
    &clk_multiplier=4.

    gosub Print_Clk_Info_Line
  )

  &match=0
  &wild_head=0
  &wild_tail=0
  &clk_input_length=STRING.LENGTH("&clk")
  &clk_itr_length=STRING.LENGTH("wcss_phy1_x2_clk")

  if (STRING.SCAN("&clk", "*", 0)==0)
  (
    &wild_head=1
  )
  if (STRING.SCAN("&clk", "*", 1)==(STRING.LENGTH("&clk")-1))
  (
    &wild_tail=1
  )

  if ((&wild_head==1)&&(&wild_tail==1))
  (
    if (STRING.SCAN("wcss_phy1_x2_clk", STRING.MID("&clk", 1, &clk_input_length-2), 0)!=-1)
    ( 
      &match=1
    )
  )
  else if (&wild_head==1)
  (
    if (STRING.MID("wcss_phy1_x2_clk", &clk_itr_length-&clk_input_length+1, &clk_input_length-1)==STRING.CUT("&clk", 1))
    ( 
      &match=1
    )
  )
  else if (&wild_tail==1)
  (
    if (STRING.MID("wcss_phy1_x2_clk", 0, &clk_input_length-1)==STRING.CUT("&clk", -1))
    ( 
      &match=1
    )
  )
  else if ("wcss_phy1_x2_clk"=="&clk")
  (
    &match=1
  )
  
  if (&match==1)
  (
    &clk_test=&CLK_TEST_WCSS_PHY1_X2_CLK
    &clk_reg=&HWIO_WCSS_HM_A_WCSS_CLK_CTL_WCSS_PHY1_X2_CBCR_ADDR
    &clk_reg_name="WCSS_HM_A_WCSS_CLK_CTL_WCSS_PHY1_X2_CBCR"
    &clk_name="wcss_phy1_x2_clk"
    &clk_reg_cbcr_type="sm_cbc"
    &clk_vote_bit=-1.
    &clk_multiplier=4.

    gosub Print_Clk_Info_Line
  )

  &match=0
  &wild_head=0
  &wild_tail=0
  &clk_input_length=STRING.LENGTH("&clk")
  &clk_itr_length=STRING.LENGTH("wcss_rfactrl_phy1_80_clk")

  if (STRING.SCAN("&clk", "*", 0)==0)
  (
    &wild_head=1
  )
  if (STRING.SCAN("&clk", "*", 1)==(STRING.LENGTH("&clk")-1))
  (
    &wild_tail=1
  )

  if ((&wild_head==1)&&(&wild_tail==1))
  (
    if (STRING.SCAN("wcss_rfactrl_phy1_80_clk", STRING.MID("&clk", 1, &clk_input_length-2), 0)!=-1)
    ( 
      &match=1
    )
  )
  else if (&wild_head==1)
  (
    if (STRING.MID("wcss_rfactrl_phy1_80_clk", &clk_itr_length-&clk_input_length+1, &clk_input_length-1)==STRING.CUT("&clk", 1))
    ( 
      &match=1
    )
  )
  else if (&wild_tail==1)
  (
    if (STRING.MID("wcss_rfactrl_phy1_80_clk", 0, &clk_input_length-1)==STRING.CUT("&clk", -1))
    ( 
      &match=1
    )
  )
  else if ("wcss_rfactrl_phy1_80_clk"=="&clk")
  (
    &match=1
  )
  
  if (&match==1)
  (
    &clk_test=&CLK_TEST_WCSS_RFACTRL_PHY1_80_CLK
    &clk_reg=&HWIO_WCSS_HM_A_WCSS_CLK_CTL_WCSS_RFACTRL_PHY1_80_CBCR_ADDR
    &clk_reg_name="WCSS_HM_A_WCSS_CLK_CTL_WCSS_RFACTRL_PHY1_80_CBCR"
    &clk_name="wcss_rfactrl_phy1_80_clk"
    &clk_reg_cbcr_type="sm_cbc"
    &clk_vote_bit=-1.
    &clk_multiplier=4.

    gosub Print_Clk_Info_Line
  )

  &match=0
  &wild_head=0
  &wild_tail=0
  &clk_input_length=STRING.LENGTH("&clk")
  &clk_itr_length=STRING.LENGTH("wcss_css_phy2_t240_clk")

  if (STRING.SCAN("&clk", "*", 0)==0)
  (
    &wild_head=1
  )
  if (STRING.SCAN("&clk", "*", 1)==(STRING.LENGTH("&clk")-1))
  (
    &wild_tail=1
  )

  if ((&wild_head==1)&&(&wild_tail==1))
  (
    if (STRING.SCAN("wcss_css_phy2_t240_clk", STRING.MID("&clk", 1, &clk_input_length-2), 0)!=-1)
    ( 
      &match=1
    )
  )
  else if (&wild_head==1)
  (
    if (STRING.MID("wcss_css_phy2_t240_clk", &clk_itr_length-&clk_input_length+1, &clk_input_length-1)==STRING.CUT("&clk", 1))
    ( 
      &match=1
    )
  )
  else if (&wild_tail==1)
  (
    if (STRING.MID("wcss_css_phy2_t240_clk", 0, &clk_input_length-1)==STRING.CUT("&clk", -1))
    ( 
      &match=1
    )
  )
  else if ("wcss_css_phy2_t240_clk"=="&clk")
  (
    &match=1
  )
  
  if (&match==1)
  (
    &clk_test=0
    &clk_reg=&HWIO_WCSS_HM_A_WCSS_CLK_CTL_WCSS_CSS_PHY2_T240_CBCR_ADDR
    &clk_reg_name="WCSS_HM_A_WCSS_CLK_CTL_WCSS_CSS_PHY2_T240_CBCR"
    &clk_name="wcss_css_phy2_t240_clk"
    &clk_reg_cbcr_type="sm_cbc"
    &clk_vote_bit=-1.
    &clk_multiplier=4.

    gosub Print_Clk_Info_Line
  )

  &match=0
  &wild_head=0
  &wild_tail=0
  &clk_input_length=STRING.LENGTH("&clk")
  &clk_itr_length=STRING.LENGTH("wcss_phy2_160_clk")

  if (STRING.SCAN("&clk", "*", 0)==0)
  (
    &wild_head=1
  )
  if (STRING.SCAN("&clk", "*", 1)==(STRING.LENGTH("&clk")-1))
  (
    &wild_tail=1
  )

  if ((&wild_head==1)&&(&wild_tail==1))
  (
    if (STRING.SCAN("wcss_phy2_160_clk", STRING.MID("&clk", 1, &clk_input_length-2), 0)!=-1)
    ( 
      &match=1
    )
  )
  else if (&wild_head==1)
  (
    if (STRING.MID("wcss_phy2_160_clk", &clk_itr_length-&clk_input_length+1, &clk_input_length-1)==STRING.CUT("&clk", 1))
    ( 
      &match=1
    )
  )
  else if (&wild_tail==1)
  (
    if (STRING.MID("wcss_phy2_160_clk", 0, &clk_input_length-1)==STRING.CUT("&clk", -1))
    ( 
      &match=1
    )
  )
  else if ("wcss_phy2_160_clk"=="&clk")
  (
    &match=1
  )
  
  if (&match==1)
  (
    &clk_test=&CLK_TEST_WCSS_PHY2_160_CLK
    &clk_reg=&HWIO_WCSS_HM_A_WCSS_CLK_CTL_WCSS_PHY2_160_CBCR_ADDR
    &clk_reg_name="WCSS_HM_A_WCSS_CLK_CTL_WCSS_PHY2_160_CBCR"
    &clk_name="wcss_phy2_160_clk"
    &clk_reg_cbcr_type="sm_sreg_pscbc"
    &clk_vote_bit=-1.
    &clk_multiplier=4.

    gosub Print_Clk_Info_Line
  )

  &match=0
  &wild_head=0
  &wild_tail=0
  &clk_input_length=STRING.LENGTH("&clk")
  &clk_itr_length=STRING.LENGTH("wcss_phy2_20_clk")

  if (STRING.SCAN("&clk", "*", 0)==0)
  (
    &wild_head=1
  )
  if (STRING.SCAN("&clk", "*", 1)==(STRING.LENGTH("&clk")-1))
  (
    &wild_tail=1
  )

  if ((&wild_head==1)&&(&wild_tail==1))
  (
    if (STRING.SCAN("wcss_phy2_20_clk", STRING.MID("&clk", 1, &clk_input_length-2), 0)!=-1)
    ( 
      &match=1
    )
  )
  else if (&wild_head==1)
  (
    if (STRING.MID("wcss_phy2_20_clk", &clk_itr_length-&clk_input_length+1, &clk_input_length-1)==STRING.CUT("&clk", 1))
    ( 
      &match=1
    )
  )
  else if (&wild_tail==1)
  (
    if (STRING.MID("wcss_phy2_20_clk", 0, &clk_input_length-1)==STRING.CUT("&clk", -1))
    ( 
      &match=1
    )
  )
  else if ("wcss_phy2_20_clk"=="&clk")
  (
    &match=1
  )
  
  if (&match==1)
  (
    &clk_test=&CLK_TEST_WCSS_PHY2_20_CLK
    &clk_reg=&HWIO_WCSS_HM_A_WCSS_CLK_CTL_WCSS_PHY2_20_CBCR_ADDR
    &clk_reg_name="WCSS_HM_A_WCSS_CLK_CTL_WCSS_PHY2_20_CBCR"
    &clk_name="wcss_phy2_20_clk"
    &clk_reg_cbcr_type="sm_sreg_pscbc"
    &clk_vote_bit=-1.
    &clk_multiplier=4.

    gosub Print_Clk_Info_Line
  )

  &match=0
  &wild_head=0
  &wild_tail=0
  &clk_input_length=STRING.LENGTH("&clk")
  &clk_itr_length=STRING.LENGTH("wcss_phy2_30_clk")

  if (STRING.SCAN("&clk", "*", 0)==0)
  (
    &wild_head=1
  )
  if (STRING.SCAN("&clk", "*", 1)==(STRING.LENGTH("&clk")-1))
  (
    &wild_tail=1
  )

  if ((&wild_head==1)&&(&wild_tail==1))
  (
    if (STRING.SCAN("wcss_phy2_30_clk", STRING.MID("&clk", 1, &clk_input_length-2), 0)!=-1)
    ( 
      &match=1
    )
  )
  else if (&wild_head==1)
  (
    if (STRING.MID("wcss_phy2_30_clk", &clk_itr_length-&clk_input_length+1, &clk_input_length-1)==STRING.CUT("&clk", 1))
    ( 
      &match=1
    )
  )
  else if (&wild_tail==1)
  (
    if (STRING.MID("wcss_phy2_30_clk", 0, &clk_input_length-1)==STRING.CUT("&clk", -1))
    ( 
      &match=1
    )
  )
  else if ("wcss_phy2_30_clk"=="&clk")
  (
    &match=1
  )
  
  if (&match==1)
  (
    &clk_test=&CLK_TEST_WCSS_PHY2_30_CLK
    &clk_reg=&HWIO_WCSS_HM_A_WCSS_CLK_CTL_WCSS_PHY2_30_CBCR_ADDR
    &clk_reg_name="WCSS_HM_A_WCSS_CLK_CTL_WCSS_PHY2_30_CBCR"
    &clk_name="wcss_phy2_30_clk"
    &clk_reg_cbcr_type="sm_cbc"
    &clk_vote_bit=-1.
    &clk_multiplier=4.

    gosub Print_Clk_Info_Line
  )

  &match=0
  &wild_head=0
  &wild_tail=0
  &clk_input_length=STRING.LENGTH("&clk")
  &clk_itr_length=STRING.LENGTH("wcss_phy2_320_clk")

  if (STRING.SCAN("&clk", "*", 0)==0)
  (
    &wild_head=1
  )
  if (STRING.SCAN("&clk", "*", 1)==(STRING.LENGTH("&clk")-1))
  (
    &wild_tail=1
  )

  if ((&wild_head==1)&&(&wild_tail==1))
  (
    if (STRING.SCAN("wcss_phy2_320_clk", STRING.MID("&clk", 1, &clk_input_length-2), 0)!=-1)
    ( 
      &match=1
    )
  )
  else if (&wild_head==1)
  (
    if (STRING.MID("wcss_phy2_320_clk", &clk_itr_length-&clk_input_length+1, &clk_input_length-1)==STRING.CUT("&clk", 1))
    ( 
      &match=1
    )
  )
  else if (&wild_tail==1)
  (
    if (STRING.MID("wcss_phy2_320_clk", 0, &clk_input_length-1)==STRING.CUT("&clk", -1))
    ( 
      &match=1
    )
  )
  else if ("wcss_phy2_320_clk"=="&clk")
  (
    &match=1
  )
  
  if (&match==1)
  (
    &clk_test=&CLK_TEST_WCSS_PHY2_320_CLK
    &clk_reg=&HWIO_WCSS_HM_A_WCSS_CLK_CTL_WCSS_PHY2_320_CBCR_ADDR
    &clk_reg_name="WCSS_HM_A_WCSS_CLK_CTL_WCSS_PHY2_320_CBCR"
    &clk_name="wcss_phy2_320_clk"
    &clk_reg_cbcr_type="sm_sreg_pscbc"
    &clk_vote_bit=-1.
    &clk_multiplier=4.

    gosub Print_Clk_Info_Line
  )

  &match=0
  &wild_head=0
  &wild_tail=0
  &clk_input_length=STRING.LENGTH("&clk")
  &clk_itr_length=STRING.LENGTH("wcss_phy2_40_clk")

  if (STRING.SCAN("&clk", "*", 0)==0)
  (
    &wild_head=1
  )
  if (STRING.SCAN("&clk", "*", 1)==(STRING.LENGTH("&clk")-1))
  (
    &wild_tail=1
  )

  if ((&wild_head==1)&&(&wild_tail==1))
  (
    if (STRING.SCAN("wcss_phy2_40_clk", STRING.MID("&clk", 1, &clk_input_length-2), 0)!=-1)
    ( 
      &match=1
    )
  )
  else if (&wild_head==1)
  (
    if (STRING.MID("wcss_phy2_40_clk", &clk_itr_length-&clk_input_length+1, &clk_input_length-1)==STRING.CUT("&clk", 1))
    ( 
      &match=1
    )
  )
  else if (&wild_tail==1)
  (
    if (STRING.MID("wcss_phy2_40_clk", 0, &clk_input_length-1)==STRING.CUT("&clk", -1))
    ( 
      &match=1
    )
  )
  else if ("wcss_phy2_40_clk"=="&clk")
  (
    &match=1
  )
  
  if (&match==1)
  (
    &clk_test=&CLK_TEST_WCSS_PHY2_40_CLK
    &clk_reg=&HWIO_WCSS_HM_A_WCSS_CLK_CTL_WCSS_PHY2_40_CBCR_ADDR
    &clk_reg_name="WCSS_HM_A_WCSS_CLK_CTL_WCSS_PHY2_40_CBCR"
    &clk_name="wcss_phy2_40_clk"
    &clk_reg_cbcr_type="sm_sreg_pscbc"
    &clk_vote_bit=-1.
    &clk_multiplier=4.

    gosub Print_Clk_Info_Line
  )

  &match=0
  &wild_head=0
  &wild_tail=0
  &clk_input_length=STRING.LENGTH("&clk")
  &clk_itr_length=STRING.LENGTH("wcss_phy2_80_clk")

  if (STRING.SCAN("&clk", "*", 0)==0)
  (
    &wild_head=1
  )
  if (STRING.SCAN("&clk", "*", 1)==(STRING.LENGTH("&clk")-1))
  (
    &wild_tail=1
  )

  if ((&wild_head==1)&&(&wild_tail==1))
  (
    if (STRING.SCAN("wcss_phy2_80_clk", STRING.MID("&clk", 1, &clk_input_length-2), 0)!=-1)
    ( 
      &match=1
    )
  )
  else if (&wild_head==1)
  (
    if (STRING.MID("wcss_phy2_80_clk", &clk_itr_length-&clk_input_length+1, &clk_input_length-1)==STRING.CUT("&clk", 1))
    ( 
      &match=1
    )
  )
  else if (&wild_tail==1)
  (
    if (STRING.MID("wcss_phy2_80_clk", 0, &clk_input_length-1)==STRING.CUT("&clk", -1))
    ( 
      &match=1
    )
  )
  else if ("wcss_phy2_80_clk"=="&clk")
  (
    &match=1
  )
  
  if (&match==1)
  (
    &clk_test=&CLK_TEST_WCSS_PHY2_80_CLK
    &clk_reg=&HWIO_WCSS_HM_A_WCSS_CLK_CTL_WCSS_PHY2_80_CBCR_ADDR
    &clk_reg_name="WCSS_HM_A_WCSS_CLK_CTL_WCSS_PHY2_80_CBCR"
    &clk_name="wcss_phy2_80_clk"
    &clk_reg_cbcr_type="sm_sreg_pscbc"
    &clk_vote_bit=-1.
    &clk_multiplier=4.

    gosub Print_Clk_Info_Line
  )

  &match=0
  &wild_head=0
  &wild_tail=0
  &clk_input_length=STRING.LENGTH("&clk")
  &clk_itr_length=STRING.LENGTH("wcss_phy2_bw_clk")

  if (STRING.SCAN("&clk", "*", 0)==0)
  (
    &wild_head=1
  )
  if (STRING.SCAN("&clk", "*", 1)==(STRING.LENGTH("&clk")-1))
  (
    &wild_tail=1
  )

  if ((&wild_head==1)&&(&wild_tail==1))
  (
    if (STRING.SCAN("wcss_phy2_bw_clk", STRING.MID("&clk", 1, &clk_input_length-2), 0)!=-1)
    ( 
      &match=1
    )
  )
  else if (&wild_head==1)
  (
    if (STRING.MID("wcss_phy2_bw_clk", &clk_itr_length-&clk_input_length+1, &clk_input_length-1)==STRING.CUT("&clk", 1))
    ( 
      &match=1
    )
  )
  else if (&wild_tail==1)
  (
    if (STRING.MID("wcss_phy2_bw_clk", 0, &clk_input_length-1)==STRING.CUT("&clk", -1))
    ( 
      &match=1
    )
  )
  else if ("wcss_phy2_bw_clk"=="&clk")
  (
    &match=1
  )
  
  if (&match==1)
  (
    &clk_test=&CLK_TEST_WCSS_PHY2_BW_CLK
    &clk_reg=&HWIO_WCSS_HM_A_WCSS_CLK_CTL_WCSS_PHY2_BW_CBCR_ADDR
    &clk_reg_name="WCSS_HM_A_WCSS_CLK_CTL_WCSS_PHY2_BW_CBCR"
    &clk_name="wcss_phy2_bw_clk"
    &clk_reg_cbcr_type="sm_sreg_pscbc"
    &clk_vote_bit=-1.
    &clk_multiplier=4.

    gosub Print_Clk_Info_Line
  )

  &match=0
  &wild_head=0
  &wild_tail=0
  &clk_input_length=STRING.LENGTH("&clk")
  &clk_itr_length=STRING.LENGTH("wcss_phy2_bwx2_clk")

  if (STRING.SCAN("&clk", "*", 0)==0)
  (
    &wild_head=1
  )
  if (STRING.SCAN("&clk", "*", 1)==(STRING.LENGTH("&clk")-1))
  (
    &wild_tail=1
  )

  if ((&wild_head==1)&&(&wild_tail==1))
  (
    if (STRING.SCAN("wcss_phy2_bwx2_clk", STRING.MID("&clk", 1, &clk_input_length-2), 0)!=-1)
    ( 
      &match=1
    )
  )
  else if (&wild_head==1)
  (
    if (STRING.MID("wcss_phy2_bwx2_clk", &clk_itr_length-&clk_input_length+1, &clk_input_length-1)==STRING.CUT("&clk", 1))
    ( 
      &match=1
    )
  )
  else if (&wild_tail==1)
  (
    if (STRING.MID("wcss_phy2_bwx2_clk", 0, &clk_input_length-1)==STRING.CUT("&clk", -1))
    ( 
      &match=1
    )
  )
  else if ("wcss_phy2_bwx2_clk"=="&clk")
  (
    &match=1
  )
  
  if (&match==1)
  (
    &clk_test=&CLK_TEST_WCSS_PHY2_BWX2_CLK
    &clk_reg=&HWIO_WCSS_HM_A_WCSS_CLK_CTL_WCSS_PHY2_BWX2_CBCR_ADDR
    &clk_reg_name="WCSS_HM_A_WCSS_CLK_CTL_WCSS_PHY2_BWX2_CBCR"
    &clk_name="wcss_phy2_bwx2_clk"
    &clk_reg_cbcr_type="sm_cbc"
    &clk_vote_bit=-1.
    &clk_multiplier=4.

    gosub Print_Clk_Info_Line
  )

  &match=0
  &wild_head=0
  &wild_tail=0
  &clk_input_length=STRING.LENGTH("&clk")
  &clk_itr_length=STRING.LENGTH("wcss_phy2_clk")

  if (STRING.SCAN("&clk", "*", 0)==0)
  (
    &wild_head=1
  )
  if (STRING.SCAN("&clk", "*", 1)==(STRING.LENGTH("&clk")-1))
  (
    &wild_tail=1
  )

  if ((&wild_head==1)&&(&wild_tail==1))
  (
    if (STRING.SCAN("wcss_phy2_clk", STRING.MID("&clk", 1, &clk_input_length-2), 0)!=-1)
    ( 
      &match=1
    )
  )
  else if (&wild_head==1)
  (
    if (STRING.MID("wcss_phy2_clk", &clk_itr_length-&clk_input_length+1, &clk_input_length-1)==STRING.CUT("&clk", 1))
    ( 
      &match=1
    )
  )
  else if (&wild_tail==1)
  (
    if (STRING.MID("wcss_phy2_clk", 0, &clk_input_length-1)==STRING.CUT("&clk", -1))
    ( 
      &match=1
    )
  )
  else if ("wcss_phy2_clk"=="&clk")
  (
    &match=1
  )
  
  if (&match==1)
  (
    &clk_test=&CLK_TEST_WCSS_PHY2_CLK
    &clk_reg=&HWIO_WCSS_HM_A_WCSS_CLK_CTL_WCSS_PHY2_CBCR_ADDR
    &clk_reg_name="WCSS_HM_A_WCSS_CLK_CTL_WCSS_PHY2_CBCR"
    &clk_name="wcss_phy2_clk"
    &clk_reg_cbcr_type="sm_sreg_pscbc"
    &clk_vote_bit=-1.
    &clk_multiplier=4.

    gosub Print_Clk_Info_Line
  )

  &match=0
  &wild_head=0
  &wild_tail=0
  &clk_input_length=STRING.LENGTH("&clk")
  &clk_itr_length=STRING.LENGTH("wcss_phy2_dfs_clk")

  if (STRING.SCAN("&clk", "*", 0)==0)
  (
    &wild_head=1
  )
  if (STRING.SCAN("&clk", "*", 1)==(STRING.LENGTH("&clk")-1))
  (
    &wild_tail=1
  )

  if ((&wild_head==1)&&(&wild_tail==1))
  (
    if (STRING.SCAN("wcss_phy2_dfs_clk", STRING.MID("&clk", 1, &clk_input_length-2), 0)!=-1)
    ( 
      &match=1
    )
  )
  else if (&wild_head==1)
  (
    if (STRING.MID("wcss_phy2_dfs_clk", &clk_itr_length-&clk_input_length+1, &clk_input_length-1)==STRING.CUT("&clk", 1))
    ( 
      &match=1
    )
  )
  else if (&wild_tail==1)
  (
    if (STRING.MID("wcss_phy2_dfs_clk", 0, &clk_input_length-1)==STRING.CUT("&clk", -1))
    ( 
      &match=1
    )
  )
  else if ("wcss_phy2_dfs_clk"=="&clk")
  (
    &match=1
  )
  
  if (&match==1)
  (
    &clk_test=&CLK_TEST_WCSS_PHY2_DFS_CLK
    &clk_reg=&HWIO_WCSS_HM_A_WCSS_CLK_CTL_WCSS_PHY2_DFS_CBCR_ADDR
    &clk_reg_name="WCSS_HM_A_WCSS_CLK_CTL_WCSS_PHY2_DFS_CBCR"
    &clk_name="wcss_phy2_dfs_clk"
    &clk_reg_cbcr_type="sm_sreg_pscbc"
    &clk_vote_bit=-1.
    &clk_multiplier=4.

    gosub Print_Clk_Info_Line
  )

  &match=0
  &wild_head=0
  &wild_tail=0
  &clk_input_length=STRING.LENGTH("&clk")
  &clk_itr_length=STRING.LENGTH("wcss_phy2_t240_clk")

  if (STRING.SCAN("&clk", "*", 0)==0)
  (
    &wild_head=1
  )
  if (STRING.SCAN("&clk", "*", 1)==(STRING.LENGTH("&clk")-1))
  (
    &wild_tail=1
  )

  if ((&wild_head==1)&&(&wild_tail==1))
  (
    if (STRING.SCAN("wcss_phy2_t240_clk", STRING.MID("&clk", 1, &clk_input_length-2), 0)!=-1)
    ( 
      &match=1
    )
  )
  else if (&wild_head==1)
  (
    if (STRING.MID("wcss_phy2_t240_clk", &clk_itr_length-&clk_input_length+1, &clk_input_length-1)==STRING.CUT("&clk", 1))
    ( 
      &match=1
    )
  )
  else if (&wild_tail==1)
  (
    if (STRING.MID("wcss_phy2_t240_clk", 0, &clk_input_length-1)==STRING.CUT("&clk", -1))
    ( 
      &match=1
    )
  )
  else if ("wcss_phy2_t240_clk"=="&clk")
  (
    &match=1
  )
  
  if (&match==1)
  (
    &clk_test=&CLK_TEST_WCSS_PHY2_T240_CLK
    &clk_reg=&HWIO_WCSS_HM_A_WCSS_CLK_CTL_WCSS_PHY2_T240_CBCR_ADDR
    &clk_reg_name="WCSS_HM_A_WCSS_CLK_CTL_WCSS_PHY2_T240_CBCR"
    &clk_name="wcss_phy2_t240_clk"
    &clk_reg_cbcr_type="sm_cbc"
    &clk_vote_bit=-1.
    &clk_multiplier=4.

    gosub Print_Clk_Info_Line
  )

  &match=0
  &wild_head=0
  &wild_tail=0
  &clk_input_length=STRING.LENGTH("&clk")
  &clk_itr_length=STRING.LENGTH("wcss_phy2_tadc_clk")

  if (STRING.SCAN("&clk", "*", 0)==0)
  (
    &wild_head=1
  )
  if (STRING.SCAN("&clk", "*", 1)==(STRING.LENGTH("&clk")-1))
  (
    &wild_tail=1
  )

  if ((&wild_head==1)&&(&wild_tail==1))
  (
    if (STRING.SCAN("wcss_phy2_tadc_clk", STRING.MID("&clk", 1, &clk_input_length-2), 0)!=-1)
    ( 
      &match=1
    )
  )
  else if (&wild_head==1)
  (
    if (STRING.MID("wcss_phy2_tadc_clk", &clk_itr_length-&clk_input_length+1, &clk_input_length-1)==STRING.CUT("&clk", 1))
    ( 
      &match=1
    )
  )
  else if (&wild_tail==1)
  (
    if (STRING.MID("wcss_phy2_tadc_clk", 0, &clk_input_length-1)==STRING.CUT("&clk", -1))
    ( 
      &match=1
    )
  )
  else if ("wcss_phy2_tadc_clk"=="&clk")
  (
    &match=1
  )
  
  if (&match==1)
  (
    &clk_test=&CLK_TEST_WCSS_PHY2_TADC_CLK
    &clk_reg=&HWIO_WCSS_HM_A_WCSS_CLK_CTL_WCSS_PHY2_TADC_CBCR_ADDR
    &clk_reg_name="WCSS_HM_A_WCSS_CLK_CTL_WCSS_PHY2_TADC_CBCR"
    &clk_name="wcss_phy2_tadc_clk"
    &clk_reg_cbcr_type="sm_cbc"
    &clk_vote_bit=-1.
    &clk_multiplier=4.

    gosub Print_Clk_Info_Line
  )

  &match=0
  &wild_head=0
  &wild_tail=0
  &clk_input_length=STRING.LENGTH("&clk")
  &clk_itr_length=STRING.LENGTH("wcss_phy2_tdac_clk")

  if (STRING.SCAN("&clk", "*", 0)==0)
  (
    &wild_head=1
  )
  if (STRING.SCAN("&clk", "*", 1)==(STRING.LENGTH("&clk")-1))
  (
    &wild_tail=1
  )

  if ((&wild_head==1)&&(&wild_tail==1))
  (
    if (STRING.SCAN("wcss_phy2_tdac_clk", STRING.MID("&clk", 1, &clk_input_length-2), 0)!=-1)
    ( 
      &match=1
    )
  )
  else if (&wild_head==1)
  (
    if (STRING.MID("wcss_phy2_tdac_clk", &clk_itr_length-&clk_input_length+1, &clk_input_length-1)==STRING.CUT("&clk", 1))
    ( 
      &match=1
    )
  )
  else if (&wild_tail==1)
  (
    if (STRING.MID("wcss_phy2_tdac_clk", 0, &clk_input_length-1)==STRING.CUT("&clk", -1))
    ( 
      &match=1
    )
  )
  else if ("wcss_phy2_tdac_clk"=="&clk")
  (
    &match=1
  )
  
  if (&match==1)
  (
    &clk_test=&CLK_TEST_WCSS_PHY2_TDAC_CLK
    &clk_reg=&HWIO_WCSS_HM_A_WCSS_CLK_CTL_WCSS_PHY2_TDAC_CBCR_ADDR
    &clk_reg_name="WCSS_HM_A_WCSS_CLK_CTL_WCSS_PHY2_TDAC_CBCR"
    &clk_name="wcss_phy2_tdac_clk"
    &clk_reg_cbcr_type="sm_sreg_pscbc"
    &clk_vote_bit=-1.
    &clk_multiplier=4.

    gosub Print_Clk_Info_Line
  )

  &match=0
  &wild_head=0
  &wild_tail=0
  &clk_input_length=STRING.LENGTH("&clk")
  &clk_itr_length=STRING.LENGTH("wcss_phy2_x2_clk")

  if (STRING.SCAN("&clk", "*", 0)==0)
  (
    &wild_head=1
  )
  if (STRING.SCAN("&clk", "*", 1)==(STRING.LENGTH("&clk")-1))
  (
    &wild_tail=1
  )

  if ((&wild_head==1)&&(&wild_tail==1))
  (
    if (STRING.SCAN("wcss_phy2_x2_clk", STRING.MID("&clk", 1, &clk_input_length-2), 0)!=-1)
    ( 
      &match=1
    )
  )
  else if (&wild_head==1)
  (
    if (STRING.MID("wcss_phy2_x2_clk", &clk_itr_length-&clk_input_length+1, &clk_input_length-1)==STRING.CUT("&clk", 1))
    ( 
      &match=1
    )
  )
  else if (&wild_tail==1)
  (
    if (STRING.MID("wcss_phy2_x2_clk", 0, &clk_input_length-1)==STRING.CUT("&clk", -1))
    ( 
      &match=1
    )
  )
  else if ("wcss_phy2_x2_clk"=="&clk")
  (
    &match=1
  )
  
  if (&match==1)
  (
    &clk_test=&CLK_TEST_WCSS_PHY2_X2_CLK
    &clk_reg=&HWIO_WCSS_HM_A_WCSS_CLK_CTL_WCSS_PHY2_X2_CBCR_ADDR
    &clk_reg_name="WCSS_HM_A_WCSS_CLK_CTL_WCSS_PHY2_X2_CBCR"
    &clk_name="wcss_phy2_x2_clk"
    &clk_reg_cbcr_type="sm_cbc"
    &clk_vote_bit=-1.
    &clk_multiplier=4.

    gosub Print_Clk_Info_Line
  )

  &match=0
  &wild_head=0
  &wild_tail=0
  &clk_input_length=STRING.LENGTH("&clk")
  &clk_itr_length=STRING.LENGTH("wcss_rfactrl_phy2_80_clk")

  if (STRING.SCAN("&clk", "*", 0)==0)
  (
    &wild_head=1
  )
  if (STRING.SCAN("&clk", "*", 1)==(STRING.LENGTH("&clk")-1))
  (
    &wild_tail=1
  )

  if ((&wild_head==1)&&(&wild_tail==1))
  (
    if (STRING.SCAN("wcss_rfactrl_phy2_80_clk", STRING.MID("&clk", 1, &clk_input_length-2), 0)!=-1)
    ( 
      &match=1
    )
  )
  else if (&wild_head==1)
  (
    if (STRING.MID("wcss_rfactrl_phy2_80_clk", &clk_itr_length-&clk_input_length+1, &clk_input_length-1)==STRING.CUT("&clk", 1))
    ( 
      &match=1
    )
  )
  else if (&wild_tail==1)
  (
    if (STRING.MID("wcss_rfactrl_phy2_80_clk", 0, &clk_input_length-1)==STRING.CUT("&clk", -1))
    ( 
      &match=1
    )
  )
  else if ("wcss_rfactrl_phy2_80_clk"=="&clk")
  (
    &match=1
  )
  
  if (&match==1)
  (
    &clk_test=&CLK_TEST_WCSS_RFACTRL_PHY2_80_CLK
    &clk_reg=&HWIO_WCSS_HM_A_WCSS_CLK_CTL_WCSS_RFACTRL_PHY2_80_CBCR_ADDR
    &clk_reg_name="WCSS_HM_A_WCSS_CLK_CTL_WCSS_RFACTRL_PHY2_80_CBCR"
    &clk_name="wcss_rfactrl_phy2_80_clk"
    &clk_reg_cbcr_type="sm_cbc"
    &clk_vote_bit=-1.
    &clk_multiplier=4.

    gosub Print_Clk_Info_Line
  )

  &match=0
  &wild_head=0
  &wild_tail=0
  &clk_input_length=STRING.LENGTH("&clk")
  &clk_itr_length=STRING.LENGTH("phy2_11ac_radio_adc_0_clk")

  if (STRING.SCAN("&clk", "*", 0)==0)
  (
    &wild_head=1
  )
  if (STRING.SCAN("&clk", "*", 1)==(STRING.LENGTH("&clk")-1))
  (
    &wild_tail=1
  )

  if ((&wild_head==1)&&(&wild_tail==1))
  (
    if (STRING.SCAN("phy2_11ac_radio_adc_0_clk", STRING.MID("&clk", 1, &clk_input_length-2), 0)!=-1)
    ( 
      &match=1
    )
  )
  else if (&wild_head==1)
  (
    if (STRING.MID("phy2_11ac_radio_adc_0_clk", &clk_itr_length-&clk_input_length+1, &clk_input_length-1)==STRING.CUT("&clk", 1))
    ( 
      &match=1
    )
  )
  else if (&wild_tail==1)
  (
    if (STRING.MID("phy2_11ac_radio_adc_0_clk", 0, &clk_input_length-1)==STRING.CUT("&clk", -1))
    ( 
      &match=1
    )
  )
  else if ("phy2_11ac_radio_adc_0_clk"=="&clk")
  (
    &match=1
  )
  
  if (&match==1)
  (
    &clk_test=&CLK_TEST_PHY2_11AC_RADIO_ADC_0_CLK
    &clk_reg=&HWIO_WCSS_HM_A_WCSS_CLK_CTL_PHY2_11AC_RADIO_ADC_0_CBCR_ADDR
    &clk_reg_name="WCSS_HM_A_WCSS_CLK_CTL_PHY2_11AC_RADIO_ADC_0_CBCR"
    &clk_name="phy2_11ac_radio_adc_0_clk"
    &clk_reg_cbcr_type="sm_cbc"
    &clk_vote_bit=-1.
    &clk_multiplier=4.

    gosub Print_Clk_Info_Line
  )

  &match=0
  &wild_head=0
  &wild_tail=0
  &clk_input_length=STRING.LENGTH("&clk")
  &clk_itr_length=STRING.LENGTH("wcss_css_phy2_t240_clk")

  if (STRING.SCAN("&clk", "*", 0)==0)
  (
    &wild_head=1
  )
  if (STRING.SCAN("&clk", "*", 1)==(STRING.LENGTH("&clk")-1))
  (
    &wild_tail=1
  )

  if ((&wild_head==1)&&(&wild_tail==1))
  (
    if (STRING.SCAN("wcss_css_phy2_t240_clk", STRING.MID("&clk", 1, &clk_input_length-2), 0)!=-1)
    ( 
      &match=1
    )
  )
  else if (&wild_head==1)
  (
    if (STRING.MID("wcss_css_phy2_t240_clk", &clk_itr_length-&clk_input_length+1, &clk_input_length-1)==STRING.CUT("&clk", 1))
    ( 
      &match=1
    )
  )
  else if (&wild_tail==1)
  (
    if (STRING.MID("wcss_css_phy2_t240_clk", 0, &clk_input_length-1)==STRING.CUT("&clk", -1))
    ( 
      &match=1
    )
  )
  else if ("wcss_css_phy2_t240_clk"=="&clk")
  (
    &match=1
  )
  
  if (&match==1)
  (
    &clk_test=0
    &clk_reg=&HWIO_WCSS_HM_A_WCSS_CLK_CTL_WCSS_CSS_PHY2_T240_CBCR_ADDR
    &clk_reg_name="WCSS_HM_A_WCSS_CLK_CTL_WCSS_CSS_PHY2_T240_CBCR"
    &clk_name="wcss_css_phy2_t240_clk"
    &clk_reg_cbcr_type="sm_cbc"
    &clk_vote_bit=-1.
    &clk_multiplier=4.

    gosub Print_Clk_Info_Line
  )

  &match=0
  &wild_head=0
  &wild_tail=0
  &clk_input_length=STRING.LENGTH("&clk")
  &clk_itr_length=STRING.LENGTH("wcss_phy2_160_clk")

  if (STRING.SCAN("&clk", "*", 0)==0)
  (
    &wild_head=1
  )
  if (STRING.SCAN("&clk", "*", 1)==(STRING.LENGTH("&clk")-1))
  (
    &wild_tail=1
  )

  if ((&wild_head==1)&&(&wild_tail==1))
  (
    if (STRING.SCAN("wcss_phy2_160_clk", STRING.MID("&clk", 1, &clk_input_length-2), 0)!=-1)
    ( 
      &match=1
    )
  )
  else if (&wild_head==1)
  (
    if (STRING.MID("wcss_phy2_160_clk", &clk_itr_length-&clk_input_length+1, &clk_input_length-1)==STRING.CUT("&clk", 1))
    ( 
      &match=1
    )
  )
  else if (&wild_tail==1)
  (
    if (STRING.MID("wcss_phy2_160_clk", 0, &clk_input_length-1)==STRING.CUT("&clk", -1))
    ( 
      &match=1
    )
  )
  else if ("wcss_phy2_160_clk"=="&clk")
  (
    &match=1
  )
  
  if (&match==1)
  (
    &clk_test=&CLK_TEST_WCSS_PHY2_160_CLK
    &clk_reg=&HWIO_WCSS_HM_A_WCSS_CLK_CTL_WCSS_PHY2_160_CBCR_ADDR
    &clk_reg_name="WCSS_HM_A_WCSS_CLK_CTL_WCSS_PHY2_160_CBCR"
    &clk_name="wcss_phy2_160_clk"
    &clk_reg_cbcr_type="sm_sreg_pscbc"
    &clk_vote_bit=-1.
    &clk_multiplier=4.

    gosub Print_Clk_Info_Line
  )

  &match=0
  &wild_head=0
  &wild_tail=0
  &clk_input_length=STRING.LENGTH("&clk")
  &clk_itr_length=STRING.LENGTH("wcss_phy2_20_clk")

  if (STRING.SCAN("&clk", "*", 0)==0)
  (
    &wild_head=1
  )
  if (STRING.SCAN("&clk", "*", 1)==(STRING.LENGTH("&clk")-1))
  (
    &wild_tail=1
  )

  if ((&wild_head==1)&&(&wild_tail==1))
  (
    if (STRING.SCAN("wcss_phy2_20_clk", STRING.MID("&clk", 1, &clk_input_length-2), 0)!=-1)
    ( 
      &match=1
    )
  )
  else if (&wild_head==1)
  (
    if (STRING.MID("wcss_phy2_20_clk", &clk_itr_length-&clk_input_length+1, &clk_input_length-1)==STRING.CUT("&clk", 1))
    ( 
      &match=1
    )
  )
  else if (&wild_tail==1)
  (
    if (STRING.MID("wcss_phy2_20_clk", 0, &clk_input_length-1)==STRING.CUT("&clk", -1))
    ( 
      &match=1
    )
  )
  else if ("wcss_phy2_20_clk"=="&clk")
  (
    &match=1
  )
  
  if (&match==1)
  (
    &clk_test=&CLK_TEST_WCSS_PHY2_20_CLK
    &clk_reg=&HWIO_WCSS_HM_A_WCSS_CLK_CTL_WCSS_PHY2_20_CBCR_ADDR
    &clk_reg_name="WCSS_HM_A_WCSS_CLK_CTL_WCSS_PHY2_20_CBCR"
    &clk_name="wcss_phy2_20_clk"
    &clk_reg_cbcr_type="sm_sreg_pscbc"
    &clk_vote_bit=-1.
    &clk_multiplier=4.

    gosub Print_Clk_Info_Line
  )

  &match=0
  &wild_head=0
  &wild_tail=0
  &clk_input_length=STRING.LENGTH("&clk")
  &clk_itr_length=STRING.LENGTH("wcss_phy2_30_clk")

  if (STRING.SCAN("&clk", "*", 0)==0)
  (
    &wild_head=1
  )
  if (STRING.SCAN("&clk", "*", 1)==(STRING.LENGTH("&clk")-1))
  (
    &wild_tail=1
  )

  if ((&wild_head==1)&&(&wild_tail==1))
  (
    if (STRING.SCAN("wcss_phy2_30_clk", STRING.MID("&clk", 1, &clk_input_length-2), 0)!=-1)
    ( 
      &match=1
    )
  )
  else if (&wild_head==1)
  (
    if (STRING.MID("wcss_phy2_30_clk", &clk_itr_length-&clk_input_length+1, &clk_input_length-1)==STRING.CUT("&clk", 1))
    ( 
      &match=1
    )
  )
  else if (&wild_tail==1)
  (
    if (STRING.MID("wcss_phy2_30_clk", 0, &clk_input_length-1)==STRING.CUT("&clk", -1))
    ( 
      &match=1
    )
  )
  else if ("wcss_phy2_30_clk"=="&clk")
  (
    &match=1
  )
  
  if (&match==1)
  (
    &clk_test=&CLK_TEST_WCSS_PHY2_30_CLK
    &clk_reg=&HWIO_WCSS_HM_A_WCSS_CLK_CTL_WCSS_PHY2_30_CBCR_ADDR
    &clk_reg_name="WCSS_HM_A_WCSS_CLK_CTL_WCSS_PHY2_30_CBCR"
    &clk_name="wcss_phy2_30_clk"
    &clk_reg_cbcr_type="sm_cbc"
    &clk_vote_bit=-1.
    &clk_multiplier=4.

    gosub Print_Clk_Info_Line
  )

  &match=0
  &wild_head=0
  &wild_tail=0
  &clk_input_length=STRING.LENGTH("&clk")
  &clk_itr_length=STRING.LENGTH("wcss_phy2_320_clk")

  if (STRING.SCAN("&clk", "*", 0)==0)
  (
    &wild_head=1
  )
  if (STRING.SCAN("&clk", "*", 1)==(STRING.LENGTH("&clk")-1))
  (
    &wild_tail=1
  )

  if ((&wild_head==1)&&(&wild_tail==1))
  (
    if (STRING.SCAN("wcss_phy2_320_clk", STRING.MID("&clk", 1, &clk_input_length-2), 0)!=-1)
    ( 
      &match=1
    )
  )
  else if (&wild_head==1)
  (
    if (STRING.MID("wcss_phy2_320_clk", &clk_itr_length-&clk_input_length+1, &clk_input_length-1)==STRING.CUT("&clk", 1))
    ( 
      &match=1
    )
  )
  else if (&wild_tail==1)
  (
    if (STRING.MID("wcss_phy2_320_clk", 0, &clk_input_length-1)==STRING.CUT("&clk", -1))
    ( 
      &match=1
    )
  )
  else if ("wcss_phy2_320_clk"=="&clk")
  (
    &match=1
  )
  
  if (&match==1)
  (
    &clk_test=&CLK_TEST_WCSS_PHY2_320_CLK
    &clk_reg=&HWIO_WCSS_HM_A_WCSS_CLK_CTL_WCSS_PHY2_320_CBCR_ADDR
    &clk_reg_name="WCSS_HM_A_WCSS_CLK_CTL_WCSS_PHY2_320_CBCR"
    &clk_name="wcss_phy2_320_clk"
    &clk_reg_cbcr_type="sm_sreg_pscbc"
    &clk_vote_bit=-1.
    &clk_multiplier=4.

    gosub Print_Clk_Info_Line
  )

  &match=0
  &wild_head=0
  &wild_tail=0
  &clk_input_length=STRING.LENGTH("&clk")
  &clk_itr_length=STRING.LENGTH("wcss_phy2_40_clk")

  if (STRING.SCAN("&clk", "*", 0)==0)
  (
    &wild_head=1
  )
  if (STRING.SCAN("&clk", "*", 1)==(STRING.LENGTH("&clk")-1))
  (
    &wild_tail=1
  )

  if ((&wild_head==1)&&(&wild_tail==1))
  (
    if (STRING.SCAN("wcss_phy2_40_clk", STRING.MID("&clk", 1, &clk_input_length-2), 0)!=-1)
    ( 
      &match=1
    )
  )
  else if (&wild_head==1)
  (
    if (STRING.MID("wcss_phy2_40_clk", &clk_itr_length-&clk_input_length+1, &clk_input_length-1)==STRING.CUT("&clk", 1))
    ( 
      &match=1
    )
  )
  else if (&wild_tail==1)
  (
    if (STRING.MID("wcss_phy2_40_clk", 0, &clk_input_length-1)==STRING.CUT("&clk", -1))
    ( 
      &match=1
    )
  )
  else if ("wcss_phy2_40_clk"=="&clk")
  (
    &match=1
  )
  
  if (&match==1)
  (
    &clk_test=&CLK_TEST_WCSS_PHY2_40_CLK
    &clk_reg=&HWIO_WCSS_HM_A_WCSS_CLK_CTL_WCSS_PHY2_40_CBCR_ADDR
    &clk_reg_name="WCSS_HM_A_WCSS_CLK_CTL_WCSS_PHY2_40_CBCR"
    &clk_name="wcss_phy2_40_clk"
    &clk_reg_cbcr_type="sm_sreg_pscbc"
    &clk_vote_bit=-1.
    &clk_multiplier=4.

    gosub Print_Clk_Info_Line
  )

  &match=0
  &wild_head=0
  &wild_tail=0
  &clk_input_length=STRING.LENGTH("&clk")
  &clk_itr_length=STRING.LENGTH("wcss_phy2_80_clk")

  if (STRING.SCAN("&clk", "*", 0)==0)
  (
    &wild_head=1
  )
  if (STRING.SCAN("&clk", "*", 1)==(STRING.LENGTH("&clk")-1))
  (
    &wild_tail=1
  )

  if ((&wild_head==1)&&(&wild_tail==1))
  (
    if (STRING.SCAN("wcss_phy2_80_clk", STRING.MID("&clk", 1, &clk_input_length-2), 0)!=-1)
    ( 
      &match=1
    )
  )
  else if (&wild_head==1)
  (
    if (STRING.MID("wcss_phy2_80_clk", &clk_itr_length-&clk_input_length+1, &clk_input_length-1)==STRING.CUT("&clk", 1))
    ( 
      &match=1
    )
  )
  else if (&wild_tail==1)
  (
    if (STRING.MID("wcss_phy2_80_clk", 0, &clk_input_length-1)==STRING.CUT("&clk", -1))
    ( 
      &match=1
    )
  )
  else if ("wcss_phy2_80_clk"=="&clk")
  (
    &match=1
  )
  
  if (&match==1)
  (
    &clk_test=&CLK_TEST_WCSS_PHY2_80_CLK
    &clk_reg=&HWIO_WCSS_HM_A_WCSS_CLK_CTL_WCSS_PHY2_80_CBCR_ADDR
    &clk_reg_name="WCSS_HM_A_WCSS_CLK_CTL_WCSS_PHY2_80_CBCR"
    &clk_name="wcss_phy2_80_clk"
    &clk_reg_cbcr_type="sm_sreg_pscbc"
    &clk_vote_bit=-1.
    &clk_multiplier=4.

    gosub Print_Clk_Info_Line
  )

  &match=0
  &wild_head=0
  &wild_tail=0
  &clk_input_length=STRING.LENGTH("&clk")
  &clk_itr_length=STRING.LENGTH("wcss_phy2_bw_clk")

  if (STRING.SCAN("&clk", "*", 0)==0)
  (
    &wild_head=1
  )
  if (STRING.SCAN("&clk", "*", 1)==(STRING.LENGTH("&clk")-1))
  (
    &wild_tail=1
  )

  if ((&wild_head==1)&&(&wild_tail==1))
  (
    if (STRING.SCAN("wcss_phy2_bw_clk", STRING.MID("&clk", 1, &clk_input_length-2), 0)!=-1)
    ( 
      &match=1
    )
  )
  else if (&wild_head==1)
  (
    if (STRING.MID("wcss_phy2_bw_clk", &clk_itr_length-&clk_input_length+1, &clk_input_length-1)==STRING.CUT("&clk", 1))
    ( 
      &match=1
    )
  )
  else if (&wild_tail==1)
  (
    if (STRING.MID("wcss_phy2_bw_clk", 0, &clk_input_length-1)==STRING.CUT("&clk", -1))
    ( 
      &match=1
    )
  )
  else if ("wcss_phy2_bw_clk"=="&clk")
  (
    &match=1
  )
  
  if (&match==1)
  (
    &clk_test=&CLK_TEST_WCSS_PHY2_BW_CLK
    &clk_reg=&HWIO_WCSS_HM_A_WCSS_CLK_CTL_WCSS_PHY2_BW_CBCR_ADDR
    &clk_reg_name="WCSS_HM_A_WCSS_CLK_CTL_WCSS_PHY2_BW_CBCR"
    &clk_name="wcss_phy2_bw_clk"
    &clk_reg_cbcr_type="sm_sreg_pscbc"
    &clk_vote_bit=-1.
    &clk_multiplier=4.

    gosub Print_Clk_Info_Line
  )

  &match=0
  &wild_head=0
  &wild_tail=0
  &clk_input_length=STRING.LENGTH("&clk")
  &clk_itr_length=STRING.LENGTH("wcss_phy2_bwx2_clk")

  if (STRING.SCAN("&clk", "*", 0)==0)
  (
    &wild_head=1
  )
  if (STRING.SCAN("&clk", "*", 1)==(STRING.LENGTH("&clk")-1))
  (
    &wild_tail=1
  )

  if ((&wild_head==1)&&(&wild_tail==1))
  (
    if (STRING.SCAN("wcss_phy2_bwx2_clk", STRING.MID("&clk", 1, &clk_input_length-2), 0)!=-1)
    ( 
      &match=1
    )
  )
  else if (&wild_head==1)
  (
    if (STRING.MID("wcss_phy2_bwx2_clk", &clk_itr_length-&clk_input_length+1, &clk_input_length-1)==STRING.CUT("&clk", 1))
    ( 
      &match=1
    )
  )
  else if (&wild_tail==1)
  (
    if (STRING.MID("wcss_phy2_bwx2_clk", 0, &clk_input_length-1)==STRING.CUT("&clk", -1))
    ( 
      &match=1
    )
  )
  else if ("wcss_phy2_bwx2_clk"=="&clk")
  (
    &match=1
  )
  
  if (&match==1)
  (
    &clk_test=&CLK_TEST_WCSS_PHY2_BWX2_CLK
    &clk_reg=&HWIO_WCSS_HM_A_WCSS_CLK_CTL_WCSS_PHY2_BWX2_CBCR_ADDR
    &clk_reg_name="WCSS_HM_A_WCSS_CLK_CTL_WCSS_PHY2_BWX2_CBCR"
    &clk_name="wcss_phy2_bwx2_clk"
    &clk_reg_cbcr_type="sm_cbc"
    &clk_vote_bit=-1.
    &clk_multiplier=4.

    gosub Print_Clk_Info_Line
  )

  &match=0
  &wild_head=0
  &wild_tail=0
  &clk_input_length=STRING.LENGTH("&clk")
  &clk_itr_length=STRING.LENGTH("wcss_phy2_clk")

  if (STRING.SCAN("&clk", "*", 0)==0)
  (
    &wild_head=1
  )
  if (STRING.SCAN("&clk", "*", 1)==(STRING.LENGTH("&clk")-1))
  (
    &wild_tail=1
  )

  if ((&wild_head==1)&&(&wild_tail==1))
  (
    if (STRING.SCAN("wcss_phy2_clk", STRING.MID("&clk", 1, &clk_input_length-2), 0)!=-1)
    ( 
      &match=1
    )
  )
  else if (&wild_head==1)
  (
    if (STRING.MID("wcss_phy2_clk", &clk_itr_length-&clk_input_length+1, &clk_input_length-1)==STRING.CUT("&clk", 1))
    ( 
      &match=1
    )
  )
  else if (&wild_tail==1)
  (
    if (STRING.MID("wcss_phy2_clk", 0, &clk_input_length-1)==STRING.CUT("&clk", -1))
    ( 
      &match=1
    )
  )
  else if ("wcss_phy2_clk"=="&clk")
  (
    &match=1
  )
  
  if (&match==1)
  (
    &clk_test=&CLK_TEST_WCSS_PHY2_CLK
    &clk_reg=&HWIO_WCSS_HM_A_WCSS_CLK_CTL_WCSS_PHY2_CBCR_ADDR
    &clk_reg_name="WCSS_HM_A_WCSS_CLK_CTL_WCSS_PHY2_CBCR"
    &clk_name="wcss_phy2_clk"
    &clk_reg_cbcr_type="sm_sreg_pscbc"
    &clk_vote_bit=-1.
    &clk_multiplier=4.

    gosub Print_Clk_Info_Line
  )

  &match=0
  &wild_head=0
  &wild_tail=0
  &clk_input_length=STRING.LENGTH("&clk")
  &clk_itr_length=STRING.LENGTH("wcss_phy2_dfs_clk")

  if (STRING.SCAN("&clk", "*", 0)==0)
  (
    &wild_head=1
  )
  if (STRING.SCAN("&clk", "*", 1)==(STRING.LENGTH("&clk")-1))
  (
    &wild_tail=1
  )

  if ((&wild_head==1)&&(&wild_tail==1))
  (
    if (STRING.SCAN("wcss_phy2_dfs_clk", STRING.MID("&clk", 1, &clk_input_length-2), 0)!=-1)
    ( 
      &match=1
    )
  )
  else if (&wild_head==1)
  (
    if (STRING.MID("wcss_phy2_dfs_clk", &clk_itr_length-&clk_input_length+1, &clk_input_length-1)==STRING.CUT("&clk", 1))
    ( 
      &match=1
    )
  )
  else if (&wild_tail==1)
  (
    if (STRING.MID("wcss_phy2_dfs_clk", 0, &clk_input_length-1)==STRING.CUT("&clk", -1))
    ( 
      &match=1
    )
  )
  else if ("wcss_phy2_dfs_clk"=="&clk")
  (
    &match=1
  )
  
  if (&match==1)
  (
    &clk_test=&CLK_TEST_WCSS_PHY2_DFS_CLK
    &clk_reg=&HWIO_WCSS_HM_A_WCSS_CLK_CTL_WCSS_PHY2_DFS_CBCR_ADDR
    &clk_reg_name="WCSS_HM_A_WCSS_CLK_CTL_WCSS_PHY2_DFS_CBCR"
    &clk_name="wcss_phy2_dfs_clk"
    &clk_reg_cbcr_type="sm_sreg_pscbc"
    &clk_vote_bit=-1.
    &clk_multiplier=4.

    gosub Print_Clk_Info_Line
  )

  &match=0
  &wild_head=0
  &wild_tail=0
  &clk_input_length=STRING.LENGTH("&clk")
  &clk_itr_length=STRING.LENGTH("wcss_phy2_t240_clk")

  if (STRING.SCAN("&clk", "*", 0)==0)
  (
    &wild_head=1
  )
  if (STRING.SCAN("&clk", "*", 1)==(STRING.LENGTH("&clk")-1))
  (
    &wild_tail=1
  )

  if ((&wild_head==1)&&(&wild_tail==1))
  (
    if (STRING.SCAN("wcss_phy2_t240_clk", STRING.MID("&clk", 1, &clk_input_length-2), 0)!=-1)
    ( 
      &match=1
    )
  )
  else if (&wild_head==1)
  (
    if (STRING.MID("wcss_phy2_t240_clk", &clk_itr_length-&clk_input_length+1, &clk_input_length-1)==STRING.CUT("&clk", 1))
    ( 
      &match=1
    )
  )
  else if (&wild_tail==1)
  (
    if (STRING.MID("wcss_phy2_t240_clk", 0, &clk_input_length-1)==STRING.CUT("&clk", -1))
    ( 
      &match=1
    )
  )
  else if ("wcss_phy2_t240_clk"=="&clk")
  (
    &match=1
  )
  
  if (&match==1)
  (
    &clk_test=&CLK_TEST_WCSS_PHY2_T240_CLK
    &clk_reg=&HWIO_WCSS_HM_A_WCSS_CLK_CTL_WCSS_PHY2_T240_CBCR_ADDR
    &clk_reg_name="WCSS_HM_A_WCSS_CLK_CTL_WCSS_PHY2_T240_CBCR"
    &clk_name="wcss_phy2_t240_clk"
    &clk_reg_cbcr_type="sm_cbc"
    &clk_vote_bit=-1.
    &clk_multiplier=4.

    gosub Print_Clk_Info_Line
  )

  &match=0
  &wild_head=0
  &wild_tail=0
  &clk_input_length=STRING.LENGTH("&clk")
  &clk_itr_length=STRING.LENGTH("wcss_phy2_tadc_clk")

  if (STRING.SCAN("&clk", "*", 0)==0)
  (
    &wild_head=1
  )
  if (STRING.SCAN("&clk", "*", 1)==(STRING.LENGTH("&clk")-1))
  (
    &wild_tail=1
  )

  if ((&wild_head==1)&&(&wild_tail==1))
  (
    if (STRING.SCAN("wcss_phy2_tadc_clk", STRING.MID("&clk", 1, &clk_input_length-2), 0)!=-1)
    ( 
      &match=1
    )
  )
  else if (&wild_head==1)
  (
    if (STRING.MID("wcss_phy2_tadc_clk", &clk_itr_length-&clk_input_length+1, &clk_input_length-1)==STRING.CUT("&clk", 1))
    ( 
      &match=1
    )
  )
  else if (&wild_tail==1)
  (
    if (STRING.MID("wcss_phy2_tadc_clk", 0, &clk_input_length-1)==STRING.CUT("&clk", -1))
    ( 
      &match=1
    )
  )
  else if ("wcss_phy2_tadc_clk"=="&clk")
  (
    &match=1
  )
  
  if (&match==1)
  (
    &clk_test=&CLK_TEST_WCSS_PHY2_TADC_CLK
    &clk_reg=&HWIO_WCSS_HM_A_WCSS_CLK_CTL_WCSS_PHY2_TADC_CBCR_ADDR
    &clk_reg_name="WCSS_HM_A_WCSS_CLK_CTL_WCSS_PHY2_TADC_CBCR"
    &clk_name="wcss_phy2_tadc_clk"
    &clk_reg_cbcr_type="sm_cbc"
    &clk_vote_bit=-1.
    &clk_multiplier=4.

    gosub Print_Clk_Info_Line
  )

  &match=0
  &wild_head=0
  &wild_tail=0
  &clk_input_length=STRING.LENGTH("&clk")
  &clk_itr_length=STRING.LENGTH("wcss_phy2_tdac_clk")

  if (STRING.SCAN("&clk", "*", 0)==0)
  (
    &wild_head=1
  )
  if (STRING.SCAN("&clk", "*", 1)==(STRING.LENGTH("&clk")-1))
  (
    &wild_tail=1
  )

  if ((&wild_head==1)&&(&wild_tail==1))
  (
    if (STRING.SCAN("wcss_phy2_tdac_clk", STRING.MID("&clk", 1, &clk_input_length-2), 0)!=-1)
    ( 
      &match=1
    )
  )
  else if (&wild_head==1)
  (
    if (STRING.MID("wcss_phy2_tdac_clk", &clk_itr_length-&clk_input_length+1, &clk_input_length-1)==STRING.CUT("&clk", 1))
    ( 
      &match=1
    )
  )
  else if (&wild_tail==1)
  (
    if (STRING.MID("wcss_phy2_tdac_clk", 0, &clk_input_length-1)==STRING.CUT("&clk", -1))
    ( 
      &match=1
    )
  )
  else if ("wcss_phy2_tdac_clk"=="&clk")
  (
    &match=1
  )
  
  if (&match==1)
  (
    &clk_test=&CLK_TEST_WCSS_PHY2_TDAC_CLK
    &clk_reg=&HWIO_WCSS_HM_A_WCSS_CLK_CTL_WCSS_PHY2_TDAC_CBCR_ADDR
    &clk_reg_name="WCSS_HM_A_WCSS_CLK_CTL_WCSS_PHY2_TDAC_CBCR"
    &clk_name="wcss_phy2_tdac_clk"
    &clk_reg_cbcr_type="sm_sreg_pscbc"
    &clk_vote_bit=-1.
    &clk_multiplier=4.

    gosub Print_Clk_Info_Line
  )

  &match=0
  &wild_head=0
  &wild_tail=0
  &clk_input_length=STRING.LENGTH("&clk")
  &clk_itr_length=STRING.LENGTH("wcss_phy2_x2_clk")

  if (STRING.SCAN("&clk", "*", 0)==0)
  (
    &wild_head=1
  )
  if (STRING.SCAN("&clk", "*", 1)==(STRING.LENGTH("&clk")-1))
  (
    &wild_tail=1
  )

  if ((&wild_head==1)&&(&wild_tail==1))
  (
    if (STRING.SCAN("wcss_phy2_x2_clk", STRING.MID("&clk", 1, &clk_input_length-2), 0)!=-1)
    ( 
      &match=1
    )
  )
  else if (&wild_head==1)
  (
    if (STRING.MID("wcss_phy2_x2_clk", &clk_itr_length-&clk_input_length+1, &clk_input_length-1)==STRING.CUT("&clk", 1))
    ( 
      &match=1
    )
  )
  else if (&wild_tail==1)
  (
    if (STRING.MID("wcss_phy2_x2_clk", 0, &clk_input_length-1)==STRING.CUT("&clk", -1))
    ( 
      &match=1
    )
  )
  else if ("wcss_phy2_x2_clk"=="&clk")
  (
    &match=1
  )
  
  if (&match==1)
  (
    &clk_test=&CLK_TEST_WCSS_PHY2_X2_CLK
    &clk_reg=&HWIO_WCSS_HM_A_WCSS_CLK_CTL_WCSS_PHY2_X2_CBCR_ADDR
    &clk_reg_name="WCSS_HM_A_WCSS_CLK_CTL_WCSS_PHY2_X2_CBCR"
    &clk_name="wcss_phy2_x2_clk"
    &clk_reg_cbcr_type="sm_cbc"
    &clk_vote_bit=-1.
    &clk_multiplier=4.

    gosub Print_Clk_Info_Line
  )

  &match=0
  &wild_head=0
  &wild_tail=0
  &clk_input_length=STRING.LENGTH("&clk")
  &clk_itr_length=STRING.LENGTH("wcss_rfactrl_phy2_80_clk")

  if (STRING.SCAN("&clk", "*", 0)==0)
  (
    &wild_head=1
  )
  if (STRING.SCAN("&clk", "*", 1)==(STRING.LENGTH("&clk")-1))
  (
    &wild_tail=1
  )

  if ((&wild_head==1)&&(&wild_tail==1))
  (
    if (STRING.SCAN("wcss_rfactrl_phy2_80_clk", STRING.MID("&clk", 1, &clk_input_length-2), 0)!=-1)
    ( 
      &match=1
    )
  )
  else if (&wild_head==1)
  (
    if (STRING.MID("wcss_rfactrl_phy2_80_clk", &clk_itr_length-&clk_input_length+1, &clk_input_length-1)==STRING.CUT("&clk", 1))
    ( 
      &match=1
    )
  )
  else if (&wild_tail==1)
  (
    if (STRING.MID("wcss_rfactrl_phy2_80_clk", 0, &clk_input_length-1)==STRING.CUT("&clk", -1))
    ( 
      &match=1
    )
  )
  else if ("wcss_rfactrl_phy2_80_clk"=="&clk")
  (
    &match=1
  )
  
  if (&match==1)
  (
    &clk_test=&CLK_TEST_WCSS_RFACTRL_PHY2_80_CLK
    &clk_reg=&HWIO_WCSS_HM_A_WCSS_CLK_CTL_WCSS_RFACTRL_PHY2_80_CBCR_ADDR
    &clk_reg_name="WCSS_HM_A_WCSS_CLK_CTL_WCSS_RFACTRL_PHY2_80_CBCR"
    &clk_name="wcss_rfactrl_phy2_80_clk"
    &clk_reg_cbcr_type="sm_cbc"
    &clk_vote_bit=-1.
    &clk_multiplier=4.

    gosub Print_Clk_Info_Line
  )

  &match=0
  &wild_head=0
  &wild_tail=0
  &clk_input_length=STRING.LENGTH("&clk")
  &clk_itr_length=STRING.LENGTH("phy1_11ac_radio_adc_1_clk")

  if (STRING.SCAN("&clk", "*", 0)==0)
  (
    &wild_head=1
  )
  if (STRING.SCAN("&clk", "*", 1)==(STRING.LENGTH("&clk")-1))
  (
    &wild_tail=1
  )

  if ((&wild_head==1)&&(&wild_tail==1))
  (
    if (STRING.SCAN("phy1_11ac_radio_adc_1_clk", STRING.MID("&clk", 1, &clk_input_length-2), 0)!=-1)
    ( 
      &match=1
    )
  )
  else if (&wild_head==1)
  (
    if (STRING.MID("phy1_11ac_radio_adc_1_clk", &clk_itr_length-&clk_input_length+1, &clk_input_length-1)==STRING.CUT("&clk", 1))
    ( 
      &match=1
    )
  )
  else if (&wild_tail==1)
  (
    if (STRING.MID("phy1_11ac_radio_adc_1_clk", 0, &clk_input_length-1)==STRING.CUT("&clk", -1))
    ( 
      &match=1
    )
  )
  else if ("phy1_11ac_radio_adc_1_clk"=="&clk")
  (
    &match=1
  )
  
  if (&match==1)
  (
    &clk_test=&CLK_TEST_PHY1_11AC_RADIO_ADC_1_CLK
    &clk_reg=&HWIO_WCSS_HM_A_WCSS_CLK_CTL_PHY1_11AC_RADIO_ADC_1_CBCR_ADDR
    &clk_reg_name="WCSS_HM_A_WCSS_CLK_CTL_PHY1_11AC_RADIO_ADC_1_CBCR"
    &clk_name="phy1_11ac_radio_adc_1_clk"
    &clk_reg_cbcr_type="sm_cbc"
    &clk_vote_bit=-1.
    &clk_multiplier=4.

    gosub Print_Clk_Info_Line
  )

  &match=0
  &wild_head=0
  &wild_tail=0
  &clk_input_length=STRING.LENGTH("&clk")
  &clk_itr_length=STRING.LENGTH("wcss_rfactrl_phy1_11ac_radio_adc_1_clk")

  if (STRING.SCAN("&clk", "*", 0)==0)
  (
    &wild_head=1
  )
  if (STRING.SCAN("&clk", "*", 1)==(STRING.LENGTH("&clk")-1))
  (
    &wild_tail=1
  )

  if ((&wild_head==1)&&(&wild_tail==1))
  (
    if (STRING.SCAN("wcss_rfactrl_phy1_11ac_radio_adc_1_clk", STRING.MID("&clk", 1, &clk_input_length-2), 0)!=-1)
    ( 
      &match=1
    )
  )
  else if (&wild_head==1)
  (
    if (STRING.MID("wcss_rfactrl_phy1_11ac_radio_adc_1_clk", &clk_itr_length-&clk_input_length+1, &clk_input_length-1)==STRING.CUT("&clk", 1))
    ( 
      &match=1
    )
  )
  else if (&wild_tail==1)
  (
    if (STRING.MID("wcss_rfactrl_phy1_11ac_radio_adc_1_clk", 0, &clk_input_length-1)==STRING.CUT("&clk", -1))
    ( 
      &match=1
    )
  )
  else if ("wcss_rfactrl_phy1_11ac_radio_adc_1_clk"=="&clk")
  (
    &match=1
  )
  
  if (&match==1)
  (
    &clk_test=&CLK_TEST_WCSS_RFACTRL_PHY1_11AC_RADIO_ADC_1_CLK
    &clk_reg=&MACRO_TOO_LONG_5
    &clk_reg_name="WCSS_HM_A_WCSS_CLK_CTL_WCSS_RFACTRL_PHY1_11AC_RADIO_ADC_1_CBCR"
    &clk_name="wcss_rfactrl_phy1_11ac_radio_adc_1_clk"
    &clk_reg_cbcr_type="sm_cbc"
    &clk_vote_bit=-1.
    &clk_multiplier=4.

    gosub Print_Clk_Info_Line
  )

  &match=0
  &wild_head=0
  &wild_tail=0
  &clk_input_length=STRING.LENGTH("&clk")
  &clk_itr_length=STRING.LENGTH("phy2_11ac_radio_adc_1_clk")

  if (STRING.SCAN("&clk", "*", 0)==0)
  (
    &wild_head=1
  )
  if (STRING.SCAN("&clk", "*", 1)==(STRING.LENGTH("&clk")-1))
  (
    &wild_tail=1
  )

  if ((&wild_head==1)&&(&wild_tail==1))
  (
    if (STRING.SCAN("phy2_11ac_radio_adc_1_clk", STRING.MID("&clk", 1, &clk_input_length-2), 0)!=-1)
    ( 
      &match=1
    )
  )
  else if (&wild_head==1)
  (
    if (STRING.MID("phy2_11ac_radio_adc_1_clk", &clk_itr_length-&clk_input_length+1, &clk_input_length-1)==STRING.CUT("&clk", 1))
    ( 
      &match=1
    )
  )
  else if (&wild_tail==1)
  (
    if (STRING.MID("phy2_11ac_radio_adc_1_clk", 0, &clk_input_length-1)==STRING.CUT("&clk", -1))
    ( 
      &match=1
    )
  )
  else if ("phy2_11ac_radio_adc_1_clk"=="&clk")
  (
    &match=1
  )
  
  if (&match==1)
  (
    &clk_test=&CLK_TEST_PHY2_11AC_RADIO_ADC_1_CLK
    &clk_reg=&HWIO_WCSS_HM_A_WCSS_CLK_CTL_PHY2_11AC_RADIO_ADC_1_CBCR_ADDR
    &clk_reg_name="WCSS_HM_A_WCSS_CLK_CTL_PHY2_11AC_RADIO_ADC_1_CBCR"
    &clk_name="phy2_11ac_radio_adc_1_clk"
    &clk_reg_cbcr_type="sm_cbc"
    &clk_vote_bit=-1.
    &clk_multiplier=4.

    gosub Print_Clk_Info_Line
  )

  &match=0
  &wild_head=0
  &wild_tail=0
  &clk_input_length=STRING.LENGTH("&clk")
  &clk_itr_length=STRING.LENGTH("wcss_dac_sm_clk")

  if (STRING.SCAN("&clk", "*", 0)==0)
  (
    &wild_head=1
  )
  if (STRING.SCAN("&clk", "*", 1)==(STRING.LENGTH("&clk")-1))
  (
    &wild_tail=1
  )

  if ((&wild_head==1)&&(&wild_tail==1))
  (
    if (STRING.SCAN("wcss_dac_sm_clk", STRING.MID("&clk", 1, &clk_input_length-2), 0)!=-1)
    ( 
      &match=1
    )
  )
  else if (&wild_head==1)
  (
    if (STRING.MID("wcss_dac_sm_clk", &clk_itr_length-&clk_input_length+1, &clk_input_length-1)==STRING.CUT("&clk", 1))
    ( 
      &match=1
    )
  )
  else if (&wild_tail==1)
  (
    if (STRING.MID("wcss_dac_sm_clk", 0, &clk_input_length-1)==STRING.CUT("&clk", -1))
    ( 
      &match=1
    )
  )
  else if ("wcss_dac_sm_clk"=="&clk")
  (
    &match=1
  )
  
  if (&match==1)
  (
    &clk_test=0
    &clk_reg=&HWIO_WCSS_HM_A_WCSS_CLK_CTL_WCSS_DAC_SM_CBCR_ADDR
    &clk_reg_name="WCSS_HM_A_WCSS_CLK_CTL_WCSS_DAC_SM_CBCR"
    &clk_name="wcss_dac_sm_clk"
    &clk_reg_cbcr_type="sm_cbc"
    &clk_vote_bit=-1.
    &clk_multiplier=4.

    gosub Print_Clk_Info_Line
  )

  &match=0
  &wild_head=0
  &wild_tail=0
  &clk_input_length=STRING.LENGTH("&clk")
  &clk_itr_length=STRING.LENGTH("wcss_top_ref_clk")

  if (STRING.SCAN("&clk", "*", 0)==0)
  (
    &wild_head=1
  )
  if (STRING.SCAN("&clk", "*", 1)==(STRING.LENGTH("&clk")-1))
  (
    &wild_tail=1
  )

  if ((&wild_head==1)&&(&wild_tail==1))
  (
    if (STRING.SCAN("wcss_top_ref_clk", STRING.MID("&clk", 1, &clk_input_length-2), 0)!=-1)
    ( 
      &match=1
    )
  )
  else if (&wild_head==1)
  (
    if (STRING.MID("wcss_top_ref_clk", &clk_itr_length-&clk_input_length+1, &clk_input_length-1)==STRING.CUT("&clk", 1))
    ( 
      &match=1
    )
  )
  else if (&wild_tail==1)
  (
    if (STRING.MID("wcss_top_ref_clk", 0, &clk_input_length-1)==STRING.CUT("&clk", -1))
    ( 
      &match=1
    )
  )
  else if ("wcss_top_ref_clk"=="&clk")
  (
    &match=1
  )
  
  if (&match==1)
  (
    &clk_test=&CLK_TEST_WCSS_TOP_REF_CLK
    &clk_reg=&HWIO_WCSS_HM_A_WCSS_CLK_CTL_WCSS_TOP_REF_CBCR_ADDR
    &clk_reg_name="WCSS_HM_A_WCSS_CLK_CTL_WCSS_TOP_REF_CBCR"
    &clk_name="wcss_top_ref_clk"
    &clk_reg_cbcr_type="sm_cbc"
    &clk_vote_bit=-1.
    &clk_multiplier=4.

    gosub Print_Clk_Info_Line
  )

  &match=0
  &wild_head=0
  &wild_tail=0
  &clk_input_length=STRING.LENGTH("&clk")
  &clk_itr_length=STRING.LENGTH("wcss_rfactrl_clk")

  if (STRING.SCAN("&clk", "*", 0)==0)
  (
    &wild_head=1
  )
  if (STRING.SCAN("&clk", "*", 1)==(STRING.LENGTH("&clk")-1))
  (
    &wild_tail=1
  )

  if ((&wild_head==1)&&(&wild_tail==1))
  (
    if (STRING.SCAN("wcss_rfactrl_clk", STRING.MID("&clk", 1, &clk_input_length-2), 0)!=-1)
    ( 
      &match=1
    )
  )
  else if (&wild_head==1)
  (
    if (STRING.MID("wcss_rfactrl_clk", &clk_itr_length-&clk_input_length+1, &clk_input_length-1)==STRING.CUT("&clk", 1))
    ( 
      &match=1
    )
  )
  else if (&wild_tail==1)
  (
    if (STRING.MID("wcss_rfactrl_clk", 0, &clk_input_length-1)==STRING.CUT("&clk", -1))
    ( 
      &match=1
    )
  )
  else if ("wcss_rfactrl_clk"=="&clk")
  (
    &match=1
  )
  
  if (&match==1)
  (
    &clk_test=&CLK_TEST_WCSS_RFACTRL_CLK
    &clk_reg=&HWIO_WCSS_HM_A_WCSS_CLK_CTL_WCSS_RFACTRL_CBCR_ADDR
    &clk_reg_name="WCSS_HM_A_WCSS_CLK_CTL_WCSS_RFACTRL_CBCR"
    &clk_name="wcss_rfactrl_clk"
    &clk_reg_cbcr_type="sm_cbc"
    &clk_vote_bit=-1.
    &clk_multiplier=4.

    gosub Print_Clk_Info_Line
  )

  &match=0
  &wild_head=0
  &wild_tail=0
  &clk_input_length=STRING.LENGTH("&clk")
  &clk_itr_length=STRING.LENGTH("wcss_top_slp_clk")

  if (STRING.SCAN("&clk", "*", 0)==0)
  (
    &wild_head=1
  )
  if (STRING.SCAN("&clk", "*", 1)==(STRING.LENGTH("&clk")-1))
  (
    &wild_tail=1
  )

  if ((&wild_head==1)&&(&wild_tail==1))
  (
    if (STRING.SCAN("wcss_top_slp_clk", STRING.MID("&clk", 1, &clk_input_length-2), 0)!=-1)
    ( 
      &match=1
    )
  )
  else if (&wild_head==1)
  (
    if (STRING.MID("wcss_top_slp_clk", &clk_itr_length-&clk_input_length+1, &clk_input_length-1)==STRING.CUT("&clk", 1))
    ( 
      &match=1
    )
  )
  else if (&wild_tail==1)
  (
    if (STRING.MID("wcss_top_slp_clk", 0, &clk_input_length-1)==STRING.CUT("&clk", -1))
    ( 
      &match=1
    )
  )
  else if ("wcss_top_slp_clk"=="&clk")
  (
    &match=1
  )
  
  if (&match==1)
  (
    &clk_test=&CLK_TEST_WCSS_TOP_SLP_CLK
    &clk_reg=&HWIO_WCSS_HM_A_WCSS_CLK_CTL_WCSS_TOP_SLP_CBCR_ADDR
    &clk_reg_name="WCSS_HM_A_WCSS_CLK_CTL_WCSS_TOP_SLP_CBCR"
    &clk_name="wcss_top_slp_clk"
    &clk_reg_cbcr_type="sm_cbc"
    &clk_vote_bit=-1.
    &clk_multiplier=4.

    gosub Print_Clk_Info_Line
  )

  &match=0
  &wild_head=0
  &wild_tail=0
  &clk_input_length=STRING.LENGTH("&clk")
  &clk_itr_length=STRING.LENGTH("wcss_debug_clkout_cbc_out")

  if (STRING.SCAN("&clk", "*", 0)==0)
  (
    &wild_head=1
  )
  if (STRING.SCAN("&clk", "*", 1)==(STRING.LENGTH("&clk")-1))
  (
    &wild_tail=1
  )

  if ((&wild_head==1)&&(&wild_tail==1))
  (
    if (STRING.SCAN("wcss_debug_clkout_cbc_out", STRING.MID("&clk", 1, &clk_input_length-2), 0)!=-1)
    ( 
      &match=1
    )
  )
  else if (&wild_head==1)
  (
    if (STRING.MID("wcss_debug_clkout_cbc_out", &clk_itr_length-&clk_input_length+1, &clk_input_length-1)==STRING.CUT("&clk", 1))
    ( 
      &match=1
    )
  )
  else if (&wild_tail==1)
  (
    if (STRING.MID("wcss_debug_clkout_cbc_out", 0, &clk_input_length-1)==STRING.CUT("&clk", -1))
    ( 
      &match=1
    )
  )
  else if ("wcss_debug_clkout_cbc_out"=="&clk")
  (
    &match=1
  )
  
  if (&match==1)
  (
    &clk_test=0
    &clk_reg=&HWIO_WCSS_HM_A_WCSS_CLK_CTL_WCSS_DEBUG_CBCR_ADDR
    &clk_reg_name="WCSS_HM_A_WCSS_CLK_CTL_WCSS_DEBUG_CBCR"
    &clk_name="wcss_debug_clkout_cbc_out"
    &clk_reg_cbcr_type="sm_cbc"
    &clk_vote_bit=-1.
    &clk_multiplier=4.

    gosub Print_Clk_Info_Line
  )

  &match=0
  &wild_head=0
  &wild_tail=0
  &clk_input_length=STRING.LENGTH("&clk")
  &clk_itr_length=STRING.LENGTH("wcss_wmac1_css_mac_clk")

  if (STRING.SCAN("&clk", "*", 0)==0)
  (
    &wild_head=1
  )
  if (STRING.SCAN("&clk", "*", 1)==(STRING.LENGTH("&clk")-1))
  (
    &wild_tail=1
  )

  if ((&wild_head==1)&&(&wild_tail==1))
  (
    if (STRING.SCAN("wcss_wmac1_css_mac_clk", STRING.MID("&clk", 1, &clk_input_length-2), 0)!=-1)
    ( 
      &match=1
    )
  )
  else if (&wild_head==1)
  (
    if (STRING.MID("wcss_wmac1_css_mac_clk", &clk_itr_length-&clk_input_length+1, &clk_input_length-1)==STRING.CUT("&clk", 1))
    ( 
      &match=1
    )
  )
  else if (&wild_tail==1)
  (
    if (STRING.MID("wcss_wmac1_css_mac_clk", 0, &clk_input_length-1)==STRING.CUT("&clk", -1))
    ( 
      &match=1
    )
  )
  else if ("wcss_wmac1_css_mac_clk"=="&clk")
  (
    &match=1
  )
  
  if (&match==1)
  (
    &clk_test=&CLK_TEST_WCSS_WMAC1_CSS_MAC_CLK
    &clk_reg=&HWIO_WCSS_HM_A_WCSS_CLK_CTL_WCSS_WMAC1_CSS_MAC_CBCR_ADDR
    &clk_reg_name="WCSS_HM_A_WCSS_CLK_CTL_WCSS_WMAC1_CSS_MAC_CBCR"
    &clk_name="wcss_wmac1_css_mac_clk"
    &clk_reg_cbcr_type="sm_cbc"
    &clk_vote_bit=-1.
    &clk_multiplier=4.

    gosub Print_Clk_Info_Line
  )

  &match=0
  &wild_head=0
  &wild_tail=0
  &clk_input_length=STRING.LENGTH("&clk")
  &clk_itr_length=STRING.LENGTH("wcss_wmac1_mac_clk")

  if (STRING.SCAN("&clk", "*", 0)==0)
  (
    &wild_head=1
  )
  if (STRING.SCAN("&clk", "*", 1)==(STRING.LENGTH("&clk")-1))
  (
    &wild_tail=1
  )

  if ((&wild_head==1)&&(&wild_tail==1))
  (
    if (STRING.SCAN("wcss_wmac1_mac_clk", STRING.MID("&clk", 1, &clk_input_length-2), 0)!=-1)
    ( 
      &match=1
    )
  )
  else if (&wild_head==1)
  (
    if (STRING.MID("wcss_wmac1_mac_clk", &clk_itr_length-&clk_input_length+1, &clk_input_length-1)==STRING.CUT("&clk", 1))
    ( 
      &match=1
    )
  )
  else if (&wild_tail==1)
  (
    if (STRING.MID("wcss_wmac1_mac_clk", 0, &clk_input_length-1)==STRING.CUT("&clk", -1))
    ( 
      &match=1
    )
  )
  else if ("wcss_wmac1_mac_clk"=="&clk")
  (
    &match=1
  )
  
  if (&match==1)
  (
    &clk_test=&CLK_TEST_WCSS_WMAC1_MAC_CLK
    &clk_reg=&HWIO_WCSS_HM_A_WCSS_CLK_CTL_WCSS_WMAC1_MAC_CBCR_ADDR
    &clk_reg_name="WCSS_HM_A_WCSS_CLK_CTL_WCSS_WMAC1_MAC_CBCR"
    &clk_name="wcss_wmac1_mac_clk"
    &clk_reg_cbcr_type="sm_sreg_pscbc"
    &clk_vote_bit=-1.
    &clk_multiplier=4.

    gosub Print_Clk_Info_Line
  )

  &match=0
  &wild_head=0
  &wild_tail=0
  &clk_input_length=STRING.LENGTH("&clk")
  &clk_itr_length=STRING.LENGTH("wcss_wmac2_css_mac_clk")

  if (STRING.SCAN("&clk", "*", 0)==0)
  (
    &wild_head=1
  )
  if (STRING.SCAN("&clk", "*", 1)==(STRING.LENGTH("&clk")-1))
  (
    &wild_tail=1
  )

  if ((&wild_head==1)&&(&wild_tail==1))
  (
    if (STRING.SCAN("wcss_wmac2_css_mac_clk", STRING.MID("&clk", 1, &clk_input_length-2), 0)!=-1)
    ( 
      &match=1
    )
  )
  else if (&wild_head==1)
  (
    if (STRING.MID("wcss_wmac2_css_mac_clk", &clk_itr_length-&clk_input_length+1, &clk_input_length-1)==STRING.CUT("&clk", 1))
    ( 
      &match=1
    )
  )
  else if (&wild_tail==1)
  (
    if (STRING.MID("wcss_wmac2_css_mac_clk", 0, &clk_input_length-1)==STRING.CUT("&clk", -1))
    ( 
      &match=1
    )
  )
  else if ("wcss_wmac2_css_mac_clk"=="&clk")
  (
    &match=1
  )
  
  if (&match==1)
  (
    &clk_test=&CLK_TEST_WCSS_WMAC2_CSS_MAC_CLK
    &clk_reg=&HWIO_WCSS_HM_A_WCSS_CLK_CTL_WCSS_WMAC2_CSS_MAC_CBCR_ADDR
    &clk_reg_name="WCSS_HM_A_WCSS_CLK_CTL_WCSS_WMAC2_CSS_MAC_CBCR"
    &clk_name="wcss_wmac2_css_mac_clk"
    &clk_reg_cbcr_type="sm_cbc"
    &clk_vote_bit=-1.
    &clk_multiplier=4.

    gosub Print_Clk_Info_Line
  )

  &match=0
  &wild_head=0
  &wild_tail=0
  &clk_input_length=STRING.LENGTH("&clk")
  &clk_itr_length=STRING.LENGTH("wcss_wmac2_mac_clk")

  if (STRING.SCAN("&clk", "*", 0)==0)
  (
    &wild_head=1
  )
  if (STRING.SCAN("&clk", "*", 1)==(STRING.LENGTH("&clk")-1))
  (
    &wild_tail=1
  )

  if ((&wild_head==1)&&(&wild_tail==1))
  (
    if (STRING.SCAN("wcss_wmac2_mac_clk", STRING.MID("&clk", 1, &clk_input_length-2), 0)!=-1)
    ( 
      &match=1
    )
  )
  else if (&wild_head==1)
  (
    if (STRING.MID("wcss_wmac2_mac_clk", &clk_itr_length-&clk_input_length+1, &clk_input_length-1)==STRING.CUT("&clk", 1))
    ( 
      &match=1
    )
  )
  else if (&wild_tail==1)
  (
    if (STRING.MID("wcss_wmac2_mac_clk", 0, &clk_input_length-1)==STRING.CUT("&clk", -1))
    ( 
      &match=1
    )
  )
  else if ("wcss_wmac2_mac_clk"=="&clk")
  (
    &match=1
  )
  
  if (&match==1)
  (
    &clk_test=&CLK_TEST_WCSS_WMAC2_MAC_CLK
    &clk_reg=&HWIO_WCSS_HM_A_WCSS_CLK_CTL_WCSS_WMAC2_MAC_CBCR_ADDR
    &clk_reg_name="WCSS_HM_A_WCSS_CLK_CTL_WCSS_WMAC2_MAC_CBCR"
    &clk_name="wcss_wmac2_mac_clk"
    &clk_reg_cbcr_type="sm_sreg_pscbc"
    &clk_vote_bit=-1.
    &clk_multiplier=4.

    gosub Print_Clk_Info_Line
  )

  &match=0
  &wild_head=0
  &wild_tail=0
  &clk_input_length=STRING.LENGTH("&clk")
  &clk_itr_length=STRING.LENGTH("wcss_css_wsi_clk")

  if (STRING.SCAN("&clk", "*", 0)==0)
  (
    &wild_head=1
  )
  if (STRING.SCAN("&clk", "*", 1)==(STRING.LENGTH("&clk")-1))
  (
    &wild_tail=1
  )

  if ((&wild_head==1)&&(&wild_tail==1))
  (
    if (STRING.SCAN("wcss_css_wsi_clk", STRING.MID("&clk", 1, &clk_input_length-2), 0)!=-1)
    ( 
      &match=1
    )
  )
  else if (&wild_head==1)
  (
    if (STRING.MID("wcss_css_wsi_clk", &clk_itr_length-&clk_input_length+1, &clk_input_length-1)==STRING.CUT("&clk", 1))
    ( 
      &match=1
    )
  )
  else if (&wild_tail==1)
  (
    if (STRING.MID("wcss_css_wsi_clk", 0, &clk_input_length-1)==STRING.CUT("&clk", -1))
    ( 
      &match=1
    )
  )
  else if ("wcss_css_wsi_clk"=="&clk")
  (
    &match=1
  )
  
  if (&match==1)
  (
    &clk_test=&CLK_TEST_WCSS_CSS_WSI_CLK
    &clk_reg=&HWIO_WCSS_HM_A_WCSS_CLK_CTL_WCSS_CSS_WSI_CBCR_ADDR
    &clk_reg_name="WCSS_HM_A_WCSS_CLK_CTL_WCSS_CSS_WSI_CBCR"
    &clk_name="wcss_css_wsi_clk"
    &clk_reg_cbcr_type="sm_cbc"
    &clk_vote_bit=-1.
    &clk_multiplier=4.

    gosub Print_Clk_Info_Line
  )


  return



;-----------------------------------------------------------------------------
; Set appropriate mux settings for configurable clocks 
;-----------------------------------------------------------------------------

Set_Clock_Freq_Enter:

  ; Return for now. Need to figure out a way to map source to HW.
  return

  if ("&clk"=="gcc_sec_ctrl_acc_clk")
  (
    gosub PRINT_SET_CLOCK_FREQ_WARNING

    &clk_cmd_rcgr_addr=&HWIO_GCC_ACC_CMD_RCGR_ADDR
    &clk_cfg_rcgr_addr=&HWIO_GCC_ACC_CFG_RCGR_ADDR

    print "Choose frequency (MHz) from list below: " 

    print "19.2           37.5           75.0           " 
    print "150.0          200.0          " 

    print " "
    print "Enter desired frequency (r to return): "
    enter &clk_desired_freq
    print " "

    if ("&clk_desired_freq"=="19.2")
    (
      &clk_src_name="XO"
      &clk_src_sel=SRC_SEL TODO.
      &clk_src_div=2.
      &clk_m_val=0.
      &clk_n_val=0.
      &clk_2d_val=0.
      
      gosub Set_Clock_Freq
      return
    )
    else if ("&clk_desired_freq"=="37.5")
    (
      &clk_src_name="GPLL0_OUT_MAIN"
      &clk_src_sel=SRC_SEL TODO.
      &clk_src_div=32.
      &clk_m_val=0.
      &clk_n_val=0.
      &clk_2d_val=0.
      
      gosub Set_Clock_Freq
      return
    )
    else if ("&clk_desired_freq"=="75.0")
    (
      &clk_src_name="GPLL0_OUT_MAIN"
      &clk_src_sel=SRC_SEL TODO.
      &clk_src_div=16.
      &clk_m_val=0.
      &clk_n_val=0.
      &clk_2d_val=0.
      
      gosub Set_Clock_Freq
      return
    )
    else if ("&clk_desired_freq"=="150.0")
    (
      &clk_src_name="GPLL0_OUT_MAIN"
      &clk_src_sel=SRC_SEL TODO.
      &clk_src_div=8.
      &clk_m_val=0.
      &clk_n_val=0.
      &clk_2d_val=0.
      
      gosub Set_Clock_Freq
      return
    )
    else if ("&clk_desired_freq"=="200.0")
    (
      &clk_src_name="GPLL0_OUT_MAIN"
      &clk_src_sel=SRC_SEL TODO.
      &clk_src_div=6.
      &clk_m_val=0.
      &clk_n_val=0.
      &clk_2d_val=0.
      
      gosub Set_Clock_Freq
      return
    )
    else if ("&clk_desired_freq"=="r")
    (
      return
    )
    else
    (
      print "Invalid selection."
      goto Set_Clock_Freq_Enter
    )
  )

  if ("&clk"=="gcc_apc0_vs_clk")
  (
    gosub PRINT_SET_CLOCK_FREQ_WARNING

    &clk_cmd_rcgr_addr=&HWIO_GCC_APC0_VS_CMD_RCGR_ADDR
    &clk_cfg_rcgr_addr=&HWIO_GCC_APC0_VS_CFG_RCGR_ADDR

    print "Choose frequency (MHz) from list below: " 

    print "400.0          600.0          " 

    print " "
    print "Enter desired frequency (r to return): "
    enter &clk_desired_freq
    print " "

    if ("&clk_desired_freq"=="400.0")
    (
      &clk_src_name="GPLL0_OUT_MAIN"
      &clk_src_sel=SRC_SEL TODO.
      &clk_src_div=3.
      &clk_m_val=0.
      &clk_n_val=0.
      &clk_2d_val=0.
      
      gosub Set_Clock_Freq
      return
    )
    else if ("&clk_desired_freq"=="600.0")
    (
      &clk_src_name="GPLL0_OUT_MAIN"
      &clk_src_sel=SRC_SEL TODO.
      &clk_src_div=2.
      &clk_m_val=0.
      &clk_n_val=0.
      &clk_2d_val=0.
      
      gosub Set_Clock_Freq
      return
    )
    else if ("&clk_desired_freq"=="r")
    (
      return
    )
    else
    (
      print "Invalid selection."
      goto Set_Clock_Freq_Enter
    )
  )

  if ("&clk"=="gcc_apc1_vs_clk")
  (
    gosub PRINT_SET_CLOCK_FREQ_WARNING

    &clk_cmd_rcgr_addr=&HWIO_GCC_APC1_VS_CMD_RCGR_ADDR
    &clk_cfg_rcgr_addr=&HWIO_GCC_APC1_VS_CFG_RCGR_ADDR

    print "Choose frequency (MHz) from list below: " 

    print "400.0          600.0          " 

    print " "
    print "Enter desired frequency (r to return): "
    enter &clk_desired_freq
    print " "

    if ("&clk_desired_freq"=="400.0")
    (
      &clk_src_name="GPLL0_OUT_MAIN"
      &clk_src_sel=SRC_SEL TODO.
      &clk_src_div=3.
      &clk_m_val=0.
      &clk_n_val=0.
      &clk_2d_val=0.
      
      gosub Set_Clock_Freq
      return
    )
    else if ("&clk_desired_freq"=="600.0")
    (
      &clk_src_name="GPLL0_OUT_MAIN"
      &clk_src_sel=SRC_SEL TODO.
      &clk_src_div=2.
      &clk_m_val=0.
      &clk_n_val=0.
      &clk_2d_val=0.
      
      gosub Set_Clock_Freq
      return
    )
    else if ("&clk_desired_freq"=="r")
    (
      return
    )
    else
    (
      print "Invalid selection."
      goto Set_Clock_Freq_Enter
    )
  )

  if ("&clk"=="gcc_bimc_dtts_xo_clk")||("&clk"=="gcc_bimc_xo_clk")||("&clk"=="gcc_cfg_noc_ddr_cfg_clk")||("&clk"=="gcc_cnoc_bus_timeout5_ahb_clk")||("&clk"=="gcc_ddr_dim_cfg_clk")
  (
    gosub PRINT_SET_CLOCK_FREQ_WARNING

    &clk_cmd_rcgr_addr=&HWIO_GCC_BIMC_DDR_XO_CMD_RCGR_ADDR
    &clk_cfg_rcgr_addr=&HWIO_GCC_BIMC_DDR_XO_CFG_RCGR_ADDR

    print "Choose frequency (MHz) from list below: " 

    print "19.2           " 

    print " "
    print "Enter desired frequency (r to return): "
    enter &clk_desired_freq
    print " "

    if ("&clk_desired_freq"=="19.2")
    (
      &clk_src_name="XO"
      &clk_src_sel=SRC_SEL TODO.
      &clk_src_div=2.
      &clk_m_val=0.
      &clk_n_val=0.
      &clk_2d_val=0.
      
      gosub Set_Clock_Freq
      return
    )
    else if ("&clk_desired_freq"=="r")
    (
      return
    )
    else
    (
      print "Invalid selection."
      goto Set_Clock_Freq_Enter
    )
  )

  if ("&clk"=="gcc_blsp1_qup1_i2c_apps_clk")
  (
    gosub PRINT_SET_CLOCK_FREQ_WARNING

    &clk_cmd_rcgr_addr=&HWIO_GCC_BLSP1_QUP1_I2C_APPS_CMD_RCGR_ADDR
    &clk_cfg_rcgr_addr=&HWIO_GCC_BLSP1_QUP1_I2C_APPS_CFG_RCGR_ADDR

    print "Choose frequency (MHz) from list below: " 

    print "19.2           50.0           " 

    print " "
    print "Enter desired frequency (r to return): "
    enter &clk_desired_freq
    print " "

    if ("&clk_desired_freq"=="19.2")
    (
      &clk_src_name="XO"
      &clk_src_sel=SRC_SEL TODO.
      &clk_src_div=2.
      &clk_m_val=0.
      &clk_n_val=0.
      &clk_2d_val=0.
      
      gosub Set_Clock_Freq
      return
    )
    else if ("&clk_desired_freq"=="50.0")
    (
      &clk_src_name="GPLL0_OUT_MAIN"
      &clk_src_sel=SRC_SEL TODO.
      &clk_src_div=24.
      &clk_m_val=0.
      &clk_n_val=0.
      &clk_2d_val=0.
      
      gosub Set_Clock_Freq
      return
    )
    else if ("&clk_desired_freq"=="r")
    (
      return
    )
    else
    (
      print "Invalid selection."
      goto Set_Clock_Freq_Enter
    )
  )

  if ("&clk"=="gcc_blsp1_qup1_spi_apps_clk")
  (
    gosub PRINT_SET_CLOCK_FREQ_WARNING

    &clk_cmd_rcgr_addr=&HWIO_GCC_BLSP1_QUP1_SPI_APPS_CMD_RCGR_ADDR
    &clk_cfg_rcgr_addr=&HWIO_GCC_BLSP1_QUP1_SPI_APPS_CFG_RCGR_ADDR

    print "Choose frequency (MHz) from list below: " 

    print "0.96           4.8            9.6            " 
    print "15.0           19.2           25.0           " 
    print "50.0           " 

    print " "
    print "Enter desired frequency (r to return): "
    enter &clk_desired_freq
    print " "

    if ("&clk_desired_freq"=="0.96")
    (
      &clk_src_name="XO"
      &clk_src_sel=SRC_SEL TODO.
      &clk_src_div=20.
      &clk_m_val=1.
      &clk_n_val=2.
      &clk_2d_val=2.
      
      gosub Set_Clock_Freq
      return
    )
    else if ("&clk_desired_freq"=="4.8")
    (
      &clk_src_name="XO"
      &clk_src_sel=SRC_SEL TODO.
      &clk_src_div=8.
      &clk_m_val=0.
      &clk_n_val=0.
      &clk_2d_val=0.
      
      gosub Set_Clock_Freq
      return
    )
    else if ("&clk_desired_freq"=="9.6")
    (
      &clk_src_name="XO"
      &clk_src_sel=SRC_SEL TODO.
      &clk_src_div=4.
      &clk_m_val=0.
      &clk_n_val=0.
      &clk_2d_val=0.
      
      gosub Set_Clock_Freq
      return
    )
    else if ("&clk_desired_freq"=="15.0")
    (
      &clk_src_name="GPLL0_OUT_MAIN"
      &clk_src_sel=SRC_SEL TODO.
      &clk_src_div=20.
      &clk_m_val=1.
      &clk_n_val=4.
      &clk_2d_val=4.
      
      gosub Set_Clock_Freq
      return
    )
    else if ("&clk_desired_freq"=="19.2")
    (
      &clk_src_name="XO"
      &clk_src_sel=SRC_SEL TODO.
      &clk_src_div=2.
      &clk_m_val=0.
      &clk_n_val=0.
      &clk_2d_val=0.
      
      gosub Set_Clock_Freq
      return
    )
    else if ("&clk_desired_freq"=="25.0")
    (
      &clk_src_name="GPLL0_OUT_MAIN"
      &clk_src_sel=SRC_SEL TODO.
      &clk_src_div=24.
      &clk_m_val=1.
      &clk_n_val=2.
      &clk_2d_val=2.
      
      gosub Set_Clock_Freq
      return
    )
    else if ("&clk_desired_freq"=="50.0")
    (
      &clk_src_name="GPLL0_OUT_MAIN"
      &clk_src_sel=SRC_SEL TODO.
      &clk_src_div=24.
      &clk_m_val=0.
      &clk_n_val=0.
      &clk_2d_val=0.
      
      gosub Set_Clock_Freq
      return
    )
    else if ("&clk_desired_freq"=="r")
    (
      return
    )
    else
    (
      print "Invalid selection."
      goto Set_Clock_Freq_Enter
    )
  )

  if ("&clk"=="gcc_blsp1_qup2_i2c_apps_clk")
  (
    gosub PRINT_SET_CLOCK_FREQ_WARNING

    &clk_cmd_rcgr_addr=&HWIO_GCC_BLSP1_QUP2_I2C_APPS_CMD_RCGR_ADDR
    &clk_cfg_rcgr_addr=&HWIO_GCC_BLSP1_QUP2_I2C_APPS_CFG_RCGR_ADDR

    print "Choose frequency (MHz) from list below: " 

    print "19.2           50.0           " 

    print " "
    print "Enter desired frequency (r to return): "
    enter &clk_desired_freq
    print " "

    if ("&clk_desired_freq"=="19.2")
    (
      &clk_src_name="XO"
      &clk_src_sel=SRC_SEL TODO.
      &clk_src_div=2.
      &clk_m_val=0.
      &clk_n_val=0.
      &clk_2d_val=0.
      
      gosub Set_Clock_Freq
      return
    )
    else if ("&clk_desired_freq"=="50.0")
    (
      &clk_src_name="GPLL0_OUT_MAIN"
      &clk_src_sel=SRC_SEL TODO.
      &clk_src_div=24.
      &clk_m_val=0.
      &clk_n_val=0.
      &clk_2d_val=0.
      
      gosub Set_Clock_Freq
      return
    )
    else if ("&clk_desired_freq"=="r")
    (
      return
    )
    else
    (
      print "Invalid selection."
      goto Set_Clock_Freq_Enter
    )
  )

  if ("&clk"=="gcc_blsp1_qup2_spi_apps_clk")
  (
    gosub PRINT_SET_CLOCK_FREQ_WARNING

    &clk_cmd_rcgr_addr=&HWIO_GCC_BLSP1_QUP2_SPI_APPS_CMD_RCGR_ADDR
    &clk_cfg_rcgr_addr=&HWIO_GCC_BLSP1_QUP2_SPI_APPS_CFG_RCGR_ADDR

    print "Choose frequency (MHz) from list below: " 

    print "0.96           4.8            9.6            " 
    print "15.0           19.2           25.0           " 
    print "50.0           " 

    print " "
    print "Enter desired frequency (r to return): "
    enter &clk_desired_freq
    print " "

    if ("&clk_desired_freq"=="0.96")
    (
      &clk_src_name="XO"
      &clk_src_sel=SRC_SEL TODO.
      &clk_src_div=20.
      &clk_m_val=1.
      &clk_n_val=2.
      &clk_2d_val=2.
      
      gosub Set_Clock_Freq
      return
    )
    else if ("&clk_desired_freq"=="4.8")
    (
      &clk_src_name="XO"
      &clk_src_sel=SRC_SEL TODO.
      &clk_src_div=8.
      &clk_m_val=0.
      &clk_n_val=0.
      &clk_2d_val=0.
      
      gosub Set_Clock_Freq
      return
    )
    else if ("&clk_desired_freq"=="9.6")
    (
      &clk_src_name="XO"
      &clk_src_sel=SRC_SEL TODO.
      &clk_src_div=4.
      &clk_m_val=0.
      &clk_n_val=0.
      &clk_2d_val=0.
      
      gosub Set_Clock_Freq
      return
    )
    else if ("&clk_desired_freq"=="15.0")
    (
      &clk_src_name="GPLL0_OUT_MAIN"
      &clk_src_sel=SRC_SEL TODO.
      &clk_src_div=20.
      &clk_m_val=1.
      &clk_n_val=4.
      &clk_2d_val=4.
      
      gosub Set_Clock_Freq
      return
    )
    else if ("&clk_desired_freq"=="19.2")
    (
      &clk_src_name="XO"
      &clk_src_sel=SRC_SEL TODO.
      &clk_src_div=2.
      &clk_m_val=0.
      &clk_n_val=0.
      &clk_2d_val=0.
      
      gosub Set_Clock_Freq
      return
    )
    else if ("&clk_desired_freq"=="25.0")
    (
      &clk_src_name="GPLL0_OUT_MAIN"
      &clk_src_sel=SRC_SEL TODO.
      &clk_src_div=24.
      &clk_m_val=1.
      &clk_n_val=2.
      &clk_2d_val=2.
      
      gosub Set_Clock_Freq
      return
    )
    else if ("&clk_desired_freq"=="50.0")
    (
      &clk_src_name="GPLL0_OUT_MAIN"
      &clk_src_sel=SRC_SEL TODO.
      &clk_src_div=24.
      &clk_m_val=0.
      &clk_n_val=0.
      &clk_2d_val=0.
      
      gosub Set_Clock_Freq
      return
    )
    else if ("&clk_desired_freq"=="r")
    (
      return
    )
    else
    (
      print "Invalid selection."
      goto Set_Clock_Freq_Enter
    )
  )

  if ("&clk"=="gcc_blsp1_qup3_i2c_apps_clk")
  (
    gosub PRINT_SET_CLOCK_FREQ_WARNING

    &clk_cmd_rcgr_addr=&HWIO_GCC_BLSP1_QUP3_I2C_APPS_CMD_RCGR_ADDR
    &clk_cfg_rcgr_addr=&HWIO_GCC_BLSP1_QUP3_I2C_APPS_CFG_RCGR_ADDR

    print "Choose frequency (MHz) from list below: " 

    print "19.2           50.0           " 

    print " "
    print "Enter desired frequency (r to return): "
    enter &clk_desired_freq
    print " "

    if ("&clk_desired_freq"=="19.2")
    (
      &clk_src_name="XO"
      &clk_src_sel=SRC_SEL TODO.
      &clk_src_div=2.
      &clk_m_val=0.
      &clk_n_val=0.
      &clk_2d_val=0.
      
      gosub Set_Clock_Freq
      return
    )
    else if ("&clk_desired_freq"=="50.0")
    (
      &clk_src_name="GPLL0_OUT_MAIN"
      &clk_src_sel=SRC_SEL TODO.
      &clk_src_div=24.
      &clk_m_val=0.
      &clk_n_val=0.
      &clk_2d_val=0.
      
      gosub Set_Clock_Freq
      return
    )
    else if ("&clk_desired_freq"=="r")
    (
      return
    )
    else
    (
      print "Invalid selection."
      goto Set_Clock_Freq_Enter
    )
  )

  if ("&clk"=="gcc_blsp1_qup3_spi_apps_clk")
  (
    gosub PRINT_SET_CLOCK_FREQ_WARNING

    &clk_cmd_rcgr_addr=&HWIO_GCC_BLSP1_QUP3_SPI_APPS_CMD_RCGR_ADDR
    &clk_cfg_rcgr_addr=&HWIO_GCC_BLSP1_QUP3_SPI_APPS_CFG_RCGR_ADDR

    print "Choose frequency (MHz) from list below: " 

    print "0.96           4.8            9.6            " 
    print "15.0           19.2           25.0           " 
    print "50.0           " 

    print " "
    print "Enter desired frequency (r to return): "
    enter &clk_desired_freq
    print " "

    if ("&clk_desired_freq"=="0.96")
    (
      &clk_src_name="XO"
      &clk_src_sel=SRC_SEL TODO.
      &clk_src_div=20.
      &clk_m_val=1.
      &clk_n_val=2.
      &clk_2d_val=2.
      
      gosub Set_Clock_Freq
      return
    )
    else if ("&clk_desired_freq"=="4.8")
    (
      &clk_src_name="XO"
      &clk_src_sel=SRC_SEL TODO.
      &clk_src_div=8.
      &clk_m_val=0.
      &clk_n_val=0.
      &clk_2d_val=0.
      
      gosub Set_Clock_Freq
      return
    )
    else if ("&clk_desired_freq"=="9.6")
    (
      &clk_src_name="XO"
      &clk_src_sel=SRC_SEL TODO.
      &clk_src_div=4.
      &clk_m_val=0.
      &clk_n_val=0.
      &clk_2d_val=0.
      
      gosub Set_Clock_Freq
      return
    )
    else if ("&clk_desired_freq"=="15.0")
    (
      &clk_src_name="GPLL0_OUT_MAIN"
      &clk_src_sel=SRC_SEL TODO.
      &clk_src_div=20.
      &clk_m_val=1.
      &clk_n_val=4.
      &clk_2d_val=4.
      
      gosub Set_Clock_Freq
      return
    )
    else if ("&clk_desired_freq"=="19.2")
    (
      &clk_src_name="XO"
      &clk_src_sel=SRC_SEL TODO.
      &clk_src_div=2.
      &clk_m_val=0.
      &clk_n_val=0.
      &clk_2d_val=0.
      
      gosub Set_Clock_Freq
      return
    )
    else if ("&clk_desired_freq"=="25.0")
    (
      &clk_src_name="GPLL0_OUT_MAIN"
      &clk_src_sel=SRC_SEL TODO.
      &clk_src_div=24.
      &clk_m_val=1.
      &clk_n_val=2.
      &clk_2d_val=2.
      
      gosub Set_Clock_Freq
      return
    )
    else if ("&clk_desired_freq"=="50.0")
    (
      &clk_src_name="GPLL0_OUT_MAIN"
      &clk_src_sel=SRC_SEL TODO.
      &clk_src_div=24.
      &clk_m_val=0.
      &clk_n_val=0.
      &clk_2d_val=0.
      
      gosub Set_Clock_Freq
      return
    )
    else if ("&clk_desired_freq"=="r")
    (
      return
    )
    else
    (
      print "Invalid selection."
      goto Set_Clock_Freq_Enter
    )
  )

  if ("&clk"=="gcc_blsp1_qup4_i2c_apps_clk")
  (
    gosub PRINT_SET_CLOCK_FREQ_WARNING

    &clk_cmd_rcgr_addr=&HWIO_GCC_BLSP1_QUP4_I2C_APPS_CMD_RCGR_ADDR
    &clk_cfg_rcgr_addr=&HWIO_GCC_BLSP1_QUP4_I2C_APPS_CFG_RCGR_ADDR

    print "Choose frequency (MHz) from list below: " 

    print "19.2           50.0           " 

    print " "
    print "Enter desired frequency (r to return): "
    enter &clk_desired_freq
    print " "

    if ("&clk_desired_freq"=="19.2")
    (
      &clk_src_name="XO"
      &clk_src_sel=SRC_SEL TODO.
      &clk_src_div=2.
      &clk_m_val=0.
      &clk_n_val=0.
      &clk_2d_val=0.
      
      gosub Set_Clock_Freq
      return
    )
    else if ("&clk_desired_freq"=="50.0")
    (
      &clk_src_name="GPLL0_OUT_MAIN"
      &clk_src_sel=SRC_SEL TODO.
      &clk_src_div=24.
      &clk_m_val=0.
      &clk_n_val=0.
      &clk_2d_val=0.
      
      gosub Set_Clock_Freq
      return
    )
    else if ("&clk_desired_freq"=="r")
    (
      return
    )
    else
    (
      print "Invalid selection."
      goto Set_Clock_Freq_Enter
    )
  )

  if ("&clk"=="gcc_blsp1_qup4_spi_apps_clk")
  (
    gosub PRINT_SET_CLOCK_FREQ_WARNING

    &clk_cmd_rcgr_addr=&HWIO_GCC_BLSP1_QUP4_SPI_APPS_CMD_RCGR_ADDR
    &clk_cfg_rcgr_addr=&HWIO_GCC_BLSP1_QUP4_SPI_APPS_CFG_RCGR_ADDR

    print "Choose frequency (MHz) from list below: " 

    print "0.96           4.8            9.6            " 
    print "15.0           19.2           25.0           " 
    print "50.0           " 

    print " "
    print "Enter desired frequency (r to return): "
    enter &clk_desired_freq
    print " "

    if ("&clk_desired_freq"=="0.96")
    (
      &clk_src_name="XO"
      &clk_src_sel=SRC_SEL TODO.
      &clk_src_div=20.
      &clk_m_val=1.
      &clk_n_val=2.
      &clk_2d_val=2.
      
      gosub Set_Clock_Freq
      return
    )
    else if ("&clk_desired_freq"=="4.8")
    (
      &clk_src_name="XO"
      &clk_src_sel=SRC_SEL TODO.
      &clk_src_div=8.
      &clk_m_val=0.
      &clk_n_val=0.
      &clk_2d_val=0.
      
      gosub Set_Clock_Freq
      return
    )
    else if ("&clk_desired_freq"=="9.6")
    (
      &clk_src_name="XO"
      &clk_src_sel=SRC_SEL TODO.
      &clk_src_div=4.
      &clk_m_val=0.
      &clk_n_val=0.
      &clk_2d_val=0.
      
      gosub Set_Clock_Freq
      return
    )
    else if ("&clk_desired_freq"=="15.0")
    (
      &clk_src_name="GPLL0_OUT_MAIN"
      &clk_src_sel=SRC_SEL TODO.
      &clk_src_div=20.
      &clk_m_val=1.
      &clk_n_val=4.
      &clk_2d_val=4.
      
      gosub Set_Clock_Freq
      return
    )
    else if ("&clk_desired_freq"=="19.2")
    (
      &clk_src_name="XO"
      &clk_src_sel=SRC_SEL TODO.
      &clk_src_div=2.
      &clk_m_val=0.
      &clk_n_val=0.
      &clk_2d_val=0.
      
      gosub Set_Clock_Freq
      return
    )
    else if ("&clk_desired_freq"=="25.0")
    (
      &clk_src_name="GPLL0_OUT_MAIN"
      &clk_src_sel=SRC_SEL TODO.
      &clk_src_div=24.
      &clk_m_val=1.
      &clk_n_val=2.
      &clk_2d_val=2.
      
      gosub Set_Clock_Freq
      return
    )
    else if ("&clk_desired_freq"=="50.0")
    (
      &clk_src_name="GPLL0_OUT_MAIN"
      &clk_src_sel=SRC_SEL TODO.
      &clk_src_div=24.
      &clk_m_val=0.
      &clk_n_val=0.
      &clk_2d_val=0.
      
      gosub Set_Clock_Freq
      return
    )
    else if ("&clk_desired_freq"=="r")
    (
      return
    )
    else
    (
      print "Invalid selection."
      goto Set_Clock_Freq_Enter
    )
  )

  if ("&clk"=="gcc_blsp1_qup5_i2c_apps_clk")
  (
    gosub PRINT_SET_CLOCK_FREQ_WARNING

    &clk_cmd_rcgr_addr=&HWIO_GCC_BLSP1_QUP5_I2C_APPS_CMD_RCGR_ADDR
    &clk_cfg_rcgr_addr=&HWIO_GCC_BLSP1_QUP5_I2C_APPS_CFG_RCGR_ADDR

    print "Choose frequency (MHz) from list below: " 

    print "19.2           50.0           " 

    print " "
    print "Enter desired frequency (r to return): "
    enter &clk_desired_freq
    print " "

    if ("&clk_desired_freq"=="19.2")
    (
      &clk_src_name="XO"
      &clk_src_sel=SRC_SEL TODO.
      &clk_src_div=2.
      &clk_m_val=0.
      &clk_n_val=0.
      &clk_2d_val=0.
      
      gosub Set_Clock_Freq
      return
    )
    else if ("&clk_desired_freq"=="50.0")
    (
      &clk_src_name="GPLL0_OUT_MAIN"
      &clk_src_sel=SRC_SEL TODO.
      &clk_src_div=24.
      &clk_m_val=0.
      &clk_n_val=0.
      &clk_2d_val=0.
      
      gosub Set_Clock_Freq
      return
    )
    else if ("&clk_desired_freq"=="r")
    (
      return
    )
    else
    (
      print "Invalid selection."
      goto Set_Clock_Freq_Enter
    )
  )

  if ("&clk"=="gcc_blsp1_qup5_spi_apps_clk")
  (
    gosub PRINT_SET_CLOCK_FREQ_WARNING

    &clk_cmd_rcgr_addr=&HWIO_GCC_BLSP1_QUP5_SPI_APPS_CMD_RCGR_ADDR
    &clk_cfg_rcgr_addr=&HWIO_GCC_BLSP1_QUP5_SPI_APPS_CFG_RCGR_ADDR

    print "Choose frequency (MHz) from list below: " 

    print "0.96           4.8            9.6            " 
    print "15.0           19.2           25.0           " 
    print "50.0           " 

    print " "
    print "Enter desired frequency (r to return): "
    enter &clk_desired_freq
    print " "

    if ("&clk_desired_freq"=="0.96")
    (
      &clk_src_name="XO"
      &clk_src_sel=SRC_SEL TODO.
      &clk_src_div=20.
      &clk_m_val=1.
      &clk_n_val=2.
      &clk_2d_val=2.
      
      gosub Set_Clock_Freq
      return
    )
    else if ("&clk_desired_freq"=="4.8")
    (
      &clk_src_name="XO"
      &clk_src_sel=SRC_SEL TODO.
      &clk_src_div=8.
      &clk_m_val=0.
      &clk_n_val=0.
      &clk_2d_val=0.
      
      gosub Set_Clock_Freq
      return
    )
    else if ("&clk_desired_freq"=="9.6")
    (
      &clk_src_name="XO"
      &clk_src_sel=SRC_SEL TODO.
      &clk_src_div=4.
      &clk_m_val=0.
      &clk_n_val=0.
      &clk_2d_val=0.
      
      gosub Set_Clock_Freq
      return
    )
    else if ("&clk_desired_freq"=="15.0")
    (
      &clk_src_name="GPLL0_OUT_MAIN"
      &clk_src_sel=SRC_SEL TODO.
      &clk_src_div=20.
      &clk_m_val=1.
      &clk_n_val=4.
      &clk_2d_val=4.
      
      gosub Set_Clock_Freq
      return
    )
    else if ("&clk_desired_freq"=="19.2")
    (
      &clk_src_name="XO"
      &clk_src_sel=SRC_SEL TODO.
      &clk_src_div=2.
      &clk_m_val=0.
      &clk_n_val=0.
      &clk_2d_val=0.
      
      gosub Set_Clock_Freq
      return
    )
    else if ("&clk_desired_freq"=="25.0")
    (
      &clk_src_name="GPLL0_OUT_MAIN"
      &clk_src_sel=SRC_SEL TODO.
      &clk_src_div=24.
      &clk_m_val=1.
      &clk_n_val=2.
      &clk_2d_val=2.
      
      gosub Set_Clock_Freq
      return
    )
    else if ("&clk_desired_freq"=="50.0")
    (
      &clk_src_name="GPLL0_OUT_MAIN"
      &clk_src_sel=SRC_SEL TODO.
      &clk_src_div=24.
      &clk_m_val=0.
      &clk_n_val=0.
      &clk_2d_val=0.
      
      gosub Set_Clock_Freq
      return
    )
    else if ("&clk_desired_freq"=="r")
    (
      return
    )
    else
    (
      print "Invalid selection."
      goto Set_Clock_Freq_Enter
    )
  )

  if ("&clk"=="gcc_blsp1_qup6_i2c_apps_clk")
  (
    gosub PRINT_SET_CLOCK_FREQ_WARNING

    &clk_cmd_rcgr_addr=&HWIO_GCC_BLSP1_QUP6_I2C_APPS_CMD_RCGR_ADDR
    &clk_cfg_rcgr_addr=&HWIO_GCC_BLSP1_QUP6_I2C_APPS_CFG_RCGR_ADDR

    print "Choose frequency (MHz) from list below: " 

    print "19.2           50.0           " 

    print " "
    print "Enter desired frequency (r to return): "
    enter &clk_desired_freq
    print " "

    if ("&clk_desired_freq"=="19.2")
    (
      &clk_src_name="XO"
      &clk_src_sel=SRC_SEL TODO.
      &clk_src_div=2.
      &clk_m_val=0.
      &clk_n_val=0.
      &clk_2d_val=0.
      
      gosub Set_Clock_Freq
      return
    )
    else if ("&clk_desired_freq"=="50.0")
    (
      &clk_src_name="GPLL0_OUT_MAIN"
      &clk_src_sel=SRC_SEL TODO.
      &clk_src_div=24.
      &clk_m_val=0.
      &clk_n_val=0.
      &clk_2d_val=0.
      
      gosub Set_Clock_Freq
      return
    )
    else if ("&clk_desired_freq"=="r")
    (
      return
    )
    else
    (
      print "Invalid selection."
      goto Set_Clock_Freq_Enter
    )
  )

  if ("&clk"=="gcc_blsp1_qup6_spi_apps_clk")
  (
    gosub PRINT_SET_CLOCK_FREQ_WARNING

    &clk_cmd_rcgr_addr=&HWIO_GCC_BLSP1_QUP6_SPI_APPS_CMD_RCGR_ADDR
    &clk_cfg_rcgr_addr=&HWIO_GCC_BLSP1_QUP6_SPI_APPS_CFG_RCGR_ADDR

    print "Choose frequency (MHz) from list below: " 

    print "0.96           4.8            9.6            " 
    print "15.0           19.2           25.0           " 
    print "50.0           " 

    print " "
    print "Enter desired frequency (r to return): "
    enter &clk_desired_freq
    print " "

    if ("&clk_desired_freq"=="0.96")
    (
      &clk_src_name="XO"
      &clk_src_sel=SRC_SEL TODO.
      &clk_src_div=20.
      &clk_m_val=1.
      &clk_n_val=2.
      &clk_2d_val=2.
      
      gosub Set_Clock_Freq
      return
    )
    else if ("&clk_desired_freq"=="4.8")
    (
      &clk_src_name="XO"
      &clk_src_sel=SRC_SEL TODO.
      &clk_src_div=8.
      &clk_m_val=0.
      &clk_n_val=0.
      &clk_2d_val=0.
      
      gosub Set_Clock_Freq
      return
    )
    else if ("&clk_desired_freq"=="9.6")
    (
      &clk_src_name="XO"
      &clk_src_sel=SRC_SEL TODO.
      &clk_src_div=4.
      &clk_m_val=0.
      &clk_n_val=0.
      &clk_2d_val=0.
      
      gosub Set_Clock_Freq
      return
    )
    else if ("&clk_desired_freq"=="15.0")
    (
      &clk_src_name="GPLL0_OUT_MAIN"
      &clk_src_sel=SRC_SEL TODO.
      &clk_src_div=20.
      &clk_m_val=1.
      &clk_n_val=4.
      &clk_2d_val=4.
      
      gosub Set_Clock_Freq
      return
    )
    else if ("&clk_desired_freq"=="19.2")
    (
      &clk_src_name="XO"
      &clk_src_sel=SRC_SEL TODO.
      &clk_src_div=2.
      &clk_m_val=0.
      &clk_n_val=0.
      &clk_2d_val=0.
      
      gosub Set_Clock_Freq
      return
    )
    else if ("&clk_desired_freq"=="25.0")
    (
      &clk_src_name="GPLL0_OUT_MAIN"
      &clk_src_sel=SRC_SEL TODO.
      &clk_src_div=24.
      &clk_m_val=1.
      &clk_n_val=2.
      &clk_2d_val=2.
      
      gosub Set_Clock_Freq
      return
    )
    else if ("&clk_desired_freq"=="50.0")
    (
      &clk_src_name="GPLL0_OUT_MAIN"
      &clk_src_sel=SRC_SEL TODO.
      &clk_src_div=24.
      &clk_m_val=0.
      &clk_n_val=0.
      &clk_2d_val=0.
      
      gosub Set_Clock_Freq
      return
    )
    else if ("&clk_desired_freq"=="r")
    (
      return
    )
    else
    (
      print "Invalid selection."
      goto Set_Clock_Freq_Enter
    )
  )

  if ("&clk"=="gcc_blsp1_uart1_apps_clk")
  (
    gosub PRINT_SET_CLOCK_FREQ_WARNING

    &clk_cmd_rcgr_addr=&HWIO_GCC_BLSP1_UART1_APPS_CMD_RCGR_ADDR
    &clk_cfg_rcgr_addr=&HWIO_GCC_BLSP1_UART1_APPS_CFG_RCGR_ADDR

    print "Choose frequency (MHz) from list below: " 

    print "3.6864         7.3728         14.7456        " 
    print "16.0           19.2           24.0           " 
    print "32.0           40.0           46.4           " 
    print "48.0           51.2           56.0           " 
    print "58.9824        60.0           63.157895      " 

    print " "
    print "Enter desired frequency (r to return): "
    enter &clk_desired_freq
    print " "

    if ("&clk_desired_freq"=="3.6864")
    (
      &clk_src_name="GPLL0_OUT_MAIN"
      &clk_src_sel=SRC_SEL TODO.
      &clk_src_div=2.
      &clk_m_val=96.
      &clk_n_val=15625.
      &clk_2d_val=15625.
      
      gosub Set_Clock_Freq
      return
    )
    else if ("&clk_desired_freq"=="7.3728")
    (
      &clk_src_name="GPLL0_OUT_MAIN"
      &clk_src_sel=SRC_SEL TODO.
      &clk_src_div=2.
      &clk_m_val=192.
      &clk_n_val=15625.
      &clk_2d_val=15625.
      
      gosub Set_Clock_Freq
      return
    )
    else if ("&clk_desired_freq"=="14.7456")
    (
      &clk_src_name="GPLL0_OUT_MAIN"
      &clk_src_sel=SRC_SEL TODO.
      &clk_src_div=2.
      &clk_m_val=384.
      &clk_n_val=15625.
      &clk_2d_val=15625.
      
      gosub Set_Clock_Freq
      return
    )
    else if ("&clk_desired_freq"=="16.0")
    (
      &clk_src_name="GPLL0_OUT_MAIN"
      &clk_src_sel=SRC_SEL TODO.
      &clk_src_div=10.
      &clk_m_val=2.
      &clk_n_val=15.
      &clk_2d_val=15.
      
      gosub Set_Clock_Freq
      return
    )
    else if ("&clk_desired_freq"=="19.2")
    (
      &clk_src_name="XO"
      &clk_src_sel=SRC_SEL TODO.
      &clk_src_div=2.
      &clk_m_val=0.
      &clk_n_val=0.
      &clk_2d_val=0.
      
      gosub Set_Clock_Freq
      return
    )
    else if ("&clk_desired_freq"=="24.0")
    (
      &clk_src_name="GPLL0_OUT_MAIN"
      &clk_src_sel=SRC_SEL TODO.
      &clk_src_div=10.
      &clk_m_val=1.
      &clk_n_val=5.
      &clk_2d_val=5.
      
      gosub Set_Clock_Freq
      return
    )
    else if ("&clk_desired_freq"=="32.0")
    (
      &clk_src_name="GPLL0_OUT_MAIN"
      &clk_src_sel=SRC_SEL TODO.
      &clk_src_div=2.
      &clk_m_val=4.
      &clk_n_val=75.
      &clk_2d_val=75.
      
      gosub Set_Clock_Freq
      return
    )
    else if ("&clk_desired_freq"=="40.0")
    (
      &clk_src_name="GPLL0_OUT_MAIN"
      &clk_src_sel=SRC_SEL TODO.
      &clk_src_div=30.
      &clk_m_val=0.
      &clk_n_val=0.
      &clk_2d_val=0.
      
      gosub Set_Clock_Freq
      return
    )
    else if ("&clk_desired_freq"=="46.4")
    (
      &clk_src_name="GPLL0_OUT_MAIN"
      &clk_src_sel=SRC_SEL TODO.
      &clk_src_div=2.
      &clk_m_val=29.
      &clk_n_val=375.
      &clk_2d_val=375.
      
      gosub Set_Clock_Freq
      return
    )
    else if ("&clk_desired_freq"=="48.0")
    (
      &clk_src_name="GPLL0_OUT_MAIN"
      &clk_src_sel=SRC_SEL TODO.
      &clk_src_div=25.
      &clk_m_val=0.
      &clk_n_val=0.
      &clk_2d_val=0.
      
      gosub Set_Clock_Freq
      return
    )
    else if ("&clk_desired_freq"=="51.2")
    (
      &clk_src_name="GPLL0_OUT_MAIN"
      &clk_src_sel=SRC_SEL TODO.
      &clk_src_div=2.
      &clk_m_val=32.
      &clk_n_val=375.
      &clk_2d_val=375.
      
      gosub Set_Clock_Freq
      return
    )
    else if ("&clk_desired_freq"=="56.0")
    (
      &clk_src_name="GPLL0_OUT_MAIN"
      &clk_src_sel=SRC_SEL TODO.
      &clk_src_div=2.
      &clk_m_val=7.
      &clk_n_val=75.
      &clk_2d_val=75.
      
      gosub Set_Clock_Freq
      return
    )
    else if ("&clk_desired_freq"=="58.9824")
    (
      &clk_src_name="GPLL0_OUT_MAIN"
      &clk_src_sel=SRC_SEL TODO.
      &clk_src_div=2.
      &clk_m_val=1536.
      &clk_n_val=15625.
      &clk_2d_val=15625.
      
      gosub Set_Clock_Freq
      return
    )
    else if ("&clk_desired_freq"=="60.0")
    (
      &clk_src_name="GPLL0_OUT_MAIN"
      &clk_src_sel=SRC_SEL TODO.
      &clk_src_div=20.
      &clk_m_val=0.
      &clk_n_val=0.
      &clk_2d_val=0.
      
      gosub Set_Clock_Freq
      return
    )
    else if ("&clk_desired_freq"=="63.157895")
    (
      &clk_src_name="GPLL0_OUT_MAIN"
      &clk_src_sel=SRC_SEL TODO.
      &clk_src_div=19.
      &clk_m_val=0.
      &clk_n_val=0.
      &clk_2d_val=0.
      
      gosub Set_Clock_Freq
      return
    )
    else if ("&clk_desired_freq"=="r")
    (
      return
    )
    else
    (
      print "Invalid selection."
      goto Set_Clock_Freq_Enter
    )
  )

  if ("&clk"=="gcc_blsp1_uart2_apps_clk")
  (
    gosub PRINT_SET_CLOCK_FREQ_WARNING

    &clk_cmd_rcgr_addr=&HWIO_GCC_BLSP1_UART2_APPS_CMD_RCGR_ADDR
    &clk_cfg_rcgr_addr=&HWIO_GCC_BLSP1_UART2_APPS_CFG_RCGR_ADDR

    print "Choose frequency (MHz) from list below: " 

    print "3.6864         7.3728         14.7456        " 
    print "16.0           19.2           24.0           " 
    print "32.0           40.0           46.4           " 
    print "48.0           51.2           56.0           " 
    print "58.9824        60.0           63.157895      " 

    print " "
    print "Enter desired frequency (r to return): "
    enter &clk_desired_freq
    print " "

    if ("&clk_desired_freq"=="3.6864")
    (
      &clk_src_name="GPLL0_OUT_MAIN"
      &clk_src_sel=SRC_SEL TODO.
      &clk_src_div=2.
      &clk_m_val=96.
      &clk_n_val=15625.
      &clk_2d_val=15625.
      
      gosub Set_Clock_Freq
      return
    )
    else if ("&clk_desired_freq"=="7.3728")
    (
      &clk_src_name="GPLL0_OUT_MAIN"
      &clk_src_sel=SRC_SEL TODO.
      &clk_src_div=2.
      &clk_m_val=192.
      &clk_n_val=15625.
      &clk_2d_val=15625.
      
      gosub Set_Clock_Freq
      return
    )
    else if ("&clk_desired_freq"=="14.7456")
    (
      &clk_src_name="GPLL0_OUT_MAIN"
      &clk_src_sel=SRC_SEL TODO.
      &clk_src_div=2.
      &clk_m_val=384.
      &clk_n_val=15625.
      &clk_2d_val=15625.
      
      gosub Set_Clock_Freq
      return
    )
    else if ("&clk_desired_freq"=="16.0")
    (
      &clk_src_name="GPLL0_OUT_MAIN"
      &clk_src_sel=SRC_SEL TODO.
      &clk_src_div=10.
      &clk_m_val=2.
      &clk_n_val=15.
      &clk_2d_val=15.
      
      gosub Set_Clock_Freq
      return
    )
    else if ("&clk_desired_freq"=="19.2")
    (
      &clk_src_name="XO"
      &clk_src_sel=SRC_SEL TODO.
      &clk_src_div=2.
      &clk_m_val=0.
      &clk_n_val=0.
      &clk_2d_val=0.
      
      gosub Set_Clock_Freq
      return
    )
    else if ("&clk_desired_freq"=="24.0")
    (
      &clk_src_name="GPLL0_OUT_MAIN"
      &clk_src_sel=SRC_SEL TODO.
      &clk_src_div=10.
      &clk_m_val=1.
      &clk_n_val=5.
      &clk_2d_val=5.
      
      gosub Set_Clock_Freq
      return
    )
    else if ("&clk_desired_freq"=="32.0")
    (
      &clk_src_name="GPLL0_OUT_MAIN"
      &clk_src_sel=SRC_SEL TODO.
      &clk_src_div=2.
      &clk_m_val=4.
      &clk_n_val=75.
      &clk_2d_val=75.
      
      gosub Set_Clock_Freq
      return
    )
    else if ("&clk_desired_freq"=="40.0")
    (
      &clk_src_name="GPLL0_OUT_MAIN"
      &clk_src_sel=SRC_SEL TODO.
      &clk_src_div=30.
      &clk_m_val=0.
      &clk_n_val=0.
      &clk_2d_val=0.
      
      gosub Set_Clock_Freq
      return
    )
    else if ("&clk_desired_freq"=="46.4")
    (
      &clk_src_name="GPLL0_OUT_MAIN"
      &clk_src_sel=SRC_SEL TODO.
      &clk_src_div=2.
      &clk_m_val=29.
      &clk_n_val=375.
      &clk_2d_val=375.
      
      gosub Set_Clock_Freq
      return
    )
    else if ("&clk_desired_freq"=="48.0")
    (
      &clk_src_name="GPLL0_OUT_MAIN"
      &clk_src_sel=SRC_SEL TODO.
      &clk_src_div=25.
      &clk_m_val=0.
      &clk_n_val=0.
      &clk_2d_val=0.
      
      gosub Set_Clock_Freq
      return
    )
    else if ("&clk_desired_freq"=="51.2")
    (
      &clk_src_name="GPLL0_OUT_MAIN"
      &clk_src_sel=SRC_SEL TODO.
      &clk_src_div=2.
      &clk_m_val=32.
      &clk_n_val=375.
      &clk_2d_val=375.
      
      gosub Set_Clock_Freq
      return
    )
    else if ("&clk_desired_freq"=="56.0")
    (
      &clk_src_name="GPLL0_OUT_MAIN"
      &clk_src_sel=SRC_SEL TODO.
      &clk_src_div=2.
      &clk_m_val=7.
      &clk_n_val=75.
      &clk_2d_val=75.
      
      gosub Set_Clock_Freq
      return
    )
    else if ("&clk_desired_freq"=="58.9824")
    (
      &clk_src_name="GPLL0_OUT_MAIN"
      &clk_src_sel=SRC_SEL TODO.
      &clk_src_div=2.
      &clk_m_val=1536.
      &clk_n_val=15625.
      &clk_2d_val=15625.
      
      gosub Set_Clock_Freq
      return
    )
    else if ("&clk_desired_freq"=="60.0")
    (
      &clk_src_name="GPLL0_OUT_MAIN"
      &clk_src_sel=SRC_SEL TODO.
      &clk_src_div=20.
      &clk_m_val=0.
      &clk_n_val=0.
      &clk_2d_val=0.
      
      gosub Set_Clock_Freq
      return
    )
    else if ("&clk_desired_freq"=="63.157895")
    (
      &clk_src_name="GPLL0_OUT_MAIN"
      &clk_src_sel=SRC_SEL TODO.
      &clk_src_div=19.
      &clk_m_val=0.
      &clk_n_val=0.
      &clk_2d_val=0.
      
      gosub Set_Clock_Freq
      return
    )
    else if ("&clk_desired_freq"=="r")
    (
      return
    )
    else
    (
      print "Invalid selection."
      goto Set_Clock_Freq_Enter
    )
  )

  if ("&clk"=="gcc_blsp1_uart3_apps_clk")
  (
    gosub PRINT_SET_CLOCK_FREQ_WARNING

    &clk_cmd_rcgr_addr=&HWIO_GCC_BLSP1_UART3_APPS_CMD_RCGR_ADDR
    &clk_cfg_rcgr_addr=&HWIO_GCC_BLSP1_UART3_APPS_CFG_RCGR_ADDR

    print "Choose frequency (MHz) from list below: " 

    print "3.6864         7.3728         14.7456        " 
    print "16.0           19.2           24.0           " 
    print "32.0           40.0           46.4           " 
    print "48.0           51.2           56.0           " 
    print "58.9824        60.0           63.157895      " 

    print " "
    print "Enter desired frequency (r to return): "
    enter &clk_desired_freq
    print " "

    if ("&clk_desired_freq"=="3.6864")
    (
      &clk_src_name="GPLL0_OUT_MAIN"
      &clk_src_sel=SRC_SEL TODO.
      &clk_src_div=2.
      &clk_m_val=96.
      &clk_n_val=15625.
      &clk_2d_val=15625.
      
      gosub Set_Clock_Freq
      return
    )
    else if ("&clk_desired_freq"=="7.3728")
    (
      &clk_src_name="GPLL0_OUT_MAIN"
      &clk_src_sel=SRC_SEL TODO.
      &clk_src_div=2.
      &clk_m_val=192.
      &clk_n_val=15625.
      &clk_2d_val=15625.
      
      gosub Set_Clock_Freq
      return
    )
    else if ("&clk_desired_freq"=="14.7456")
    (
      &clk_src_name="GPLL0_OUT_MAIN"
      &clk_src_sel=SRC_SEL TODO.
      &clk_src_div=2.
      &clk_m_val=384.
      &clk_n_val=15625.
      &clk_2d_val=15625.
      
      gosub Set_Clock_Freq
      return
    )
    else if ("&clk_desired_freq"=="16.0")
    (
      &clk_src_name="GPLL0_OUT_MAIN"
      &clk_src_sel=SRC_SEL TODO.
      &clk_src_div=10.
      &clk_m_val=2.
      &clk_n_val=15.
      &clk_2d_val=15.
      
      gosub Set_Clock_Freq
      return
    )
    else if ("&clk_desired_freq"=="19.2")
    (
      &clk_src_name="XO"
      &clk_src_sel=SRC_SEL TODO.
      &clk_src_div=2.
      &clk_m_val=0.
      &clk_n_val=0.
      &clk_2d_val=0.
      
      gosub Set_Clock_Freq
      return
    )
    else if ("&clk_desired_freq"=="24.0")
    (
      &clk_src_name="GPLL0_OUT_MAIN"
      &clk_src_sel=SRC_SEL TODO.
      &clk_src_div=10.
      &clk_m_val=1.
      &clk_n_val=5.
      &clk_2d_val=5.
      
      gosub Set_Clock_Freq
      return
    )
    else if ("&clk_desired_freq"=="32.0")
    (
      &clk_src_name="GPLL0_OUT_MAIN"
      &clk_src_sel=SRC_SEL TODO.
      &clk_src_div=2.
      &clk_m_val=4.
      &clk_n_val=75.
      &clk_2d_val=75.
      
      gosub Set_Clock_Freq
      return
    )
    else if ("&clk_desired_freq"=="40.0")
    (
      &clk_src_name="GPLL0_OUT_MAIN"
      &clk_src_sel=SRC_SEL TODO.
      &clk_src_div=30.
      &clk_m_val=0.
      &clk_n_val=0.
      &clk_2d_val=0.
      
      gosub Set_Clock_Freq
      return
    )
    else if ("&clk_desired_freq"=="46.4")
    (
      &clk_src_name="GPLL0_OUT_MAIN"
      &clk_src_sel=SRC_SEL TODO.
      &clk_src_div=2.
      &clk_m_val=29.
      &clk_n_val=375.
      &clk_2d_val=375.
      
      gosub Set_Clock_Freq
      return
    )
    else if ("&clk_desired_freq"=="48.0")
    (
      &clk_src_name="GPLL0_OUT_MAIN"
      &clk_src_sel=SRC_SEL TODO.
      &clk_src_div=25.
      &clk_m_val=0.
      &clk_n_val=0.
      &clk_2d_val=0.
      
      gosub Set_Clock_Freq
      return
    )
    else if ("&clk_desired_freq"=="51.2")
    (
      &clk_src_name="GPLL0_OUT_MAIN"
      &clk_src_sel=SRC_SEL TODO.
      &clk_src_div=2.
      &clk_m_val=32.
      &clk_n_val=375.
      &clk_2d_val=375.
      
      gosub Set_Clock_Freq
      return
    )
    else if ("&clk_desired_freq"=="56.0")
    (
      &clk_src_name="GPLL0_OUT_MAIN"
      &clk_src_sel=SRC_SEL TODO.
      &clk_src_div=2.
      &clk_m_val=7.
      &clk_n_val=75.
      &clk_2d_val=75.
      
      gosub Set_Clock_Freq
      return
    )
    else if ("&clk_desired_freq"=="58.9824")
    (
      &clk_src_name="GPLL0_OUT_MAIN"
      &clk_src_sel=SRC_SEL TODO.
      &clk_src_div=2.
      &clk_m_val=1536.
      &clk_n_val=15625.
      &clk_2d_val=15625.
      
      gosub Set_Clock_Freq
      return
    )
    else if ("&clk_desired_freq"=="60.0")
    (
      &clk_src_name="GPLL0_OUT_MAIN"
      &clk_src_sel=SRC_SEL TODO.
      &clk_src_div=20.
      &clk_m_val=0.
      &clk_n_val=0.
      &clk_2d_val=0.
      
      gosub Set_Clock_Freq
      return
    )
    else if ("&clk_desired_freq"=="63.157895")
    (
      &clk_src_name="GPLL0_OUT_MAIN"
      &clk_src_sel=SRC_SEL TODO.
      &clk_src_div=19.
      &clk_m_val=0.
      &clk_n_val=0.
      &clk_2d_val=0.
      
      gosub Set_Clock_Freq
      return
    )
    else if ("&clk_desired_freq"=="r")
    (
      return
    )
    else
    (
      print "Invalid selection."
      goto Set_Clock_Freq_Enter
    )
  )

  if ("&clk"=="gcc_blsp2_qup1_i2c_apps_clk")
  (
    gosub PRINT_SET_CLOCK_FREQ_WARNING

    &clk_cmd_rcgr_addr=&HWIO_GCC_BLSP2_QUP1_I2C_APPS_CMD_RCGR_ADDR
    &clk_cfg_rcgr_addr=&HWIO_GCC_BLSP2_QUP1_I2C_APPS_CFG_RCGR_ADDR

    print "Choose frequency (MHz) from list below: " 

    print "19.2           50.0           " 

    print " "
    print "Enter desired frequency (r to return): "
    enter &clk_desired_freq
    print " "

    if ("&clk_desired_freq"=="19.2")
    (
      &clk_src_name="XO"
      &clk_src_sel=SRC_SEL TODO.
      &clk_src_div=2.
      &clk_m_val=0.
      &clk_n_val=0.
      &clk_2d_val=0.
      
      gosub Set_Clock_Freq
      return
    )
    else if ("&clk_desired_freq"=="50.0")
    (
      &clk_src_name="GPLL0_OUT_MAIN"
      &clk_src_sel=SRC_SEL TODO.
      &clk_src_div=24.
      &clk_m_val=0.
      &clk_n_val=0.
      &clk_2d_val=0.
      
      gosub Set_Clock_Freq
      return
    )
    else if ("&clk_desired_freq"=="r")
    (
      return
    )
    else
    (
      print "Invalid selection."
      goto Set_Clock_Freq_Enter
    )
  )

  if ("&clk"=="gcc_blsp2_qup1_spi_apps_clk")
  (
    gosub PRINT_SET_CLOCK_FREQ_WARNING

    &clk_cmd_rcgr_addr=&HWIO_GCC_BLSP2_QUP1_SPI_APPS_CMD_RCGR_ADDR
    &clk_cfg_rcgr_addr=&HWIO_GCC_BLSP2_QUP1_SPI_APPS_CFG_RCGR_ADDR

    print "Choose frequency (MHz) from list below: " 

    print "0.96           4.8            9.6            " 
    print "15.0           19.2           25.0           " 
    print "50.0           " 

    print " "
    print "Enter desired frequency (r to return): "
    enter &clk_desired_freq
    print " "

    if ("&clk_desired_freq"=="0.96")
    (
      &clk_src_name="XO"
      &clk_src_sel=SRC_SEL TODO.
      &clk_src_div=20.
      &clk_m_val=1.
      &clk_n_val=2.
      &clk_2d_val=2.
      
      gosub Set_Clock_Freq
      return
    )
    else if ("&clk_desired_freq"=="4.8")
    (
      &clk_src_name="XO"
      &clk_src_sel=SRC_SEL TODO.
      &clk_src_div=8.
      &clk_m_val=0.
      &clk_n_val=0.
      &clk_2d_val=0.
      
      gosub Set_Clock_Freq
      return
    )
    else if ("&clk_desired_freq"=="9.6")
    (
      &clk_src_name="XO"
      &clk_src_sel=SRC_SEL TODO.
      &clk_src_div=4.
      &clk_m_val=0.
      &clk_n_val=0.
      &clk_2d_val=0.
      
      gosub Set_Clock_Freq
      return
    )
    else if ("&clk_desired_freq"=="15.0")
    (
      &clk_src_name="GPLL0_OUT_MAIN"
      &clk_src_sel=SRC_SEL TODO.
      &clk_src_div=20.
      &clk_m_val=1.
      &clk_n_val=4.
      &clk_2d_val=4.
      
      gosub Set_Clock_Freq
      return
    )
    else if ("&clk_desired_freq"=="19.2")
    (
      &clk_src_name="XO"
      &clk_src_sel=SRC_SEL TODO.
      &clk_src_div=2.
      &clk_m_val=0.
      &clk_n_val=0.
      &clk_2d_val=0.
      
      gosub Set_Clock_Freq
      return
    )
    else if ("&clk_desired_freq"=="25.0")
    (
      &clk_src_name="GPLL0_OUT_MAIN"
      &clk_src_sel=SRC_SEL TODO.
      &clk_src_div=24.
      &clk_m_val=1.
      &clk_n_val=2.
      &clk_2d_val=2.
      
      gosub Set_Clock_Freq
      return
    )
    else if ("&clk_desired_freq"=="50.0")
    (
      &clk_src_name="GPLL0_OUT_MAIN"
      &clk_src_sel=SRC_SEL TODO.
      &clk_src_div=24.
      &clk_m_val=0.
      &clk_n_val=0.
      &clk_2d_val=0.
      
      gosub Set_Clock_Freq
      return
    )
    else if ("&clk_desired_freq"=="r")
    (
      return
    )
    else
    (
      print "Invalid selection."
      goto Set_Clock_Freq_Enter
    )
  )

  if ("&clk"=="gcc_blsp2_qup2_i2c_apps_clk")
  (
    gosub PRINT_SET_CLOCK_FREQ_WARNING

    &clk_cmd_rcgr_addr=&HWIO_GCC_BLSP2_QUP2_I2C_APPS_CMD_RCGR_ADDR
    &clk_cfg_rcgr_addr=&HWIO_GCC_BLSP2_QUP2_I2C_APPS_CFG_RCGR_ADDR

    print "Choose frequency (MHz) from list below: " 

    print "19.2           50.0           " 

    print " "
    print "Enter desired frequency (r to return): "
    enter &clk_desired_freq
    print " "

    if ("&clk_desired_freq"=="19.2")
    (
      &clk_src_name="XO"
      &clk_src_sel=SRC_SEL TODO.
      &clk_src_div=2.
      &clk_m_val=0.
      &clk_n_val=0.
      &clk_2d_val=0.
      
      gosub Set_Clock_Freq
      return
    )
    else if ("&clk_desired_freq"=="50.0")
    (
      &clk_src_name="GPLL0_OUT_MAIN"
      &clk_src_sel=SRC_SEL TODO.
      &clk_src_div=24.
      &clk_m_val=0.
      &clk_n_val=0.
      &clk_2d_val=0.
      
      gosub Set_Clock_Freq
      return
    )
    else if ("&clk_desired_freq"=="r")
    (
      return
    )
    else
    (
      print "Invalid selection."
      goto Set_Clock_Freq_Enter
    )
  )

  if ("&clk"=="gcc_blsp2_qup2_spi_apps_clk")
  (
    gosub PRINT_SET_CLOCK_FREQ_WARNING

    &clk_cmd_rcgr_addr=&HWIO_GCC_BLSP2_QUP2_SPI_APPS_CMD_RCGR_ADDR
    &clk_cfg_rcgr_addr=&HWIO_GCC_BLSP2_QUP2_SPI_APPS_CFG_RCGR_ADDR

    print "Choose frequency (MHz) from list below: " 

    print "0.96           4.8            9.6            " 
    print "15.0           19.2           25.0           " 
    print "50.0           " 

    print " "
    print "Enter desired frequency (r to return): "
    enter &clk_desired_freq
    print " "

    if ("&clk_desired_freq"=="0.96")
    (
      &clk_src_name="XO"
      &clk_src_sel=SRC_SEL TODO.
      &clk_src_div=20.
      &clk_m_val=1.
      &clk_n_val=2.
      &clk_2d_val=2.
      
      gosub Set_Clock_Freq
      return
    )
    else if ("&clk_desired_freq"=="4.8")
    (
      &clk_src_name="XO"
      &clk_src_sel=SRC_SEL TODO.
      &clk_src_div=8.
      &clk_m_val=0.
      &clk_n_val=0.
      &clk_2d_val=0.
      
      gosub Set_Clock_Freq
      return
    )
    else if ("&clk_desired_freq"=="9.6")
    (
      &clk_src_name="XO"
      &clk_src_sel=SRC_SEL TODO.
      &clk_src_div=4.
      &clk_m_val=0.
      &clk_n_val=0.
      &clk_2d_val=0.
      
      gosub Set_Clock_Freq
      return
    )
    else if ("&clk_desired_freq"=="15.0")
    (
      &clk_src_name="GPLL0_OUT_MAIN"
      &clk_src_sel=SRC_SEL TODO.
      &clk_src_div=20.
      &clk_m_val=1.
      &clk_n_val=4.
      &clk_2d_val=4.
      
      gosub Set_Clock_Freq
      return
    )
    else if ("&clk_desired_freq"=="19.2")
    (
      &clk_src_name="XO"
      &clk_src_sel=SRC_SEL TODO.
      &clk_src_div=2.
      &clk_m_val=0.
      &clk_n_val=0.
      &clk_2d_val=0.
      
      gosub Set_Clock_Freq
      return
    )
    else if ("&clk_desired_freq"=="25.0")
    (
      &clk_src_name="GPLL0_OUT_MAIN"
      &clk_src_sel=SRC_SEL TODO.
      &clk_src_div=24.
      &clk_m_val=1.
      &clk_n_val=2.
      &clk_2d_val=2.
      
      gosub Set_Clock_Freq
      return
    )
    else if ("&clk_desired_freq"=="50.0")
    (
      &clk_src_name="GPLL0_OUT_MAIN"
      &clk_src_sel=SRC_SEL TODO.
      &clk_src_div=24.
      &clk_m_val=0.
      &clk_n_val=0.
      &clk_2d_val=0.
      
      gosub Set_Clock_Freq
      return
    )
    else if ("&clk_desired_freq"=="r")
    (
      return
    )
    else
    (
      print "Invalid selection."
      goto Set_Clock_Freq_Enter
    )
  )

  if ("&clk"=="gcc_blsp2_qup3_i2c_apps_clk")
  (
    gosub PRINT_SET_CLOCK_FREQ_WARNING

    &clk_cmd_rcgr_addr=&HWIO_GCC_BLSP2_QUP3_I2C_APPS_CMD_RCGR_ADDR
    &clk_cfg_rcgr_addr=&HWIO_GCC_BLSP2_QUP3_I2C_APPS_CFG_RCGR_ADDR

    print "Choose frequency (MHz) from list below: " 

    print "19.2           50.0           " 

    print " "
    print "Enter desired frequency (r to return): "
    enter &clk_desired_freq
    print " "

    if ("&clk_desired_freq"=="19.2")
    (
      &clk_src_name="XO"
      &clk_src_sel=SRC_SEL TODO.
      &clk_src_div=2.
      &clk_m_val=0.
      &clk_n_val=0.
      &clk_2d_val=0.
      
      gosub Set_Clock_Freq
      return
    )
    else if ("&clk_desired_freq"=="50.0")
    (
      &clk_src_name="GPLL0_OUT_MAIN"
      &clk_src_sel=SRC_SEL TODO.
      &clk_src_div=24.
      &clk_m_val=0.
      &clk_n_val=0.
      &clk_2d_val=0.
      
      gosub Set_Clock_Freq
      return
    )
    else if ("&clk_desired_freq"=="r")
    (
      return
    )
    else
    (
      print "Invalid selection."
      goto Set_Clock_Freq_Enter
    )
  )

  if ("&clk"=="gcc_blsp2_qup3_spi_apps_clk")
  (
    gosub PRINT_SET_CLOCK_FREQ_WARNING

    &clk_cmd_rcgr_addr=&HWIO_GCC_BLSP2_QUP3_SPI_APPS_CMD_RCGR_ADDR
    &clk_cfg_rcgr_addr=&HWIO_GCC_BLSP2_QUP3_SPI_APPS_CFG_RCGR_ADDR

    print "Choose frequency (MHz) from list below: " 

    print "0.96           4.8            9.6            " 
    print "15.0           19.2           25.0           " 
    print "50.0           " 

    print " "
    print "Enter desired frequency (r to return): "
    enter &clk_desired_freq
    print " "

    if ("&clk_desired_freq"=="0.96")
    (
      &clk_src_name="XO"
      &clk_src_sel=SRC_SEL TODO.
      &clk_src_div=20.
      &clk_m_val=1.
      &clk_n_val=2.
      &clk_2d_val=2.
      
      gosub Set_Clock_Freq
      return
    )
    else if ("&clk_desired_freq"=="4.8")
    (
      &clk_src_name="XO"
      &clk_src_sel=SRC_SEL TODO.
      &clk_src_div=8.
      &clk_m_val=0.
      &clk_n_val=0.
      &clk_2d_val=0.
      
      gosub Set_Clock_Freq
      return
    )
    else if ("&clk_desired_freq"=="9.6")
    (
      &clk_src_name="XO"
      &clk_src_sel=SRC_SEL TODO.
      &clk_src_div=4.
      &clk_m_val=0.
      &clk_n_val=0.
      &clk_2d_val=0.
      
      gosub Set_Clock_Freq
      return
    )
    else if ("&clk_desired_freq"=="15.0")
    (
      &clk_src_name="GPLL0_OUT_MAIN"
      &clk_src_sel=SRC_SEL TODO.
      &clk_src_div=20.
      &clk_m_val=1.
      &clk_n_val=4.
      &clk_2d_val=4.
      
      gosub Set_Clock_Freq
      return
    )
    else if ("&clk_desired_freq"=="19.2")
    (
      &clk_src_name="XO"
      &clk_src_sel=SRC_SEL TODO.
      &clk_src_div=2.
      &clk_m_val=0.
      &clk_n_val=0.
      &clk_2d_val=0.
      
      gosub Set_Clock_Freq
      return
    )
    else if ("&clk_desired_freq"=="25.0")
    (
      &clk_src_name="GPLL0_OUT_MAIN"
      &clk_src_sel=SRC_SEL TODO.
      &clk_src_div=24.
      &clk_m_val=1.
      &clk_n_val=2.
      &clk_2d_val=2.
      
      gosub Set_Clock_Freq
      return
    )
    else if ("&clk_desired_freq"=="50.0")
    (
      &clk_src_name="GPLL0_OUT_MAIN"
      &clk_src_sel=SRC_SEL TODO.
      &clk_src_div=24.
      &clk_m_val=0.
      &clk_n_val=0.
      &clk_2d_val=0.
      
      gosub Set_Clock_Freq
      return
    )
    else if ("&clk_desired_freq"=="r")
    (
      return
    )
    else
    (
      print "Invalid selection."
      goto Set_Clock_Freq_Enter
    )
  )

  if ("&clk"=="gcc_blsp2_qup4_i2c_apps_clk")
  (
    gosub PRINT_SET_CLOCK_FREQ_WARNING

    &clk_cmd_rcgr_addr=&HWIO_GCC_BLSP2_QUP4_I2C_APPS_CMD_RCGR_ADDR
    &clk_cfg_rcgr_addr=&HWIO_GCC_BLSP2_QUP4_I2C_APPS_CFG_RCGR_ADDR

    print "Choose frequency (MHz) from list below: " 

    print "19.2           50.0           " 

    print " "
    print "Enter desired frequency (r to return): "
    enter &clk_desired_freq
    print " "

    if ("&clk_desired_freq"=="19.2")
    (
      &clk_src_name="XO"
      &clk_src_sel=SRC_SEL TODO.
      &clk_src_div=2.
      &clk_m_val=0.
      &clk_n_val=0.
      &clk_2d_val=0.
      
      gosub Set_Clock_Freq
      return
    )
    else if ("&clk_desired_freq"=="50.0")
    (
      &clk_src_name="GPLL0_OUT_MAIN"
      &clk_src_sel=SRC_SEL TODO.
      &clk_src_div=24.
      &clk_m_val=0.
      &clk_n_val=0.
      &clk_2d_val=0.
      
      gosub Set_Clock_Freq
      return
    )
    else if ("&clk_desired_freq"=="r")
    (
      return
    )
    else
    (
      print "Invalid selection."
      goto Set_Clock_Freq_Enter
    )
  )

  if ("&clk"=="gcc_blsp2_qup4_spi_apps_clk")
  (
    gosub PRINT_SET_CLOCK_FREQ_WARNING

    &clk_cmd_rcgr_addr=&HWIO_GCC_BLSP2_QUP4_SPI_APPS_CMD_RCGR_ADDR
    &clk_cfg_rcgr_addr=&HWIO_GCC_BLSP2_QUP4_SPI_APPS_CFG_RCGR_ADDR

    print "Choose frequency (MHz) from list below: " 

    print "0.96           4.8            9.6            " 
    print "15.0           19.2           25.0           " 
    print "50.0           " 

    print " "
    print "Enter desired frequency (r to return): "
    enter &clk_desired_freq
    print " "

    if ("&clk_desired_freq"=="0.96")
    (
      &clk_src_name="XO"
      &clk_src_sel=SRC_SEL TODO.
      &clk_src_div=20.
      &clk_m_val=1.
      &clk_n_val=2.
      &clk_2d_val=2.
      
      gosub Set_Clock_Freq
      return
    )
    else if ("&clk_desired_freq"=="4.8")
    (
      &clk_src_name="XO"
      &clk_src_sel=SRC_SEL TODO.
      &clk_src_div=8.
      &clk_m_val=0.
      &clk_n_val=0.
      &clk_2d_val=0.
      
      gosub Set_Clock_Freq
      return
    )
    else if ("&clk_desired_freq"=="9.6")
    (
      &clk_src_name="XO"
      &clk_src_sel=SRC_SEL TODO.
      &clk_src_div=4.
      &clk_m_val=0.
      &clk_n_val=0.
      &clk_2d_val=0.
      
      gosub Set_Clock_Freq
      return
    )
    else if ("&clk_desired_freq"=="15.0")
    (
      &clk_src_name="GPLL0_OUT_MAIN"
      &clk_src_sel=SRC_SEL TODO.
      &clk_src_div=20.
      &clk_m_val=1.
      &clk_n_val=4.
      &clk_2d_val=4.
      
      gosub Set_Clock_Freq
      return
    )
    else if ("&clk_desired_freq"=="19.2")
    (
      &clk_src_name="XO"
      &clk_src_sel=SRC_SEL TODO.
      &clk_src_div=2.
      &clk_m_val=0.
      &clk_n_val=0.
      &clk_2d_val=0.
      
      gosub Set_Clock_Freq
      return
    )
    else if ("&clk_desired_freq"=="25.0")
    (
      &clk_src_name="GPLL0_OUT_MAIN"
      &clk_src_sel=SRC_SEL TODO.
      &clk_src_div=24.
      &clk_m_val=1.
      &clk_n_val=2.
      &clk_2d_val=2.
      
      gosub Set_Clock_Freq
      return
    )
    else if ("&clk_desired_freq"=="50.0")
    (
      &clk_src_name="GPLL0_OUT_MAIN"
      &clk_src_sel=SRC_SEL TODO.
      &clk_src_div=24.
      &clk_m_val=0.
      &clk_n_val=0.
      &clk_2d_val=0.
      
      gosub Set_Clock_Freq
      return
    )
    else if ("&clk_desired_freq"=="r")
    (
      return
    )
    else
    (
      print "Invalid selection."
      goto Set_Clock_Freq_Enter
    )
  )

  if ("&clk"=="gcc_blsp2_qup5_i2c_apps_clk")
  (
    gosub PRINT_SET_CLOCK_FREQ_WARNING

    &clk_cmd_rcgr_addr=&HWIO_GCC_BLSP2_QUP5_I2C_APPS_CMD_RCGR_ADDR
    &clk_cfg_rcgr_addr=&HWIO_GCC_BLSP2_QUP5_I2C_APPS_CFG_RCGR_ADDR

    print "Choose frequency (MHz) from list below: " 

    print "19.2           50.0           " 

    print " "
    print "Enter desired frequency (r to return): "
    enter &clk_desired_freq
    print " "

    if ("&clk_desired_freq"=="19.2")
    (
      &clk_src_name="XO"
      &clk_src_sel=SRC_SEL TODO.
      &clk_src_div=2.
      &clk_m_val=0.
      &clk_n_val=0.
      &clk_2d_val=0.
      
      gosub Set_Clock_Freq
      return
    )
    else if ("&clk_desired_freq"=="50.0")
    (
      &clk_src_name="GPLL0_OUT_MAIN"
      &clk_src_sel=SRC_SEL TODO.
      &clk_src_div=24.
      &clk_m_val=0.
      &clk_n_val=0.
      &clk_2d_val=0.
      
      gosub Set_Clock_Freq
      return
    )
    else if ("&clk_desired_freq"=="r")
    (
      return
    )
    else
    (
      print "Invalid selection."
      goto Set_Clock_Freq_Enter
    )
  )

  if ("&clk"=="gcc_blsp2_qup5_spi_apps_clk")
  (
    gosub PRINT_SET_CLOCK_FREQ_WARNING

    &clk_cmd_rcgr_addr=&HWIO_GCC_BLSP2_QUP5_SPI_APPS_CMD_RCGR_ADDR
    &clk_cfg_rcgr_addr=&HWIO_GCC_BLSP2_QUP5_SPI_APPS_CFG_RCGR_ADDR

    print "Choose frequency (MHz) from list below: " 

    print "0.96           4.8            9.6            " 
    print "15.0           19.2           25.0           " 
    print "50.0           " 

    print " "
    print "Enter desired frequency (r to return): "
    enter &clk_desired_freq
    print " "

    if ("&clk_desired_freq"=="0.96")
    (
      &clk_src_name="XO"
      &clk_src_sel=SRC_SEL TODO.
      &clk_src_div=20.
      &clk_m_val=1.
      &clk_n_val=2.
      &clk_2d_val=2.
      
      gosub Set_Clock_Freq
      return
    )
    else if ("&clk_desired_freq"=="4.8")
    (
      &clk_src_name="XO"
      &clk_src_sel=SRC_SEL TODO.
      &clk_src_div=8.
      &clk_m_val=0.
      &clk_n_val=0.
      &clk_2d_val=0.
      
      gosub Set_Clock_Freq
      return
    )
    else if ("&clk_desired_freq"=="9.6")
    (
      &clk_src_name="XO"
      &clk_src_sel=SRC_SEL TODO.
      &clk_src_div=4.
      &clk_m_val=0.
      &clk_n_val=0.
      &clk_2d_val=0.
      
      gosub Set_Clock_Freq
      return
    )
    else if ("&clk_desired_freq"=="15.0")
    (
      &clk_src_name="GPLL0_OUT_MAIN"
      &clk_src_sel=SRC_SEL TODO.
      &clk_src_div=20.
      &clk_m_val=1.
      &clk_n_val=4.
      &clk_2d_val=4.
      
      gosub Set_Clock_Freq
      return
    )
    else if ("&clk_desired_freq"=="19.2")
    (
      &clk_src_name="XO"
      &clk_src_sel=SRC_SEL TODO.
      &clk_src_div=2.
      &clk_m_val=0.
      &clk_n_val=0.
      &clk_2d_val=0.
      
      gosub Set_Clock_Freq
      return
    )
    else if ("&clk_desired_freq"=="25.0")
    (
      &clk_src_name="GPLL0_OUT_MAIN"
      &clk_src_sel=SRC_SEL TODO.
      &clk_src_div=24.
      &clk_m_val=1.
      &clk_n_val=2.
      &clk_2d_val=2.
      
      gosub Set_Clock_Freq
      return
    )
    else if ("&clk_desired_freq"=="50.0")
    (
      &clk_src_name="GPLL0_OUT_MAIN"
      &clk_src_sel=SRC_SEL TODO.
      &clk_src_div=24.
      &clk_m_val=0.
      &clk_n_val=0.
      &clk_2d_val=0.
      
      gosub Set_Clock_Freq
      return
    )
    else if ("&clk_desired_freq"=="r")
    (
      return
    )
    else
    (
      print "Invalid selection."
      goto Set_Clock_Freq_Enter
    )
  )

  if ("&clk"=="gcc_blsp2_qup6_i2c_apps_clk")
  (
    gosub PRINT_SET_CLOCK_FREQ_WARNING

    &clk_cmd_rcgr_addr=&HWIO_GCC_BLSP2_QUP6_I2C_APPS_CMD_RCGR_ADDR
    &clk_cfg_rcgr_addr=&HWIO_GCC_BLSP2_QUP6_I2C_APPS_CFG_RCGR_ADDR

    print "Choose frequency (MHz) from list below: " 

    print "19.2           50.0           " 

    print " "
    print "Enter desired frequency (r to return): "
    enter &clk_desired_freq
    print " "

    if ("&clk_desired_freq"=="19.2")
    (
      &clk_src_name="XO"
      &clk_src_sel=SRC_SEL TODO.
      &clk_src_div=2.
      &clk_m_val=0.
      &clk_n_val=0.
      &clk_2d_val=0.
      
      gosub Set_Clock_Freq
      return
    )
    else if ("&clk_desired_freq"=="50.0")
    (
      &clk_src_name="GPLL0_OUT_MAIN"
      &clk_src_sel=SRC_SEL TODO.
      &clk_src_div=24.
      &clk_m_val=0.
      &clk_n_val=0.
      &clk_2d_val=0.
      
      gosub Set_Clock_Freq
      return
    )
    else if ("&clk_desired_freq"=="r")
    (
      return
    )
    else
    (
      print "Invalid selection."
      goto Set_Clock_Freq_Enter
    )
  )

  if ("&clk"=="gcc_blsp2_qup6_spi_apps_clk")
  (
    gosub PRINT_SET_CLOCK_FREQ_WARNING

    &clk_cmd_rcgr_addr=&HWIO_GCC_BLSP2_QUP6_SPI_APPS_CMD_RCGR_ADDR
    &clk_cfg_rcgr_addr=&HWIO_GCC_BLSP2_QUP6_SPI_APPS_CFG_RCGR_ADDR

    print "Choose frequency (MHz) from list below: " 

    print "0.96           4.8            9.6            " 
    print "15.0           19.2           25.0           " 
    print "50.0           " 

    print " "
    print "Enter desired frequency (r to return): "
    enter &clk_desired_freq
    print " "

    if ("&clk_desired_freq"=="0.96")
    (
      &clk_src_name="XO"
      &clk_src_sel=SRC_SEL TODO.
      &clk_src_div=20.
      &clk_m_val=1.
      &clk_n_val=2.
      &clk_2d_val=2.
      
      gosub Set_Clock_Freq
      return
    )
    else if ("&clk_desired_freq"=="4.8")
    (
      &clk_src_name="XO"
      &clk_src_sel=SRC_SEL TODO.
      &clk_src_div=8.
      &clk_m_val=0.
      &clk_n_val=0.
      &clk_2d_val=0.
      
      gosub Set_Clock_Freq
      return
    )
    else if ("&clk_desired_freq"=="9.6")
    (
      &clk_src_name="XO"
      &clk_src_sel=SRC_SEL TODO.
      &clk_src_div=4.
      &clk_m_val=0.
      &clk_n_val=0.
      &clk_2d_val=0.
      
      gosub Set_Clock_Freq
      return
    )
    else if ("&clk_desired_freq"=="15.0")
    (
      &clk_src_name="GPLL0_OUT_MAIN"
      &clk_src_sel=SRC_SEL TODO.
      &clk_src_div=20.
      &clk_m_val=1.
      &clk_n_val=4.
      &clk_2d_val=4.
      
      gosub Set_Clock_Freq
      return
    )
    else if ("&clk_desired_freq"=="19.2")
    (
      &clk_src_name="XO"
      &clk_src_sel=SRC_SEL TODO.
      &clk_src_div=2.
      &clk_m_val=0.
      &clk_n_val=0.
      &clk_2d_val=0.
      
      gosub Set_Clock_Freq
      return
    )
    else if ("&clk_desired_freq"=="25.0")
    (
      &clk_src_name="GPLL0_OUT_MAIN"
      &clk_src_sel=SRC_SEL TODO.
      &clk_src_div=24.
      &clk_m_val=1.
      &clk_n_val=2.
      &clk_2d_val=2.
      
      gosub Set_Clock_Freq
      return
    )
    else if ("&clk_desired_freq"=="50.0")
    (
      &clk_src_name="GPLL0_OUT_MAIN"
      &clk_src_sel=SRC_SEL TODO.
      &clk_src_div=24.
      &clk_m_val=0.
      &clk_n_val=0.
      &clk_2d_val=0.
      
      gosub Set_Clock_Freq
      return
    )
    else if ("&clk_desired_freq"=="r")
    (
      return
    )
    else
    (
      print "Invalid selection."
      goto Set_Clock_Freq_Enter
    )
  )

  if ("&clk"=="gcc_blsp2_uart1_apps_clk")
  (
    gosub PRINT_SET_CLOCK_FREQ_WARNING

    &clk_cmd_rcgr_addr=&HWIO_GCC_BLSP2_UART1_APPS_CMD_RCGR_ADDR
    &clk_cfg_rcgr_addr=&HWIO_GCC_BLSP2_UART1_APPS_CFG_RCGR_ADDR

    print "Choose frequency (MHz) from list below: " 

    print "3.6864         7.3728         14.7456        " 
    print "16.0           19.2           24.0           " 
    print "32.0           40.0           46.4           " 
    print "48.0           51.2           56.0           " 
    print "58.9824        60.0           63.157895      " 

    print " "
    print "Enter desired frequency (r to return): "
    enter &clk_desired_freq
    print " "

    if ("&clk_desired_freq"=="3.6864")
    (
      &clk_src_name="GPLL0_OUT_MAIN"
      &clk_src_sel=SRC_SEL TODO.
      &clk_src_div=2.
      &clk_m_val=96.
      &clk_n_val=15625.
      &clk_2d_val=15625.
      
      gosub Set_Clock_Freq
      return
    )
    else if ("&clk_desired_freq"=="7.3728")
    (
      &clk_src_name="GPLL0_OUT_MAIN"
      &clk_src_sel=SRC_SEL TODO.
      &clk_src_div=2.
      &clk_m_val=192.
      &clk_n_val=15625.
      &clk_2d_val=15625.
      
      gosub Set_Clock_Freq
      return
    )
    else if ("&clk_desired_freq"=="14.7456")
    (
      &clk_src_name="GPLL0_OUT_MAIN"
      &clk_src_sel=SRC_SEL TODO.
      &clk_src_div=2.
      &clk_m_val=384.
      &clk_n_val=15625.
      &clk_2d_val=15625.
      
      gosub Set_Clock_Freq
      return
    )
    else if ("&clk_desired_freq"=="16.0")
    (
      &clk_src_name="GPLL0_OUT_MAIN"
      &clk_src_sel=SRC_SEL TODO.
      &clk_src_div=10.
      &clk_m_val=2.
      &clk_n_val=15.
      &clk_2d_val=15.
      
      gosub Set_Clock_Freq
      return
    )
    else if ("&clk_desired_freq"=="19.2")
    (
      &clk_src_name="XO"
      &clk_src_sel=SRC_SEL TODO.
      &clk_src_div=2.
      &clk_m_val=0.
      &clk_n_val=0.
      &clk_2d_val=0.
      
      gosub Set_Clock_Freq
      return
    )
    else if ("&clk_desired_freq"=="24.0")
    (
      &clk_src_name="GPLL0_OUT_MAIN"
      &clk_src_sel=SRC_SEL TODO.
      &clk_src_div=10.
      &clk_m_val=1.
      &clk_n_val=5.
      &clk_2d_val=5.
      
      gosub Set_Clock_Freq
      return
    )
    else if ("&clk_desired_freq"=="32.0")
    (
      &clk_src_name="GPLL0_OUT_MAIN"
      &clk_src_sel=SRC_SEL TODO.
      &clk_src_div=2.
      &clk_m_val=4.
      &clk_n_val=75.
      &clk_2d_val=75.
      
      gosub Set_Clock_Freq
      return
    )
    else if ("&clk_desired_freq"=="40.0")
    (
      &clk_src_name="GPLL0_OUT_MAIN"
      &clk_src_sel=SRC_SEL TODO.
      &clk_src_div=30.
      &clk_m_val=0.
      &clk_n_val=0.
      &clk_2d_val=0.
      
      gosub Set_Clock_Freq
      return
    )
    else if ("&clk_desired_freq"=="46.4")
    (
      &clk_src_name="GPLL0_OUT_MAIN"
      &clk_src_sel=SRC_SEL TODO.
      &clk_src_div=2.
      &clk_m_val=29.
      &clk_n_val=375.
      &clk_2d_val=375.
      
      gosub Set_Clock_Freq
      return
    )
    else if ("&clk_desired_freq"=="48.0")
    (
      &clk_src_name="GPLL0_OUT_MAIN"
      &clk_src_sel=SRC_SEL TODO.
      &clk_src_div=25.
      &clk_m_val=0.
      &clk_n_val=0.
      &clk_2d_val=0.
      
      gosub Set_Clock_Freq
      return
    )
    else if ("&clk_desired_freq"=="51.2")
    (
      &clk_src_name="GPLL0_OUT_MAIN"
      &clk_src_sel=SRC_SEL TODO.
      &clk_src_div=2.
      &clk_m_val=32.
      &clk_n_val=375.
      &clk_2d_val=375.
      
      gosub Set_Clock_Freq
      return
    )
    else if ("&clk_desired_freq"=="56.0")
    (
      &clk_src_name="GPLL0_OUT_MAIN"
      &clk_src_sel=SRC_SEL TODO.
      &clk_src_div=2.
      &clk_m_val=7.
      &clk_n_val=75.
      &clk_2d_val=75.
      
      gosub Set_Clock_Freq
      return
    )
    else if ("&clk_desired_freq"=="58.9824")
    (
      &clk_src_name="GPLL0_OUT_MAIN"
      &clk_src_sel=SRC_SEL TODO.
      &clk_src_div=2.
      &clk_m_val=1536.
      &clk_n_val=15625.
      &clk_2d_val=15625.
      
      gosub Set_Clock_Freq
      return
    )
    else if ("&clk_desired_freq"=="60.0")
    (
      &clk_src_name="GPLL0_OUT_MAIN"
      &clk_src_sel=SRC_SEL TODO.
      &clk_src_div=20.
      &clk_m_val=0.
      &clk_n_val=0.
      &clk_2d_val=0.
      
      gosub Set_Clock_Freq
      return
    )
    else if ("&clk_desired_freq"=="63.157895")
    (
      &clk_src_name="GPLL0_OUT_MAIN"
      &clk_src_sel=SRC_SEL TODO.
      &clk_src_div=19.
      &clk_m_val=0.
      &clk_n_val=0.
      &clk_2d_val=0.
      
      gosub Set_Clock_Freq
      return
    )
    else if ("&clk_desired_freq"=="r")
    (
      return
    )
    else
    (
      print "Invalid selection."
      goto Set_Clock_Freq_Enter
    )
  )

  if ("&clk"=="gcc_blsp2_uart2_apps_clk")
  (
    gosub PRINT_SET_CLOCK_FREQ_WARNING

    &clk_cmd_rcgr_addr=&HWIO_GCC_BLSP2_UART2_APPS_CMD_RCGR_ADDR
    &clk_cfg_rcgr_addr=&HWIO_GCC_BLSP2_UART2_APPS_CFG_RCGR_ADDR

    print "Choose frequency (MHz) from list below: " 

    print "3.6864         7.3728         14.7456        " 
    print "16.0           19.2           24.0           " 
    print "32.0           40.0           46.4           " 
    print "48.0           51.2           56.0           " 
    print "58.9824        60.0           63.157895      " 

    print " "
    print "Enter desired frequency (r to return): "
    enter &clk_desired_freq
    print " "

    if ("&clk_desired_freq"=="3.6864")
    (
      &clk_src_name="GPLL0_OUT_MAIN"
      &clk_src_sel=SRC_SEL TODO.
      &clk_src_div=2.
      &clk_m_val=96.
      &clk_n_val=15625.
      &clk_2d_val=15625.
      
      gosub Set_Clock_Freq
      return
    )
    else if ("&clk_desired_freq"=="7.3728")
    (
      &clk_src_name="GPLL0_OUT_MAIN"
      &clk_src_sel=SRC_SEL TODO.
      &clk_src_div=2.
      &clk_m_val=192.
      &clk_n_val=15625.
      &clk_2d_val=15625.
      
      gosub Set_Clock_Freq
      return
    )
    else if ("&clk_desired_freq"=="14.7456")
    (
      &clk_src_name="GPLL0_OUT_MAIN"
      &clk_src_sel=SRC_SEL TODO.
      &clk_src_div=2.
      &clk_m_val=384.
      &clk_n_val=15625.
      &clk_2d_val=15625.
      
      gosub Set_Clock_Freq
      return
    )
    else if ("&clk_desired_freq"=="16.0")
    (
      &clk_src_name="GPLL0_OUT_MAIN"
      &clk_src_sel=SRC_SEL TODO.
      &clk_src_div=10.
      &clk_m_val=2.
      &clk_n_val=15.
      &clk_2d_val=15.
      
      gosub Set_Clock_Freq
      return
    )
    else if ("&clk_desired_freq"=="19.2")
    (
      &clk_src_name="XO"
      &clk_src_sel=SRC_SEL TODO.
      &clk_src_div=2.
      &clk_m_val=0.
      &clk_n_val=0.
      &clk_2d_val=0.
      
      gosub Set_Clock_Freq
      return
    )
    else if ("&clk_desired_freq"=="24.0")
    (
      &clk_src_name="GPLL0_OUT_MAIN"
      &clk_src_sel=SRC_SEL TODO.
      &clk_src_div=10.
      &clk_m_val=1.
      &clk_n_val=5.
      &clk_2d_val=5.
      
      gosub Set_Clock_Freq
      return
    )
    else if ("&clk_desired_freq"=="32.0")
    (
      &clk_src_name="GPLL0_OUT_MAIN"
      &clk_src_sel=SRC_SEL TODO.
      &clk_src_div=2.
      &clk_m_val=4.
      &clk_n_val=75.
      &clk_2d_val=75.
      
      gosub Set_Clock_Freq
      return
    )
    else if ("&clk_desired_freq"=="40.0")
    (
      &clk_src_name="GPLL0_OUT_MAIN"
      &clk_src_sel=SRC_SEL TODO.
      &clk_src_div=30.
      &clk_m_val=0.
      &clk_n_val=0.
      &clk_2d_val=0.
      
      gosub Set_Clock_Freq
      return
    )
    else if ("&clk_desired_freq"=="46.4")
    (
      &clk_src_name="GPLL0_OUT_MAIN"
      &clk_src_sel=SRC_SEL TODO.
      &clk_src_div=2.
      &clk_m_val=29.
      &clk_n_val=375.
      &clk_2d_val=375.
      
      gosub Set_Clock_Freq
      return
    )
    else if ("&clk_desired_freq"=="48.0")
    (
      &clk_src_name="GPLL0_OUT_MAIN"
      &clk_src_sel=SRC_SEL TODO.
      &clk_src_div=25.
      &clk_m_val=0.
      &clk_n_val=0.
      &clk_2d_val=0.
      
      gosub Set_Clock_Freq
      return
    )
    else if ("&clk_desired_freq"=="51.2")
    (
      &clk_src_name="GPLL0_OUT_MAIN"
      &clk_src_sel=SRC_SEL TODO.
      &clk_src_div=2.
      &clk_m_val=32.
      &clk_n_val=375.
      &clk_2d_val=375.
      
      gosub Set_Clock_Freq
      return
    )
    else if ("&clk_desired_freq"=="56.0")
    (
      &clk_src_name="GPLL0_OUT_MAIN"
      &clk_src_sel=SRC_SEL TODO.
      &clk_src_div=2.
      &clk_m_val=7.
      &clk_n_val=75.
      &clk_2d_val=75.
      
      gosub Set_Clock_Freq
      return
    )
    else if ("&clk_desired_freq"=="58.9824")
    (
      &clk_src_name="GPLL0_OUT_MAIN"
      &clk_src_sel=SRC_SEL TODO.
      &clk_src_div=2.
      &clk_m_val=1536.
      &clk_n_val=15625.
      &clk_2d_val=15625.
      
      gosub Set_Clock_Freq
      return
    )
    else if ("&clk_desired_freq"=="60.0")
    (
      &clk_src_name="GPLL0_OUT_MAIN"
      &clk_src_sel=SRC_SEL TODO.
      &clk_src_div=20.
      &clk_m_val=0.
      &clk_n_val=0.
      &clk_2d_val=0.
      
      gosub Set_Clock_Freq
      return
    )
    else if ("&clk_desired_freq"=="63.157895")
    (
      &clk_src_name="GPLL0_OUT_MAIN"
      &clk_src_sel=SRC_SEL TODO.
      &clk_src_div=19.
      &clk_m_val=0.
      &clk_n_val=0.
      &clk_2d_val=0.
      
      gosub Set_Clock_Freq
      return
    )
    else if ("&clk_desired_freq"=="r")
    (
      return
    )
    else
    (
      print "Invalid selection."
      goto Set_Clock_Freq_Enter
    )
  )

  if ("&clk"=="gcc_blsp2_uart3_apps_clk")
  (
    gosub PRINT_SET_CLOCK_FREQ_WARNING

    &clk_cmd_rcgr_addr=&HWIO_GCC_BLSP2_UART3_APPS_CMD_RCGR_ADDR
    &clk_cfg_rcgr_addr=&HWIO_GCC_BLSP2_UART3_APPS_CFG_RCGR_ADDR

    print "Choose frequency (MHz) from list below: " 

    print "3.6864         7.3728         14.7456        " 
    print "16.0           19.2           24.0           " 
    print "32.0           40.0           46.4           " 
    print "48.0           51.2           56.0           " 
    print "58.9824        60.0           63.157895      " 

    print " "
    print "Enter desired frequency (r to return): "
    enter &clk_desired_freq
    print " "

    if ("&clk_desired_freq"=="3.6864")
    (
      &clk_src_name="GPLL0_OUT_MAIN"
      &clk_src_sel=SRC_SEL TODO.
      &clk_src_div=2.
      &clk_m_val=96.
      &clk_n_val=15625.
      &clk_2d_val=15625.
      
      gosub Set_Clock_Freq
      return
    )
    else if ("&clk_desired_freq"=="7.3728")
    (
      &clk_src_name="GPLL0_OUT_MAIN"
      &clk_src_sel=SRC_SEL TODO.
      &clk_src_div=2.
      &clk_m_val=192.
      &clk_n_val=15625.
      &clk_2d_val=15625.
      
      gosub Set_Clock_Freq
      return
    )
    else if ("&clk_desired_freq"=="14.7456")
    (
      &clk_src_name="GPLL0_OUT_MAIN"
      &clk_src_sel=SRC_SEL TODO.
      &clk_src_div=2.
      &clk_m_val=384.
      &clk_n_val=15625.
      &clk_2d_val=15625.
      
      gosub Set_Clock_Freq
      return
    )
    else if ("&clk_desired_freq"=="16.0")
    (
      &clk_src_name="GPLL0_OUT_MAIN"
      &clk_src_sel=SRC_SEL TODO.
      &clk_src_div=10.
      &clk_m_val=2.
      &clk_n_val=15.
      &clk_2d_val=15.
      
      gosub Set_Clock_Freq
      return
    )
    else if ("&clk_desired_freq"=="19.2")
    (
      &clk_src_name="XO"
      &clk_src_sel=SRC_SEL TODO.
      &clk_src_div=2.
      &clk_m_val=0.
      &clk_n_val=0.
      &clk_2d_val=0.
      
      gosub Set_Clock_Freq
      return
    )
    else if ("&clk_desired_freq"=="24.0")
    (
      &clk_src_name="GPLL0_OUT_MAIN"
      &clk_src_sel=SRC_SEL TODO.
      &clk_src_div=10.
      &clk_m_val=1.
      &clk_n_val=5.
      &clk_2d_val=5.
      
      gosub Set_Clock_Freq
      return
    )
    else if ("&clk_desired_freq"=="32.0")
    (
      &clk_src_name="GPLL0_OUT_MAIN"
      &clk_src_sel=SRC_SEL TODO.
      &clk_src_div=2.
      &clk_m_val=4.
      &clk_n_val=75.
      &clk_2d_val=75.
      
      gosub Set_Clock_Freq
      return
    )
    else if ("&clk_desired_freq"=="40.0")
    (
      &clk_src_name="GPLL0_OUT_MAIN"
      &clk_src_sel=SRC_SEL TODO.
      &clk_src_div=30.
      &clk_m_val=0.
      &clk_n_val=0.
      &clk_2d_val=0.
      
      gosub Set_Clock_Freq
      return
    )
    else if ("&clk_desired_freq"=="46.4")
    (
      &clk_src_name="GPLL0_OUT_MAIN"
      &clk_src_sel=SRC_SEL TODO.
      &clk_src_div=2.
      &clk_m_val=29.
      &clk_n_val=375.
      &clk_2d_val=375.
      
      gosub Set_Clock_Freq
      return
    )
    else if ("&clk_desired_freq"=="48.0")
    (
      &clk_src_name="GPLL0_OUT_MAIN"
      &clk_src_sel=SRC_SEL TODO.
      &clk_src_div=25.
      &clk_m_val=0.
      &clk_n_val=0.
      &clk_2d_val=0.
      
      gosub Set_Clock_Freq
      return
    )
    else if ("&clk_desired_freq"=="51.2")
    (
      &clk_src_name="GPLL0_OUT_MAIN"
      &clk_src_sel=SRC_SEL TODO.
      &clk_src_div=2.
      &clk_m_val=32.
      &clk_n_val=375.
      &clk_2d_val=375.
      
      gosub Set_Clock_Freq
      return
    )
    else if ("&clk_desired_freq"=="56.0")
    (
      &clk_src_name="GPLL0_OUT_MAIN"
      &clk_src_sel=SRC_SEL TODO.
      &clk_src_div=2.
      &clk_m_val=7.
      &clk_n_val=75.
      &clk_2d_val=75.
      
      gosub Set_Clock_Freq
      return
    )
    else if ("&clk_desired_freq"=="58.9824")
    (
      &clk_src_name="GPLL0_OUT_MAIN"
      &clk_src_sel=SRC_SEL TODO.
      &clk_src_div=2.
      &clk_m_val=1536.
      &clk_n_val=15625.
      &clk_2d_val=15625.
      
      gosub Set_Clock_Freq
      return
    )
    else if ("&clk_desired_freq"=="60.0")
    (
      &clk_src_name="GPLL0_OUT_MAIN"
      &clk_src_sel=SRC_SEL TODO.
      &clk_src_div=20.
      &clk_m_val=0.
      &clk_n_val=0.
      &clk_2d_val=0.
      
      gosub Set_Clock_Freq
      return
    )
    else if ("&clk_desired_freq"=="63.157895")
    (
      &clk_src_name="GPLL0_OUT_MAIN"
      &clk_src_sel=SRC_SEL TODO.
      &clk_src_div=19.
      &clk_m_val=0.
      &clk_n_val=0.
      &clk_2d_val=0.
      
      gosub Set_Clock_Freq
      return
    )
    else if ("&clk_desired_freq"=="r")
    (
      return
    )
    else
    (
      print "Invalid selection."
      goto Set_Clock_Freq_Enter
    )
  )

  if ("&clk"=="gcc_blsp1_uart1_sim_clk")||("&clk"=="gcc_blsp1_uart2_sim_clk")||("&clk"=="gcc_blsp1_uart3_sim_clk")||("&clk"=="gcc_blsp2_uart1_sim_clk")||("&clk"=="gcc_blsp2_uart2_sim_clk")||("&clk"=="gcc_blsp2_uart3_sim_clk")
  (
    gosub PRINT_SET_CLOCK_FREQ_WARNING

    &clk_cmd_rcgr_addr=&HWIO_GCC_BLSP_UART_SIM_CMD_RCGR_ADDR
    &clk_cfg_rcgr_addr=&HWIO_GCC_BLSP_UART_SIM_CFG_RCGR_ADDR

    print "Choose frequency (MHz) from list below: " 

    print "3.84           " 

    print " "
    print "Enter desired frequency (r to return): "
    enter &clk_desired_freq
    print " "

    if ("&clk_desired_freq"=="3.84")
    (
      &clk_src_name="XO"
      &clk_src_sel=SRC_SEL TODO.
      &clk_src_div=10.
      &clk_m_val=0.
      &clk_n_val=0.
      &clk_2d_val=0.
      
      gosub Set_Clock_Freq
      return
    )
    else if ("&clk_desired_freq"=="r")
    (
      return
    )
    else
    (
      print "Invalid selection."
      goto Set_Clock_Freq_Enter
    )
  )

  if ("&clk"=="gcc_ce1_clk")
  (
    gosub PRINT_SET_CLOCK_FREQ_WARNING

    &clk_cmd_rcgr_addr=&HWIO_GCC_CE1_CMD_RCGR_ADDR
    &clk_cfg_rcgr_addr=&HWIO_GCC_CE1_CFG_RCGR_ADDR

    print "Choose frequency (MHz) from list below: " 

    print "42.857143      85.714286      171.428571     " 

    print " "
    print "Enter desired frequency (r to return): "
    enter &clk_desired_freq
    print " "

    if ("&clk_desired_freq"=="42.857143")
    (
      &clk_src_name="GPLL0_OUT_MAIN"
      &clk_src_sel=SRC_SEL TODO.
      &clk_src_div=28.
      &clk_m_val=0.
      &clk_n_val=0.
      &clk_2d_val=0.
      
      gosub Set_Clock_Freq
      return
    )
    else if ("&clk_desired_freq"=="85.714286")
    (
      &clk_src_name="GPLL0_OUT_MAIN"
      &clk_src_sel=SRC_SEL TODO.
      &clk_src_div=14.
      &clk_m_val=0.
      &clk_n_val=0.
      &clk_2d_val=0.
      
      gosub Set_Clock_Freq
      return
    )
    else if ("&clk_desired_freq"=="171.428571")
    (
      &clk_src_name="GPLL0_OUT_MAIN"
      &clk_src_sel=SRC_SEL TODO.
      &clk_src_div=7.
      &clk_m_val=0.
      &clk_n_val=0.
      &clk_2d_val=0.
      
      gosub Set_Clock_Freq
      return
    )
    else if ("&clk_desired_freq"=="r")
    (
      return
    )
    else
    (
      print "Invalid selection."
      goto Set_Clock_Freq_Enter
    )
  )

  if ("&clk"=="gcc_aggre1_cnoc_periph_ahb_clk")||("&clk"=="gcc_aggre2_cnoc_periph_ahb_clk")||("&clk"=="gcc_blsp1_ahb_clk")||("&clk"=="gcc_blsp2_ahb_clk")||("&clk"=="gcc_cnoc_periph_bus_timeout1_ahb_clk")||("&clk"=="gcc_cnoc_periph_bus_timeout2_ahb_clk")||("&clk"=="gcc_cnoc_periph_east_ahb_clk")||("&clk"=="gcc_cnoc_periph_west_ahb_clk")||("&clk"=="gcc_pdm_ahb_clk")||("&clk"=="gcc_sdcc2_ahb_clk")||("&clk"=="gcc_sdcc4_ahb_clk")||("&clk"=="gcc_spdm_pnoc_cy_clk")||("&clk"=="gcc_tsif_ahb_clk")||("&clk"=="gcc_usb_phy_cfg_ahb2phy_clk")
  (
    gosub PRINT_SET_CLOCK_FREQ_WARNING

    &clk_cmd_rcgr_addr=&HWIO_GCC_CNOC_PERIPH_CMD_RCGR_ADDR
    &clk_cfg_rcgr_addr=&HWIO_GCC_CNOC_PERIPH_CFG_RCGR_ADDR

    print "Choose frequency (MHz) from list below: " 

    print "19.2           37.5           50.0           " 
    print "75.0           100.0          " 

    print " "
    print "Enter desired frequency (r to return): "
    enter &clk_desired_freq
    print " "

    if ("&clk_desired_freq"=="19.2")
    (
      &clk_src_name="XO"
      &clk_src_sel=SRC_SEL TODO.
      &clk_src_div=2.
      &clk_m_val=0.
      &clk_n_val=0.
      &clk_2d_val=0.
      
      gosub Set_Clock_Freq
      return
    )
    else if ("&clk_desired_freq"=="37.5")
    (
      &clk_src_name="GPLL0_OUT_MAIN"
      &clk_src_sel=SRC_SEL TODO.
      &clk_src_div=32.
      &clk_m_val=0.
      &clk_n_val=0.
      &clk_2d_val=0.
      
      gosub Set_Clock_Freq
      return
    )
    else if ("&clk_desired_freq"=="50.0")
    (
      &clk_src_name="GPLL0_OUT_MAIN"
      &clk_src_sel=SRC_SEL TODO.
      &clk_src_div=24.
      &clk_m_val=0.
      &clk_n_val=0.
      &clk_2d_val=0.
      
      gosub Set_Clock_Freq
      return
    )
    else if ("&clk_desired_freq"=="75.0")
    (
      &clk_src_name="GPLL0_OUT_MAIN"
      &clk_src_sel=SRC_SEL TODO.
      &clk_src_div=16.
      &clk_m_val=0.
      &clk_n_val=0.
      &clk_2d_val=0.
      
      gosub Set_Clock_Freq
      return
    )
    else if ("&clk_desired_freq"=="100.0")
    (
      &clk_src_name="GPLL0_OUT_MAIN"
      &clk_src_sel=SRC_SEL TODO.
      &clk_src_div=12.
      &clk_m_val=0.
      &clk_n_val=0.
      &clk_2d_val=0.
      
      gosub Set_Clock_Freq
      return
    )
    else if ("&clk_desired_freq"=="r")
    (
      return
    )
    else
    (
      print "Invalid selection."
      goto Set_Clock_Freq_Enter
    )
  )

  if ("&clk"=="gcc_aggre1_cnoc_ahb_clk")||("&clk"=="gcc_aggre1_noc_msmpu_cfg_ahb_clk")||("&clk"=="gcc_aggre2_cnoc_ahb_clk")||("&clk"=="gcc_aggre2_noc_msmpu_cfg_ahb_clk")||("&clk"=="gcc_ahb_clk")||("&clk"=="gcc_bimc_cfg_ahb_clk")||("&clk"=="gcc_bimc_nius_cfg_ahb_clk")||("&clk"=="gcc_boot_rom_ahb_clk")||("&clk"=="gcc_ce1_ahb_clk")||("&clk"=="gcc_cfg_noc_ahb_clk")||("&clk"=="gcc_cfg_noc_east_ahb_clk")||("&clk"=="gcc_cfg_noc_north_ahb_clk")||("&clk"=="gcc_cfg_noc_west_ahb_clk")||("&clk"=="gcc_cnoc_bus_timeout0_ahb_clk")||("&clk"=="gcc_cnoc_bus_timeout10_ahb_clk")||("&clk"=="gcc_cnoc_bus_timeout11_ahb_clk")||("&clk"=="gcc_cnoc_bus_timeout12_ahb_clk")||("&clk"=="gcc_cnoc_bus_timeout1_ahb_clk")||("&clk"=="gcc_cnoc_bus_timeout2_ahb_clk")||("&clk"=="gcc_cnoc_bus_timeout3_ahb_clk")||("&clk"=="gcc_cnoc_bus_timeout4_ahb_clk")||("&clk"=="gcc_cnoc_bus_timeout6_ahb_clk")||("&clk"=="gcc_cnoc_bus_timeout7_ahb_clk")||("&clk"=="gcc_cnoc_bus_timeout8_ahb_clk")||("&clk"=="gcc_cnoc_bus_timeout9_ahb_clk")||("&clk"=="gcc_cnoc_mst_rpm_ahb_clk")||("&clk"=="gcc_dcc_ahb_clk")||("&clk"=="gcc_glm_ahb_clk")||("&clk"=="gcc_gpu_cfg_ahb_clk")||("&clk"=="gcc_imem_cfg_ahb_clk")||("&clk"=="gcc_ipa_ahb_clk")||("&clk"=="gcc_lpass_core_smmu_ahb_clk")||("&clk"=="gcc_lpass_q6_smmu_ahb_clk")||("&clk"=="gcc_lpass_smmu_aon_ahb_clk")||("&clk"=="gcc_mccc_cfg_ahb_clk")||("&clk"=="gcc_mmss_noc_cfg_ahb_clk")||("&clk"=="gcc_mmss_qm_ahb_clk")||("&clk"=="gcc_mpm_ahb_clk")||("&clk"=="gcc_msg_ram_ahb_clk")||("&clk"=="gcc_mss_cfg_ahb_clk")||("&clk"=="gcc_mss_msmpu_cfg_ahb_clk")||("&clk"=="gcc_mss_q6_msmpu_cfg_ahb_clk")||("&clk"=="gcc_pcie_0_cfg_ahb_clk")||("&clk"=="gcc_pimem_ahb_clk")||("&clk"=="gcc_prng_ahb_clk")||("&clk"=="gcc_qdss_cfg_ahb_clk")||("&clk"=="gcc_qdss_dap_ahb_clk")||("&clk"=="gcc_rbcpr_cx_ahb_clk")||("&clk"=="gcc_rbcpr_mx_ahb_clk")||("&clk"=="gcc_rpm_mst_m2_cnoc_ahb_clk")||("&clk"=="gcc_sec_ctrl_ahb_clk")||("&clk"=="gcc_sec_ctrl_boot_rom_patch_clk")||("&clk"=="gcc_skl_ahb_clk")||("&clk"=="gcc_smmu_aggre1_ahb_clk")||("&clk"=="gcc_smmu_aggre2_ahb_clk")||("&clk"=="gcc_snoc_cnoc_ahb_clk")||("&clk"=="gcc_spdm_cfg_ahb_clk")||("&clk"=="gcc_spdm_mstr_ahb_clk")||("&clk"=="gcc_spmi_cnoc_ahb_clk")||("&clk"=="gcc_spss_cfg_ahb_clk")||("&clk"=="gcc_spss_scsr_clk")||("&clk"=="gcc_ssc_cnoc_ahbs_clk")||("&clk"=="gcc_ssc_cnoc_mpu_clk")||("&clk"=="gcc_tcsr_ahb_clk")||("&clk"=="gcc_tic_cfg_ahb_clk")||("&clk"=="gcc_tlmm_clk")||("&clk"=="gcc_tlmm_east_ahb_clk")||("&clk"=="gcc_tlmm_north_ahb_clk")||("&clk"=="gcc_tlmm_west_ahb_clk")||("&clk"=="gcc_ufs_ahb_clk")
  (
    gosub PRINT_SET_CLOCK_FREQ_WARNING

    &clk_cmd_rcgr_addr=&HWIO_GCC_CONFIG_NOC_CMD_RCGR_ADDR
    &clk_cfg_rcgr_addr=&HWIO_GCC_CONFIG_NOC_CFG_RCGR_ADDR

    print "Choose frequency (MHz) from list below: " 

    print "19.2           37.5           75.0           " 

    print " "
    print "Enter desired frequency (r to return): "
    enter &clk_desired_freq
    print " "

    if ("&clk_desired_freq"=="19.2")
    (
      &clk_src_name="XO"
      &clk_src_sel=SRC_SEL TODO.
      &clk_src_div=2.
      &clk_m_val=0.
      &clk_n_val=0.
      &clk_2d_val=0.
      
      gosub Set_Clock_Freq
      return
    )
    else if ("&clk_desired_freq"=="37.5")
    (
      &clk_src_name="GPLL0_OUT_MAIN"
      &clk_src_sel=SRC_SEL TODO.
      &clk_src_div=32.
      &clk_m_val=0.
      &clk_n_val=0.
      &clk_2d_val=0.
      
      gosub Set_Clock_Freq
      return
    )
    else if ("&clk_desired_freq"=="75.0")
    (
      &clk_src_name="GPLL0_OUT_MAIN"
      &clk_src_sel=SRC_SEL TODO.
      &clk_src_div=16.
      &clk_m_val=0.
      &clk_n_val=0.
      &clk_2d_val=0.
      
      gosub Set_Clock_Freq
      return
    )
    else if ("&clk_desired_freq"=="r")
    (
      return
    )
    else
    (
      print "Invalid selection."
      goto Set_Clock_Freq_Enter
    )
  )

  if ("&clk"=="gcc_aggre1_noc_xo_clk")||("&clk"=="gcc_ahb2phy_east_clk")||("&clk"=="gcc_cfg_noc_ah2phy_xo_clk")||("&clk"=="gcc_cfg_noc_dcd_xo_clk")||("&clk"=="gcc_cfg_noc_east_dcd_xo_clk")||("&clk"=="gcc_cfg_noc_north_dcd_xo_clk")||("&clk"=="gcc_cfg_noc_west_dcd_xo_clk")||("&clk"=="gcc_cm_phy_refgen1_clk")||("&clk"=="gcc_cm_phy_refgen2_clk")||("&clk"=="gcc_cnoc_bus_timeout13_ahb_clk")||("&clk"=="gcc_glm_xo_clk")||("&clk"=="gcc_pdm_xo4_clk")||("&clk"=="gcc_qdss_xo_clk")||("&clk"=="gcc_qrefs_vbg_cal_clk")||("&clk"=="gcc_rpm_timer_clk")||("&clk"=="gcc_spdm_ff_clk")||("&clk"=="gcc_spss_xo_clk")||("&clk"=="gcc_sram_sensor_xo_clk")||("&clk"=="gcc_ssc_xo_clk")||("&clk"=="gcc_sys_noc_dcd_xo_clk")||("&clk"=="gcc_xo_clk")||("&clk"=="gcc_xo_div4_clk")
  (
    gosub PRINT_SET_CLOCK_FREQ_WARNING

    &clk_cmd_rcgr_addr=&HWIO_GCC_GCC_XO_CMD_RCGR_ADDR
    &clk_cfg_rcgr_addr=&HWIO_GCC_GCC_XO_CFG_RCGR_ADDR

    print "Choose frequency (MHz) from list below: " 

    print "19.2           " 

    print " "
    print "Enter desired frequency (r to return): "
    enter &clk_desired_freq
    print " "

    if ("&clk_desired_freq"=="19.2")
    (
      &clk_src_name="XO"
      &clk_src_sel=SRC_SEL TODO.
      &clk_src_div=2.
      &clk_m_val=0.
      &clk_n_val=0.
      &clk_2d_val=0.
      
      gosub Set_Clock_Freq
      return
    )
    else if ("&clk_desired_freq"=="r")
    (
      return
    )
    else
    (
      print "Invalid selection."
      goto Set_Clock_Freq_Enter
    )
  )

  if ("&clk"=="gcc_gp1_clk")
  (
    gosub PRINT_SET_CLOCK_FREQ_WARNING

    &clk_cmd_rcgr_addr=&HWIO_GCC_GP1_CMD_RCGR_ADDR
    &clk_cfg_rcgr_addr=&HWIO_GCC_GP1_CFG_RCGR_ADDR

    print "Choose frequency (MHz) from list below: " 

    print "19.2           100.0          200.0          " 

    print " "
    print "Enter desired frequency (r to return): "
    enter &clk_desired_freq
    print " "

    if ("&clk_desired_freq"=="19.2")
    (
      &clk_src_name="XO"
      &clk_src_sel=SRC_SEL TODO.
      &clk_src_div=2.
      &clk_m_val=0.
      &clk_n_val=0.
      &clk_2d_val=0.
      
      gosub Set_Clock_Freq
      return
    )
    else if ("&clk_desired_freq"=="100.0")
    (
      &clk_src_name="GPLL0_OUT_MAIN"
      &clk_src_sel=SRC_SEL TODO.
      &clk_src_div=12.
      &clk_m_val=0.
      &clk_n_val=0.
      &clk_2d_val=0.
      
      gosub Set_Clock_Freq
      return
    )
    else if ("&clk_desired_freq"=="200.0")
    (
      &clk_src_name="GPLL0_OUT_MAIN"
      &clk_src_sel=SRC_SEL TODO.
      &clk_src_div=6.
      &clk_m_val=0.
      &clk_n_val=0.
      &clk_2d_val=0.
      
      gosub Set_Clock_Freq
      return
    )
    else if ("&clk_desired_freq"=="r")
    (
      return
    )
    else
    (
      print "Invalid selection."
      goto Set_Clock_Freq_Enter
    )
  )

  if ("&clk"=="gcc_gp2_clk")
  (
    gosub PRINT_SET_CLOCK_FREQ_WARNING

    &clk_cmd_rcgr_addr=&HWIO_GCC_GP2_CMD_RCGR_ADDR
    &clk_cfg_rcgr_addr=&HWIO_GCC_GP2_CFG_RCGR_ADDR

    print "Choose frequency (MHz) from list below: " 

    print "19.2           100.0          200.0          " 

    print " "
    print "Enter desired frequency (r to return): "
    enter &clk_desired_freq
    print " "

    if ("&clk_desired_freq"=="19.2")
    (
      &clk_src_name="XO"
      &clk_src_sel=SRC_SEL TODO.
      &clk_src_div=2.
      &clk_m_val=0.
      &clk_n_val=0.
      &clk_2d_val=0.
      
      gosub Set_Clock_Freq
      return
    )
    else if ("&clk_desired_freq"=="100.0")
    (
      &clk_src_name="GPLL0_OUT_MAIN"
      &clk_src_sel=SRC_SEL TODO.
      &clk_src_div=12.
      &clk_m_val=0.
      &clk_n_val=0.
      &clk_2d_val=0.
      
      gosub Set_Clock_Freq
      return
    )
    else if ("&clk_desired_freq"=="200.0")
    (
      &clk_src_name="GPLL0_OUT_MAIN"
      &clk_src_sel=SRC_SEL TODO.
      &clk_src_div=6.
      &clk_m_val=0.
      &clk_n_val=0.
      &clk_2d_val=0.
      
      gosub Set_Clock_Freq
      return
    )
    else if ("&clk_desired_freq"=="r")
    (
      return
    )
    else
    (
      print "Invalid selection."
      goto Set_Clock_Freq_Enter
    )
  )

  if ("&clk"=="gcc_gp3_clk")
  (
    gosub PRINT_SET_CLOCK_FREQ_WARNING

    &clk_cmd_rcgr_addr=&HWIO_GCC_GP3_CMD_RCGR_ADDR
    &clk_cfg_rcgr_addr=&HWIO_GCC_GP3_CFG_RCGR_ADDR

    print "Choose frequency (MHz) from list below: " 

    print "19.2           100.0          200.0          " 

    print " "
    print "Enter desired frequency (r to return): "
    enter &clk_desired_freq
    print " "

    if ("&clk_desired_freq"=="19.2")
    (
      &clk_src_name="XO"
      &clk_src_sel=SRC_SEL TODO.
      &clk_src_div=2.
      &clk_m_val=0.
      &clk_n_val=0.
      &clk_2d_val=0.
      
      gosub Set_Clock_Freq
      return
    )
    else if ("&clk_desired_freq"=="100.0")
    (
      &clk_src_name="GPLL0_OUT_MAIN"
      &clk_src_sel=SRC_SEL TODO.
      &clk_src_div=12.
      &clk_m_val=0.
      &clk_n_val=0.
      &clk_2d_val=0.
      
      gosub Set_Clock_Freq
      return
    )
    else if ("&clk_desired_freq"=="200.0")
    (
      &clk_src_name="GPLL0_OUT_MAIN"
      &clk_src_sel=SRC_SEL TODO.
      &clk_src_div=6.
      &clk_m_val=0.
      &clk_n_val=0.
      &clk_2d_val=0.
      
      gosub Set_Clock_Freq
      return
    )
    else if ("&clk_desired_freq"=="r")
    (
      return
    )
    else
    (
      print "Invalid selection."
      goto Set_Clock_Freq_Enter
    )
  )

  if ("&clk"=="gcc_gpu_vs_clk")
  (
    gosub PRINT_SET_CLOCK_FREQ_WARNING

    &clk_cmd_rcgr_addr=&HWIO_GCC_GPU_VS_CMD_RCGR_ADDR
    &clk_cfg_rcgr_addr=&HWIO_GCC_GPU_VS_CFG_RCGR_ADDR

    print "Choose frequency (MHz) from list below: " 

    print "400.0          600.0          " 

    print " "
    print "Enter desired frequency (r to return): "
    enter &clk_desired_freq
    print " "

    if ("&clk_desired_freq"=="400.0")
    (
      &clk_src_name="GPLL0_OUT_MAIN"
      &clk_src_sel=SRC_SEL TODO.
      &clk_src_div=3.
      &clk_m_val=0.
      &clk_n_val=0.
      &clk_2d_val=0.
      
      gosub Set_Clock_Freq
      return
    )
    else if ("&clk_desired_freq"=="600.0")
    (
      &clk_src_name="GPLL0_OUT_MAIN"
      &clk_src_sel=SRC_SEL TODO.
      &clk_src_div=2.
      &clk_m_val=0.
      &clk_n_val=0.
      &clk_2d_val=0.
      
      gosub Set_Clock_Freq
      return
    )
    else if ("&clk_desired_freq"=="r")
    (
      return
    )
    else
    (
      print "Invalid selection."
      goto Set_Clock_Freq_Enter
    )
  )

  if ("&clk"=="gcc_hmss_ahb_clk")||("&clk"=="gcc_snoc_bus_timeout0_ahb_clk")||("&clk"=="gcc_sys_noc_hmss_ahb_clk")
  (
    gosub PRINT_SET_CLOCK_FREQ_WARNING

    &clk_cmd_rcgr_addr=&HWIO_GCC_HMSS_AHB_CMD_RCGR_ADDR
    &clk_cfg_rcgr_addr=&HWIO_GCC_HMSS_AHB_CFG_RCGR_ADDR

    print "Choose frequency (MHz) from list below: " 

    print "19.2           37.5           75.0           " 

    print " "
    print "Enter desired frequency (r to return): "
    enter &clk_desired_freq
    print " "

    if ("&clk_desired_freq"=="19.2")
    (
      &clk_src_name="XO"
      &clk_src_sel=SRC_SEL TODO.
      &clk_src_div=2.
      &clk_m_val=0.
      &clk_n_val=0.
      &clk_2d_val=0.
      
      gosub Set_Clock_Freq
      return
    )
    else if ("&clk_desired_freq"=="37.5")
    (
      &clk_src_name="GPLL0_OUT_MAIN"
      &clk_src_sel=SRC_SEL TODO.
      &clk_src_div=32.
      &clk_m_val=0.
      &clk_n_val=0.
      &clk_2d_val=0.
      
      gosub Set_Clock_Freq
      return
    )
    else if ("&clk_desired_freq"=="75.0")
    (
      &clk_src_name="GPLL0_OUT_MAIN"
      &clk_src_sel=SRC_SEL TODO.
      &clk_src_div=16.
      &clk_m_val=0.
      &clk_n_val=0.
      &clk_2d_val=0.
      
      gosub Set_Clock_Freq
      return
    )
    else if ("&clk_desired_freq"=="r")
    (
      return
    )
    else
    (
      print "Invalid selection."
      goto Set_Clock_Freq_Enter
    )
  )

  if ("&clk"=="gcc_hmss_rbcpr_clk")
  (
    gosub PRINT_SET_CLOCK_FREQ_WARNING

    &clk_cmd_rcgr_addr=&HWIO_GCC_HMSS_RBCPR_CMD_RCGR_ADDR
    &clk_cfg_rcgr_addr=&HWIO_GCC_HMSS_RBCPR_CFG_RCGR_ADDR

    print "Choose frequency (MHz) from list below: " 

    print "19.2           " 

    print " "
    print "Enter desired frequency (r to return): "
    enter &clk_desired_freq
    print " "

    if ("&clk_desired_freq"=="19.2")
    (
      &clk_src_name="XO"
      &clk_src_sel=SRC_SEL TODO.
      &clk_src_div=2.
      &clk_m_val=0.
      &clk_n_val=0.
      &clk_2d_val=0.
      
      gosub Set_Clock_Freq
      return
    )
    else if ("&clk_desired_freq"=="r")
    (
      return
    )
    else
    (
      print "Invalid selection."
      goto Set_Clock_Freq_Enter
    )
  )

  if ("&clk"=="gcc_mss_vs_clk")
  (
    gosub PRINT_SET_CLOCK_FREQ_WARNING

    &clk_cmd_rcgr_addr=&HWIO_GCC_MSS_VS_CMD_RCGR_ADDR
    &clk_cfg_rcgr_addr=&HWIO_GCC_MSS_VS_CFG_RCGR_ADDR

    print "Choose frequency (MHz) from list below: " 

    print "400.0          600.0          " 

    print " "
    print "Enter desired frequency (r to return): "
    enter &clk_desired_freq
    print " "

    if ("&clk_desired_freq"=="400.0")
    (
      &clk_src_name="GPLL0_OUT_MAIN"
      &clk_src_sel=SRC_SEL TODO.
      &clk_src_div=3.
      &clk_m_val=0.
      &clk_n_val=0.
      &clk_2d_val=0.
      
      gosub Set_Clock_Freq
      return
    )
    else if ("&clk_desired_freq"=="600.0")
    (
      &clk_src_name="GPLL0_OUT_MAIN"
      &clk_src_sel=SRC_SEL TODO.
      &clk_src_div=2.
      &clk_m_val=0.
      &clk_n_val=0.
      &clk_2d_val=0.
      
      gosub Set_Clock_Freq
      return
    )
    else if ("&clk_desired_freq"=="r")
    (
      return
    )
    else
    (
      print "Invalid selection."
      goto Set_Clock_Freq_Enter
    )
  )

  if ("&clk"=="gcc_pcie_0_aux_clk")||("&clk"=="gcc_pcie_phy_aux_clk")
  (
    gosub PRINT_SET_CLOCK_FREQ_WARNING

    &clk_cmd_rcgr_addr=&HWIO_GCC_PCIE_AUX_CMD_RCGR_ADDR
    &clk_cfg_rcgr_addr=&HWIO_GCC_PCIE_AUX_CFG_RCGR_ADDR

    print "Choose frequency (MHz) from list below: " 

    print "1.010526       " 

    print " "
    print "Enter desired frequency (r to return): "
    enter &clk_desired_freq
    print " "

    if ("&clk_desired_freq"=="1.010526")
    (
      &clk_src_name="XO"
      &clk_src_sel=SRC_SEL TODO.
      &clk_src_div=2.
      &clk_m_val=1.
      &clk_n_val=19.
      &clk_2d_val=19.
      
      gosub Set_Clock_Freq
      return
    )
    else if ("&clk_desired_freq"=="r")
    (
      return
    )
    else
    (
      print "Invalid selection."
      goto Set_Clock_Freq_Enter
    )
  )

  if ("&clk"=="gcc_pdm2_clk")
  (
    gosub PRINT_SET_CLOCK_FREQ_WARNING

    &clk_cmd_rcgr_addr=&HWIO_GCC_PDM2_CMD_RCGR_ADDR
    &clk_cfg_rcgr_addr=&HWIO_GCC_PDM2_CFG_RCGR_ADDR

    print "Choose frequency (MHz) from list below: " 

    print "60.0           " 

    print " "
    print "Enter desired frequency (r to return): "
    enter &clk_desired_freq
    print " "

    if ("&clk_desired_freq"=="60.0")
    (
      &clk_src_name="GPLL0_OUT_MAIN"
      &clk_src_sel=SRC_SEL TODO.
      &clk_src_div=20.
      &clk_m_val=0.
      &clk_n_val=0.
      &clk_2d_val=0.
      
      gosub Set_Clock_Freq
      return
    )
    else if ("&clk_desired_freq"=="r")
    (
      return
    )
    else
    (
      print "Invalid selection."
      goto Set_Clock_Freq_Enter
    )
  )

  if ("&clk"=="gcc_bimc_pimem_axi_clk")||("&clk"=="gcc_pimem_axi_clk")||("&clk"=="gcc_sys_noc_pimem_axi_clk")
  (
    gosub PRINT_SET_CLOCK_FREQ_WARNING

    &clk_cmd_rcgr_addr=&HWIO_GCC_PIMEM_AXI_CMD_RCGR_ADDR
    &clk_cfg_rcgr_addr=&HWIO_GCC_PIMEM_AXI_CFG_RCGR_ADDR

    print "Choose frequency (MHz) from list below: " 

    print "19.2           50.0           100.0          " 
    print "150.0          150.0          200.0          " 
    print "240.0          240.0          " 

    print " "
    print "Enter desired frequency (r to return): "
    enter &clk_desired_freq
    print " "

    if ("&clk_desired_freq"=="19.2")
    (
      &clk_src_name="XO"
      &clk_src_sel=SRC_SEL TODO.
      &clk_src_div=2.
      &clk_m_val=0.
      &clk_n_val=0.
      &clk_2d_val=0.
      
      gosub Set_Clock_Freq
      return
    )
    else if ("&clk_desired_freq"=="50.0")
    (
      &clk_src_name="PLL0_EARLY_DIV_CLK_SRC"
      &clk_src_sel=SRC_SEL TODO.
      &clk_src_div=12.
      &clk_m_val=0.
      &clk_n_val=0.
      &clk_2d_val=0.
      
      gosub Set_Clock_Freq
      return
    )
    else if ("&clk_desired_freq"=="100.0")
    (
      &clk_src_name="GPLL0_OUT_MAIN"
      &clk_src_sel=SRC_SEL TODO.
      &clk_src_div=12.
      &clk_m_val=0.
      &clk_n_val=0.
      &clk_2d_val=0.
      
      gosub Set_Clock_Freq
      return
    )
    else if ("&clk_desired_freq"=="150.0")
    (
      &clk_src_name="GPLL0_OUT_MAIN"
      &clk_src_sel=SRC_SEL TODO.
      &clk_src_div=8.
      &clk_m_val=0.
      &clk_n_val=0.
      &clk_2d_val=0.
      
      gosub Set_Clock_Freq
      return
    )
    else if ("&clk_desired_freq"=="150.0")
    (
      &clk_src_name="GPLL0_OUT_MAIN"
      &clk_src_sel=SRC_SEL TODO.
      &clk_src_div=8.
      &clk_m_val=0.
      &clk_n_val=0.
      &clk_2d_val=0.
      
      gosub Set_Clock_Freq
      return
    )
    else if ("&clk_desired_freq"=="200.0")
    (
      &clk_src_name="GPLL0_OUT_MAIN"
      &clk_src_sel=SRC_SEL TODO.
      &clk_src_div=6.
      &clk_m_val=0.
      &clk_n_val=0.
      &clk_2d_val=0.
      
      gosub Set_Clock_Freq
      return
    )
    else if ("&clk_desired_freq"=="240.0")
    (
      &clk_src_name="GPLL0_OUT_MAIN"
      &clk_src_sel=SRC_SEL TODO.
      &clk_src_div=5.
      &clk_m_val=0.
      &clk_n_val=0.
      &clk_2d_val=0.
      
      gosub Set_Clock_Freq
      return
    )
    else if ("&clk_desired_freq"=="240.0")
    (
      &clk_src_name="GPLL0_OUT_MAIN"
      &clk_src_sel=SRC_SEL TODO.
      &clk_src_div=5.
      &clk_m_val=0.
      &clk_n_val=0.
      &clk_2d_val=0.
      
      gosub Set_Clock_Freq
      return
    )
    else if ("&clk_desired_freq"=="r")
    (
      return
    )
    else
    (
      print "Invalid selection."
      goto Set_Clock_Freq_Enter
    )
  )

  if ("&clk"=="gcc_center_apb_clk")||("&clk"=="gcc_east_apb_clk")||("&clk"=="gcc_gpu_trig_clk")||("&clk"=="gcc_hmss_trig_clk")||("&clk"=="gcc_lpass_trig_clk")||("&clk"=="gcc_mmss_trig_clk")||("&clk"=="gcc_mss_trig_clk")||("&clk"=="gcc_north_apb_clk")||("&clk"=="gcc_qdss_apb2jtag_clk")||("&clk"=="gcc_qdss_dap_clk")||("&clk"=="gcc_qdss_trig_clk")||("&clk"=="gcc_spss_trig_clk")||("&clk"=="gcc_ssc_apb_clk")||("&clk"=="gcc_wcss_apb_clk")||("&clk"=="gcc_west_apb_clk")
  (
    gosub PRINT_SET_CLOCK_FREQ_WARNING

    &clk_cmd_rcgr_addr=&HWIO_GCC_QDSS_APB_TRIG_CMD_RCGR_ADDR
    &clk_cfg_rcgr_addr=&HWIO_GCC_QDSS_APB_TRIG_CFG_RCGR_ADDR

    print "Choose frequency (MHz) from list below: " 

    print "75.0           150.0          " 

    print " "
    print "Enter desired frequency (r to return): "
    enter &clk_desired_freq
    print " "

    if ("&clk_desired_freq"=="75.0")
    (
      &clk_src_name="PLL0_EARLY_DIV_CLK_SRC"
      &clk_src_sel=SRC_SEL TODO.
      &clk_src_div=8.
      &clk_m_val=0.
      &clk_n_val=0.
      &clk_2d_val=0.
      
      gosub Set_Clock_Freq
      return
    )
    else if ("&clk_desired_freq"=="150.0")
    (
      &clk_src_name="GPLL0_OUT_MAIN"
      &clk_src_sel=SRC_SEL TODO.
      &clk_src_div=8.
      &clk_m_val=0.
      &clk_n_val=0.
      &clk_2d_val=0.
      
      gosub Set_Clock_Freq
      return
    )
    else if ("&clk_desired_freq"=="r")
    (
      return
    )
    else
    (
      print "Invalid selection."
      goto Set_Clock_Freq_Enter
    )
  )

  if ("&clk"=="gcc_aggre1_noc_at_clk")||("&clk"=="gcc_aggre2_noc_at_clk")||("&clk"=="gcc_east_at_clk")||("&clk"=="gcc_gpu_at_clk")||("&clk"=="gcc_hmss_at_clk")||("&clk"=="gcc_mmss_at_clk")||("&clk"=="gcc_mmss_noc_at_clk")||("&clk"=="gcc_qdss_center_at_clk")||("&clk"=="gcc_sys_noc_at_clk")||("&clk"=="gcc_wcss_at_clk")||("&clk"=="gcc_west_at_clk")
  (
    gosub PRINT_SET_CLOCK_FREQ_WARNING

    &clk_cmd_rcgr_addr=&HWIO_GCC_QDSS_ATB_A_CMD_RCGR_ADDR
    &clk_cfg_rcgr_addr=&HWIO_GCC_QDSS_ATB_A_CFG_RCGR_ADDR

    print "Choose frequency (MHz) from list below: " 

    print "60.0           120.0          240.0          " 

    print " "
    print "Enter desired frequency (r to return): "
    enter &clk_desired_freq
    print " "

    if ("&clk_desired_freq"=="60.0")
    (
      &clk_src_name="PLL0_EARLY_DIV_CLK_SRC"
      &clk_src_sel=SRC_SEL TODO.
      &clk_src_div=10.
      &clk_m_val=0.
      &clk_n_val=0.
      &clk_2d_val=0.
      
      gosub Set_Clock_Freq
      return
    )
    else if ("&clk_desired_freq"=="120.0")
    (
      &clk_src_name="GPLL0_OUT_MAIN"
      &clk_src_sel=SRC_SEL TODO.
      &clk_src_div=10.
      &clk_m_val=0.
      &clk_n_val=0.
      &clk_2d_val=0.
      
      gosub Set_Clock_Freq
      return
    )
    else if ("&clk_desired_freq"=="240.0")
    (
      &clk_src_name="GPLL0_OUT_MAIN"
      &clk_src_sel=SRC_SEL TODO.
      &clk_src_div=5.
      &clk_m_val=0.
      &clk_n_val=0.
      &clk_2d_val=0.
      
      gosub Set_Clock_Freq
      return
    )
    else if ("&clk_desired_freq"=="r")
    (
      return
    )
    else
    (
      print "Invalid selection."
      goto Set_Clock_Freq_Enter
    )
  )

  if ("&clk"=="gcc_qdss_stm_clk")||("&clk"=="gcc_sys_noc_qdss_stm_axi_clk")
  (
    gosub PRINT_SET_CLOCK_FREQ_WARNING

    &clk_cmd_rcgr_addr=&HWIO_GCC_QDSS_STM_CMD_RCGR_ADDR
    &clk_cfg_rcgr_addr=&HWIO_GCC_QDSS_STM_CFG_RCGR_ADDR

    print "Choose frequency (MHz) from list below: " 

    print "50.0           100.0          200.0          " 

    print " "
    print "Enter desired frequency (r to return): "
    enter &clk_desired_freq
    print " "

    if ("&clk_desired_freq"=="50.0")
    (
      &clk_src_name="PLL0_EARLY_DIV_CLK_SRC"
      &clk_src_sel=SRC_SEL TODO.
      &clk_src_div=12.
      &clk_m_val=0.
      &clk_n_val=0.
      &clk_2d_val=0.
      
      gosub Set_Clock_Freq
      return
    )
    else if ("&clk_desired_freq"=="100.0")
    (
      &clk_src_name="GPLL0_OUT_MAIN"
      &clk_src_sel=SRC_SEL TODO.
      &clk_src_div=12.
      &clk_m_val=0.
      &clk_n_val=0.
      &clk_2d_val=0.
      
      gosub Set_Clock_Freq
      return
    )
    else if ("&clk_desired_freq"=="200.0")
    (
      &clk_src_name="GPLL0_OUT_MAIN"
      &clk_src_sel=SRC_SEL TODO.
      &clk_src_div=6.
      &clk_m_val=0.
      &clk_n_val=0.
      &clk_2d_val=0.
      
      gosub Set_Clock_Freq
      return
    )
    else if ("&clk_desired_freq"=="r")
    (
      return
    )
    else
    (
      print "Invalid selection."
      goto Set_Clock_Freq_Enter
    )
  )

  if ("&clk"=="gcc_qdss_traceclkin_clk")
  (
    gosub PRINT_SET_CLOCK_FREQ_WARNING

    &clk_cmd_rcgr_addr=&HWIO_GCC_QDSS_TRACECLKIN_CMD_RCGR_ADDR
    &clk_cfg_rcgr_addr=&HWIO_GCC_QDSS_TRACECLKIN_CFG_RCGR_ADDR

    print "Choose frequency (MHz) from list below: " 

    print "75.0           150.0          300.0          " 

    print " "
    print "Enter desired frequency (r to return): "
    enter &clk_desired_freq
    print " "

    if ("&clk_desired_freq"=="75.0")
    (
      &clk_src_name="PLL0_EARLY_DIV_CLK_SRC"
      &clk_src_sel=SRC_SEL TODO.
      &clk_src_div=8.
      &clk_m_val=0.
      &clk_n_val=0.
      &clk_2d_val=0.
      
      gosub Set_Clock_Freq
      return
    )
    else if ("&clk_desired_freq"=="150.0")
    (
      &clk_src_name="GPLL0_OUT_MAIN"
      &clk_src_sel=SRC_SEL TODO.
      &clk_src_div=8.
      &clk_m_val=0.
      &clk_n_val=0.
      &clk_2d_val=0.
      
      gosub Set_Clock_Freq
      return
    )
    else if ("&clk_desired_freq"=="300.0")
    (
      &clk_src_name="GPLL0_OUT_MAIN"
      &clk_src_sel=SRC_SEL TODO.
      &clk_src_div=4.
      &clk_m_val=0.
      &clk_n_val=0.
      &clk_2d_val=0.
      
      gosub Set_Clock_Freq
      return
    )
    else if ("&clk_desired_freq"=="r")
    (
      return
    )
    else
    (
      print "Invalid selection."
      goto Set_Clock_Freq_Enter
    )
  )

  if ("&clk"=="gcc_qdss_tsctr_div16_clk")||("&clk"=="gcc_qdss_tsctr_div2_clk")||("&clk"=="gcc_qdss_tsctr_div3_clk")||("&clk"=="gcc_qdss_tsctr_div4_clk")||("&clk"=="gcc_qdss_tsctr_div8_clk")||("&clk"=="gcc_wcss_tsctr_div2_clk")||("&clk"=="gcc_apss_qdss_tsctr_div2_clk")||("&clk"=="gcc_apss_qdss_tsctr_div8_clk")
  (
    gosub PRINT_SET_CLOCK_FREQ_WARNING

    &clk_cmd_rcgr_addr=&HWIO_GCC_QDSS_TSCTR_CMD_RCGR_ADDR
    &clk_cfg_rcgr_addr=&HWIO_GCC_QDSS_TSCTR_CFG_RCGR_ADDR

    print "Choose frequency (MHz) from list below: " 

    print "150.0          150.0          300.0          " 
    print "300.0          600.0          600.0          " 

    print " "
    print "Enter desired frequency (r to return): "
    enter &clk_desired_freq
    print " "

    if ("&clk_desired_freq"=="150.0")
    (
      &clk_src_name="PLL0_EARLY_DIV_CLK_SRC"
      &clk_src_sel=SRC_SEL TODO.
      &clk_src_div=4.
      &clk_m_val=0.
      &clk_n_val=0.
      &clk_2d_val=0.
      
      gosub Set_Clock_Freq
      return
    )
    else if ("&clk_desired_freq"=="150.0")
    (
      &clk_src_name="PLL0_EARLY_DIV_CLK_SRC"
      &clk_src_sel=SRC_SEL TODO.
      &clk_src_div=4.
      &clk_m_val=0.
      &clk_n_val=0.
      &clk_2d_val=0.
      
      gosub Set_Clock_Freq
      return
    )
    else if ("&clk_desired_freq"=="300.0")
    (
      &clk_src_name="GPLL0_OUT_MAIN"
      &clk_src_sel=SRC_SEL TODO.
      &clk_src_div=4.
      &clk_m_val=0.
      &clk_n_val=0.
      &clk_2d_val=0.
      
      gosub Set_Clock_Freq
      return
    )
    else if ("&clk_desired_freq"=="300.0")
    (
      &clk_src_name="GPLL0_OUT_MAIN"
      &clk_src_sel=SRC_SEL TODO.
      &clk_src_div=4.
      &clk_m_val=0.
      &clk_n_val=0.
      &clk_2d_val=0.
      
      gosub Set_Clock_Freq
      return
    )
    else if ("&clk_desired_freq"=="600.0")
    (
      &clk_src_name="GPLL0_OUT_MAIN"
      &clk_src_sel=SRC_SEL TODO.
      &clk_src_div=2.
      &clk_m_val=0.
      &clk_n_val=0.
      &clk_2d_val=0.
      
      gosub Set_Clock_Freq
      return
    )
    else if ("&clk_desired_freq"=="600.0")
    (
      &clk_src_name="GPLL0_OUT_MAIN"
      &clk_src_sel=SRC_SEL TODO.
      &clk_src_div=2.
      &clk_m_val=0.
      &clk_n_val=0.
      &clk_2d_val=0.
      
      gosub Set_Clock_Freq
      return
    )
    else if ("&clk_desired_freq"=="r")
    (
      return
    )
    else
    (
      print "Invalid selection."
      goto Set_Clock_Freq_Enter
    )
  )

  if ("&clk"=="gcc_rbcpr_cx_clk")
  (
    gosub PRINT_SET_CLOCK_FREQ_WARNING

    &clk_cmd_rcgr_addr=&HWIO_GCC_RBCPR_CX_CMD_RCGR_ADDR
    &clk_cfg_rcgr_addr=&HWIO_GCC_RBCPR_CX_CFG_RCGR_ADDR

    print "Choose frequency (MHz) from list below: " 

    print "19.2           " 

    print " "
    print "Enter desired frequency (r to return): "
    enter &clk_desired_freq
    print " "

    if ("&clk_desired_freq"=="19.2")
    (
      &clk_src_name="XO"
      &clk_src_sel=SRC_SEL TODO.
      &clk_src_div=2.
      &clk_m_val=0.
      &clk_n_val=0.
      &clk_2d_val=0.
      
      gosub Set_Clock_Freq
      return
    )
    else if ("&clk_desired_freq"=="r")
    (
      return
    )
    else
    (
      print "Invalid selection."
      goto Set_Clock_Freq_Enter
    )
  )

  if ("&clk"=="gcc_rbcpr_mx_clk")
  (
    gosub PRINT_SET_CLOCK_FREQ_WARNING

    &clk_cmd_rcgr_addr=&HWIO_GCC_RBCPR_MX_CMD_RCGR_ADDR
    &clk_cfg_rcgr_addr=&HWIO_GCC_RBCPR_MX_CFG_RCGR_ADDR

    print "Choose frequency (MHz) from list below: " 

    print "19.2           " 

    print " "
    print "Enter desired frequency (r to return): "
    enter &clk_desired_freq
    print " "

    if ("&clk_desired_freq"=="19.2")
    (
      &clk_src_name="XO"
      &clk_src_sel=SRC_SEL TODO.
      &clk_src_div=2.
      &clk_m_val=0.
      &clk_n_val=0.
      &clk_2d_val=0.
      
      gosub Set_Clock_Freq
      return
    )
    else if ("&clk_desired_freq"=="r")
    (
      return
    )
    else
    (
      print "Invalid selection."
      goto Set_Clock_Freq_Enter
    )
  )

  if ("&clk"=="gcc_rpm_bus_ahb_clk")||("&clk"=="gcc_rpm_proc_fclk")||("&clk"=="gcc_rpm_proc_hclk")||("&clk"=="gcc_spdm_rpm_cy_clk")
  (
    gosub PRINT_SET_CLOCK_FREQ_WARNING

    &clk_cmd_rcgr_addr=&HWIO_GCC_RPM_CMD_RCGR_ADDR
    &clk_cfg_rcgr_addr=&HWIO_GCC_RPM_CFG_RCGR_ADDR

    print "Choose frequency (MHz) from list below: " 

    print "19.2           300.0          400.0          " 
    print "600.0          " 

    print " "
    print "Enter desired frequency (r to return): "
    enter &clk_desired_freq
    print " "

    if ("&clk_desired_freq"=="19.2")
    (
      &clk_src_name="XO"
      &clk_src_sel=SRC_SEL TODO.
      &clk_src_div=2.
      &clk_m_val=0.
      &clk_n_val=0.
      &clk_2d_val=0.
      
      gosub Set_Clock_Freq
      return
    )
    else if ("&clk_desired_freq"=="300.0")
    (
      &clk_src_name="PLL0_EARLY_DIV_CLK_SRC"
      &clk_src_sel=SRC_SEL TODO.
      &clk_src_div=2.
      &clk_m_val=0.
      &clk_n_val=0.
      &clk_2d_val=0.
      
      gosub Set_Clock_Freq
      return
    )
    else if ("&clk_desired_freq"=="400.0")
    (
      &clk_src_name="GPLL0_OUT_MAIN"
      &clk_src_sel=SRC_SEL TODO.
      &clk_src_div=3.
      &clk_m_val=0.
      &clk_n_val=0.
      &clk_2d_val=0.
      
      gosub Set_Clock_Freq
      return
    )
    else if ("&clk_desired_freq"=="600.0")
    (
      &clk_src_name="GPLL0_OUT_MAIN"
      &clk_src_sel=SRC_SEL TODO.
      &clk_src_div=2.
      &clk_m_val=0.
      &clk_n_val=0.
      &clk_2d_val=0.
      
      gosub Set_Clock_Freq
      return
    )
    else if ("&clk_desired_freq"=="r")
    (
      return
    )
    else
    (
      print "Invalid selection."
      goto Set_Clock_Freq_Enter
    )
  )

  if ("&clk"=="gcc_sdcc2_apps_clk")
  (
    gosub PRINT_SET_CLOCK_FREQ_WARNING

    &clk_cmd_rcgr_addr=&HWIO_GCC_SDCC2_APPS_CMD_RCGR_ADDR
    &clk_cfg_rcgr_addr=&HWIO_GCC_SDCC2_APPS_CFG_RCGR_ADDR

    print "Choose frequency (MHz) from list below: " 

    print "0.144          0.4            20.0           " 
    print "25.0           50.0           100.0          " 
    print "200.0          " 

    print " "
    print "Enter desired frequency (r to return): "
    enter &clk_desired_freq
    print " "

    if ("&clk_desired_freq"=="0.144")
    (
      &clk_src_name="XO"
      &clk_src_sel=SRC_SEL TODO.
      &clk_src_div=32.
      &clk_m_val=3.
      &clk_n_val=25.
      &clk_2d_val=25.
      
      gosub Set_Clock_Freq
      return
    )
    else if ("&clk_desired_freq"=="0.4")
    (
      &clk_src_name="XO"
      &clk_src_sel=SRC_SEL TODO.
      &clk_src_div=24.
      &clk_m_val=1.
      &clk_n_val=4.
      &clk_2d_val=4.
      
      gosub Set_Clock_Freq
      return
    )
    else if ("&clk_desired_freq"=="20.0")
    (
      &clk_src_name="GPLL0_OUT_MAIN"
      &clk_src_sel=SRC_SEL TODO.
      &clk_src_div=30.
      &clk_m_val=1.
      &clk_n_val=2.
      &clk_2d_val=2.
      
      gosub Set_Clock_Freq
      return
    )
    else if ("&clk_desired_freq"=="25.0")
    (
      &clk_src_name="GPLL0_OUT_MAIN"
      &clk_src_sel=SRC_SEL TODO.
      &clk_src_div=24.
      &clk_m_val=1.
      &clk_n_val=2.
      &clk_2d_val=2.
      
      gosub Set_Clock_Freq
      return
    )
    else if ("&clk_desired_freq"=="50.0")
    (
      &clk_src_name="GPLL0_OUT_MAIN"
      &clk_src_sel=SRC_SEL TODO.
      &clk_src_div=24.
      &clk_m_val=0.
      &clk_n_val=0.
      &clk_2d_val=0.
      
      gosub Set_Clock_Freq
      return
    )
    else if ("&clk_desired_freq"=="100.0")
    (
      &clk_src_name="GPLL0_OUT_MAIN"
      &clk_src_sel=SRC_SEL TODO.
      &clk_src_div=12.
      &clk_m_val=0.
      &clk_n_val=0.
      &clk_2d_val=0.
      
      gosub Set_Clock_Freq
      return
    )
    else if ("&clk_desired_freq"=="200.0")
    (
      &clk_src_name="GPLL0_OUT_MAIN"
      &clk_src_sel=SRC_SEL TODO.
      &clk_src_div=6.
      &clk_m_val=0.
      &clk_n_val=0.
      &clk_2d_val=0.
      
      gosub Set_Clock_Freq
      return
    )
    else if ("&clk_desired_freq"=="r")
    (
      return
    )
    else
    (
      print "Invalid selection."
      goto Set_Clock_Freq_Enter
    )
  )

  if ("&clk"=="gcc_sdcc4_apps_clk")
  (
    gosub PRINT_SET_CLOCK_FREQ_WARNING

    &clk_cmd_rcgr_addr=&HWIO_GCC_SDCC4_APPS_CMD_RCGR_ADDR
    &clk_cfg_rcgr_addr=&HWIO_GCC_SDCC4_APPS_CFG_RCGR_ADDR

    print "Choose frequency (MHz) from list below: " 

    print "0.144          0.4            20.0           " 
    print "25.0           50.0           100.0          " 

    print " "
    print "Enter desired frequency (r to return): "
    enter &clk_desired_freq
    print " "

    if ("&clk_desired_freq"=="0.144")
    (
      &clk_src_name="XO"
      &clk_src_sel=SRC_SEL TODO.
      &clk_src_div=32.
      &clk_m_val=3.
      &clk_n_val=25.
      &clk_2d_val=25.
      
      gosub Set_Clock_Freq
      return
    )
    else if ("&clk_desired_freq"=="0.4")
    (
      &clk_src_name="XO"
      &clk_src_sel=SRC_SEL TODO.
      &clk_src_div=24.
      &clk_m_val=1.
      &clk_n_val=4.
      &clk_2d_val=4.
      
      gosub Set_Clock_Freq
      return
    )
    else if ("&clk_desired_freq"=="20.0")
    (
      &clk_src_name="GPLL0_OUT_MAIN"
      &clk_src_sel=SRC_SEL TODO.
      &clk_src_div=30.
      &clk_m_val=1.
      &clk_n_val=2.
      &clk_2d_val=2.
      
      gosub Set_Clock_Freq
      return
    )
    else if ("&clk_desired_freq"=="25.0")
    (
      &clk_src_name="GPLL0_OUT_MAIN"
      &clk_src_sel=SRC_SEL TODO.
      &clk_src_div=24.
      &clk_m_val=1.
      &clk_n_val=2.
      &clk_2d_val=2.
      
      gosub Set_Clock_Freq
      return
    )
    else if ("&clk_desired_freq"=="50.0")
    (
      &clk_src_name="GPLL0_OUT_MAIN"
      &clk_src_sel=SRC_SEL TODO.
      &clk_src_div=24.
      &clk_m_val=0.
      &clk_n_val=0.
      &clk_2d_val=0.
      
      gosub Set_Clock_Freq
      return
    )
    else if ("&clk_desired_freq"=="100.0")
    (
      &clk_src_name="GPLL0_OUT_MAIN"
      &clk_src_sel=SRC_SEL TODO.
      &clk_src_div=12.
      &clk_m_val=0.
      &clk_n_val=0.
      &clk_2d_val=0.
      
      gosub Set_Clock_Freq
      return
    )
    else if ("&clk_desired_freq"=="r")
    (
      return
    )
    else
    (
      print "Invalid selection."
      goto Set_Clock_Freq_Enter
    )
  )

  if ("&clk"=="gcc_spmi_ahb_clk")
  (
    gosub PRINT_SET_CLOCK_FREQ_WARNING

    &clk_cmd_rcgr_addr=&HWIO_GCC_SPMI_AHB_CMD_RCGR_ADDR
    &clk_cfg_rcgr_addr=&HWIO_GCC_SPMI_AHB_CFG_RCGR_ADDR

    print "Choose frequency (MHz) from list below: " 

    print "37.5           " 

    print " "
    print "Enter desired frequency (r to return): "
    enter &clk_desired_freq
    print " "

    if ("&clk_desired_freq"=="37.5")
    (
      &clk_src_name="GPLL0_OUT_MAIN"
      &clk_src_sel=SRC_SEL TODO.
      &clk_src_div=32.
      &clk_m_val=0.
      &clk_n_val=0.
      &clk_2d_val=0.
      
      gosub Set_Clock_Freq
      return
    )
    else if ("&clk_desired_freq"=="r")
    (
      return
    )
    else
    (
      print "Invalid selection."
      goto Set_Clock_Freq_Enter
    )
  )

  if ("&clk"=="gcc_spmi_ser_clk")
  (
    gosub PRINT_SET_CLOCK_FREQ_WARNING

    &clk_cmd_rcgr_addr=&HWIO_GCC_SPMI_SER_CMD_RCGR_ADDR
    &clk_cfg_rcgr_addr=&HWIO_GCC_SPMI_SER_CFG_RCGR_ADDR

    print "Choose frequency (MHz) from list below: " 

    print "19.2           " 

    print " "
    print "Enter desired frequency (r to return): "
    enter &clk_desired_freq
    print " "

    if ("&clk_desired_freq"=="19.2")
    (
      &clk_src_name="XO"
      &clk_src_sel=SRC_SEL TODO.
      &clk_src_div=2.
      &clk_m_val=0.
      &clk_n_val=0.
      &clk_2d_val=0.
      
      gosub Set_Clock_Freq
      return
    )
    else if ("&clk_desired_freq"=="r")
    (
      return
    )
    else
    (
      print "Invalid selection."
      goto Set_Clock_Freq_Enter
    )
  )

  if ("&clk"=="gcc_bimc_nius_hs_axi_clk")||("&clk"=="gcc_bimc_sysnoc_hs_axi_clk")||("&clk"=="gcc_lpass_q6_axi_clk")||("&clk"=="gcc_lpass_q6_smmu_axi_clk")||("&clk"=="gcc_lpass_q6_smmu_axi_src_clk")||("&clk"=="gcc_mss_mnoc_bimc_axi_clk")||("&clk"=="gcc_mss_msmpu_client_axi_clk")||("&clk"=="gcc_sys_noc_hs_axi_clk")
  (
    gosub PRINT_SET_CLOCK_FREQ_WARNING

    &clk_cmd_rcgr_addr=&HWIO_GCC_SYS_NOC_HS_AXI_CMD_RCGR_ADDR
    &clk_cfg_rcgr_addr=&HWIO_GCC_SYS_NOC_HS_AXI_CFG_RCGR_ADDR

    print "Choose frequency (MHz) from list below: " 

    print "19.2           100.0          200.0          " 
    print "300.0          400.0          533.0          " 

    print " "
    print "Enter desired frequency (r to return): "
    enter &clk_desired_freq
    print " "

    if ("&clk_desired_freq"=="19.2")
    (
      &clk_src_name="XO"
      &clk_src_sel=SRC_SEL TODO.
      &clk_src_div=2.
      &clk_m_val=0.
      &clk_n_val=0.
      &clk_2d_val=0.
      
      gosub Set_Clock_Freq
      return
    )
    else if ("&clk_desired_freq"=="100.0")
    (
      &clk_src_name="PLL0_EARLY_DIV_CLK_SRC"
      &clk_src_sel=SRC_SEL TODO.
      &clk_src_div=6.
      &clk_m_val=0.
      &clk_n_val=0.
      &clk_2d_val=0.
      
      gosub Set_Clock_Freq
      return
    )
    else if ("&clk_desired_freq"=="200.0")
    (
      &clk_src_name="GPLL0_OUT_MAIN"
      &clk_src_sel=SRC_SEL TODO.
      &clk_src_div=6.
      &clk_m_val=0.
      &clk_n_val=0.
      &clk_2d_val=0.
      
      gosub Set_Clock_Freq
      return
    )
    else if ("&clk_desired_freq"=="300.0")
    (
      &clk_src_name="GPLL0_OUT_MAIN"
      &clk_src_sel=SRC_SEL TODO.
      &clk_src_div=4.
      &clk_m_val=0.
      &clk_n_val=0.
      &clk_2d_val=0.
      
      gosub Set_Clock_Freq
      return
    )
    else if ("&clk_desired_freq"=="400.0")
    (
      &clk_src_name="GPLL0_OUT_MAIN"
      &clk_src_sel=SRC_SEL TODO.
      &clk_src_div=3.
      &clk_m_val=0.
      &clk_n_val=0.
      &clk_2d_val=0.
      
      gosub Set_Clock_Freq
      return
    )
    else if ("&clk_desired_freq"=="533.0")
    (
      &clk_src_name="GPLL1_OUT_MAIN"
      &clk_src_sel=SRC_SEL TODO.
      &clk_src_div=2.
      &clk_m_val=0.
      &clk_n_val=0.
      &clk_2d_val=0.
      
      gosub Set_Clock_Freq
      return
    )
    else if ("&clk_desired_freq"=="r")
    (
      return
    )
    else
    (
      print "Invalid selection."
      goto Set_Clock_Freq_Enter
    )
  )

  if ("&clk"=="gcc_aggre1_snoc_axi_clk")||("&clk"=="gcc_aggre1_snoc_msmpu_client_axi_clk")||("&clk"=="gcc_aggre2_snoc_axi_clk")||("&clk"=="gcc_aggre2_snoc_east_axi_clk")||("&clk"=="gcc_aggre2_snoc_msmpu_client_axi_clk")||("&clk"=="gcc_aggre2_snoc_north_axi_clk")||("&clk"=="gcc_bimc_nius_axi_clk")||("&clk"=="gcc_bimc_sysnoc_axi_clk")||("&clk"=="gcc_ce1_axi_clk")||("&clk"=="gcc_hmss_dvm_bus_clk")||("&clk"=="gcc_imem_axi_clk")||("&clk"=="gcc_lpass_core_smmu_client_clk")||("&clk"=="gcc_lpass_core_smmu_client_src_clk")||("&clk"=="gcc_lpass_sway_clk")||("&clk"=="gcc_mmss_sys_noc_axi_clk")||("&clk"=="gcc_mss_snoc_axi_clk")||("&clk"=="gcc_pcie_0_mstr_axi_clk")||("&clk"=="gcc_pcie_0_slv_axi_clk")||("&clk"=="gcc_qdss_etr_usb_clk")||("&clk"=="gcc_smmu_aggre1_axi_clk")||("&clk"=="gcc_smmu_aggre1_axi_src_clk")||("&clk"=="gcc_smmu_aggre2_axi_clk")||("&clk"=="gcc_smmu_aggre2_axi_src_clk")||("&clk"=="gcc_snoc_bus_timeout1_ahb_clk")||("&clk"=="gcc_snoc_bus_timeout3_ahb_clk")||("&clk"=="gcc_spdm_snoc_cy_clk")||("&clk"=="gcc_spss_snoc_emm_clk")||("&clk"=="gcc_ssc_snoc_ahbm_clk")||("&clk"=="gcc_sys_noc_axi_clk")||("&clk"=="gcc_sys_noc_east_axi_clk")||("&clk"=="gcc_sys_noc_ssc_q6_axi_clk")||("&clk"=="gcc_sys_noc_west_axi_clk")||("&clk"=="gcc_wcss_ahb_s0_clk")||("&clk"=="gcc_wcss_axi_m_clk")||("&clk"=="gcc_wcss_ecahb_clk")||("&clk"=="gcc_wcss_shdreg_ahb_clk")
  (
    gosub PRINT_SET_CLOCK_FREQ_WARNING

    &clk_cmd_rcgr_addr=&HWIO_GCC_SYSTEM_NOC_CMD_RCGR_ADDR
    &clk_cfg_rcgr_addr=&HWIO_GCC_SYSTEM_NOC_CFG_RCGR_ADDR

    print "Choose frequency (MHz) from list below: " 

    print "19.2           50.0           100.0          " 
    print "150.0          200.0          240.0          " 

    print " "
    print "Enter desired frequency (r to return): "
    enter &clk_desired_freq
    print " "

    if ("&clk_desired_freq"=="19.2")
    (
      &clk_src_name="XO"
      &clk_src_sel=SRC_SEL TODO.
      &clk_src_div=2.
      &clk_m_val=0.
      &clk_n_val=0.
      &clk_2d_val=0.
      
      gosub Set_Clock_Freq
      return
    )
    else if ("&clk_desired_freq"=="50.0")
    (
      &clk_src_name="PLL0_EARLY_DIV_CLK_SRC"
      &clk_src_sel=SRC_SEL TODO.
      &clk_src_div=12.
      &clk_m_val=0.
      &clk_n_val=0.
      &clk_2d_val=0.
      
      gosub Set_Clock_Freq
      return
    )
    else if ("&clk_desired_freq"=="100.0")
    (
      &clk_src_name="GPLL0_OUT_MAIN"
      &clk_src_sel=SRC_SEL TODO.
      &clk_src_div=12.
      &clk_m_val=0.
      &clk_n_val=0.
      &clk_2d_val=0.
      
      gosub Set_Clock_Freq
      return
    )
    else if ("&clk_desired_freq"=="150.0")
    (
      &clk_src_name="GPLL0_OUT_MAIN"
      &clk_src_sel=SRC_SEL TODO.
      &clk_src_div=8.
      &clk_m_val=0.
      &clk_n_val=0.
      &clk_2d_val=0.
      
      gosub Set_Clock_Freq
      return
    )
    else if ("&clk_desired_freq"=="200.0")
    (
      &clk_src_name="GPLL0_OUT_MAIN"
      &clk_src_sel=SRC_SEL TODO.
      &clk_src_div=6.
      &clk_m_val=0.
      &clk_n_val=0.
      &clk_2d_val=0.
      
      gosub Set_Clock_Freq
      return
    )
    else if ("&clk_desired_freq"=="240.0")
    (
      &clk_src_name="GPLL0_OUT_MAIN"
      &clk_src_sel=SRC_SEL TODO.
      &clk_src_div=5.
      &clk_m_val=0.
      &clk_n_val=0.
      &clk_2d_val=0.
      
      gosub Set_Clock_Freq
      return
    )
    else if ("&clk_desired_freq"=="r")
    (
      return
    )
    else
    (
      print "Invalid selection."
      goto Set_Clock_Freq_Enter
    )
  )

  if ("&clk"=="gcc_tsif_ref_clk")
  (
    gosub PRINT_SET_CLOCK_FREQ_WARNING

    &clk_cmd_rcgr_addr=&HWIO_GCC_TSIF_REF_CMD_RCGR_ADDR
    &clk_cfg_rcgr_addr=&HWIO_GCC_TSIF_REF_CFG_RCGR_ADDR

    print "Choose frequency (MHz) from list below: " 

    print "0.105495       " 

    print " "
    print "Enter desired frequency (r to return): "
    enter &clk_desired_freq
    print " "

    if ("&clk_desired_freq"=="0.105495")
    (
      &clk_src_name="XO"
      &clk_src_sel=SRC_SEL TODO.
      &clk_src_div=2.
      &clk_m_val=1.
      &clk_n_val=182.
      &clk_2d_val=182.
      
      gosub Set_Clock_Freq
      return
    )
    else if ("&clk_desired_freq"=="r")
    (
      return
    )
    else
    (
      print "Invalid selection."
      goto Set_Clock_Freq_Enter
    )
  )

  if ("&clk"=="gcc_aggre1_ufs_axi_clk")||("&clk"=="gcc_ufs_axi_clk")
  (
    gosub PRINT_SET_CLOCK_FREQ_WARNING

    &clk_cmd_rcgr_addr=&HWIO_GCC_UFS_AXI_CMD_RCGR_ADDR
    &clk_cfg_rcgr_addr=&HWIO_GCC_UFS_AXI_CFG_RCGR_ADDR

    print "Choose frequency (MHz) from list below: " 

    print "100.0          200.0          240.0          " 

    print " "
    print "Enter desired frequency (r to return): "
    enter &clk_desired_freq
    print " "

    if ("&clk_desired_freq"=="100.0")
    (
      &clk_src_name="GPLL0_OUT_MAIN"
      &clk_src_sel=SRC_SEL TODO.
      &clk_src_div=12.
      &clk_m_val=0.
      &clk_n_val=0.
      &clk_2d_val=0.
      
      gosub Set_Clock_Freq
      return
    )
    else if ("&clk_desired_freq"=="200.0")
    (
      &clk_src_name="GPLL0_OUT_MAIN"
      &clk_src_sel=SRC_SEL TODO.
      &clk_src_div=6.
      &clk_m_val=0.
      &clk_n_val=0.
      &clk_2d_val=0.
      
      gosub Set_Clock_Freq
      return
    )
    else if ("&clk_desired_freq"=="240.0")
    (
      &clk_src_name="GPLL0_OUT_MAIN"
      &clk_src_sel=SRC_SEL TODO.
      &clk_src_div=5.
      &clk_m_val=0.
      &clk_n_val=0.
      &clk_2d_val=0.
      
      gosub Set_Clock_Freq
      return
    )
    else if ("&clk_desired_freq"=="r")
    (
      return
    )
    else
    (
      print "Invalid selection."
      goto Set_Clock_Freq_Enter
    )
  )

  if ("&clk"=="gcc_aggre1_usb3_axi_clk")||("&clk"=="gcc_cfg_noc_usb3_axi_clk")||("&clk"=="gcc_cnoc_bus_timeout14_ahb_clk")||("&clk"=="gcc_usb30_master_clk")
  (
    gosub PRINT_SET_CLOCK_FREQ_WARNING

    &clk_cmd_rcgr_addr=&HWIO_GCC_USB30_MASTER_CMD_RCGR_ADDR
    &clk_cfg_rcgr_addr=&HWIO_GCC_USB30_MASTER_CFG_RCGR_ADDR

    print "Choose frequency (MHz) from list below: " 

    print "19.2           120.0          150.0          " 

    print " "
    print "Enter desired frequency (r to return): "
    enter &clk_desired_freq
    print " "

    if ("&clk_desired_freq"=="19.2")
    (
      &clk_src_name="XO"
      &clk_src_sel=SRC_SEL TODO.
      &clk_src_div=2.
      &clk_m_val=0.
      &clk_n_val=0.
      &clk_2d_val=0.
      
      gosub Set_Clock_Freq
      return
    )
    else if ("&clk_desired_freq"=="120.0")
    (
      &clk_src_name="GPLL0_OUT_MAIN"
      &clk_src_sel=SRC_SEL TODO.
      &clk_src_div=10.
      &clk_m_val=0.
      &clk_n_val=0.
      &clk_2d_val=0.
      
      gosub Set_Clock_Freq
      return
    )
    else if ("&clk_desired_freq"=="150.0")
    (
      &clk_src_name="GPLL0_OUT_MAIN"
      &clk_src_sel=SRC_SEL TODO.
      &clk_src_div=8.
      &clk_m_val=0.
      &clk_n_val=0.
      &clk_2d_val=0.
      
      gosub Set_Clock_Freq
      return
    )
    else if ("&clk_desired_freq"=="r")
    (
      return
    )
    else
    (
      print "Invalid selection."
      goto Set_Clock_Freq_Enter
    )
  )

  if ("&clk"=="gcc_usb30_mock_utmi_clk")
  (
    gosub PRINT_SET_CLOCK_FREQ_WARNING

    &clk_cmd_rcgr_addr=&HWIO_GCC_USB30_MOCK_UTMI_CMD_RCGR_ADDR
    &clk_cfg_rcgr_addr=&HWIO_GCC_USB30_MOCK_UTMI_CFG_RCGR_ADDR

    print "Choose frequency (MHz) from list below: " 

    print "19.2           " 

    print " "
    print "Enter desired frequency (r to return): "
    enter &clk_desired_freq
    print " "

    if ("&clk_desired_freq"=="19.2")
    (
      &clk_src_name="XO"
      &clk_src_sel=SRC_SEL TODO.
      &clk_src_div=2.
      &clk_m_val=0.
      &clk_n_val=0.
      &clk_2d_val=0.
      
      gosub Set_Clock_Freq
      return
    )
    else if ("&clk_desired_freq"=="r")
    (
      return
    )
    else
    (
      print "Invalid selection."
      goto Set_Clock_Freq_Enter
    )
  )

  if ("&clk"=="gcc_usb3_phy_aux_clk")
  (
    gosub PRINT_SET_CLOCK_FREQ_WARNING

    &clk_cmd_rcgr_addr=&HWIO_GCC_USB3_PHY_AUX_CMD_RCGR_ADDR
    &clk_cfg_rcgr_addr=&HWIO_GCC_USB3_PHY_AUX_CFG_RCGR_ADDR

    print "Choose frequency (MHz) from list below: " 

    print "1.2            " 

    print " "
    print "Enter desired frequency (r to return): "
    enter &clk_desired_freq
    print " "

    if ("&clk_desired_freq"=="1.2")
    (
      &clk_src_name="XO"
      &clk_src_sel=SRC_SEL TODO.
      &clk_src_div=32.
      &clk_m_val=0.
      &clk_n_val=0.
      &clk_2d_val=0.
      
      gosub Set_Clock_Freq
      return
    )
    else if ("&clk_desired_freq"=="r")
    (
      return
    )
    else
    (
      print "Invalid selection."
      goto Set_Clock_Freq_Enter
    )
  )

  if ("&clk"=="gcc_vdda_vs_clk")
  (
    gosub PRINT_SET_CLOCK_FREQ_WARNING

    &clk_cmd_rcgr_addr=&HWIO_GCC_VDDA_VS_CMD_RCGR_ADDR
    &clk_cfg_rcgr_addr=&HWIO_GCC_VDDA_VS_CFG_RCGR_ADDR

    print "Choose frequency (MHz) from list below: " 

    print "400.0          600.0          " 

    print " "
    print "Enter desired frequency (r to return): "
    enter &clk_desired_freq
    print " "

    if ("&clk_desired_freq"=="400.0")
    (
      &clk_src_name="GPLL0_OUT_MAIN"
      &clk_src_sel=SRC_SEL TODO.
      &clk_src_div=3.
      &clk_m_val=0.
      &clk_n_val=0.
      &clk_2d_val=0.
      
      gosub Set_Clock_Freq
      return
    )
    else if ("&clk_desired_freq"=="600.0")
    (
      &clk_src_name="GPLL0_OUT_MAIN"
      &clk_src_sel=SRC_SEL TODO.
      &clk_src_div=2.
      &clk_m_val=0.
      &clk_n_val=0.
      &clk_2d_val=0.
      
      gosub Set_Clock_Freq
      return
    )
    else if ("&clk_desired_freq"=="r")
    (
      return
    )
    else
    (
      print "Invalid selection."
      goto Set_Clock_Freq_Enter
    )
  )

  if ("&clk"=="gcc_vddcx_vs_clk")
  (
    gosub PRINT_SET_CLOCK_FREQ_WARNING

    &clk_cmd_rcgr_addr=&HWIO_GCC_VDDCX_VS_CMD_RCGR_ADDR
    &clk_cfg_rcgr_addr=&HWIO_GCC_VDDCX_VS_CFG_RCGR_ADDR

    print "Choose frequency (MHz) from list below: " 

    print "400.0          600.0          " 

    print " "
    print "Enter desired frequency (r to return): "
    enter &clk_desired_freq
    print " "

    if ("&clk_desired_freq"=="400.0")
    (
      &clk_src_name="GPLL0_OUT_MAIN"
      &clk_src_sel=SRC_SEL TODO.
      &clk_src_div=3.
      &clk_m_val=0.
      &clk_n_val=0.
      &clk_2d_val=0.
      
      gosub Set_Clock_Freq
      return
    )
    else if ("&clk_desired_freq"=="600.0")
    (
      &clk_src_name="GPLL0_OUT_MAIN"
      &clk_src_sel=SRC_SEL TODO.
      &clk_src_div=2.
      &clk_m_val=0.
      &clk_n_val=0.
      &clk_2d_val=0.
      
      gosub Set_Clock_Freq
      return
    )
    else if ("&clk_desired_freq"=="r")
    (
      return
    )
    else
    (
      print "Invalid selection."
      goto Set_Clock_Freq_Enter
    )
  )

  if ("&clk"=="gcc_vddmx_vs_clk")
  (
    gosub PRINT_SET_CLOCK_FREQ_WARNING

    &clk_cmd_rcgr_addr=&HWIO_GCC_VDDMX_VS_CMD_RCGR_ADDR
    &clk_cfg_rcgr_addr=&HWIO_GCC_VDDMX_VS_CFG_RCGR_ADDR

    print "Choose frequency (MHz) from list below: " 

    print "400.0          600.0          " 

    print " "
    print "Enter desired frequency (r to return): "
    enter &clk_desired_freq
    print " "

    if ("&clk_desired_freq"=="400.0")
    (
      &clk_src_name="GPLL0_OUT_MAIN"
      &clk_src_sel=SRC_SEL TODO.
      &clk_src_div=3.
      &clk_m_val=0.
      &clk_n_val=0.
      &clk_2d_val=0.
      
      gosub Set_Clock_Freq
      return
    )
    else if ("&clk_desired_freq"=="600.0")
    (
      &clk_src_name="GPLL0_OUT_MAIN"
      &clk_src_sel=SRC_SEL TODO.
      &clk_src_div=2.
      &clk_m_val=0.
      &clk_n_val=0.
      &clk_2d_val=0.
      
      gosub Set_Clock_Freq
      return
    )
    else if ("&clk_desired_freq"=="r")
    (
      return
    )
    else
    (
      print "Invalid selection."
      goto Set_Clock_Freq_Enter
    )
  )

  if ("&clk"=="gcc_vs_ctrl_clk")
  (
    gosub PRINT_SET_CLOCK_FREQ_WARNING

    &clk_cmd_rcgr_addr=&HWIO_GCC_VS_CTRL_CMD_RCGR_ADDR
    &clk_cfg_rcgr_addr=&HWIO_GCC_VS_CTRL_CFG_RCGR_ADDR

    print "Choose frequency (MHz) from list below: " 

    print "19.2           " 

    print " "
    print "Enter desired frequency (r to return): "
    enter &clk_desired_freq
    print " "

    if ("&clk_desired_freq"=="19.2")
    (
      &clk_src_name="XO"
      &clk_src_sel=SRC_SEL TODO.
      &clk_src_div=2.
      &clk_m_val=0.
      &clk_n_val=0.
      &clk_2d_val=0.
      
      gosub Set_Clock_Freq
      return
    )
    else if ("&clk_desired_freq"=="r")
    (
      return
    )
    else
    (
      print "Invalid selection."
      goto Set_Clock_Freq_Enter
    )
  )

  if ("&clk"=="wcss_dbg_apb_clk")||("&clk"=="wcss_dbg_atb_clk")||("&clk"=="wcss_dbg_css_apb_clk")||("&clk"=="wcss_dbg_css_atb_clk")||("&clk"=="wcss_dbg_css_ts_clk")||("&clk"=="wcss_dbg_ts_clk")
  (
    gosub PRINT_SET_CLOCK_FREQ_WARNING

    &clk_cmd_rcgr_addr=&HWIO_WCSS_HM_A_WCSS_CLK_CTL_DBG_ATB_CMD_RCGR_ADDR
    &clk_cfg_rcgr_addr=&HWIO_WCSS_HM_A_WCSS_CLK_CTL_DBG_ATB_CFG_RCGR_ADDR

    print "Choose frequency (MHz) from list below: " 

    print "240.0          240.0          " 

    print " "
    print "Enter desired frequency (r to return): "
    enter &clk_desired_freq
    print " "

    if ("&clk_desired_freq"=="240.0")
    (
      &clk_src_name="WPLL0_OUT_MAIN"
      &clk_src_sel=SRC_SEL TODO.
      &clk_src_div=4.
      &clk_m_val=0.
      &clk_n_val=0.
      &clk_2d_val=0.
      
      gosub Set_Clock_Freq
      return
    )
    else if ("&clk_desired_freq"=="240.0")
    (
      &clk_src_name="EXTERNAL"
      &clk_src_sel=SRC_SEL TODO.
      &clk_src_div=2.
      &clk_m_val=0.
      &clk_n_val=0.
      &clk_2d_val=0.
      
      gosub Set_Clock_Freq
      return
    )
    else if ("&clk_desired_freq"=="r")
    (
      return
    )
    else
    (
      print "Invalid selection."
      goto Set_Clock_Freq_Enter
    )
  )

  if ("&clk"=="wcss_ahb_tslv_clk")||("&clk"=="wcss_css_apb_clk")||("&clk"=="wcss_css_noc_clk")||("&clk"=="wcss_phy1_apb_clk")||("&clk"=="wcss_phy2_apb_clk")||("&clk"=="wcss_rfactrl_apb_clk")||("&clk"=="wcss_rfactrl_dac_apb_clk")||("&clk"=="wcss_top_ahb_clk")||("&clk"=="wcss_top_axi_clk")||("&clk"=="wcss_top_dac_apb_clk")||("&clk"=="wcss_wcssdbg_cfg_apb_clk")||("&clk"=="wcss_wcssdbg_trc_clk")||("&clk"=="wcss_wmac1_apb_clk")||("&clk"=="wcss_wmac2_apb_clk")
  (
    gosub PRINT_SET_CLOCK_FREQ_WARNING

    &clk_cmd_rcgr_addr=&HWIO_WCSS_HM_A_WCSS_CLK_CTL_NOC_CMD_RCGR_ADDR
    &clk_cfg_rcgr_addr=&HWIO_WCSS_HM_A_WCSS_CLK_CTL_NOC_CFG_RCGR_ADDR

    print "Choose frequency (MHz) from list below: " 

    print "240.0          240.0          " 

    print " "
    print "Enter desired frequency (r to return): "
    enter &clk_desired_freq
    print " "

    if ("&clk_desired_freq"=="240.0")
    (
      &clk_src_name="WPLL0_OUT_MAIN"
      &clk_src_sel=SRC_SEL TODO.
      &clk_src_div=4.
      &clk_m_val=0.
      &clk_n_val=0.
      &clk_2d_val=0.
      
      gosub Set_Clock_Freq
      return
    )
    else if ("&clk_desired_freq"=="240.0")
    (
      &clk_src_name="EXTERNAL"
      &clk_src_sel=SRC_SEL TODO.
      &clk_src_div=2.
      &clk_m_val=0.
      &clk_n_val=0.
      &clk_2d_val=0.
      
      gosub Set_Clock_Freq
      return
    )
    else if ("&clk_desired_freq"=="r")
    (
      return
    )
    else
    (
      print "Invalid selection."
      goto Set_Clock_Freq_Enter
    )
  )

  if ("&clk"=="wcss_css_phy1_t240_clk")||("&clk"=="wcss_phy1_160_clk")||("&clk"=="wcss_phy1_20_clk")||("&clk"=="wcss_phy1_30_clk")||("&clk"=="wcss_phy1_320_clk")||("&clk"=="wcss_phy1_40_clk")||("&clk"=="wcss_phy1_80_clk")||("&clk"=="wcss_phy1_bw_clk")||("&clk"=="wcss_phy1_bwx2_clk")||("&clk"=="wcss_phy1_clk")||("&clk"=="wcss_phy1_dfs_clk")||("&clk"=="wcss_phy1_t240_clk")||("&clk"=="wcss_phy1_tadc_clk")||("&clk"=="wcss_phy1_tdac_clk")||("&clk"=="wcss_phy1_x2_clk")||("&clk"=="wcss_rfactrl_phy1_80_clk")
  (
    gosub PRINT_SET_CLOCK_FREQ_WARNING

    &clk_cmd_rcgr_addr=&HWIO_WCSS_HM_A_WCSS_CLK_CTL_PHY1_CMD_RCGR_ADDR
    &clk_cfg_rcgr_addr=&HWIO_WCSS_HM_A_WCSS_CLK_CTL_PHY1_CFG_RCGR_ADDR

    print "Choose frequency (MHz) from list below: " 

    print "960.0          960.0          960.0          " 

    print " "
    print "Enter desired frequency (r to return): "
    enter &clk_desired_freq
    print " "

    if ("&clk_desired_freq"=="960.0")
    (
      &clk_src_name="WPLL0_OUT_EARLY"
      &clk_src_sel=SRC_SEL TODO.
      &clk_src_div=2.
      &clk_m_val=0.
      &clk_n_val=0.
      &clk_2d_val=0.
      
      gosub Set_Clock_Freq
      return
    )
    else if ("&clk_desired_freq"=="960.0")
    (
      &clk_src_name="EXTERNAL"
      &clk_src_sel=SRC_SEL TODO.
      &clk_src_div=2.
      &clk_m_val=0.
      &clk_n_val=0.
      &clk_2d_val=0.
      
      gosub Set_Clock_Freq
      return
    )
    else if ("&clk_desired_freq"=="960.0")
    (
      &clk_src_name="WPLL0_OUT_EARLY"
      &clk_src_sel=SRC_SEL TODO.
      &clk_src_div=2.
      &clk_m_val=0.
      &clk_n_val=0.
      &clk_2d_val=0.
      
      gosub Set_Clock_Freq
      return
    )
    else if ("&clk_desired_freq"=="r")
    (
      return
    )
    else
    (
      print "Invalid selection."
      goto Set_Clock_Freq_Enter
    )
  )

  if ("&clk"=="wcss_css_phy2_t240_clk")||("&clk"=="wcss_phy2_160_clk")||("&clk"=="wcss_phy2_20_clk")||("&clk"=="wcss_phy2_30_clk")||("&clk"=="wcss_phy2_320_clk")||("&clk"=="wcss_phy2_40_clk")||("&clk"=="wcss_phy2_80_clk")||("&clk"=="wcss_phy2_bw_clk")||("&clk"=="wcss_phy2_bwx2_clk")||("&clk"=="wcss_phy2_clk")||("&clk"=="wcss_phy2_dfs_clk")||("&clk"=="wcss_phy2_t240_clk")||("&clk"=="wcss_phy2_tadc_clk")||("&clk"=="wcss_phy2_tdac_clk")||("&clk"=="wcss_phy2_x2_clk")||("&clk"=="wcss_rfactrl_phy2_80_clk")
  (
    gosub PRINT_SET_CLOCK_FREQ_WARNING

    &clk_cmd_rcgr_addr=&HWIO_WCSS_HM_A_WCSS_CLK_CTL_PHY2_CMD_RCGR_ADDR
    &clk_cfg_rcgr_addr=&HWIO_WCSS_HM_A_WCSS_CLK_CTL_PHY2_CFG_RCGR_ADDR

    print "Choose frequency (MHz) from list below: " 

    print "960.0          960.0          960.0          " 

    print " "
    print "Enter desired frequency (r to return): "
    enter &clk_desired_freq
    print " "

    if ("&clk_desired_freq"=="960.0")
    (
      &clk_src_name="WPLL0_OUT_EARLY"
      &clk_src_sel=SRC_SEL TODO.
      &clk_src_div=2.
      &clk_m_val=0.
      &clk_n_val=0.
      &clk_2d_val=0.
      
      gosub Set_Clock_Freq
      return
    )
    else if ("&clk_desired_freq"=="960.0")
    (
      &clk_src_name="EXTERNAL"
      &clk_src_sel=SRC_SEL TODO.
      &clk_src_div=2.
      &clk_m_val=0.
      &clk_n_val=0.
      &clk_2d_val=0.
      
      gosub Set_Clock_Freq
      return
    )
    else if ("&clk_desired_freq"=="960.0")
    (
      &clk_src_name="WPLL0_OUT_EARLY"
      &clk_src_sel=SRC_SEL TODO.
      &clk_src_div=2.
      &clk_m_val=0.
      &clk_n_val=0.
      &clk_2d_val=0.
      
      gosub Set_Clock_Freq
      return
    )
    else if ("&clk_desired_freq"=="r")
    (
      return
    )
    else
    (
      print "Invalid selection."
      goto Set_Clock_Freq_Enter
    )
  )

  if ("&clk"=="wcss_dac_sm_clk")||("&clk"=="wcss_top_ref_clk")
  (
    gosub PRINT_SET_CLOCK_FREQ_WARNING

    &clk_cmd_rcgr_addr=&HWIO_WCSS_HM_A_WCSS_CLK_CTL_REF_CMD_RCGR_ADDR
    &clk_cfg_rcgr_addr=&HWIO_WCSS_HM_A_WCSS_CLK_CTL_REF_CFG_RCGR_ADDR

    print "Choose frequency (MHz) from list below: " 

    print "19.2           48.0           " 

    print " "
    print "Enter desired frequency (r to return): "
    enter &clk_desired_freq
    print " "

    if ("&clk_desired_freq"=="19.2")
    (
      &clk_src_name="XO"
      &clk_src_sel=SRC_SEL TODO.
      &clk_src_div=2.
      &clk_m_val=0.
      &clk_n_val=0.
      &clk_2d_val=0.
      
      gosub Set_Clock_Freq
      return
    )
    else if ("&clk_desired_freq"=="48.0")
    (
      &clk_src_name="RF_XO_CLK"
      &clk_src_sel=SRC_SEL TODO.
      &clk_src_div=2.
      &clk_m_val=0.
      &clk_n_val=0.
      &clk_2d_val=0.
      
      gosub Set_Clock_Freq
      return
    )
    else if ("&clk_desired_freq"=="r")
    (
      return
    )
    else
    (
      print "Invalid selection."
      goto Set_Clock_Freq_Enter
    )
  )

  if ("&clk"=="wcss_rfactrl_clk")
  (
    gosub PRINT_SET_CLOCK_FREQ_WARNING

    &clk_cmd_rcgr_addr=&HWIO_WCSS_HM_A_WCSS_CLK_CTL_RFACTRL_CMD_RCGR_ADDR
    &clk_cfg_rcgr_addr=&HWIO_WCSS_HM_A_WCSS_CLK_CTL_RFACTRL_CFG_RCGR_ADDR

    print "Choose frequency (MHz) from list below: " 

    print "240.0          240.0          " 

    print " "
    print "Enter desired frequency (r to return): "
    enter &clk_desired_freq
    print " "

    if ("&clk_desired_freq"=="240.0")
    (
      &clk_src_name="WPLL0_OUT_MAIN"
      &clk_src_sel=SRC_SEL TODO.
      &clk_src_div=4.
      &clk_m_val=0.
      &clk_n_val=0.
      &clk_2d_val=0.
      
      gosub Set_Clock_Freq
      return
    )
    else if ("&clk_desired_freq"=="240.0")
    (
      &clk_src_name="EXTERNAL"
      &clk_src_sel=SRC_SEL TODO.
      &clk_src_div=2.
      &clk_m_val=0.
      &clk_n_val=0.
      &clk_2d_val=0.
      
      gosub Set_Clock_Freq
      return
    )
    else if ("&clk_desired_freq"=="r")
    (
      return
    )
    else
    (
      print "Invalid selection."
      goto Set_Clock_Freq_Enter
    )
  )

  if ("&clk"=="wcss_top_slp_clk")
  (
    gosub PRINT_SET_CLOCK_FREQ_WARNING

    &clk_cmd_rcgr_addr=&HWIO_WCSS_HM_A_WCSS_CLK_CTL_SLP_CMD_RCGR_ADDR
    &clk_cfg_rcgr_addr=&HWIO_WCSS_HM_A_WCSS_CLK_CTL_SLP_CFG_RCGR_ADDR

    print "Choose frequency (MHz) from list below: " 

    print "0.032768       " 

    print " "
    print "Enter desired frequency (r to return): "
    enter &clk_desired_freq
    print " "

    if ("&clk_desired_freq"=="0.032768")
    (
      &clk_src_name="CORE_PI_SLEEP_CLK"
      &clk_src_sel=SRC_SEL TODO.
      &clk_src_div=2.
      &clk_m_val=0.
      &clk_n_val=0.
      &clk_2d_val=0.
      
      gosub Set_Clock_Freq
      return
    )
    else if ("&clk_desired_freq"=="r")
    (
      return
    )
    else
    (
      print "Invalid selection."
      goto Set_Clock_Freq_Enter
    )
  )

  if ("&clk"=="wcss_wmac1_css_mac_clk")||("&clk"=="wcss_wmac1_mac_clk")
  (
    gosub PRINT_SET_CLOCK_FREQ_WARNING

    &clk_cmd_rcgr_addr=&HWIO_WCSS_HM_A_WCSS_CLK_CTL_WMAC1_CMD_RCGR_ADDR
    &clk_cfg_rcgr_addr=&HWIO_WCSS_HM_A_WCSS_CLK_CTL_WMAC1_CFG_RCGR_ADDR

    print "Choose frequency (MHz) from list below: " 

    print "120.0          120.0          " 

    print " "
    print "Enter desired frequency (r to return): "
    enter &clk_desired_freq
    print " "

    if ("&clk_desired_freq"=="120.0")
    (
      &clk_src_name="WPLL0_OUT_MAIN"
      &clk_src_sel=SRC_SEL TODO.
      &clk_src_div=8.
      &clk_m_val=0.
      &clk_n_val=0.
      &clk_2d_val=0.
      
      gosub Set_Clock_Freq
      return
    )
    else if ("&clk_desired_freq"=="120.0")
    (
      &clk_src_name="EXTERNAL"
      &clk_src_sel=SRC_SEL TODO.
      &clk_src_div=2.
      &clk_m_val=0.
      &clk_n_val=0.
      &clk_2d_val=0.
      
      gosub Set_Clock_Freq
      return
    )
    else if ("&clk_desired_freq"=="r")
    (
      return
    )
    else
    (
      print "Invalid selection."
      goto Set_Clock_Freq_Enter
    )
  )

  if ("&clk"=="wcss_wmac2_css_mac_clk")||("&clk"=="wcss_wmac2_mac_clk")
  (
    gosub PRINT_SET_CLOCK_FREQ_WARNING

    &clk_cmd_rcgr_addr=&HWIO_WCSS_HM_A_WCSS_CLK_CTL_WMAC2_CMD_RCGR_ADDR
    &clk_cfg_rcgr_addr=&HWIO_WCSS_HM_A_WCSS_CLK_CTL_WMAC2_CFG_RCGR_ADDR

    print "Choose frequency (MHz) from list below: " 

    print "120.0          120.0          " 

    print " "
    print "Enter desired frequency (r to return): "
    enter &clk_desired_freq
    print " "

    if ("&clk_desired_freq"=="120.0")
    (
      &clk_src_name="WPLL0_OUT_MAIN"
      &clk_src_sel=SRC_SEL TODO.
      &clk_src_div=8.
      &clk_m_val=0.
      &clk_n_val=0.
      &clk_2d_val=0.
      
      gosub Set_Clock_Freq
      return
    )
    else if ("&clk_desired_freq"=="120.0")
    (
      &clk_src_name="EXTERNAL"
      &clk_src_sel=SRC_SEL TODO.
      &clk_src_div=2.
      &clk_m_val=0.
      &clk_n_val=0.
      &clk_2d_val=0.
      
      gosub Set_Clock_Freq
      return
    )
    else if ("&clk_desired_freq"=="r")
    (
      return
    )
    else
    (
      print "Invalid selection."
      goto Set_Clock_Freq_Enter
    )
  )

  if ("&clk"=="wcss_css_wsi_clk")
  (
    gosub PRINT_SET_CLOCK_FREQ_WARNING

    &clk_cmd_rcgr_addr=&HWIO_WCSS_HM_A_WCSS_CLK_CTL_WSI_CMD_RCGR_ADDR
    &clk_cfg_rcgr_addr=&HWIO_WCSS_HM_A_WCSS_CLK_CTL_WSI_CFG_RCGR_ADDR

    print "Choose frequency (MHz) from list below: " 

    print "19.2           20.0           40.0           " 
    print "40.0           60.0           80.0           " 
    print "80.0           " 

    print " "
    print "Enter desired frequency (r to return): "
    enter &clk_desired_freq
    print " "

    if ("&clk_desired_freq"=="19.2")
    (
      &clk_src_name="XO"
      &clk_src_sel=SRC_SEL TODO.
      &clk_src_div=2.
      &clk_m_val=0.
      &clk_n_val=0.
      &clk_2d_val=0.
      
      gosub Set_Clock_Freq
      return
    )
    else if ("&clk_desired_freq"=="20.0")
    (
      &clk_src_name="EXTERNAL"
      &clk_src_sel=SRC_SEL TODO.
      &clk_src_div=2.
      &clk_m_val=0.
      &clk_n_val=0.
      &clk_2d_val=0.
      
      gosub Set_Clock_Freq
      return
    )
    else if ("&clk_desired_freq"=="40.0")
    (
      &clk_src_name="WPLL0_OUT_MAIN"
      &clk_src_sel=SRC_SEL TODO.
      &clk_src_div=24.
      &clk_m_val=0.
      &clk_n_val=0.
      &clk_2d_val=0.
      
      gosub Set_Clock_Freq
      return
    )
    else if ("&clk_desired_freq"=="40.0")
    (
      &clk_src_name="EXTERNAL"
      &clk_src_sel=SRC_SEL TODO.
      &clk_src_div=2.
      &clk_m_val=0.
      &clk_n_val=0.
      &clk_2d_val=0.
      
      gosub Set_Clock_Freq
      return
    )
    else if ("&clk_desired_freq"=="60.0")
    (
      &clk_src_name="WPLL0_OUT_MAIN"
      &clk_src_sel=SRC_SEL TODO.
      &clk_src_div=16.
      &clk_m_val=0.
      &clk_n_val=0.
      &clk_2d_val=0.
      
      gosub Set_Clock_Freq
      return
    )
    else if ("&clk_desired_freq"=="80.0")
    (
      &clk_src_name="WPLL0_OUT_MAIN"
      &clk_src_sel=SRC_SEL TODO.
      &clk_src_div=12.
      &clk_m_val=0.
      &clk_n_val=0.
      &clk_2d_val=0.
      
      gosub Set_Clock_Freq
      return
    )
    else if ("&clk_desired_freq"=="80.0")
    (
      &clk_src_name="EXTERNAL"
      &clk_src_sel=SRC_SEL TODO.
      &clk_src_div=2.
      &clk_m_val=0.
      &clk_n_val=0.
      &clk_2d_val=0.
      
      gosub Set_Clock_Freq
      return
    )
    else if ("&clk_desired_freq"=="r")
    (
      return
    )
    else
    (
      print "Invalid selection."
      goto Set_Clock_Freq_Enter
    )
  )


  return

