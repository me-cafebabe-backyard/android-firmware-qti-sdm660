; //components/rel/boot.xf/1.0/QcomPkg/Msm8996Pkg/Tools/clock/testclock.cmm#2
;============================================================================
;
; *************** THIS SCRIPT WAS AUTOGENERATED ****************
;
; TARGET
;
;
; SCRIPT
;   TESTCLOCK.CMM
;
; GENERAL DESCRIPTION
;   This script can be used to route specific clocks to the clock test output.
;
; FUNCTIONS
;   N/A
;
;    Copyright (c) 2015 by QUALCOMM Technologies Inc.  All Rights Reserved.
;============================================================================



;-----------------------------------------------------------------------------
; Local variables
;-----------------------------------------------------------------------------

local &clk
local &choice
local &clk_name
local &clk_state
local &clk_freq
local &clk_freq_str
local &header_printed
local &choice_handled
local &old_choice
local &clk_test
local &clk_reg
local &clk_reg_str
local &clk_reg_name
local &clk_reg_val
local &clk_reg_val_str
local &clk_reg_cbcr_type
local &state_change
local &print_menu
local &input_file
local &input_line
local &input_file_prompt
local &clock_count
local &multiplier
local &tcxo_count
local &match
local &clk_access_mode
local &testclock_cmd_arg0
local &testclock_cmd_arg1
local &testclock_cmd_arg2
local &testclock_cmd_arg3
local &testclock_cmd_arg4
local &clk_cmd_rcgr_addr
local &clk_cfg_rcgr_addr
local &clk_cmd_rcgr_val
local &clk_cfg_rcgr_val
local &clk_src_name
local &clk_src_sel
local &clk_src_div
local &clk_m_addr
local &clk_n_addr
local &clk_d_addr
local &clk_m_val
local &clk_n_val
local &clk_2d_val


;-----------------------------------------------------------------------------
; Initialize autogenerated constants
;-----------------------------------------------------------------------------

goto Init_Constants


Init_Constants:

; Access Mode
&access_mode="ezaxi"


;GCC clock registers
&HWIO_GCC_AGGRE0_CNOC_AHB_CBCR_ADDR=0x38100c
&HWIO_GCC_AGGRE0_NOC_AT_CBCR_ADDR=0x381010
&HWIO_GCC_AGGRE0_NOC_MPU_CFG_AHB_CBCR_ADDR=0x385000
&HWIO_GCC_AGGRE0_SNOC_AXI_CBCR_ADDR=0x381008
&HWIO_GCC_AGGRE1_CNOC_AHB_CBCR_ADDR=0x38200c
&HWIO_GCC_AGGRE1_NOC_AT_CBCR_ADDR=0x382010
&HWIO_GCC_AGGRE1_NOC_MPU_CFG_AHB_CBCR_ADDR=0x386000
&HWIO_GCC_AGGRE1_NOC_MSMPU_CFG_AHB_CBCR_ADDR=0x38d004
&HWIO_GCC_AGGRE1_PNOC_AHB_CBCR_ADDR=0x382014
&HWIO_GCC_AGGRE1_SNOC_AXI_CBCR_ADDR=0x382008
&HWIO_GCC_AGGRE1_SNOC_MSMPU_CLIENT_AXI_CBCR_ADDR=0x38d014
&HWIO_GCC_AGGRE2_CNOC_AHB_CBCR_ADDR=0x38300c
&HWIO_GCC_AGGRE2_NOC_AT_CBCR_ADDR=0x383010
&HWIO_GCC_AGGRE2_NOC_IPA_CBCR_ADDR=0x383040
&HWIO_GCC_AGGRE2_NOC_MPU_CFG_AHB_CBCR_ADDR=0x387000
&HWIO_GCC_AGGRE2_NOC_MSMPU_CFG_AHB_CBCR_ADDR=0x38d008
&HWIO_GCC_AGGRE2_SNOC_AXI_CBCR_ADDR=0x383008
&HWIO_GCC_AGGRE2_SNOC_MSMPU_CLIENT_AXI_CBCR_ADDR=0x38d018
&HWIO_GCC_AGGRE2_UFS_AXI_CBCR_ADDR=0x383014
&HWIO_GCC_AGGRE2_USB3_AXI_CBCR_ADDR=0x383018
&HWIO_GCC_GCC_AHB_CBCR_ADDR=0x343000
&HWIO_GCC_BIMC_CFG_AHB_CBCR_ADDR=0x34400c
&HWIO_GCC_BIMC_CBCR_ADDR=0x344018
&HWIO_GCC_BIMC_DDR_CH0_CBCR_ADDR=0x346010
&HWIO_GCC_BIMC_DDR_CH1_CBCR_ADDR=0x346014
&HWIO_GCC_BIMC_DDR_CPLL0_CBCR_ADDR=0x346004
&HWIO_GCC_BIMC_DDR_CPLL1_CBCR_ADDR=0x346008
&HWIO_GCC_BIMC_DTTS_XO_CBCR_ADDR=0x344024
&HWIO_GCC_BIMC_GFX_CBCR_ADDR=0x346018
&HWIO_GCC_BIMC_HMSS_AXI_CBCR_ADDR=0x34401c
&HWIO_GCC_BIMC_NIUS_AXI_CBCR_ADDR=0x30403c
&HWIO_GCC_BIMC_NIUS_CFG_AHB_CBCR_ADDR=0x304040
&HWIO_GCC_BIMC_NIUS_HS_AXI_CBCR_ADDR=0x304038
&HWIO_GCC_BIMC_PIMEM_AXI_CBCR_ADDR=0x30a028
&HWIO_GCC_BIMC_SLEEP_CBCR_ADDR=0x344010
&HWIO_GCC_BIMC_SYSNOC_AXI_CBCR_ADDR=0x344014
&HWIO_GCC_BIMC_SYSNOC_HS_AXI_CBCR_ADDR=0x344020
&HWIO_GCC_BIMC_XO_CBCR_ADDR=0x344008
&HWIO_GCC_BLSP1_AHB_CBCR_ADDR=0x317004
&HWIO_GCC_BLSP1_QUP1_I2C_APPS_CBCR_ADDR=0x319008
&HWIO_GCC_BLSP1_QUP1_SPI_APPS_CBCR_ADDR=0x319004
&HWIO_GCC_BLSP1_QUP2_I2C_APPS_CBCR_ADDR=0x31b008
&HWIO_GCC_BLSP1_QUP2_SPI_APPS_CBCR_ADDR=0x31b004
&HWIO_GCC_BLSP1_QUP3_I2C_APPS_CBCR_ADDR=0x31d008
&HWIO_GCC_BLSP1_QUP3_SPI_APPS_CBCR_ADDR=0x31d004
&HWIO_GCC_BLSP1_QUP4_I2C_APPS_CBCR_ADDR=0x31f008
&HWIO_GCC_BLSP1_QUP4_SPI_APPS_CBCR_ADDR=0x31f004
&HWIO_GCC_BLSP1_QUP5_I2C_APPS_CBCR_ADDR=0x321008
&HWIO_GCC_BLSP1_QUP5_SPI_APPS_CBCR_ADDR=0x321004
&HWIO_GCC_BLSP1_QUP6_I2C_APPS_CBCR_ADDR=0x323008
&HWIO_GCC_BLSP1_QUP6_SPI_APPS_CBCR_ADDR=0x323004
&HWIO_GCC_BLSP1_SLEEP_CBCR_ADDR=0x317008
&HWIO_GCC_BLSP1_UART1_APPS_CBCR_ADDR=0x31a004
&HWIO_GCC_BLSP1_UART1_SIM_CBCR_ADDR=0x31a008
&HWIO_GCC_BLSP1_UART2_APPS_CBCR_ADDR=0x31c004
&HWIO_GCC_BLSP1_UART2_SIM_CBCR_ADDR=0x31c008
&HWIO_GCC_BLSP1_UART3_APPS_CBCR_ADDR=0x31e004
&HWIO_GCC_BLSP1_UART3_SIM_CBCR_ADDR=0x31e008
&HWIO_GCC_BLSP1_UART4_APPS_CBCR_ADDR=0x320004
&HWIO_GCC_BLSP1_UART4_SIM_CBCR_ADDR=0x320008
&HWIO_GCC_BLSP1_UART5_APPS_CBCR_ADDR=0x322004
&HWIO_GCC_BLSP1_UART5_SIM_CBCR_ADDR=0x322008
&HWIO_GCC_BLSP1_UART6_APPS_CBCR_ADDR=0x324004
&HWIO_GCC_BLSP1_UART6_SIM_CBCR_ADDR=0x324008
&HWIO_GCC_BLSP2_AHB_CBCR_ADDR=0x325004
&HWIO_GCC_BLSP2_QUP1_I2C_APPS_CBCR_ADDR=0x326008
&HWIO_GCC_BLSP2_QUP1_SPI_APPS_CBCR_ADDR=0x326004
&HWIO_GCC_BLSP2_QUP2_I2C_APPS_CBCR_ADDR=0x328008
&HWIO_GCC_BLSP2_QUP2_SPI_APPS_CBCR_ADDR=0x328004
&HWIO_GCC_BLSP2_QUP3_I2C_APPS_CBCR_ADDR=0x32a008
&HWIO_GCC_BLSP2_QUP3_SPI_APPS_CBCR_ADDR=0x32a004
&HWIO_GCC_BLSP2_QUP4_I2C_APPS_CBCR_ADDR=0x32c008
&HWIO_GCC_BLSP2_QUP4_SPI_APPS_CBCR_ADDR=0x32c004
&HWIO_GCC_BLSP2_QUP5_I2C_APPS_CBCR_ADDR=0x32e008
&HWIO_GCC_BLSP2_QUP5_SPI_APPS_CBCR_ADDR=0x32e004
&HWIO_GCC_BLSP2_QUP6_I2C_APPS_CBCR_ADDR=0x330008
&HWIO_GCC_BLSP2_QUP6_SPI_APPS_CBCR_ADDR=0x330004
&HWIO_GCC_BLSP2_SLEEP_CBCR_ADDR=0x325008
&HWIO_GCC_BLSP2_UART1_APPS_CBCR_ADDR=0x327004
&HWIO_GCC_BLSP2_UART1_SIM_CBCR_ADDR=0x327008
&HWIO_GCC_BLSP2_UART2_APPS_CBCR_ADDR=0x329004
&HWIO_GCC_BLSP2_UART2_SIM_CBCR_ADDR=0x329008
&HWIO_GCC_BLSP2_UART3_APPS_CBCR_ADDR=0x32b004
&HWIO_GCC_BLSP2_UART3_SIM_CBCR_ADDR=0x32b008
&HWIO_GCC_BLSP2_UART4_APPS_CBCR_ADDR=0x32d004
&HWIO_GCC_BLSP2_UART4_SIM_CBCR_ADDR=0x32d008
&HWIO_GCC_BLSP2_UART5_APPS_CBCR_ADDR=0x32f004
&HWIO_GCC_BLSP2_UART5_SIM_CBCR_ADDR=0x32f008
&HWIO_GCC_BLSP2_UART6_APPS_CBCR_ADDR=0x331004
&HWIO_GCC_BLSP2_UART6_SIM_CBCR_ADDR=0x331008
&HWIO_GCC_BOOT_ROM_AHB_CBCR_ADDR=0x338004
&HWIO_GCC_CE1_AHB_CBCR_ADDR=0x34100c
&HWIO_GCC_CE1_AXI_CBCR_ADDR=0x341008
&HWIO_GCC_CE1_CBCR_ADDR=0x341004
&HWIO_GCC_CFG_NOC_AHB_CBCR_ADDR=0x305004
&HWIO_GCC_CFG_NOC_DDR_CFG_CBCR_ADDR=0x305008
&HWIO_GCC_CNOC_BUS_TIMEOUT0_AHB_CBCR_ADDR=0x34b004
&HWIO_GCC_CNOC_BUS_TIMEOUT1_AHB_CBCR_ADDR=0x34b00c
&HWIO_GCC_CNOC_BUS_TIMEOUT2_AHB_CBCR_ADDR=0x34b014
&HWIO_GCC_CNOC_BUS_TIMEOUT3_AHB_CBCR_ADDR=0x34b01c
&HWIO_GCC_CNOC_BUS_TIMEOUT4_AHB_CBCR_ADDR=0x34b024
&HWIO_GCC_CNOC_BUS_TIMEOUT5_AHB_CBCR_ADDR=0x34b02c
&HWIO_GCC_CNOC_BUS_TIMEOUT6_AHB_CBCR_ADDR=0x34b034
&HWIO_GCC_CNOC_BUS_TIMEOUT7_AHB_CBCR_ADDR=0x34b03c
&HWIO_GCC_CNOC_BUS_TIMEOUT8_AHB_CBCR_ADDR=0x380004
&HWIO_GCC_CNOC_BUS_TIMEOUT9_AHB_CBCR_ADDR=0x38000c
&HWIO_GCC_CNOC_MST_RPM_AHB_CBCR_ADDR=0x33c014
&HWIO_GCC_DCC_AHB_CBCR_ADDR=0x384004
&HWIO_GCC_DCD_XO_CBCR_ADDR=0x370004
&HWIO_GCC_DDR_DIM_CFG_CBCR_ADDR=0x346000
&HWIO_GCC_DDR_DIM_SLEEP_CBCR_ADDR=0x34600c
&HWIO_GCC_GP1_CBCR_ADDR=0x364000
&HWIO_GCC_GP2_CBCR_ADDR=0x365000
&HWIO_GCC_GP3_CBCR_ADDR=0x366000
&HWIO_GCC_HMSS_AHB_CBCR_ADDR=0x348000
&HWIO_GCC_HMSS_MSTR_AXI_CBCR_ADDR=0x348008
&HWIO_GCC_HMSS_RBCPR_CBCR_ADDR=0x34800c
&HWIO_GCC_HMSS_SLV_AXI_CBCR_ADDR=0x348004
&HWIO_GCC_GCC_IM_SLEEP_CBCR_ADDR=0x34300c
&HWIO_GCC_IMEM_AXI_CBCR_ADDR=0x308004
&HWIO_GCC_IMEM_CFG_AHB_CBCR_ADDR=0x308008
&HWIO_GCC_IPA_AHB_CBCR_ADDR=0x38900c
&HWIO_GCC_IPA_CBCR_ADDR=0x389008
&HWIO_GCC_IPA_SLEEP_CBCR_ADDR=0x389010
&HWIO_GCC_LPASS_CORE_SMMU_AHB_CBCR_ADDR=0x347010
&HWIO_GCC_LPASS_Q6_AXI_CBCR_ADDR=0x347000
&HWIO_GCC_LPASS_Q6_SMMU_AHB_CBCR_ADDR=0x34700c
&HWIO_GCC_LPASS_Q6_SMMU_AXI_CBCR_ADDR=0x347004
&HWIO_GCC_LPASS_SMMU_AON_AHB_CBCR_ADDR=0x347014
&HWIO_GCC_LPASS_SWAY_CBCR_ADDR=0x347008
&HWIO_GCC_MMSS_BIMC_GFX_CBCR_ADDR=0x309010
&HWIO_GCC_MMSS_NOC_AT_CBCR_ADDR=0x30900c
&HWIO_GCC_MMSS_NOC_CFG_AHB_CBCR_ADDR=0x309008
&HWIO_GCC_MMSS_SYS_NOC_AXI_CBCR_ADDR=0x309004
&HWIO_GCC_MPM_AHB_CBCR_ADDR=0x33b008
&HWIO_GCC_MSG_RAM_AHB_CBCR_ADDR=0x339004
&HWIO_GCC_MSS_CFG_AHB_CBCR_ADDR=0x38a000
&HWIO_GCC_MSS_MNOC_BIMC_AXI_CBCR_ADDR=0x38a004
&HWIO_GCC_MSS_MSMPU_CFG_AHB_CBCR_ADDR=0x38d010
&HWIO_GCC_MSS_MSMPU_CLIENT_AXI_CBCR_ADDR=0x38d020
&HWIO_GCC_MSS_Q6_BIMC_AXI_CBCR_ADDR=0x38a028
&HWIO_GCC_MSS_Q6_CFG_AHB_CBCR_ADDR=0x38e008
&HWIO_GCC_MSS_Q6_MSMPU_CFG_AHB_CBCR_ADDR=0x38d00c
&HWIO_GCC_MSS_Q6_MSMPU_CLIENT_AXI_CBCR_ADDR=0x38d01c
&HWIO_GCC_MSS_Q6_SMMU_CBCR_ADDR=0x38e00c
&HWIO_GCC_MSS_SNOC_AXI_CBCR_ADDR=0x38a024
&HWIO_GCC_MSS_VS_CBCR_ADDR=0x37a08c
&HWIO_GCC_NOC_CONF_XPU_AHB_CBCR_ADDR=0x307000
&HWIO_GCC_OBT_ODT_CBCR_ADDR=0x373018
&HWIO_GCC_PCIE_0_AUX_CBCR_ADDR=0x36b014
&HWIO_GCC_PCIE_0_CFG_AHB_CBCR_ADDR=0x36b010
&HWIO_GCC_PCIE_0_MSTR_AXI_CBCR_ADDR=0x36b00c
&HWIO_GCC_PCIE_0_PIPE_CBCR_ADDR=0x36b018
&HWIO_GCC_PCIE_0_SLV_AXI_CBCR_ADDR=0x36b008
&HWIO_GCC_PCIE_1_AUX_CBCR_ADDR=0x36d014
&HWIO_GCC_PCIE_1_CFG_AHB_CBCR_ADDR=0x36d010
&HWIO_GCC_PCIE_1_MSTR_AXI_CBCR_ADDR=0x36d00c
&HWIO_GCC_PCIE_1_PIPE_CBCR_ADDR=0x36d018
&HWIO_GCC_PCIE_1_SLV_AXI_CBCR_ADDR=0x36d008
&HWIO_GCC_PCIE_2_AUX_CBCR_ADDR=0x36e014
&HWIO_GCC_PCIE_2_CFG_AHB_CBCR_ADDR=0x36e010
&HWIO_GCC_PCIE_2_MSTR_AXI_CBCR_ADDR=0x36e00c
&HWIO_GCC_PCIE_2_PIPE_CBCR_ADDR=0x36e018
&HWIO_GCC_PCIE_2_SLV_AXI_CBCR_ADDR=0x36e008
&HWIO_GCC_PCIE_PHY_AUX_CBCR_ADDR=0x36f008
&HWIO_GCC_PCIE_PHY_CFG_AHB_CBCR_ADDR=0x36f004
&HWIO_GCC_PDM2_CBCR_ADDR=0x33300c
&HWIO_GCC_PDM_AHB_CBCR_ADDR=0x333004
&HWIO_GCC_PDM_XO4_CBCR_ADDR=0x333008
&HWIO_GCC_PERIPH_NOC_AHB_CBCR_ADDR=0x306004
&HWIO_GCC_PERIPH_NOC_AT_CBCR_ADDR=0x30600c
&HWIO_GCC_PERIPH_NOC_CFG_AHB_CBCR_ADDR=0x306008
&HWIO_GCC_PERIPH_NOC_MPU_CFG_AHB_CBCR_ADDR=0x332000
&HWIO_GCC_PERIPH_NOC_USB20_AHB_CBCR_ADDR=0x306010
&HWIO_GCC_PIMEM_AHB_CBCR_ADDR=0x30a020
&HWIO_GCC_PIMEM_AXI_CBCR_ADDR=0x30a004
&HWIO_GCC_PNOC_BUS_TIMEOUT0_AHB_CBCR_ADDR=0x34a004
&HWIO_GCC_PNOC_BUS_TIMEOUT1_AHB_CBCR_ADDR=0x34a00c
&HWIO_GCC_PNOC_BUS_TIMEOUT2_AHB_CBCR_ADDR=0x34a014
&HWIO_GCC_PNOC_BUS_TIMEOUT3_AHB_CBCR_ADDR=0x34a01c
&HWIO_GCC_PNOC_BUS_TIMEOUT4_AHB_CBCR_ADDR=0x34a024
&HWIO_GCC_PRNG_AHB_CBCR_ADDR=0x334004
&HWIO_GCC_QDSS_APB2JTAG_CBCR_ADDR=0x34c004
&HWIO_GCC_QDSS_AT_CBCR_ADDR=0x30c00c
&HWIO_GCC_QDSS_CFG_AHB_CBCR_ADDR=0x30c008
&HWIO_GCC_QDSS_DAP_AHB_CBCR_ADDR=0x30c004
&HWIO_GCC_QDSS_DAP_CBCR_ADDR=0x30c024
&HWIO_GCC_QDSS_ETR_USB_CBCR_ADDR=0x30c010
&HWIO_GCC_QDSS_MPU_AHB_CBCR_ADDR=0x30b004
&HWIO_GCC_QDSS_STM_CBCR_ADDR=0x30c014
&HWIO_GCC_QDSS_TRACECLKIN_CBCR_ADDR=0x30c018
&HWIO_GCC_QDSS_TSCTR_DIV16_CBCR_ADDR=0x30c030
&HWIO_GCC_QDSS_TSCTR_DIV2_CBCR_ADDR=0x30c01c
&HWIO_GCC_QDSS_TSCTR_DIV3_CBCR_ADDR=0x30c020
&HWIO_GCC_QDSS_TSCTR_DIV4_CBCR_ADDR=0x30c028
&HWIO_GCC_QDSS_TSCTR_DIV8_CBCR_ADDR=0x30c02c
&HWIO_GCC_QREFS_VBG_CAL_CBCR_ADDR=0x388024
&HWIO_GCC_QSPI_AHB_CBCR_ADDR=0x38b004
&HWIO_GCC_QSPI_SER_CBCR_ADDR=0x38b008
&HWIO_GCC_RBCPR_CX_AHB_CBCR_ADDR=0x34e008
&HWIO_GCC_RBCPR_CX_CBCR_ADDR=0x34e004
&HWIO_GCC_RBCPR_MX_AHB_CBCR_ADDR=0x34f008
&HWIO_GCC_RBCPR_MX_CBCR_ADDR=0x34f004
&HWIO_GCC_RBCPR_XPU_AHB_CBCR_ADDR=0x30b000
&HWIO_GCC_RPM_BUS_AHB_CBCR_ADDR=0x33c004
&HWIO_GCC_RPM_MST_M2_CNOC_AHB_CBCR_ADDR=0x33c010
&HWIO_GCC_RPM_PROC_HCLK_CBCR_ADDR=0x33c000
&HWIO_GCC_RPM_SLEEP_CBCR_ADDR=0x33c008
&HWIO_GCC_RPM_TIMER_CBCR_ADDR=0x33c00c
&HWIO_GCC_SDCC1_AHB_CBCR_ADDR=0x313008
&HWIO_GCC_SDCC1_APPS_CBCR_ADDR=0x313004
&HWIO_GCC_SDCC1_ICE_CORE_CBCR_ADDR=0x313038
&HWIO_GCC_SDCC2_AHB_CBCR_ADDR=0x314008
&HWIO_GCC_SDCC2_APPS_CBCR_ADDR=0x314004
&HWIO_GCC_SDCC3_AHB_CBCR_ADDR=0x315008
&HWIO_GCC_SDCC3_APPS_CBCR_ADDR=0x315004
&HWIO_GCC_SDCC4_AHB_CBCR_ADDR=0x316008
&HWIO_GCC_SDCC4_APPS_CBCR_ADDR=0x316004
&HWIO_GCC_SEC_CTRL_ACC_CBCR_ADDR=0x33d004
&HWIO_GCC_SEC_CTRL_AHB_CBCR_ADDR=0x33d008
&HWIO_GCC_SEC_CTRL_BOOT_ROM_PATCH_CBCR_ADDR=0x33d014
&HWIO_GCC_SEC_CTRL_CBCR_ADDR=0x33d00c
&HWIO_GCC_SEC_CTRL_SENSE_CBCR_ADDR=0x33d010
&HWIO_GCC_SKL_AHB_CBCR_ADDR=0x38c004
&HWIO_GCC_SMMU_AGGRE0_AHB_CBCR_ADDR=0x381018
&HWIO_GCC_SMMU_AGGRE0_AXI_CBCR_ADDR=0x381014
&HWIO_GCC_SMMU_AGGRE1_AHB_CBCR_ADDR=0x38201c
&HWIO_GCC_SMMU_AGGRE1_AXI_CBCR_ADDR=0x382018
&HWIO_GCC_SMMU_AGGRE2_AHB_CBCR_ADDR=0x383020
&HWIO_GCC_SMMU_AGGRE2_AXI_CBCR_ADDR=0x38301c
&HWIO_GCC_SNOC_BUS_TIMEOUT0_AHB_CBCR_ADDR=0x349004
&HWIO_GCC_SNOC_BUS_TIMEOUT1_AHB_CBCR_ADDR=0x349014
&HWIO_GCC_SNOC_BUS_TIMEOUT2_AHB_CBCR_ADDR=0x34900c
&HWIO_GCC_SNOC_BUS_TIMEOUT3_AHB_CBCR_ADDR=0x34901c
&HWIO_GCC_SNOC_CNOC_AHB_CBCR_ADDR=0x304010
&HWIO_GCC_SNOC_PNOC_AHB_CBCR_ADDR=0x304014
&HWIO_GCC_SPDM_BIMC_CY_CBCR_ADDR=0x340010
&HWIO_GCC_SPDM_CFG_AHB_CBCR_ADDR=0x340004
&HWIO_GCC_SPDM_DEBUG_CY_CBCR_ADDR=0x340018
&HWIO_GCC_SPDM_FF_CBCR_ADDR=0x34000c
&HWIO_GCC_SPDM_MSTR_AHB_CBCR_ADDR=0x340008
&HWIO_GCC_SPDM_PNOC_CY_CBCR_ADDR=0x34001c
&HWIO_GCC_SPDM_RPM_CY_CBCR_ADDR=0x340020
&HWIO_GCC_SPDM_SNOC_CY_CBCR_ADDR=0x340014
&HWIO_GCC_SPMI_AHB_CBCR_ADDR=0x33f00c
&HWIO_GCC_SPMI_CNOC_AHB_CBCR_ADDR=0x33f008
&HWIO_GCC_SPMI_SER_CBCR_ADDR=0x33f004
&HWIO_GCC_SSC_APB_CBCR_ADDR=0x363018
&HWIO_GCC_SSC_AT_CBCR_ADDR=0x363014
&HWIO_GCC_SSC_CNOC_AHBS_CBCR_ADDR=0x36300c
&HWIO_GCC_SSC_CNOC_MPU_CBCR_ADDR=0x363010
&HWIO_GCC_SSC_SNOC_AHBM_CBCR_ADDR=0x363004
&HWIO_GCC_SSC_XO_CBCR_ADDR=0x36301c
&HWIO_GCC_SYS_NOC_AT_CBCR_ADDR=0x304018
&HWIO_GCC_SYS_NOC_AXI_CBCR_ADDR=0x304004
&HWIO_GCC_SYS_NOC_HMSS_AHB_CBCR_ADDR=0x30400c
&HWIO_GCC_SYS_NOC_HS_AXI_CBCR_ADDR=0x304034
&HWIO_GCC_SYS_NOC_PIMEM_AXI_CBCR_ADDR=0x30a024
&HWIO_GCC_SYS_NOC_QDSS_STM_AXI_CBCR_ADDR=0x304008
&HWIO_GCC_SYS_NOC_SSC_Q6_AXI_CBCR_ADDR=0x363008
&HWIO_GCC_SYS_NOC_UFS_AXI_CBCR_ADDR=0x375038
&HWIO_GCC_SYS_NOC_USB3_AXI_CBCR_ADDR=0x30f03c
&HWIO_GCC_TCSR_AHB_CBCR_ADDR=0x337004
&HWIO_GCC_TLMM_AHB_CBCR_ADDR=0x33a004
&HWIO_GCC_TLMM_CBCR_ADDR=0x33a008
&HWIO_GCC_TSIF_AHB_CBCR_ADDR=0x336004
&HWIO_GCC_TSIF_INACTIVITY_TIMERS_CBCR_ADDR=0x33600c
&HWIO_GCC_TSIF_REF_CBCR_ADDR=0x336008
&HWIO_GCC_UFS_AHB_CBCR_ADDR=0x37500c
&HWIO_GCC_UFS_AXI_CBCR_ADDR=0x375008
&HWIO_GCC_UFS_ICE_CORE_CBCR_ADDR=0x376010
&HWIO_GCC_UFS_RX_CFG_CBCR_ADDR=0x375014
&HWIO_GCC_UFS_RX_SYMBOL_0_CBCR_ADDR=0x37501c
&HWIO_GCC_UFS_RX_SYMBOL_1_CBCR_ADDR=0x375020
&HWIO_GCC_UFS_TX_CFG_CBCR_ADDR=0x375010
&HWIO_GCC_UFS_TX_SYMBOL_0_CBCR_ADDR=0x375018
&HWIO_GCC_UFS_UNIPRO_CORE_CBCR_ADDR=0x37600c
&HWIO_GCC_USB20_MASTER_CBCR_ADDR=0x312004
&HWIO_GCC_USB20_MOCK_UTMI_CBCR_ADDR=0x31200c
&HWIO_GCC_USB20_SLEEP_CBCR_ADDR=0x312008
&HWIO_GCC_USB30_MASTER_CBCR_ADDR=0x30f008
&HWIO_GCC_USB30_MOCK_UTMI_CBCR_ADDR=0x30f010
&HWIO_GCC_USB30_SLEEP_CBCR_ADDR=0x30f00c
&HWIO_GCC_USB3_PHY_AUX_CBCR_ADDR=0x350000
&HWIO_GCC_USB3_PHY_PIPE_CBCR_ADDR=0x350004
&HWIO_GCC_USB_PHY_CFG_AHB2PHY_CBCR_ADDR=0x36a004
&HWIO_GCC_VDDA_VS_CBCR_ADDR=0x37a00c
&HWIO_GCC_VDDCX_VS_CBCR_ADDR=0x37a004
&HWIO_GCC_VDDMX_VS_CBCR_ADDR=0x37a008
&HWIO_GCC_VS_CTRL_CBCR_ADDR=0x37a010
&HWIO_GCC_GCC_XO_CBCR_ADDR=0x343004
&HWIO_GCC_GCC_XO_DIV4_CBCR_ADDR=0x343008

;LPASS clock registers
&HWIO_LPASS_AUDIO_CORE_AUD_SLIMBUS_CBCR_ADDR=0x9015014
&HWIO_LPASS_AUDIO_CORE_AUD_SLIMBUS_CORE_CBCR_ADDR=0x9015018
&HWIO_LPASS_AUDIO_CORE_AVSYNC_STC_CBCR_ADDR=0x901a000
&HWIO_LPASS_AUDIO_CORE_BCR_SLP_CBCR_ADDR=0x9006004
&HWIO_LPASS_AUDIO_CORE_BUS_TIMEOUT_CORE_CBCR_ADDR=0x9039000
&HWIO_LPASS_AUDIO_CORE_CORE_CBCR_ADDR=0x901d000
&HWIO_LPASS_AUDIO_CORE_GDSC_XO_CBCR_ADDR=0x9009004
&HWIO_LPASS_AUDIO_CORE_LPAIF_CODEC_SPKR_EBIT_CBCR_ADDR=0x900d01c
&HWIO_LPASS_AUDIO_CORE_LPAIF_CODEC_SPKR_IBIT_CBCR_ADDR=0x900d018
&HWIO_LPASS_AUDIO_CORE_LPAIF_CODEC_SPKR_OSR_CBCR_ADDR=0x900d014
&HWIO_LPASS_AUDIO_CORE_LPAIF_PCM_DATA_OE_CBCR_ADDR=0x9017014
&HWIO_LPASS_AUDIO_CORE_LPAIF_PRI_EBIT_CBCR_ADDR=0x900e01c
&HWIO_LPASS_AUDIO_CORE_LPAIF_PRI_IBIT_CBCR_ADDR=0x900e018
&HWIO_LPASS_AUDIO_CORE_LPAIF_QUAD_EBIT_CBCR_ADDR=0x901101c
&HWIO_LPASS_AUDIO_CORE_LPAIF_QUAD_IBIT_CBCR_ADDR=0x9011018
&HWIO_LPASS_AUDIO_CORE_LPAIF_SEC_EBIT_CBCR_ADDR=0x900f01c
&HWIO_LPASS_AUDIO_CORE_LPAIF_SEC_IBIT_CBCR_ADDR=0x900f018
&HWIO_LPASS_AUDIO_CORE_LPAIF_TER_EBIT_CBCR_ADDR=0x901001c
&HWIO_LPASS_AUDIO_CORE_LPAIF_TER_IBIT_CBCR_ADDR=0x9010018
&HWIO_LPASS_AUDIO_CORE_LPM_CORE_CBCR_ADDR=0x901c000
&HWIO_LPASS_AUDIO_CORE_PERIPHERAL_SMMU_CFG_CNOC_CBCR_ADDR=0x9028000
&HWIO_LPASS_AUDIO_CORE_PERIPHERAL_SMMU_CLIENT_CORE_CBCR_ADDR=0x9025000
&HWIO_LPASS_AUDIO_CORE_QCA_SLIMBUS_CBCR_ADDR=0x9016014
&HWIO_LPASS_AUDIO_CORE_QCA_SLIMBUS_CORE_CBCR_ADDR=0x9016018
&HWIO_LPASS_AUDIO_CORE_QDSP_SWAY_AON_CBCR_ADDR=0x9026000
&MACRO_TOO_LONG_1=0x9034000
&HWIO_LPASS_AUDIO_CORE_RESAMPLER_CBCR_ADDR=0x9014014
&HWIO_LPASS_AUDIO_CORE_SYSNOC_MPORT_CORE_CBCR_ADDR=0x9021000
&HWIO_LPASS_AUDIO_CORE_SYSNOC_SWAY_SNOC_CBCR_ADDR=0x9022000
&HWIO_LPASS_AUDIO_WRAPPER_AON_CBCR_ADDR=0x9012014
&HWIO_LPASS_AUDIO_WRAPPER_BUS_TIMEOUT_AON_CBCR_ADDR=0x9038000
&HWIO_LPASS_AUDIO_WRAPPER_EXT_MCLK0_CBCR_ADDR=0x901e014
&HWIO_LPASS_AUDIO_WRAPPER_EXT_MCLK1_CBCR_ADDR=0x901f014
&HWIO_LPASS_AUDIO_WRAPPER_EXT_MCLK2_CBCR_ADDR=0x9020014
&HWIO_LPASS_AUDIO_WRAPPER_MPU_CFG_AON_CBCR_ADDR=0x902f000
&HWIO_LPASS_AUDIO_WRAPPER_Q6_AHBM_MPU_AON_CBCR_ADDR=0x9030000
&HWIO_LPASS_AUDIO_WRAPPER_Q6_SMMU_AXI_CBCR_ADDR=0x902c000
&HWIO_LPASS_AUDIO_WRAPPER_Q6_SMMU_CFG_CNOC_CBCR_ADDR=0x9029000
&HWIO_LPASS_AUDIO_WRAPPER_Q6_SMMU_GDSC_XO_CBCR_ADDR=0x900b004
&HWIO_LPASS_AUDIO_WRAPPER_QOS_AHBS_AON_CBCR_ADDR=0x9033014
&MACRO_TOO_LONG_2=0x9033020
&MACRO_TOO_LONG_3=0x903301c
&HWIO_LPASS_AUDIO_WRAPPER_QOS_XO_LAT_COUNTER_CBCR_ADDR=0x9033018
&HWIO_LPASS_AUDIO_WRAPPER_SYSNOC_SWAY_AON_CBCR_ADDR=0x9023000
&HWIO_LPASS_AUDIO_WRAPPER_SYSNOC_SWAY_SNOC_CBCR_ADDR=0x9027000
&HWIO_LPASS_AUDIO_CORE_AVSYNC_ATIME_CBCR_ADDR=0x9013014
&HWIO_LPASS_Q6SS_AHBM_AON_CBCR_ADDR=0x9024000
&HWIO_LPASS_Q6SS_AHBS_AON_CBCR_ADDR=0x9031000
&HWIO_LPASS_Q6SS_BCR_SLP_CBCR_ADDR=0x9008004
&HWIO_LPASS_Q6SS_Q6_AXIM_CBCR_ADDR=0x902b000
&HWIO_LPASS_Q6SS_Q6_CAMSS_DSP_STREAMING_0_CBCR_ADDR=0x902d000
&HWIO_LPASS_Q6SS_Q6_CAMSS_DSP_STREAMING_1_CBCR_ADDR=0x902e000
&HWIO_LPASS_QDSP6SS_SLEEP_CBCR_ADDR=0x930003c
&HWIO_LPASS_QDSP6SS_XO_CBCR_ADDR=0x9300038

;MMSS clock registers
&HWIO_MMSS_CAMSS_AHB_CBCR_ADDR=0x8c348c
&HWIO_MMSS_CAMSS_CCI_AHB_CBCR_ADDR=0x8c3348
&HWIO_MMSS_CAMSS_CCI_CBCR_ADDR=0x8c3344
&HWIO_MMSS_CAMSS_CPP_AHB_CBCR_ADDR=0x8c36b4
&HWIO_MMSS_CAMSS_CPP_AXI_CBCR_ADDR=0x8c36c4
&HWIO_MMSS_CAMSS_CPP_CBCR_ADDR=0x8c36b0
&HWIO_MMSS_CAMSS_CPP_VBIF_AHB_CBCR_ADDR=0x8c36c8
&HWIO_MMSS_CAMSS_CSI0_AHB_CBCR_ADDR=0x8c30bc
&HWIO_MMSS_CAMSS_CSI0_CBCR_ADDR=0x8c30b4
&HWIO_MMSS_CAMSS_CSI0PHY_CBCR_ADDR=0x8c30c4
&HWIO_MMSS_CAMSS_CSI0PHYTIMER_CBCR_ADDR=0x8c3024
&HWIO_MMSS_CAMSS_CSI0PIX_CBCR_ADDR=0x8c30e4
&HWIO_MMSS_CAMSS_CSI0RDI_CBCR_ADDR=0x8c30d4
&HWIO_MMSS_CAMSS_CSI1_AHB_CBCR_ADDR=0x8c3128
&HWIO_MMSS_CAMSS_CSI1_CBCR_ADDR=0x8c3124
&HWIO_MMSS_CAMSS_CSI1PHY_CBCR_ADDR=0x8c3134
&HWIO_MMSS_CAMSS_CSI1PHYTIMER_CBCR_ADDR=0x8c3054
&HWIO_MMSS_CAMSS_CSI1PIX_CBCR_ADDR=0x8c3154
&HWIO_MMSS_CAMSS_CSI1RDI_CBCR_ADDR=0x8c3144
&HWIO_MMSS_CAMSS_CSI2_AHB_CBCR_ADDR=0x8c3188
&HWIO_MMSS_CAMSS_CSI2_CBCR_ADDR=0x8c3184
&HWIO_MMSS_CAMSS_CSI2PHY_CBCR_ADDR=0x8c3194
&HWIO_MMSS_CAMSS_CSI2PHYTIMER_CBCR_ADDR=0x8c3084
&HWIO_MMSS_CAMSS_CSI2PIX_CBCR_ADDR=0x8c31b4
&HWIO_MMSS_CAMSS_CSI2RDI_CBCR_ADDR=0x8c31a4
&HWIO_MMSS_CAMSS_CSI3_AHB_CBCR_ADDR=0x8c31e8
&HWIO_MMSS_CAMSS_CSI3_CBCR_ADDR=0x8c31e4
&HWIO_MMSS_CAMSS_CSI3PHY_CBCR_ADDR=0x8c31f4
&HWIO_MMSS_CAMSS_CSI3PIX_CBCR_ADDR=0x8c3214
&HWIO_MMSS_CAMSS_CSI3RDI_CBCR_ADDR=0x8c3204
&HWIO_MMSS_CAMSS_CSI_VFE0_CBCR_ADDR=0x8c3704
&HWIO_MMSS_CAMSS_CSI_VFE1_CBCR_ADDR=0x8c3714
&HWIO_MMSS_CAMSS_CSIPHY0_3P_CBCR_ADDR=0x8c3234
&HWIO_MMSS_CAMSS_CSIPHY1_3P_CBCR_ADDR=0x8c3254
&HWIO_MMSS_CAMSS_CSIPHY2_3P_CBCR_ADDR=0x8c3274
&HWIO_MMSS_CAMSS_GP0_CBCR_ADDR=0x8c3444
&HWIO_MMSS_CAMSS_GP1_CBCR_ADDR=0x8c3474
&HWIO_MMSS_CAMSS_ISPIF_AHB_CBCR_ADDR=0x8c3224
&HWIO_MMSS_CAMSS_JPEG0_CBCR_ADDR=0x8c35a8
&HWIO_MMSS_CAMSS_JPEG2_CBCR_ADDR=0x8c35b0
&HWIO_MMSS_CAMSS_JPEG_AHB_CBCR_ADDR=0x8c35b4
&HWIO_MMSS_CAMSS_JPEG_AXI_CBCR_ADDR=0x8c35b8
&HWIO_MMSS_CAMSS_JPEG_DMA_CBCR_ADDR=0x8c35c0
&HWIO_MMSS_CAMSS_MCLK0_CBCR_ADDR=0x8c3384
&HWIO_MMSS_CAMSS_MCLK1_CBCR_ADDR=0x8c33b4
&HWIO_MMSS_CAMSS_MCLK2_CBCR_ADDR=0x8c33e4
&HWIO_MMSS_CAMSS_MCLK3_CBCR_ADDR=0x8c3414
&HWIO_MMSS_CAMSS_MICRO_AHB_CBCR_ADDR=0x8c3494
&HWIO_MMSS_CAMSS_TOP_AHB_CBCR_ADDR=0x8c3484
&HWIO_MMSS_CAMSS_VFE0_AHB_CBCR_ADDR=0x8c3668
&HWIO_MMSS_CAMSS_VFE0_CBCR_ADDR=0x8c36a8
&HWIO_MMSS_CAMSS_VFE0_STREAM_CBCR_ADDR=0x8c3720
&HWIO_MMSS_CAMSS_VFE1_AHB_CBCR_ADDR=0x8c3678
&HWIO_MMSS_CAMSS_VFE1_CBCR_ADDR=0x8c36ac
&HWIO_MMSS_CAMSS_VFE1_STREAM_CBCR_ADDR=0x8c3724
&HWIO_MMSS_CAMSS_VFE_AHB_CBCR_ADDR=0x8c36b8
&HWIO_MMSS_CAMSS_VFE_AXI_CBCR_ADDR=0x8c36bc
&HWIO_MMSS_DSA_CORE_CBCR_ADDR=0x8c50a4
&HWIO_MMSS_DSA_NOC_CFG_AHB_CBCR_ADDR=0x8c50a8
&HWIO_MMSS_FD_AHB_CBCR_ADDR=0x8c3b74
&HWIO_MMSS_FD_CORE_CBCR_ADDR=0x8c3b68
&HWIO_MMSS_FD_CORE_UAR_CBCR_ADDR=0x8c3b6c
&HWIO_MMSS_GPU_AHB_CBCR_ADDR=0x8c403c
&HWIO_MMSS_GPU_AON_ISENSE_CBCR_ADDR=0x8c4044
&HWIO_MMSS_GPU_GX_GFX3D_CBCR_ADDR=0x8c4028
&HWIO_MMSS_GPU_GX_RBBMTIMER_CBCR_ADDR=0x8c40b0
&HWIO_MMSS_MDSS_AHB_CBCR_ADDR=0x8c2308
&HWIO_MMSS_MDSS_AXI_CBCR_ADDR=0x8c2310
&HWIO_MMSS_MDSS_BYTE0_CBCR_ADDR=0x8c233c
&HWIO_MMSS_MDSS_BYTE1_CBCR_ADDR=0x8c2340
&HWIO_MMSS_MDSS_EDPAUX_CBCR_ADDR=0x8c2334
&HWIO_MMSS_MDSS_EDPGTC_CBCR_ADDR=0x8c2364
&HWIO_MMSS_MDSS_EDPLINK_CBCR_ADDR=0x8c2330
&HWIO_MMSS_MDSS_EDPPIXEL_CBCR_ADDR=0x8c232c
&HWIO_MMSS_MDSS_ESC0_CBCR_ADDR=0x8c2344
&HWIO_MMSS_MDSS_ESC1_CBCR_ADDR=0x8c2348
&HWIO_MMSS_MDSS_EXTPCLK_CBCR_ADDR=0x8c2324
&HWIO_MMSS_MDSS_HDMI_AHB_CBCR_ADDR=0x8c230c
&HWIO_MMSS_MDSS_HDMI_CBCR_ADDR=0x8c2338
&HWIO_MMSS_MDSS_MDP_CBCR_ADDR=0x8c231c
&HWIO_MMSS_MDSS_PCLK0_CBCR_ADDR=0x8c2314
&HWIO_MMSS_MDSS_PCLK1_CBCR_ADDR=0x8c2318
&HWIO_MMSS_MDSS_VSYNC_CBCR_ADDR=0x8c2328
&HWIO_MMSS_MMAGIC_BIMC_AXI_CBCR_ADDR=0x8c5294
&HWIO_MMSS_MMAGIC_BIMC_NOC_CFG_AHB_CBCR_ADDR=0x8c5298
&HWIO_MMSS_MMAGIC_CAMSS_AXI_CBCR_ADDR=0x8c3c44
&HWIO_MMSS_MMAGIC_CAMSS_NOC_CFG_AHB_CBCR_ADDR=0x8c3c48
&HWIO_MMSS_MMAGIC_MDSS_AXI_CBCR_ADDR=0x8c2474
&HWIO_MMSS_MMAGIC_MDSS_NOC_CFG_AHB_CBCR_ADDR=0x8c2478
&HWIO_MMSS_MMAGIC_VIDEO_AXI_CBCR_ADDR=0x8c1194
&HWIO_MMSS_MMAGIC_VIDEO_NOC_CFG_AHB_CBCR_ADDR=0x8c1198
&HWIO_MMSS_MMSS_BTO_AHB_CBCR_ADDR=0x8c5028
&HWIO_MMSS_MMSS_CXO_CBCR_ADDR=0x8c5104
&HWIO_MMSS_MMSS_MISC_AHB_CBCR_ADDR=0x8c5018
&HWIO_MMSS_MMSS_MISC_CXO_CBCR_ADDR=0x8c5014
&HWIO_MMSS_MMSS_MMAGIC_AHB_CBCR_ADDR=0x8c5024
&HWIO_MMSS_MMSS_MMAGIC_AXI_CBCR_ADDR=0x8c506c
&HWIO_MMSS_MMSS_MMAGIC_CFG_AHB_CBCR_ADDR=0x8c5054
&HWIO_MMSS_MMSS_MMAGIC_MAXI_CBCR_ADDR=0x8c5074
&HWIO_MMSS_MMSS_RBCPR_AHB_CBCR_ADDR=0x8c4088
&HWIO_MMSS_MMSS_RBCPR_CBCR_ADDR=0x8c4084
&HWIO_MMSS_MMSS_S0_AXI_CBCR_ADDR=0x8c5064
&HWIO_MMSS_MMSS_SLEEPCLK_CBCR_ADDR=0x8c5100
&HWIO_MMSS_MMSS_SPDM_AHB_CBCR_ADDR=0x8c0230
&HWIO_MMSS_MMSS_SPDM_AXI_CBCR_ADDR=0x8c0210
&HWIO_MMSS_MMSS_SPDM_CPP_CBCR_ADDR=0x8c0220
&HWIO_MMSS_MMSS_SPDM_CSI0_CBCR_ADDR=0x8c023c
&HWIO_MMSS_MMSS_SPDM_DEBUG_CBCR_ADDR=0x8c0240
&HWIO_MMSS_MMSS_SPDM_GFX3D_CBCR_ADDR=0x8c022c
&HWIO_MMSS_MMSS_SPDM_JPEG0_CBCR_ADDR=0x8c0204
&HWIO_MMSS_MMSS_SPDM_JPEG2_CBCR_ADDR=0x8c0224
&HWIO_MMSS_MMSS_SPDM_JPEG_DMA_CBCR_ADDR=0x8c0208
&HWIO_MMSS_MMSS_SPDM_MDP_CBCR_ADDR=0x8c020c
&HWIO_MMSS_MMSS_SPDM_PCLK0_CBCR_ADDR=0x8c0234
&HWIO_MMSS_MMSS_SPDM_PCLK1_CBCR_ADDR=0x8c0228
&HWIO_MMSS_MMSS_SPDM_RM_AXI_CBCR_ADDR=0x8c0304
&HWIO_MMSS_MMSS_SPDM_RM_MAXI_CBCR_ADDR=0x8c0308
&HWIO_MMSS_MMSS_SPDM_VFE0_CBCR_ADDR=0x8c0218
&HWIO_MMSS_MMSS_SPDM_VFE1_CBCR_ADDR=0x8c021c
&HWIO_MMSS_MMSS_SPDM_VIDEO_CORE_CBCR_ADDR=0x8c0214
&HWIO_MMSS_SMMU_CPP_AHB_CBCR_ADDR=0x8c3c14
&HWIO_MMSS_SMMU_CPP_AXI_CBCR_ADDR=0x8c3c18
&HWIO_MMSS_SMMU_JPEG_AHB_CBCR_ADDR=0x8c3c24
&HWIO_MMSS_SMMU_JPEG_AXI_CBCR_ADDR=0x8c3c28
&HWIO_MMSS_SMMU_MDP_AHB_CBCR_ADDR=0x8c2454
&HWIO_MMSS_SMMU_MDP_AXI_CBCR_ADDR=0x8c2458
&HWIO_MMSS_SMMU_ROT_AHB_CBCR_ADDR=0x8c2444
&HWIO_MMSS_SMMU_ROT_AXI_CBCR_ADDR=0x8c2448
&HWIO_MMSS_SMMU_VFE_AHB_CBCR_ADDR=0x8c3c04
&HWIO_MMSS_SMMU_VFE_AXI_CBCR_ADDR=0x8c3c08
&HWIO_MMSS_SMMU_VIDEO_AHB_CBCR_ADDR=0x8c1174
&HWIO_MMSS_SMMU_VIDEO_AXI_CBCR_ADDR=0x8c1178
&HWIO_MMSS_THROTTLE_CAMSS_AHB_CBCR_ADDR=0x8c3c34
&HWIO_MMSS_THROTTLE_CAMSS_AXI_CBCR_ADDR=0x8c3c3c
&HWIO_MMSS_THROTTLE_CAMSS_CXO_CBCR_ADDR=0x8c3c38
&HWIO_MMSS_THROTTLE_MDSS_AHB_CBCR_ADDR=0x8c2464
&HWIO_MMSS_THROTTLE_MDSS_AXI_CBCR_ADDR=0x8c246c
&HWIO_MMSS_THROTTLE_MDSS_CXO_CBCR_ADDR=0x8c2468
&HWIO_MMSS_THROTTLE_VIDEO_AHB_CBCR_ADDR=0x8c1184
&HWIO_MMSS_THROTTLE_VIDEO_AXI_CBCR_ADDR=0x8c118c
&HWIO_MMSS_THROTTLE_VIDEO_CXO_CBCR_ADDR=0x8c1188
&HWIO_MMSS_VIDEO_AHB_CBCR_ADDR=0x8c1030
&HWIO_MMSS_VIDEO_AXI_CBCR_ADDR=0x8c1034
&HWIO_MMSS_VIDEO_CORE_CBCR_ADDR=0x8c1028
&HWIO_MMSS_VIDEO_MAXI_CBCR_ADDR=0x8c1038
&HWIO_MMSS_VIDEO_SUBCORE0_CBCR_ADDR=0x8c1048
&HWIO_MMSS_VIDEO_SUBCORE1_CBCR_ADDR=0x8c104c
&HWIO_MMSS_VMEM_AHB_CBCR_ADDR=0x8c1208
&HWIO_MMSS_VMEM_MAXI_CBCR_ADDR=0x8c1204

;MSS clock registers
&HWIO_MSS_AXI_MNOC_CBCR_ADDR=0x21a9040
&HWIO_MSS_AXI_NAV_CBCR_ADDR=0x21aa09c
&HWIO_MSS_BIT_COXM_CBCR_ADDR=0x21aa0c8
&HWIO_MSS_BUS_COXM_CBCR_ADDR=0x21aa0c4
&HWIO_MSS_BUS_CRYPTO_CBCR_ADDR=0x21aa0a4
&HWIO_MSS_BUS_MGPI_CBCR_ADDR=0x21aa0dc
&HWIO_MSS_BUS_MVC_CBCR_ADDR=0x21aa0e4
&HWIO_MSS_BUS_NAV_CBCR_ADDR=0x21aa098
&HWIO_MSS_BUS_Q6SS_CBCR_ADDR=0x21aa090
&HWIO_MSS_BUS_RBCPR_CBCR_ADDR=0x21aa0d4
&HWIO_MSS_BUS_RFC_CBCR_ADDR=0x21aa0f0
&HWIO_MSS_BUS_SLAVE_TIMEOUT_CBCR_ADDR=0x21aa0e0
&HWIO_MSS_BUS_STMR_CBCR_ADDR=0x21aa0e8
&HWIO_MSS_BUS_UIM0_CBCR_ADDR=0x21aa02c
&HWIO_MSS_BUS_UIM1_CBCR_ADDR=0x21aa04c
&HWIO_MSS_BUS_UIM2_CBCR_ADDR=0x21aa06c
&HWIO_MSS_BUS_UIM3_CBCR_ADDR=0x21aa08c
&HWIO_MSS_CARD_SRC_UIM0_CBCR_ADDR=0x21aa024
&HWIO_MSS_CARD_SRC_UIM1_CBCR_ADDR=0x21aa044
&HWIO_MSS_CARD_SRC_UIM2_CBCR_ADDR=0x21aa064
&HWIO_MSS_CARD_SRC_UIM3_CBCR_ADDR=0x21aa084
&HWIO_MSS_RBCPR_REF_CBCR_ADDR=0x21aa0d8
&HWIO_MSS_UART_BIT_UIM0_CBCR_ADDR=0x21aa028
&HWIO_MSS_UART_BIT_UIM1_CBCR_ADDR=0x21aa048
&HWIO_MSS_UART_BIT_UIM2_CBCR_ADDR=0x21aa068
&HWIO_MSS_UART_BIT_UIM3_CBCR_ADDR=0x21aa088
&HWIO_MSS_XO_MDM_CBCR_ADDR=0x21a9044
&HWIO_MSS_XO_NAV_CBCR_ADDR=0x21aa0a0
&HWIO_MSS_DGR_AHB_CBCR_ADDR=0x2300004

;SSC clock registers
&HWIO_SSC_SCC_SCC_AHB_TIMEOUT_CBCR_ADDR=0x1e29038
&HWIO_SSC_SCC_SCC_AT_CBCR_ADDR=0x1e2a008
&HWIO_SSC_SCC_SCC_BLSP_H_CBCR_ADDR=0x1e2901c
&HWIO_SSC_SCC_SCC_CFG_AHB_CBCR_ADDR=0x1e29014
&HWIO_SSC_SCC_SCC_CRIF_CBCR_ADDR=0x1e29008
&HWIO_SSC_SCC_SCC_CSR_H_CBCR_ADDR=0x1e2900c
&HWIO_SSC_SCC_SCC_DATA_H_CBCR_ADDR=0x1e29010
&HWIO_SSC_SCC_SCC_DBG_TSCTR_CBCR_ADDR=0x1e2a054
&HWIO_SSC_SCC_SCC_PCLKDBG_CBCR_ADDR=0x1e2a010
&HWIO_SSC_SCC_SCC_Q6_AHBM_CBCR_ADDR=0x1e29024
&HWIO_SSC_SCC_SCC_Q6_AHBS_CBCR_ADDR=0x1e29028
&HWIO_SSC_SCC_SCC_Q6_ATBM_CBCR_ADDR=0x1e2a00c
&HWIO_SSC_SCC_SCC_Q6_SPM_CBCR_ADDR=0x1e28004
&HWIO_SSC_SCC_SCC_Q6_XPU2_CLIENT_CBCR_ADDR=0x1e2903c
&HWIO_SSC_SCC_SCC_Q6_XPU2_CONFIG_CBCR_ADDR=0x1e29044
&HWIO_SSC_SCC_SCC_QUP_I2C1_CBCR_ADDR=0x1e2200c
&HWIO_SSC_SCC_SCC_QUP_I2C2_CBCR_ADDR=0x1e2300c
&HWIO_SSC_SCC_SCC_QUP_I2C3_CBCR_ADDR=0x1e2400c
&HWIO_SSC_SCC_SCC_QUP_SPI1_CBCR_ADDR=0x1e22008
&HWIO_SSC_SCC_SCC_QUP_SPI2_CBCR_ADDR=0x1e23008
&HWIO_SSC_SCC_SCC_QUP_SPI3_CBCR_ADDR=0x1e24008
&HWIO_SSC_SCC_SCC_SMEM_CBCR_ADDR=0x1e29030
&HWIO_SSC_SCC_SCC_UART_DM_UART1_CBCR_ADDR=0x1e25004
&HWIO_SSC_SCC_SCC_UART_DM_UART2_CBCR_ADDR=0x1e26004
&HWIO_SSC_SCC_SCC_UART_DM_UART3_CBCR_ADDR=0x1e27004
&HWIO_SSC_SCC_SCC_VS_VDDCX_CBCR_ADDR=0x1e2a04c
&HWIO_SSC_SCC_SCC_VS_VDDMX_CBCR_ADDR=0x1e2a048

; CMD and CFG RCGRs for clocks with configurable frequencies
&HWIO_GCC_ACC_CMD_RCGR_ADDR=0x33e000
&HWIO_GCC_ACC_CFG_RCGR_ADDR=0x33e004
&HWIO_GCC_BIMC_DDR_XO_CMD_RCGR_ADDR=0x345000
&HWIO_GCC_BIMC_DDR_XO_CFG_RCGR_ADDR=0x345004
&HWIO_GCC_BLSP1_QUP1_I2C_APPS_CMD_RCGR_ADDR=0x319020
&HWIO_GCC_BLSP1_QUP1_I2C_APPS_CFG_RCGR_ADDR=0x319024
&HWIO_GCC_BLSP1_QUP1_SPI_APPS_CMD_RCGR_ADDR=0x31900c
&HWIO_GCC_BLSP1_QUP1_SPI_APPS_CFG_RCGR_ADDR=0x319010
&HWIO_GCC_BLSP1_QUP2_I2C_APPS_CMD_RCGR_ADDR=0x31b020
&HWIO_GCC_BLSP1_QUP2_I2C_APPS_CFG_RCGR_ADDR=0x31b024
&HWIO_GCC_BLSP1_QUP2_SPI_APPS_CMD_RCGR_ADDR=0x31b00c
&HWIO_GCC_BLSP1_QUP2_SPI_APPS_CFG_RCGR_ADDR=0x31b010
&HWIO_GCC_BLSP1_QUP3_I2C_APPS_CMD_RCGR_ADDR=0x31d020
&HWIO_GCC_BLSP1_QUP3_I2C_APPS_CFG_RCGR_ADDR=0x31d024
&HWIO_GCC_BLSP1_QUP3_SPI_APPS_CMD_RCGR_ADDR=0x31d00c
&HWIO_GCC_BLSP1_QUP3_SPI_APPS_CFG_RCGR_ADDR=0x31d010
&HWIO_GCC_BLSP1_QUP4_I2C_APPS_CMD_RCGR_ADDR=0x31f020
&HWIO_GCC_BLSP1_QUP4_I2C_APPS_CFG_RCGR_ADDR=0x31f024
&HWIO_GCC_BLSP1_QUP4_SPI_APPS_CMD_RCGR_ADDR=0x31f00c
&HWIO_GCC_BLSP1_QUP4_SPI_APPS_CFG_RCGR_ADDR=0x31f010
&HWIO_GCC_BLSP1_QUP5_I2C_APPS_CMD_RCGR_ADDR=0x321020
&HWIO_GCC_BLSP1_QUP5_I2C_APPS_CFG_RCGR_ADDR=0x321024
&HWIO_GCC_BLSP1_QUP5_SPI_APPS_CMD_RCGR_ADDR=0x32100c
&HWIO_GCC_BLSP1_QUP5_SPI_APPS_CFG_RCGR_ADDR=0x321010
&HWIO_GCC_BLSP1_QUP6_I2C_APPS_CMD_RCGR_ADDR=0x323020
&HWIO_GCC_BLSP1_QUP6_I2C_APPS_CFG_RCGR_ADDR=0x323024
&HWIO_GCC_BLSP1_QUP6_SPI_APPS_CMD_RCGR_ADDR=0x32300c
&HWIO_GCC_BLSP1_QUP6_SPI_APPS_CFG_RCGR_ADDR=0x323010
&HWIO_GCC_BLSP1_UART1_APPS_CMD_RCGR_ADDR=0x31a00c
&HWIO_GCC_BLSP1_UART1_APPS_CFG_RCGR_ADDR=0x31a010
&HWIO_GCC_BLSP1_UART2_APPS_CMD_RCGR_ADDR=0x31c00c
&HWIO_GCC_BLSP1_UART2_APPS_CFG_RCGR_ADDR=0x31c010
&HWIO_GCC_BLSP1_UART3_APPS_CMD_RCGR_ADDR=0x31e00c
&HWIO_GCC_BLSP1_UART3_APPS_CFG_RCGR_ADDR=0x31e010
&HWIO_GCC_BLSP1_UART4_APPS_CMD_RCGR_ADDR=0x32000c
&HWIO_GCC_BLSP1_UART4_APPS_CFG_RCGR_ADDR=0x320010
&HWIO_GCC_BLSP1_UART5_APPS_CMD_RCGR_ADDR=0x32200c
&HWIO_GCC_BLSP1_UART5_APPS_CFG_RCGR_ADDR=0x322010
&HWIO_GCC_BLSP1_UART6_APPS_CMD_RCGR_ADDR=0x32400c
&HWIO_GCC_BLSP1_UART6_APPS_CFG_RCGR_ADDR=0x324010
&HWIO_GCC_BLSP2_QUP1_I2C_APPS_CMD_RCGR_ADDR=0x326020
&HWIO_GCC_BLSP2_QUP1_I2C_APPS_CFG_RCGR_ADDR=0x326024
&HWIO_GCC_BLSP2_QUP1_SPI_APPS_CMD_RCGR_ADDR=0x32600c
&HWIO_GCC_BLSP2_QUP1_SPI_APPS_CFG_RCGR_ADDR=0x326010
&HWIO_GCC_BLSP2_QUP2_I2C_APPS_CMD_RCGR_ADDR=0x328020
&HWIO_GCC_BLSP2_QUP2_I2C_APPS_CFG_RCGR_ADDR=0x328024
&HWIO_GCC_BLSP2_QUP2_SPI_APPS_CMD_RCGR_ADDR=0x32800c
&HWIO_GCC_BLSP2_QUP2_SPI_APPS_CFG_RCGR_ADDR=0x328010
&HWIO_GCC_BLSP2_QUP3_I2C_APPS_CMD_RCGR_ADDR=0x32a020
&HWIO_GCC_BLSP2_QUP3_I2C_APPS_CFG_RCGR_ADDR=0x32a024
&HWIO_GCC_BLSP2_QUP3_SPI_APPS_CMD_RCGR_ADDR=0x32a00c
&HWIO_GCC_BLSP2_QUP3_SPI_APPS_CFG_RCGR_ADDR=0x32a010
&HWIO_GCC_BLSP2_QUP4_I2C_APPS_CMD_RCGR_ADDR=0x32c020
&HWIO_GCC_BLSP2_QUP4_I2C_APPS_CFG_RCGR_ADDR=0x32c024
&HWIO_GCC_BLSP2_QUP4_SPI_APPS_CMD_RCGR_ADDR=0x32c00c
&HWIO_GCC_BLSP2_QUP4_SPI_APPS_CFG_RCGR_ADDR=0x32c010
&HWIO_GCC_BLSP2_QUP5_I2C_APPS_CMD_RCGR_ADDR=0x32e020
&HWIO_GCC_BLSP2_QUP5_I2C_APPS_CFG_RCGR_ADDR=0x32e024
&HWIO_GCC_BLSP2_QUP5_SPI_APPS_CMD_RCGR_ADDR=0x32e00c
&HWIO_GCC_BLSP2_QUP5_SPI_APPS_CFG_RCGR_ADDR=0x32e010
&HWIO_GCC_BLSP2_QUP6_I2C_APPS_CMD_RCGR_ADDR=0x330020
&HWIO_GCC_BLSP2_QUP6_I2C_APPS_CFG_RCGR_ADDR=0x330024
&HWIO_GCC_BLSP2_QUP6_SPI_APPS_CMD_RCGR_ADDR=0x33000c
&HWIO_GCC_BLSP2_QUP6_SPI_APPS_CFG_RCGR_ADDR=0x330010
&HWIO_GCC_BLSP2_UART1_APPS_CMD_RCGR_ADDR=0x32700c
&HWIO_GCC_BLSP2_UART1_APPS_CFG_RCGR_ADDR=0x327010
&HWIO_GCC_BLSP2_UART2_APPS_CMD_RCGR_ADDR=0x32900c
&HWIO_GCC_BLSP2_UART2_APPS_CFG_RCGR_ADDR=0x329010
&HWIO_GCC_BLSP2_UART3_APPS_CMD_RCGR_ADDR=0x32b00c
&HWIO_GCC_BLSP2_UART3_APPS_CFG_RCGR_ADDR=0x32b010
&HWIO_GCC_BLSP2_UART4_APPS_CMD_RCGR_ADDR=0x32d00c
&HWIO_GCC_BLSP2_UART4_APPS_CFG_RCGR_ADDR=0x32d010
&HWIO_GCC_BLSP2_UART5_APPS_CMD_RCGR_ADDR=0x32f00c
&HWIO_GCC_BLSP2_UART5_APPS_CFG_RCGR_ADDR=0x32f010
&HWIO_GCC_BLSP2_UART6_APPS_CMD_RCGR_ADDR=0x33100c
&HWIO_GCC_BLSP2_UART6_APPS_CFG_RCGR_ADDR=0x331010
&HWIO_GCC_BLSP_UART_SIM_CMD_RCGR_ADDR=0x318000
&HWIO_GCC_BLSP_UART_SIM_CFG_RCGR_ADDR=0x318004
&HWIO_GCC_CE1_CMD_RCGR_ADDR=0x341010
&HWIO_GCC_CE1_CFG_RCGR_ADDR=0x341014
&HWIO_GCC_CONFIG_NOC_CMD_RCGR_ADDR=0x30500c
&HWIO_GCC_CONFIG_NOC_CFG_RCGR_ADDR=0x305010
&HWIO_GCC_GCC_XO_CMD_RCGR_ADDR=0x34302c
&HWIO_GCC_GCC_XO_CFG_RCGR_ADDR=0x343030
&HWIO_GCC_GP1_CMD_RCGR_ADDR=0x364004
&HWIO_GCC_GP1_CFG_RCGR_ADDR=0x364008
&HWIO_GCC_GP2_CMD_RCGR_ADDR=0x365004
&HWIO_GCC_GP2_CFG_RCGR_ADDR=0x365008
&HWIO_GCC_GP3_CMD_RCGR_ADDR=0x366004
&HWIO_GCC_GP3_CFG_RCGR_ADDR=0x366008
&HWIO_GCC_HMSS_AHB_CMD_RCGR_ADDR=0x348010
&HWIO_GCC_HMSS_AHB_CFG_RCGR_ADDR=0x348014
&HWIO_GCC_HMSS_RBCPR_CMD_RCGR_ADDR=0x348040
&HWIO_GCC_HMSS_RBCPR_CFG_RCGR_ADDR=0x348044
&HWIO_GCC_IPA_CMD_RCGR_ADDR=0x389014
&HWIO_GCC_IPA_CFG_RCGR_ADDR=0x389018
&HWIO_GCC_MSS_VS_CMD_RCGR_ADDR=0x37a074
&HWIO_GCC_MSS_VS_CFG_RCGR_ADDR=0x37a078
&HWIO_GCC_PCIE_AUX_CMD_RCGR_ADDR=0x36c000
&HWIO_GCC_PCIE_AUX_CFG_RCGR_ADDR=0x36c004
&HWIO_GCC_PDM2_CMD_RCGR_ADDR=0x333010
&HWIO_GCC_PDM2_CFG_RCGR_ADDR=0x333014
&HWIO_GCC_PERIPH_NOC_CMD_RCGR_ADDR=0x306014
&HWIO_GCC_PERIPH_NOC_CFG_RCGR_ADDR=0x306018
&HWIO_GCC_PIMEM_AXI_CMD_RCGR_ADDR=0x30a008
&HWIO_GCC_PIMEM_AXI_CFG_RCGR_ADDR=0x30a00c
&HWIO_GCC_QDSS_AT_CMD_RCGR_ADDR=0x30d000
&HWIO_GCC_QDSS_AT_CFG_RCGR_ADDR=0x30d004
&HWIO_GCC_QDSS_STM_CMD_RCGR_ADDR=0x30d018
&HWIO_GCC_QDSS_STM_CFG_RCGR_ADDR=0x30d01c
&HWIO_GCC_QDSS_TRACECLKIN_CMD_RCGR_ADDR=0x30e000
&HWIO_GCC_QDSS_TRACECLKIN_CFG_RCGR_ADDR=0x30e004
&HWIO_GCC_QDSS_TSCTR_CMD_RCGR_ADDR=0x30e018
&HWIO_GCC_QDSS_TSCTR_CFG_RCGR_ADDR=0x30e01c
&HWIO_GCC_RBCPR_CX_CMD_RCGR_ADDR=0x34e00c
&HWIO_GCC_RBCPR_CX_CFG_RCGR_ADDR=0x34e010
&HWIO_GCC_RBCPR_MX_CMD_RCGR_ADDR=0x34f00c
&HWIO_GCC_RBCPR_MX_CFG_RCGR_ADDR=0x34f010
&HWIO_GCC_RPM_CMD_RCGR_ADDR=0x33c018
&HWIO_GCC_RPM_CFG_RCGR_ADDR=0x33c01c
&HWIO_GCC_SDCC1_APPS_CMD_RCGR_ADDR=0x313010
&HWIO_GCC_SDCC1_APPS_CFG_RCGR_ADDR=0x313014
&HWIO_GCC_SDCC2_APPS_CMD_RCGR_ADDR=0x314010
&HWIO_GCC_SDCC2_APPS_CFG_RCGR_ADDR=0x314014
&HWIO_GCC_SDCC3_APPS_CMD_RCGR_ADDR=0x315010
&HWIO_GCC_SDCC3_APPS_CFG_RCGR_ADDR=0x315014
&HWIO_GCC_SDCC4_APPS_CMD_RCGR_ADDR=0x316010
&HWIO_GCC_SDCC4_APPS_CFG_RCGR_ADDR=0x316014
&HWIO_GCC_SPMI_AHB_CMD_RCGR_ADDR=0x33f028
&HWIO_GCC_SPMI_AHB_CFG_RCGR_ADDR=0x33f02c
&HWIO_GCC_SPMI_SER_CMD_RCGR_ADDR=0x33f010
&HWIO_GCC_SPMI_SER_CFG_RCGR_ADDR=0x33f014
&HWIO_GCC_SYS_NOC_HS_AXI_CMD_RCGR_ADDR=0x304044
&HWIO_GCC_SYS_NOC_HS_AXI_CFG_RCGR_ADDR=0x304048
&HWIO_GCC_SYSTEM_NOC_CMD_RCGR_ADDR=0x30401c
&HWIO_GCC_SYSTEM_NOC_CFG_RCGR_ADDR=0x304020
&HWIO_GCC_TSIF_REF_CMD_RCGR_ADDR=0x336010
&HWIO_GCC_TSIF_REF_CFG_RCGR_ADDR=0x336014
&HWIO_GCC_UFS_AXI_CMD_RCGR_ADDR=0x375024
&HWIO_GCC_UFS_AXI_CFG_RCGR_ADDR=0x375028
&HWIO_GCC_USB20_MASTER_CMD_RCGR_ADDR=0x312010
&HWIO_GCC_USB20_MASTER_CFG_RCGR_ADDR=0x312014
&HWIO_GCC_USB20_MOCK_UTMI_CMD_RCGR_ADDR=0x312024
&HWIO_GCC_USB20_MOCK_UTMI_CFG_RCGR_ADDR=0x312028
&HWIO_GCC_USB30_MASTER_CMD_RCGR_ADDR=0x30f014
&HWIO_GCC_USB30_MASTER_CFG_RCGR_ADDR=0x30f018
&HWIO_GCC_USB30_MOCK_UTMI_CMD_RCGR_ADDR=0x30f028
&HWIO_GCC_USB30_MOCK_UTMI_CFG_RCGR_ADDR=0x30f02c
&HWIO_GCC_USB3_PHY_AUX_CMD_RCGR_ADDR=0x35000c
&HWIO_GCC_USB3_PHY_AUX_CFG_RCGR_ADDR=0x350010
&HWIO_GCC_VDDA_VS_CMD_RCGR_ADDR=0x37a044
&HWIO_GCC_VDDA_VS_CFG_RCGR_ADDR=0x37a048
&HWIO_GCC_VDDCX_VS_CMD_RCGR_ADDR=0x37a014
&HWIO_GCC_VDDCX_VS_CFG_RCGR_ADDR=0x37a018
&HWIO_GCC_VDDMX_VS_CMD_RCGR_ADDR=0x37a02c
&HWIO_GCC_VDDMX_VS_CFG_RCGR_ADDR=0x37a030
&HWIO_GCC_VS_CTRL_CMD_RCGR_ADDR=0x37a05c
&HWIO_GCC_VS_CTRL_CFG_RCGR_ADDR=0x37a060
&HWIO_LPASS_AON_CMD_RCGR_ADDR=0x9012000
&HWIO_LPASS_AON_CFG_RCGR_ADDR=0x9012004
&HWIO_LPASS_ATIME_CMD_RCGR_ADDR=0x9013000
&HWIO_LPASS_ATIME_CFG_RCGR_ADDR=0x9013004
&HWIO_LPASS_AUD_SLIMBUS_CMD_RCGR_ADDR=0x9015000
&HWIO_LPASS_AUD_SLIMBUS_CFG_RCGR_ADDR=0x9015004
&HWIO_LPASS_CORE_CMD_RCGR_ADDR=0x901b000
&HWIO_LPASS_CORE_CFG_RCGR_ADDR=0x901b004
&HWIO_LPASS_EXT_MCLK0_CMD_RCGR_ADDR=0x901e000
&HWIO_LPASS_EXT_MCLK0_CFG_RCGR_ADDR=0x901e004
&HWIO_LPASS_EXT_MCLK1_CMD_RCGR_ADDR=0x901f000
&HWIO_LPASS_EXT_MCLK1_CFG_RCGR_ADDR=0x901f004
&HWIO_LPASS_EXT_MCLK2_CMD_RCGR_ADDR=0x9020000
&HWIO_LPASS_EXT_MCLK2_CFG_RCGR_ADDR=0x9020004
&HWIO_LPASS_LPAIF_PCMOE_CMD_RCGR_ADDR=0x9017000
&HWIO_LPASS_LPAIF_PCMOE_CFG_RCGR_ADDR=0x9017004
&HWIO_LPASS_LPAIF_PRI_CMD_RCGR_ADDR=0x900e000
&HWIO_LPASS_LPAIF_PRI_CFG_RCGR_ADDR=0x900e004
&HWIO_LPASS_LPAIF_QUAD_CMD_RCGR_ADDR=0x9011000
&HWIO_LPASS_LPAIF_QUAD_CFG_RCGR_ADDR=0x9011004
&HWIO_LPASS_LPAIF_SEC_CMD_RCGR_ADDR=0x900f000
&HWIO_LPASS_LPAIF_SEC_CFG_RCGR_ADDR=0x900f004
&HWIO_LPASS_LPAIF_SPKR_CMD_RCGR_ADDR=0x900d000
&HWIO_LPASS_LPAIF_SPKR_CFG_RCGR_ADDR=0x900d004
&HWIO_LPASS_LPAIF_TER_CMD_RCGR_ADDR=0x9010000
&HWIO_LPASS_LPAIF_TER_CFG_RCGR_ADDR=0x9010004
&HWIO_LPASS_QDSP6SS_CORE_CMD_RCGR_ADDR=0x9300028
&HWIO_LPASS_QDSP6SS_CORE_CFG_RCGR_ADDR=0x930002c
&HWIO_LPASS_QCA_SLIMBUS_CMD_RCGR_ADDR=0x9016000
&HWIO_LPASS_QCA_SLIMBUS_CFG_RCGR_ADDR=0x9016004
&HWIO_LPASS_RESAMPLER_CMD_RCGR_ADDR=0x9014000
&HWIO_LPASS_RESAMPLER_CFG_RCGR_ADDR=0x9014004
&HWIO_LPASS_XO_CMD_RCGR_ADDR=0x9019000
&HWIO_LPASS_XO_CFG_RCGR_ADDR=0x9019004
&HWIO_MMSS_AHB_CMD_RCGR_ADDR=0x8c5000
&HWIO_MMSS_AHB_CFG_RCGR_ADDR=0x8c5004
&HWIO_MMSS_AXI_CMD_RCGR_ADDR=0x8c5040
&HWIO_MMSS_AXI_CFG_RCGR_ADDR=0x8c5044
&HWIO_MMSS_BYTE0_CMD_RCGR_ADDR=0x8c2120
&HWIO_MMSS_BYTE0_CFG_RCGR_ADDR=0x8c2124
&HWIO_MMSS_BYTE1_CMD_RCGR_ADDR=0x8c2140
&HWIO_MMSS_BYTE1_CFG_RCGR_ADDR=0x8c2144
&HWIO_MMSS_CAMSS_GP0_CMD_RCGR_ADDR=0x8c3420
&HWIO_MMSS_CAMSS_GP0_CFG_RCGR_ADDR=0x8c3424
&HWIO_MMSS_CAMSS_GP1_CMD_RCGR_ADDR=0x8c3450
&HWIO_MMSS_CAMSS_GP1_CFG_RCGR_ADDR=0x8c3454
&HWIO_MMSS_CCI_CMD_RCGR_ADDR=0x8c3300
&HWIO_MMSS_CCI_CFG_RCGR_ADDR=0x8c3304
&HWIO_MMSS_CPP_CMD_RCGR_ADDR=0x8c3640
&HWIO_MMSS_CPP_CFG_RCGR_ADDR=0x8c3644
&HWIO_MMSS_CSI0_CMD_RCGR_ADDR=0x8c3090
&HWIO_MMSS_CSI0_CFG_RCGR_ADDR=0x8c3094
&HWIO_MMSS_CSI0PHYTIMER_CMD_RCGR_ADDR=0x8c3000
&HWIO_MMSS_CSI0PHYTIMER_CFG_RCGR_ADDR=0x8c3004
&HWIO_MMSS_CSI1_CMD_RCGR_ADDR=0x8c3100
&HWIO_MMSS_CSI1_CFG_RCGR_ADDR=0x8c3104
&HWIO_MMSS_CSI1PHYTIMER_CMD_RCGR_ADDR=0x8c3030
&HWIO_MMSS_CSI1PHYTIMER_CFG_RCGR_ADDR=0x8c3034
&HWIO_MMSS_CSI2_CMD_RCGR_ADDR=0x8c3160
&HWIO_MMSS_CSI2_CFG_RCGR_ADDR=0x8c3164
&HWIO_MMSS_CSI2PHYTIMER_CMD_RCGR_ADDR=0x8c3060
&HWIO_MMSS_CSI2PHYTIMER_CFG_RCGR_ADDR=0x8c3064
&HWIO_MMSS_CSI3_CMD_RCGR_ADDR=0x8c31c0
&HWIO_MMSS_CSI3_CFG_RCGR_ADDR=0x8c31c4
&HWIO_MMSS_CSIPHY0_3P_CMD_RCGR_ADDR=0x8c3240
&HWIO_MMSS_CSIPHY0_3P_CFG_RCGR_ADDR=0x8c3244
&HWIO_MMSS_CSIPHY1_3P_CMD_RCGR_ADDR=0x8c3260
&HWIO_MMSS_CSIPHY1_3P_CFG_RCGR_ADDR=0x8c3264
&HWIO_MMSS_CSIPHY2_3P_CMD_RCGR_ADDR=0x8c3280
&HWIO_MMSS_CSIPHY2_3P_CFG_RCGR_ADDR=0x8c3284
&HWIO_MMSS_DSA_CORE_CMD_RCGR_ADDR=0x8c50b0
&HWIO_MMSS_DSA_CORE_CFG_RCGR_ADDR=0x8c50b4
&HWIO_MMSS_EDPAUX_CMD_RCGR_ADDR=0x8c20e0
&HWIO_MMSS_EDPAUX_CFG_RCGR_ADDR=0x8c20e4
&HWIO_MMSS_EDPGTC_CMD_RCGR_ADDR=0x8c2220
&HWIO_MMSS_EDPGTC_CFG_RCGR_ADDR=0x8c2224
&HWIO_MMSS_EDPLINK_CMD_RCGR_ADDR=0x8c20c0
&HWIO_MMSS_EDPLINK_CFG_RCGR_ADDR=0x8c20c4
&HWIO_MMSS_EDPPIXEL_CMD_RCGR_ADDR=0x8c20a0
&HWIO_MMSS_EDPPIXEL_CFG_RCGR_ADDR=0x8c20a4
&HWIO_MMSS_ESC0_CMD_RCGR_ADDR=0x8c2160
&HWIO_MMSS_ESC0_CFG_RCGR_ADDR=0x8c2164
&HWIO_MMSS_ESC1_CMD_RCGR_ADDR=0x8c2180
&HWIO_MMSS_ESC1_CFG_RCGR_ADDR=0x8c2184
&HWIO_MMSS_EXTPCLK_CMD_RCGR_ADDR=0x8c2060
&HWIO_MMSS_EXTPCLK_CFG_RCGR_ADDR=0x8c2064
&HWIO_MMSS_FD_CORE_CMD_RCGR_ADDR=0x8c3b00
&HWIO_MMSS_FD_CORE_CFG_RCGR_ADDR=0x8c3b04
&HWIO_MMSS_GFX3D_CMD_RCGR_ADDR=0x8c4000
&HWIO_MMSS_GFX3D_CFG_RCGR_ADDR=0x8c4004
&HWIO_MMSS_HDMI_CMD_RCGR_ADDR=0x8c2100
&HWIO_MMSS_HDMI_CFG_RCGR_ADDR=0x8c2104
&HWIO_MMSS_ISENSE_CMD_RCGR_ADDR=0x8c4010
&HWIO_MMSS_ISENSE_CFG_RCGR_ADDR=0x8c4014
&HWIO_MMSS_JPEG0_CMD_RCGR_ADDR=0x8c3500
&HWIO_MMSS_JPEG0_CFG_RCGR_ADDR=0x8c3504
&HWIO_MMSS_JPEG2_CMD_RCGR_ADDR=0x8c3540
&HWIO_MMSS_JPEG2_CFG_RCGR_ADDR=0x8c3544
&HWIO_MMSS_JPEG_DMA_CMD_RCGR_ADDR=0x8c3560
&HWIO_MMSS_JPEG_DMA_CFG_RCGR_ADDR=0x8c3564
&HWIO_MMSS_MAXI_CMD_RCGR_ADDR=0x8c5090
&HWIO_MMSS_MAXI_CFG_RCGR_ADDR=0x8c5094
&HWIO_MMSS_MCLK0_CMD_RCGR_ADDR=0x8c3360
&HWIO_MMSS_MCLK0_CFG_RCGR_ADDR=0x8c3364
&HWIO_MMSS_MCLK1_CMD_RCGR_ADDR=0x8c3390
&HWIO_MMSS_MCLK1_CFG_RCGR_ADDR=0x8c3394
&HWIO_MMSS_MCLK2_CMD_RCGR_ADDR=0x8c33c0
&HWIO_MMSS_MCLK2_CFG_RCGR_ADDR=0x8c33c4
&HWIO_MMSS_MCLK3_CMD_RCGR_ADDR=0x8c33f0
&HWIO_MMSS_MCLK3_CFG_RCGR_ADDR=0x8c33f4
&HWIO_MMSS_MDP_CMD_RCGR_ADDR=0x8c2040
&HWIO_MMSS_MDP_CFG_RCGR_ADDR=0x8c2044
&HWIO_MMSS_PCLK0_CMD_RCGR_ADDR=0x8c2000
&HWIO_MMSS_PCLK0_CFG_RCGR_ADDR=0x8c2004
&HWIO_MMSS_PCLK1_CMD_RCGR_ADDR=0x8c2020
&HWIO_MMSS_PCLK1_CFG_RCGR_ADDR=0x8c2024
&HWIO_MMSS_RBBMTIMER_CMD_RCGR_ADDR=0x8c4090
&HWIO_MMSS_RBBMTIMER_CFG_RCGR_ADDR=0x8c4094
&HWIO_MMSS_RBCPR_CMD_RCGR_ADDR=0x8c4060
&HWIO_MMSS_RBCPR_CFG_RCGR_ADDR=0x8c4064
&HWIO_MMSS_VFE0_CMD_RCGR_ADDR=0x8c3600
&HWIO_MMSS_VFE0_CFG_RCGR_ADDR=0x8c3604
&HWIO_MMSS_VFE1_CMD_RCGR_ADDR=0x8c3620
&HWIO_MMSS_VFE1_CFG_RCGR_ADDR=0x8c3624
&HWIO_MMSS_VIDEO_CORE_CMD_RCGR_ADDR=0x8c1000
&HWIO_MMSS_VIDEO_CORE_CFG_RCGR_ADDR=0x8c1004
&HWIO_MMSS_VIDEO_SUBCORE0_CMD_RCGR_ADDR=0x8c1060
&HWIO_MMSS_VIDEO_SUBCORE0_CFG_RCGR_ADDR=0x8c1064
&HWIO_MMSS_VIDEO_SUBCORE1_CMD_RCGR_ADDR=0x8c1080
&HWIO_MMSS_VIDEO_SUBCORE1_CFG_RCGR_ADDR=0x8c1084
&HWIO_MMSS_VSYNC_CMD_RCGR_ADDR=0x8c2080
&HWIO_MMSS_VSYNC_CFG_RCGR_ADDR=0x8c2084
&HWIO_MSS_BIT_COXM_MND_CMD_RCGR_ADDR=0x21aa0b0
&HWIO_MSS_BIT_COXM_MND_CFG_RCGR_ADDR=0x21aa0b4
&HWIO_MSS_BUS_CMD_RCGR_ADDR=0x21aa000
&HWIO_MSS_BUS_CFG_RCGR_ADDR=0x21aa004
&HWIO_MSS_QDSP6SS_CORE_CMD_RCGR_ADDR=0x2080028
&HWIO_MSS_QDSP6SS_CORE_CFG_RCGR_ADDR=0x208002c
&HWIO_MSS_RBCPR_REF_CMD_RCGR_ADDR=0x21aa0cc
&HWIO_MSS_RBCPR_REF_CFG_RCGR_ADDR=0x21aa0d0
&HWIO_MSS_UIM_CMD_RCGR_ADDR=0x21aa008
&HWIO_MSS_UIM_CFG_RCGR_ADDR=0x21aa00c
&HWIO_MSS_UIM0_MND_CMD_RCGR_ADDR=0x21aa010
&HWIO_MSS_UIM0_MND_CFG_RCGR_ADDR=0x21aa014
&HWIO_MSS_UIM1_MND_CMD_RCGR_ADDR=0x21aa030
&HWIO_MSS_UIM1_MND_CFG_RCGR_ADDR=0x21aa034
&HWIO_MSS_UIM2_MND_CMD_RCGR_ADDR=0x21aa050
&HWIO_MSS_UIM2_MND_CFG_RCGR_ADDR=0x21aa054
&HWIO_MSS_UIM3_MND_CMD_RCGR_ADDR=0x21aa070
&HWIO_MSS_UIM3_MND_CFG_RCGR_ADDR=0x21aa074
&HWIO_SSC_SCC_SCC_100M_CMD_RCGR_ADDR=0x1e21000
&HWIO_SSC_SCC_SCC_100M_CFG_RCGR_ADDR=0x1e21004

; Utility registers
&HWIO_GCC_CLOCK_FRQ_MEASURE_CTL_ADDR=0x362004
&HWIO_GCC_CLOCK_FRQ_MEASURE_STATUS_ADDR=0x362008
&HWIO_GCC_GCC_XO_DIV4_CBCR_ADDR=0x343008
&HWIO_GCC_PLLTEST_PAD_CFG_ADDR=0x36200c
&HWIO_TLMM_GPIO_CFG0_ADDR=0x1010000

; Vote registers
v.new int[2] \vote_regs
v.a \vote_regs[0]=0x357004
v.a \vote_regs[1]=0x357008

; Constants for setting clock frequencies
&HAL_CLK_CMD_CFG_UPDATE_FMSK=0x1
&HAL_CLK_CFG_CGR_SRC_SEL_SHFT=0x8
&HAL_CLK_CFG_CGR_SRC_DIV_SHFT=0x0
&HAL_CLK_CFG_CGR_SRC_SEL_FMSK=0x700
&HAL_CLK_CFG_CGR_SRC_DIV_FMSK=0x1f
&HAL_CLK_CFG_CGR_MODE_FMSK=0x3000
&HAL_CLK_CFG_CFG_DUAL_EDGE_MODE_VAL=0x2
&HAL_CLK_CFG_CGR_MODE_SHFT=0xc
&HAL_CLK_M_REG_OFFSET=0x8
&HAL_CLK_N_REG_OFFSET=0xc
&HAL_CLK_D_REG_OFFSET=0x10


; Test Masks
&CLK_TEST_TYPE_MASK=(0x00007FFF)
&CLK_TEST_SEL_MASK=(0x000F0000)
&CLK_TEST_SUB_MUX_MASK=(0xF0000000)

; GCC Debug register
&HWIO_GCC_GCC_DEBUG_CLK_CTL_ADDR=0x362000

; GCC Test Mask
&CLK_GCC_TEST=(0x1<<0x10)

; MSS Debug register
&HWIO_MSS_DEBUG_CLOCK_CTL_ADDR=0x21a8018

; MSS Test Mask
&CLK_MSS_TEST=(0x2<<0x10)

; MSS Submuxes
&HWIO_MSS_QDSP6SS_TEST_CLK_CTL_ADDR=0x2082010
&CLK_MSS_SUB_MUX_Q6=(0x1<<0x1C)
&HWIO_MSS_NAV_CLK_CTL_ADDR=0x22f8008
&CLK_MSS_SUB_MUX_NAV=(0x2<<0x1C)
; MMSS Debug register
&HWIO_MMSS_MMSS_DEBUG_CLK_CTL_ADDR=0x8c0900

; MMSS Test Mask
&CLK_MMSS_TEST=(0x3<<0x10)

; APCS Debug register
&HWIO_APCS_CLK_DIAG_ADDR=0x9820078

; APCS Test Mask
&CLK_APCS_TEST=(0x4<<0x10)

; LPASS Debug register
&HWIO_LPASS_DBG_CLK_ADDR=0x903c000

; LPASS Test Mask
&CLK_LPASS_TEST=(0x5<<0x10)

; LPASS Submuxes
&HWIO_LPASS_QDSP6SS_TEST_CLK_CTL_ADDR=0x9302010
&CLK_LPASS_SUB_MUX_Q6=(0x1<<0x1C)
; SSC Debug register
&HWIO_SSC_SCC_SCC_DEBUG_CLK_CTL_ADDR=0x1e20034

; SSC Test Mask
&CLK_SSC_TEST=(0x6<<0x10)

; SSC Submuxes
&HWIO_SSC_QDSP6SS_TEST_CLK_CTL_ADDR=0x1c02010
&CLK_SSC_SUB_MUX_Q6=(0x1<<0x1C)

; APCS test clocks
&CLK_TEST_IM_CBFCDIV_CLK=(&CLK_APCS_TEST|0x01)
&CLK_TEST_APC0_LEAF_CLK=(&CLK_APCS_TEST|0x11)
&CLK_TEST_APC1_LEAF_CLK=(&CLK_APCS_TEST|0x21)
&CLK_TEST_SYS_APCSQSBSLV_CLK=(&CLK_APCS_TEST|0x30)
&CLK_TEST_SYS_APCSQSBMSTR_CLK=(&CLK_APCS_TEST|0x31)
&CLK_TEST_SYS_APCSAHB_CLK=(&CLK_APCS_TEST|0x32)
&CLK_TEST_ATB_APCS_CLK=(&CLK_APCS_TEST|0x33)
&CLK_TEST_APB_APCSDBG_CLK=(&CLK_APCS_TEST|0x34)
&CLK_TEST_IM_REFROOT_CLK=(&CLK_APCS_TEST|0x35)
&CLK_TEST_IM_REF_CLK=(&CLK_APCS_TEST|0x36)
&CLK_TEST_IM_SLEEP_CLK=(&CLK_APCS_TEST|0x37)

; GCC test clocks
&CLK_TEST_GCC_SEC_CTRL_ACC_CLK=(&CLK_GCC_TEST|0x08A)
&CLK_TEST_GCC_BIMC_CLK=(&CLK_GCC_TEST|0x0A4)
&CLK_TEST_GCC_SPDM_BIMC_CY_CLK=(&CLK_GCC_TEST|0x095)
&CLK_TEST_GCC_BIMC_DDR_CH0_CLK=(&CLK_GCC_TEST|0x0AD)
&CLK_TEST_GCC_BIMC_DDR_CH1_CLK=(&CLK_GCC_TEST|0x0AE)
&CLK_TEST_GCC_BIMC_DDR_CPLL0_CLK=(&CLK_GCC_TEST|0x0AA)
&CLK_TEST_GCC_BIMC_DDR_CPLL1_CLK=(&CLK_GCC_TEST|0x0AB)
&CLK_TEST_GCC_BIMC_XO_CLK=(&CLK_GCC_TEST|0x0A0)
&CLK_TEST_GCC_CFG_NOC_DDR_CFG_CLK=(&CLK_GCC_TEST|0x00F)
&CLK_TEST_GCC_CNOC_BUS_TIMEOUT5_AHB_CLK=(&CLK_GCC_TEST|0x0CB)
&CLK_TEST_GCC_DDR_DIM_CFG_CLK=(&CLK_GCC_TEST|0x0A9)
&CLK_TEST_GCC_BIMC_DTTS_XO_CLK=(&CLK_GCC_TEST|0x146)
&CLK_TEST_GCC_BIMC_HMSS_AXI_CLK=(&CLK_GCC_TEST|0x0A5)
&CLK_TEST_GCC_HMSS_MSTR_AXI_CLK=(&CLK_GCC_TEST|0x0B9)
&CLK_TEST_GCC_HMSS_SLV_AXI_CLK=(&CLK_GCC_TEST|0x0B8)
&CLK_TEST_GCC_BLSP1_QUP1_I2C_APPS_CLK=(&CLK_GCC_TEST|0x044)
&CLK_TEST_GCC_BLSP1_QUP1_SPI_APPS_CLK=(&CLK_GCC_TEST|0x043)
&CLK_TEST_GCC_BLSP1_QUP2_I2C_APPS_CLK=(&CLK_GCC_TEST|0x048)
&CLK_TEST_GCC_BLSP1_QUP2_SPI_APPS_CLK=(&CLK_GCC_TEST|0x047)
&CLK_TEST_GCC_BLSP1_QUP3_I2C_APPS_CLK=(&CLK_GCC_TEST|0x04C)
&CLK_TEST_GCC_BLSP1_QUP3_SPI_APPS_CLK=(&CLK_GCC_TEST|0x04B)
&CLK_TEST_GCC_BLSP1_QUP4_I2C_APPS_CLK=(&CLK_GCC_TEST|0x050)
&CLK_TEST_GCC_BLSP1_QUP4_SPI_APPS_CLK=(&CLK_GCC_TEST|0x04F)
&CLK_TEST_GCC_BLSP1_QUP5_I2C_APPS_CLK=(&CLK_GCC_TEST|0x054)
&CLK_TEST_GCC_BLSP1_QUP5_SPI_APPS_CLK=(&CLK_GCC_TEST|0x053)
&CLK_TEST_GCC_BLSP1_QUP6_I2C_APPS_CLK=(&CLK_GCC_TEST|0x058)
&CLK_TEST_GCC_BLSP1_QUP6_SPI_APPS_CLK=(&CLK_GCC_TEST|0x057)
&CLK_TEST_GCC_BLSP1_UART1_APPS_CLK=(&CLK_GCC_TEST|0x045)
&CLK_TEST_GCC_BLSP1_UART2_APPS_CLK=(&CLK_GCC_TEST|0x049)
&CLK_TEST_GCC_BLSP1_UART3_APPS_CLK=(&CLK_GCC_TEST|0x04D)
&CLK_TEST_GCC_BLSP1_UART4_APPS_CLK=(&CLK_GCC_TEST|0x051)
&CLK_TEST_GCC_BLSP1_UART5_APPS_CLK=(&CLK_GCC_TEST|0x055)
&CLK_TEST_GCC_BLSP1_UART6_APPS_CLK=(&CLK_GCC_TEST|0x059)
&CLK_TEST_GCC_BLSP2_QUP1_I2C_APPS_CLK=(&CLK_GCC_TEST|0x05E)
&CLK_TEST_GCC_BLSP2_QUP1_SPI_APPS_CLK=(&CLK_GCC_TEST|0x05D)
&CLK_TEST_GCC_BLSP2_QUP2_I2C_APPS_CLK=(&CLK_GCC_TEST|0x062)
&CLK_TEST_GCC_BLSP2_QUP2_SPI_APPS_CLK=(&CLK_GCC_TEST|0x061)
&CLK_TEST_GCC_BLSP2_QUP3_I2C_APPS_CLK=(&CLK_GCC_TEST|0x066)
&CLK_TEST_GCC_BLSP2_QUP3_SPI_APPS_CLK=(&CLK_GCC_TEST|0x065)
&CLK_TEST_GCC_BLSP2_QUP4_I2C_APPS_CLK=(&CLK_GCC_TEST|0x06A)
&CLK_TEST_GCC_BLSP2_QUP4_SPI_APPS_CLK=(&CLK_GCC_TEST|0x069)
&CLK_TEST_GCC_BLSP2_QUP5_I2C_APPS_CLK=(&CLK_GCC_TEST|0x06E)
&CLK_TEST_GCC_BLSP2_QUP5_SPI_APPS_CLK=(&CLK_GCC_TEST|0x06D)
&CLK_TEST_GCC_BLSP2_QUP6_I2C_APPS_CLK=(&CLK_GCC_TEST|0x072)
&CLK_TEST_GCC_BLSP2_QUP6_SPI_APPS_CLK=(&CLK_GCC_TEST|0x071)
&CLK_TEST_GCC_BLSP2_UART1_APPS_CLK=(&CLK_GCC_TEST|0x05F)
&CLK_TEST_GCC_BLSP2_UART2_APPS_CLK=(&CLK_GCC_TEST|0x063)
&CLK_TEST_GCC_BLSP2_UART3_APPS_CLK=(&CLK_GCC_TEST|0x067)
&CLK_TEST_GCC_BLSP2_UART4_APPS_CLK=(&CLK_GCC_TEST|0x06B)
&CLK_TEST_GCC_BLSP2_UART5_APPS_CLK=(&CLK_GCC_TEST|0x06F)
&CLK_TEST_GCC_BLSP2_UART6_APPS_CLK=(&CLK_GCC_TEST|0x073)
&CLK_TEST_GCC_BLSP1_UART1_SIM_CLK=(&CLK_GCC_TEST|0x046)
&CLK_TEST_GCC_BLSP1_UART2_SIM_CLK=(&CLK_GCC_TEST|0x04A)
&CLK_TEST_GCC_BLSP1_UART3_SIM_CLK=(&CLK_GCC_TEST|0x04E)
&CLK_TEST_GCC_BLSP1_UART4_SIM_CLK=(&CLK_GCC_TEST|0x052)
&CLK_TEST_GCC_BLSP1_UART5_SIM_CLK=(&CLK_GCC_TEST|0x056)
&CLK_TEST_GCC_BLSP1_UART6_SIM_CLK=(&CLK_GCC_TEST|0x05A)
&CLK_TEST_GCC_BLSP2_UART1_SIM_CLK=(&CLK_GCC_TEST|0x060)
&CLK_TEST_GCC_BLSP2_UART2_SIM_CLK=(&CLK_GCC_TEST|0x064)
&CLK_TEST_GCC_BLSP2_UART3_SIM_CLK=(&CLK_GCC_TEST|0x068)
&CLK_TEST_GCC_BLSP2_UART4_SIM_CLK=(&CLK_GCC_TEST|0x06C)
&CLK_TEST_GCC_BLSP2_UART5_SIM_CLK=(&CLK_GCC_TEST|0x070)
&CLK_TEST_GCC_BLSP2_UART6_SIM_CLK=(&CLK_GCC_TEST|0x074)
&CLK_TEST_GCC_CE1_CLK=(&CLK_GCC_TEST|0x099)
&CLK_TEST_GCC_AGGRE0_CNOC_AHB_CLK=(&CLK_GCC_TEST|0x117)
&CLK_TEST_GCC_AGGRE0_NOC_MPU_CFG_AHB_CLK=(&CLK_GCC_TEST|0x12C)
&CLK_TEST_GCC_AGGRE1_CNOC_AHB_CLK=(&CLK_GCC_TEST|0x11D)
&CLK_TEST_GCC_AGGRE1_NOC_MPU_CFG_AHB_CLK=(&CLK_GCC_TEST|0x12D)
&CLK_TEST_GCC_AGGRE2_CNOC_AHB_CLK=(&CLK_GCC_TEST|0x124)
&CLK_TEST_GCC_AGGRE2_NOC_MPU_CFG_AHB_CLK=(&CLK_GCC_TEST|0x12E)
&CLK_TEST_GCC_AHB_CLK=(&CLK_GCC_TEST|0x09C)
&CLK_TEST_GCC_BIMC_CFG_AHB_CLK=(&CLK_GCC_TEST|0x0A1)
&CLK_TEST_GCC_BIMC_NIUS_CFG_AHB_CLK=(&CLK_GCC_TEST|0x00D)
&CLK_TEST_GCC_BOOT_ROM_AHB_CLK=(&CLK_GCC_TEST|0x07E)
&CLK_TEST_GCC_CE1_AHB_CLK=(&CLK_GCC_TEST|0x09B)
&CLK_TEST_GCC_CFG_NOC_AHB_CLK=(&CLK_GCC_TEST|0x00E)
&CLK_TEST_GCC_CNOC_BUS_TIMEOUT0_AHB_CLK=(&CLK_GCC_TEST|0x0C6)
&CLK_TEST_GCC_CNOC_BUS_TIMEOUT1_AHB_CLK=(&CLK_GCC_TEST|0x0C7)
&CLK_TEST_GCC_CNOC_BUS_TIMEOUT2_AHB_CLK=(&CLK_GCC_TEST|0x0C8)
&CLK_TEST_GCC_CNOC_BUS_TIMEOUT3_AHB_CLK=(&CLK_GCC_TEST|0x0C9)
&CLK_TEST_GCC_CNOC_BUS_TIMEOUT4_AHB_CLK=(&CLK_GCC_TEST|0x0CA)
&CLK_TEST_GCC_CNOC_BUS_TIMEOUT6_AHB_CLK=(&CLK_GCC_TEST|0x0CC)
&CLK_TEST_GCC_CNOC_BUS_TIMEOUT7_AHB_CLK=(&CLK_GCC_TEST|0x0CD)
&CLK_TEST_GCC_CNOC_BUS_TIMEOUT8_AHB_CLK=(&CLK_GCC_TEST|0x0CE)
&CLK_TEST_GCC_CNOC_BUS_TIMEOUT9_AHB_CLK=(&CLK_GCC_TEST|0x0CF)
&CLK_TEST_GCC_CNOC_MST_RPM_AHB_CLK=(&CLK_GCC_TEST|0x089)
&CLK_TEST_GCC_DCC_AHB_CLK=(&CLK_GCC_TEST|0x12B)
&CLK_TEST_GCC_IMEM_CFG_AHB_CLK=(&CLK_GCC_TEST|0x017)
&CLK_TEST_GCC_LPASS_CORE_SMMU_AHB_CLK=(&CLK_GCC_TEST|0x0B4)
&CLK_TEST_GCC_LPASS_Q6_SMMU_AHB_CLK=(&CLK_GCC_TEST|0x0B3)
&CLK_TEST_GCC_LPASS_SMMU_AON_AHB_CLK=(&CLK_GCC_TEST|0x0B5)
&CLK_TEST_GCC_MMSS_NOC_CFG_AHB_CLK=(&CLK_GCC_TEST|0x019)
&CLK_TEST_GCC_MPM_AHB_CLK=(&CLK_GCC_TEST|0x082)
&CLK_TEST_GCC_MSG_RAM_AHB_CLK=(&CLK_GCC_TEST|0x07F)
&CLK_TEST_GCC_NOC_CONF_XPU_AHB_CLK=(&CLK_GCC_TEST|0x015)
&CLK_TEST_GCC_PCIE_0_CFG_AHB_CLK=(&CLK_GCC_TEST|0x0E8)
&CLK_TEST_GCC_PCIE_1_CFG_AHB_CLK=(&CLK_GCC_TEST|0x0EE)
&CLK_TEST_GCC_PCIE_2_CFG_AHB_CLK=(&CLK_GCC_TEST|0x0F4)
&CLK_TEST_GCC_PCIE_PHY_CFG_AHB_CLK=(&CLK_GCC_TEST|0x0F8)
&CLK_TEST_GCC_PERIPH_NOC_CFG_AHB_CLK=(&CLK_GCC_TEST|0x012)
&CLK_TEST_GCC_PIMEM_AHB_CLK=(&CLK_GCC_TEST|0x01E)
&CLK_TEST_GCC_PRNG_AHB_CLK=(&CLK_GCC_TEST|0x079)
&CLK_TEST_GCC_QDSS_CFG_AHB_CLK=(&CLK_GCC_TEST|0x022)
&CLK_TEST_GCC_QDSS_DAP_AHB_CLK=(&CLK_GCC_TEST|0x021)
&CLK_TEST_GCC_QDSS_MPU_AHB_CLK=(&CLK_GCC_TEST|0x020)
&CLK_TEST_GCC_RBCPR_CX_AHB_CLK=(&CLK_GCC_TEST|0x0D3)
&CLK_TEST_GCC_RBCPR_MX_AHB_CLK=(&CLK_GCC_TEST|0x0D5)
&CLK_TEST_GCC_RBCPR_XPU_AHB_CLK=(&CLK_GCC_TEST|0x01F)
&CLK_TEST_GCC_RPM_MST_M2_CNOC_AHB_CLK=(&CLK_GCC_TEST|0x088)
&CLK_TEST_GCC_SEC_CTRL_AHB_CLK=(&CLK_GCC_TEST|0x08B)
&CLK_TEST_GCC_SEC_CTRL_BOOT_ROM_PATCH_CLK=(&CLK_GCC_TEST|0x08E)
&CLK_TEST_GCC_SMMU_AGGRE0_AHB_CLK=(&CLK_GCC_TEST|0x11A)
&CLK_TEST_GCC_SMMU_AGGRE1_AHB_CLK=(&CLK_GCC_TEST|0x121)
&CLK_TEST_GCC_SMMU_AGGRE2_AHB_CLK=(&CLK_GCC_TEST|0x129)
&CLK_TEST_GCC_SNOC_CNOC_AHB_CLK=(&CLK_GCC_TEST|0x003)
&CLK_TEST_GCC_SPDM_CFG_AHB_CLK=(&CLK_GCC_TEST|0x092)
&CLK_TEST_GCC_SPDM_MSTR_AHB_CLK=(&CLK_GCC_TEST|0x093)
&CLK_TEST_GCC_SPMI_CNOC_AHB_CLK=(&CLK_GCC_TEST|0x090)
&CLK_TEST_GCC_SSC_CNOC_AHBS_CLK=(&CLK_GCC_TEST|0x10C)
&CLK_TEST_GCC_SSC_CNOC_MPU_CLK=(&CLK_GCC_TEST|0x10D)
&CLK_TEST_GCC_TCSR_AHB_CLK=(&CLK_GCC_TEST|0x07D)
&CLK_TEST_GCC_TLMM_AHB_CLK=(&CLK_GCC_TEST|0x080)
&CLK_TEST_GCC_TLMM_CLK=(&CLK_GCC_TEST|0x081)
&CLK_TEST_GCC_UFS_AHB_CLK=(&CLK_GCC_TEST|0x0FD)
&CLK_TEST_GCC_AGGRE1_NOC_MSMPU_CFG_AHB_CLK=(&CLK_GCC_TEST|0x13B)
&CLK_TEST_GCC_AGGRE2_NOC_MSMPU_CFG_AHB_CLK=(&CLK_GCC_TEST|0x13C)
&CLK_TEST_GCC_IPA_AHB_CLK=(&CLK_GCC_TEST|0x130)
&CLK_TEST_GCC_MSS_CFG_AHB_CLK=(&CLK_GCC_TEST|0x133)
&CLK_TEST_GCC_MSS_MSMPU_CFG_AHB_CLK=(&CLK_GCC_TEST|0x13E)
&CLK_TEST_GCC_MSS_Q6_CFG_AHB_CLK=(&CLK_GCC_TEST|0x143)
&CLK_TEST_GCC_MSS_Q6_MSMPU_CFG_AHB_CLK=(&CLK_GCC_TEST|0x13D)
&CLK_TEST_GCC_SKL_AHB_CLK=(&CLK_GCC_TEST|0x13A)
&CLK_TEST_GCC_BIMC_SLEEP_CLK=(&CLK_GCC_TEST|0x0A2)
&CLK_TEST_GCC_BLSP1_SLEEP_CLK=(&CLK_GCC_TEST|0x042)
&CLK_TEST_GCC_BLSP2_SLEEP_CLK=(&CLK_GCC_TEST|0x05C)
&CLK_TEST_GCC_DDR_DIM_SLEEP_CLK=(&CLK_GCC_TEST|0x0AC)
&CLK_TEST_GCC_IM_SLEEP_CLK=(&CLK_GCC_TEST|0x09F)
&CLK_TEST_GCC_RPM_SLEEP_CLK=(&CLK_GCC_TEST|0x086)
&CLK_TEST_GCC_TSIF_INACTIVITY_TIMERS_CLK=(&CLK_GCC_TEST|0x07C)
&CLK_TEST_GCC_USB20_SLEEP_CLK=(&CLK_GCC_TEST|0x036)
&CLK_TEST_GCC_USB30_SLEEP_CLK=(&CLK_GCC_TEST|0x02E)
&CLK_TEST_GCC_IPA_SLEEP_CLK=(&CLK_GCC_TEST|0x131)
&CLK_TEST_GCC_DCD_XO_CLK=(&CLK_GCC_TEST|0x0FA)
&CLK_TEST_GCC_PDM_XO4_CLK=(&CLK_GCC_TEST|0x077)
&CLK_TEST_GCC_RPM_TIMER_CLK=(&CLK_GCC_TEST|0x087)
&CLK_TEST_GCC_SPDM_FF_CLK=(&CLK_GCC_TEST|0x094)
&CLK_TEST_GCC_SSC_XO_CLK=(&CLK_GCC_TEST|0x110)
&CLK_TEST_GCC_XO_CLK=(&CLK_GCC_TEST|0x09D)
&CLK_TEST_GCC_XO_DIV4_CLK=(&CLK_GCC_TEST|0x09E)
&CLK_TEST_GCC_QREFS_VBG_CAL_CLK=(&CLK_GCC_TEST|0x14A)
&CLK_TEST_GCC_GP1_CLK=(&CLK_GCC_TEST|0x0E3)
&CLK_TEST_GCC_GP2_CLK=(&CLK_GCC_TEST|0x0E4)
&CLK_TEST_GCC_GP3_CLK=(&CLK_GCC_TEST|0x0E5)
&CLK_TEST_GCC_HMSS_AHB_CLK=(&CLK_GCC_TEST|0x0B7)
&CLK_TEST_GCC_SNOC_BUS_TIMEOUT0_AHB_CLK=(&CLK_GCC_TEST|0x0BC)
&CLK_TEST_GCC_SYS_NOC_HMSS_AHB_CLK=(&CLK_GCC_TEST|0x002)
&CLK_TEST_GCC_HMSS_RBCPR_CLK=(&CLK_GCC_TEST|0x0BA)
&CLK_TEST_GCC_AGGRE2_NOC_IPA_CLK=(&CLK_GCC_TEST|0x149)
&CLK_TEST_GCC_IPA_CLK=(&CLK_GCC_TEST|0x12F)
&CLK_TEST_GCC_BIMC_GFX_CLK=(&CLK_GCC_TEST|0x0AF)
&CLK_TEST_GCC_MMSS_BIMC_GFX_CLK=(&CLK_GCC_TEST|0x01C)
&CLK_TEST_GCC_MSS_Q6_BIMC_AXI_CLK=(&CLK_GCC_TEST|0x136)
&CLK_TEST_GCC_MSS_Q6_MSMPU_CLIENT_AXI_CLK=(&CLK_GCC_TEST|0x141)
&CLK_TEST_GCC_MSS_Q6_SMMU_CLK=(&CLK_GCC_TEST|0x144)
&CLK_TEST_GCC_MSS_VS_CLK=(&CLK_GCC_TEST|0x148)
&CLK_TEST_GCC_OBT_ODT_CLK=(&CLK_GCC_TEST|0x0FB)
&CLK_TEST_GCC_PCIE_0_PIPE_CLK=(&CLK_GCC_TEST|0x0EA)
&CLK_TEST_GCC_PCIE_1_PIPE_CLK=(&CLK_GCC_TEST|0x0F0)
&CLK_TEST_GCC_PCIE_2_PIPE_CLK=(&CLK_GCC_TEST|0x0F6)
&CLK_TEST_GCC_PCIE_0_AUX_CLK=(&CLK_GCC_TEST|0x0E9)
&CLK_TEST_GCC_PCIE_1_AUX_CLK=(&CLK_GCC_TEST|0x0EF)
&CLK_TEST_GCC_PCIE_2_AUX_CLK=(&CLK_GCC_TEST|0x0F5)
&CLK_TEST_GCC_PCIE_PHY_AUX_CLK=(&CLK_GCC_TEST|0x0F9)
&CLK_TEST_GCC_PDM2_CLK=(&CLK_GCC_TEST|0x078)
&CLK_TEST_GCC_AGGRE1_PNOC_AHB_CLK=(&CLK_GCC_TEST|0x11F)
&CLK_TEST_GCC_BLSP1_AHB_CLK=(&CLK_GCC_TEST|0x041)
&CLK_TEST_GCC_BLSP2_AHB_CLK=(&CLK_GCC_TEST|0x05B)
&CLK_TEST_GCC_PDM_AHB_CLK=(&CLK_GCC_TEST|0x076)
&CLK_TEST_GCC_PERIPH_NOC_AHB_CLK=(&CLK_GCC_TEST|0x011)
&CLK_TEST_GCC_PERIPH_NOC_MPU_CFG_AHB_CLK=(&CLK_GCC_TEST|0x075)
&CLK_TEST_GCC_PNOC_BUS_TIMEOUT1_AHB_CLK=(&CLK_GCC_TEST|0x0C2)
&CLK_TEST_GCC_PNOC_BUS_TIMEOUT2_AHB_CLK=(&CLK_GCC_TEST|0x0C3)
&CLK_TEST_GCC_PNOC_BUS_TIMEOUT3_AHB_CLK=(&CLK_GCC_TEST|0x0C4)
&CLK_TEST_GCC_PNOC_BUS_TIMEOUT4_AHB_CLK=(&CLK_GCC_TEST|0x0C5)
&CLK_TEST_GCC_SDCC1_AHB_CLK=(&CLK_GCC_TEST|0x03A)
&CLK_TEST_GCC_SDCC2_AHB_CLK=(&CLK_GCC_TEST|0x03C)
&CLK_TEST_GCC_SDCC3_AHB_CLK=(&CLK_GCC_TEST|0x03E)
&CLK_TEST_GCC_SDCC4_AHB_CLK=(&CLK_GCC_TEST|0x040)
&CLK_TEST_GCC_SNOC_PNOC_AHB_CLK=(&CLK_GCC_TEST|0x004)
&CLK_TEST_GCC_SPDM_PNOC_CY_CLK=(&CLK_GCC_TEST|0x097)
&CLK_TEST_GCC_TSIF_AHB_CLK=(&CLK_GCC_TEST|0x07A)
&CLK_TEST_GCC_USB_PHY_CFG_AHB2PHY_CLK=(&CLK_GCC_TEST|0x038)
&CLK_TEST_GCC_QSPI_AHB_CLK=(&CLK_GCC_TEST|0x138)
&CLK_TEST_GCC_BIMC_PIMEM_AXI_CLK=(&CLK_GCC_TEST|0x0A8)
&CLK_TEST_GCC_PIMEM_AXI_CLK=(&CLK_GCC_TEST|0x01D)
&CLK_TEST_GCC_SYS_NOC_PIMEM_AXI_CLK=(&CLK_GCC_TEST|0x009)
&CLK_TEST_GCC_AGGRE0_NOC_AT_CLK=(&CLK_GCC_TEST|0x118)
&CLK_TEST_GCC_AGGRE1_NOC_AT_CLK=(&CLK_GCC_TEST|0x11E)
&CLK_TEST_GCC_AGGRE2_NOC_AT_CLK=(&CLK_GCC_TEST|0x125)
&CLK_TEST_GCC_MMSS_NOC_AT_CLK=(&CLK_GCC_TEST|0x01A)
&CLK_TEST_GCC_PERIPH_NOC_AT_CLK=(&CLK_GCC_TEST|0x013)
&CLK_TEST_GCC_QDSS_AT_CLK=(&CLK_GCC_TEST|0x023)
&CLK_TEST_GCC_SSC_AT_CLK=(&CLK_GCC_TEST|0x10E)
&CLK_TEST_GCC_SYS_NOC_AT_CLK=(&CLK_GCC_TEST|0x005)
&CLK_TEST_GCC_QDSS_STM_CLK=(&CLK_GCC_TEST|0x025)
&CLK_TEST_GCC_SYS_NOC_QDSS_STM_AXI_CLK=(&CLK_GCC_TEST|0x001)
&CLK_TEST_GCC_QDSS_TRACECLKIN_CLK=(&CLK_GCC_TEST|0x026)
&CLK_TEST_GCC_QDSS_APB2JTAG_CLK=(&CLK_GCC_TEST|0x0D1)
&CLK_TEST_GCC_QDSS_DAP_CLK=(&CLK_GCC_TEST|0x029)
&CLK_TEST_GCC_QDSS_TSCTR_DIV16_CLK=(&CLK_GCC_TEST|0x02C)
&CLK_TEST_GCC_QDSS_TSCTR_DIV2_CLK=(&CLK_GCC_TEST|0x027)
&CLK_TEST_GCC_QDSS_TSCTR_DIV3_CLK=(&CLK_GCC_TEST|0x028)
&CLK_TEST_GCC_QDSS_TSCTR_DIV4_CLK=(&CLK_GCC_TEST|0x02A)
&CLK_TEST_GCC_QDSS_TSCTR_DIV8_CLK=(&CLK_GCC_TEST|0x02B)
&CLK_TEST_GCC_SSC_APB_CLK=(&CLK_GCC_TEST|0x10F)
&CLK_TEST_GCC_QSPI_SER_CLK=(&CLK_GCC_TEST|0x139)
&CLK_TEST_GCC_RBCPR_CX_CLK=(&CLK_GCC_TEST|0x0D2)
&CLK_TEST_GCC_RBCPR_MX_CLK=(&CLK_GCC_TEST|0x0D4)
&CLK_TEST_GCC_RPM_BUS_AHB_CLK=(&CLK_GCC_TEST|0x085)
&CLK_TEST_GCC_RPM_PROC_FCLK=(&CLK_GCC_TEST|0x083)
&CLK_TEST_GCC_RPM_PROC_HCLK=(&CLK_GCC_TEST|0x084)
&CLK_TEST_GCC_SPDM_RPM_CY_CLK=(&CLK_GCC_TEST|0x098)
&CLK_TEST_GCC_SDCC1_APPS_CLK=(&CLK_GCC_TEST|0x039)
&CLK_TEST_GCC_SDCC1_ICE_CORE_CLK=(&CLK_GCC_TEST|0x145)
&CLK_TEST_GCC_SDCC2_APPS_CLK=(&CLK_GCC_TEST|0x03B)
&CLK_TEST_GCC_SDCC3_APPS_CLK=(&CLK_GCC_TEST|0x03D)
&CLK_TEST_GCC_SDCC4_APPS_CLK=(&CLK_GCC_TEST|0x03F)
&CLK_TEST_GCC_SEC_CTRL_CLK=(&CLK_GCC_TEST|0x08C)
&CLK_TEST_GCC_SEC_CTRL_SENSE_CLK=(&CLK_GCC_TEST|0x08D)
&CLK_TEST_GCC_SPMI_AHB_CLK=(&CLK_GCC_TEST|0x091)
&CLK_TEST_GCC_SPMI_SER_CLK=(&CLK_GCC_TEST|0x08F)
&CLK_TEST_GCC_BIMC_NIUS_HS_AXI_CLK=(&CLK_GCC_TEST|0x00B)
&CLK_TEST_GCC_BIMC_SYSNOC_HS_AXI_CLK=(&CLK_GCC_TEST|0x0A7)
&CLK_TEST_GCC_LPASS_Q6_AXI_CLK=(&CLK_GCC_TEST|0x0B0)
&CLK_TEST_GCC_LPASS_Q6_SMMU_AXI_CLK=(&CLK_GCC_TEST|0x0B1)
&CLK_TEST_GCC_SYS_NOC_HS_AXI_CLK=(&CLK_GCC_TEST|0x00A)
&CLK_TEST_GCC_MSS_MNOC_BIMC_AXI_CLK=(&CLK_GCC_TEST|0x134)
&CLK_TEST_GCC_MSS_MSMPU_CLIENT_AXI_CLK=(&CLK_GCC_TEST|0x142)
&CLK_TEST_GCC_AGGRE0_SNOC_AXI_CLK=(&CLK_GCC_TEST|0x116)
&CLK_TEST_GCC_AGGRE1_SNOC_AXI_CLK=(&CLK_GCC_TEST|0x11C)
&CLK_TEST_GCC_AGGRE2_SNOC_AXI_CLK=(&CLK_GCC_TEST|0x123)
&CLK_TEST_GCC_BIMC_NIUS_AXI_CLK=(&CLK_GCC_TEST|0x00C)
&CLK_TEST_GCC_BIMC_SYSNOC_AXI_CLK=(&CLK_GCC_TEST|0x0A3)
&CLK_TEST_GCC_CE1_AXI_CLK=(&CLK_GCC_TEST|0x09A)
&CLK_TEST_GCC_IMEM_AXI_CLK=(&CLK_GCC_TEST|0x016)
&CLK_TEST_GCC_LPASS_SWAY_CLK=(&CLK_GCC_TEST|0x0B2)
&CLK_TEST_GCC_MMSS_SYS_NOC_AXI_CLK=(&CLK_GCC_TEST|0x018)
&CLK_TEST_GCC_PCIE_0_MSTR_AXI_CLK=(&CLK_GCC_TEST|0x0E7)
&CLK_TEST_GCC_PCIE_0_SLV_AXI_CLK=(&CLK_GCC_TEST|0x0E6)
&CLK_TEST_GCC_PCIE_1_MSTR_AXI_CLK=(&CLK_GCC_TEST|0x0ED)
&CLK_TEST_GCC_PCIE_1_SLV_AXI_CLK=(&CLK_GCC_TEST|0x0EC)
&CLK_TEST_GCC_PCIE_2_MSTR_AXI_CLK=(&CLK_GCC_TEST|0x0F3)
&CLK_TEST_GCC_PCIE_2_SLV_AXI_CLK=(&CLK_GCC_TEST|0x0F2)
&CLK_TEST_GCC_QDSS_ETR_USB_CLK=(&CLK_GCC_TEST|0x024)
&CLK_TEST_GCC_SMMU_AGGRE0_AXI_CLK=(&CLK_GCC_TEST|0x119)
&CLK_TEST_GCC_SMMU_AGGRE1_AXI_CLK=(&CLK_GCC_TEST|0x120)
&CLK_TEST_GCC_SMMU_AGGRE2_AXI_CLK=(&CLK_GCC_TEST|0x128)
&CLK_TEST_GCC_SNOC_BUS_TIMEOUT1_AHB_CLK=(&CLK_GCC_TEST|0x0BE)
&CLK_TEST_GCC_SNOC_BUS_TIMEOUT3_AHB_CLK=(&CLK_GCC_TEST|0x0BF)
&CLK_TEST_GCC_SPDM_SNOC_CY_CLK=(&CLK_GCC_TEST|0x096)
&CLK_TEST_GCC_SSC_SNOC_AHBM_CLK=(&CLK_GCC_TEST|0x10A)
&CLK_TEST_GCC_SYS_NOC_AXI_CLK=(&CLK_GCC_TEST|0x000)
&CLK_TEST_GCC_SYS_NOC_SSC_Q6_AXI_CLK=(&CLK_GCC_TEST|0x10B)
&CLK_TEST_GCC_AGGRE1_SNOC_MSMPU_CLIENT_AXI_CLK=(&CLK_GCC_TEST|0x13F)
&CLK_TEST_GCC_AGGRE2_SNOC_MSMPU_CLIENT_AXI_CLK=(&CLK_GCC_TEST|0x140)
&CLK_TEST_GCC_MSS_SNOC_AXI_CLK=(&CLK_GCC_TEST|0x135)
&CLK_TEST_GCC_CFG_NOC_TIC_CLK=(&CLK_GCC_TEST|0x010)
&CLK_TEST_GCC_TSIF_REF_CLK=(&CLK_GCC_TEST|0x07B)
&CLK_TEST_GCC_AGGRE2_UFS_AXI_CLK=(&CLK_GCC_TEST|0x126)
&CLK_TEST_GCC_SYS_NOC_UFS_AXI_CLK=(&CLK_GCC_TEST|0x007)
&CLK_TEST_GCC_UFS_AXI_CLK=(&CLK_GCC_TEST|0x0FC)
&CLK_TEST_GCC_UFS_RX_CFG_CLK=(&CLK_GCC_TEST|0x0FF)
&CLK_TEST_GCC_UFS_TX_CFG_CLK=(&CLK_GCC_TEST|0x0FE)
&CLK_TEST_GCC_UFS_ICE_CORE_CLK=(&CLK_GCC_TEST|0x107)
&CLK_TEST_GCC_UFS_UNIPRO_CORE_CLK=(&CLK_GCC_TEST|0x106)
&CLK_TEST_GCC_UFS_RX_SYMBOL_0_CLK=(&CLK_GCC_TEST|0x101)
&CLK_TEST_GCC_UFS_RX_SYMBOL_1_CLK=(&CLK_GCC_TEST|0x102)
&CLK_TEST_GCC_UFS_TX_SYMBOL_0_CLK=(&CLK_GCC_TEST|0x100)
&CLK_TEST_GCC_PERIPH_NOC_USB20_AHB_CLK=(&CLK_GCC_TEST|0x014)
&CLK_TEST_GCC_PNOC_BUS_TIMEOUT0_AHB_CLK=(&CLK_GCC_TEST|0x0C1)
&CLK_TEST_GCC_USB20_MASTER_CLK=(&CLK_GCC_TEST|0x035)
&CLK_TEST_GCC_USB20_MOCK_UTMI_CLK=(&CLK_GCC_TEST|0x037)
&CLK_TEST_GCC_AGGRE2_USB3_AXI_CLK=(&CLK_GCC_TEST|0x127)
&CLK_TEST_GCC_SNOC_BUS_TIMEOUT2_AHB_CLK=(&CLK_GCC_TEST|0x0BD)
&CLK_TEST_GCC_SYS_NOC_USB3_AXI_CLK=(&CLK_GCC_TEST|0x006)
&CLK_TEST_GCC_USB30_MASTER_CLK=(&CLK_GCC_TEST|0x02D)
&CLK_TEST_GCC_USB30_MOCK_UTMI_CLK=(&CLK_GCC_TEST|0x02F)
&CLK_TEST_GCC_USB3_PHY_AUX_CLK=(&CLK_GCC_TEST|0x030)
&CLK_TEST_GCC_USB3_PHY_PIPE_CLK=(&CLK_GCC_TEST|0x031)
&CLK_TEST_GCC_VDDA_VS_CLK=(&CLK_GCC_TEST|0x114)
&CLK_TEST_GCC_VDDCX_VS_CLK=(&CLK_GCC_TEST|0x112)
&CLK_TEST_GCC_VDDMX_VS_CLK=(&CLK_GCC_TEST|0x113)
&CLK_TEST_GCC_VS_CTRL_CLK=(&CLK_GCC_TEST|0x115)
&CLK_TEST_GCC_AGGRE0_NOC_QOSGEN_EXTREF=(&CLK_GCC_TEST|0x11B)
&CLK_TEST_GCC_AGGRE1_NOC_QOSGEN_EXTREF=(&CLK_GCC_TEST|0x122)
&CLK_TEST_GCC_AGGRE2_NOC_QOSGEN_EXTREF=(&CLK_GCC_TEST|0x12A)
&CLK_TEST_GCC_CNOC_BUS_TIMEOUT_EXTREF=(&CLK_GCC_TEST|0x0D0)
&CLK_TEST_GCC_SNOC_BUS_TIMEOUT_EXTREF=(&CLK_GCC_TEST|0x0C0)
&CLK_TEST_GCC_SNOC_QOSGEN_EXTREF=(&CLK_GCC_TEST|0x008)
&CLK_TEST_GPLL0_DTEST=(&CLK_GCC_TEST|0x0D8)
&CLK_TEST_GPLL0_LOCK_DET=(&CLK_GCC_TEST|0x0D9)
&CLK_TEST_GPLL1_DTEST=(&CLK_GCC_TEST|0x0DA)
&CLK_TEST_GPLL1_LOCK_DET=(&CLK_GCC_TEST|0x0DB)
&CLK_TEST_GPLL2_DTEST=(&CLK_GCC_TEST|0x0DC)
&CLK_TEST_GPLL2_LOCK_DET=(&CLK_GCC_TEST|0x0DD)
&CLK_TEST_GPLL3_DTEST=(&CLK_GCC_TEST|0x0DE)
&CLK_TEST_GPLL3_LOCK_DET=(&CLK_GCC_TEST|0x0DF)
&CLK_TEST_GPLL4_DTEST=(&CLK_GCC_TEST|0x0E1)
&CLK_TEST_GPLL4_LOCK_DET=(&CLK_GCC_TEST|0x0E2)
&CLK_TEST_HMSS_GCC_DBG_CLK=(&CLK_GCC_TEST|0x0BB)
&CLK_TEST_LPASS_GCC_DBG_CLK=(&CLK_GCC_TEST|0x0B6)
&CLK_TEST_MMSS_GCC_DBG_CLK=(&CLK_GCC_TEST|0x01B)
&CLK_TEST_MPM_GCC_TEMP0_SENSOR_RINGOSC_CLK=(&CLK_GCC_TEST|0x0E0)
&CLK_TEST_MPM_GCC_TEMP1_SENSOR_RINGOSC_CLK=(&CLK_GCC_TEST|0x147)
&CLK_TEST_MPM_GCC_TEMP_SENSOR_RINGOSC_CLK=(&CLK_GCC_TEST|0x0E0)
&CLK_TEST_MSS_GCC_DBG_CLK=(&CLK_GCC_TEST|0x137)
&CLK_TEST_QUSB2PHY_GCC_CLK_TEST_PRIM=(&CLK_GCC_TEST|0x0D6)
&CLK_TEST_QUSB2PHY_GCC_CLK_TEST_SEC=(&CLK_GCC_TEST|0x0D7)
&CLK_TEST_QUSB2PHY_PRIM_GCC_USB30_UTMI_CLK=(&CLK_GCC_TEST|0x033)
&CLK_TEST_QUSB2PHY_SEC_GCC_USB20S_UTMI_CLK=(&CLK_GCC_TEST|0x034)
&CLK_TEST_SSC_GCC_DBG_CLK=(&CLK_GCC_TEST|0x111)
&CLK_TEST_UFS_RX_SYMBOL_0_CLK=(&CLK_GCC_TEST|0x104)
&CLK_TEST_UFS_RX_SYMBOL_1_CLK=(&CLK_GCC_TEST|0x105)
&CLK_TEST_UFS_TX_SYMBOL_0_CLK=(&CLK_GCC_TEST|0x103)
&CLK_TEST_USB3_PHY_WRAPPER_GCC_USB3_PIPE_CLK=(&CLK_GCC_TEST|0x032)

; LPASS test clocks
&CLK_TEST_AON_CLK_SRC=(&CLK_LPASS_TEST|0x016)
&CLK_TEST_AUDIO_CORE_QDSP_SWAY_AON_CLK=(&CLK_LPASS_TEST|0x03D)
&CLK_TEST_AUDIO_WRAPPER_AON_CLK=(&CLK_LPASS_TEST|0x044)
&CLK_TEST_AUDIO_WRAPPER_BUS_TIMEOUT_AON_CLK=(&CLK_LPASS_TEST|0x056)
&CLK_TEST_AUDIO_WRAPPER_MPU_CFG_AON_CLK=(&CLK_LPASS_TEST|0x04E)
&CLK_TEST_AUDIO_WRAPPER_Q6_AHBM_MPU_AON_CLK=(&CLK_LPASS_TEST|0x04F)
&CLK_TEST_AUDIO_WRAPPER_QOS_AHBS_AON_CLK=(&CLK_LPASS_TEST|0x045)
&CLK_TEST_AUDIO_WRAPPER_SYSNOC_SWAY_AON_CLK=(&CLK_LPASS_TEST|0x049)
&CLK_TEST_Q6SS_AHBM_AON_CLK=(&CLK_LPASS_TEST|0x04A)
&CLK_TEST_Q6SS_AHBS_AON_CLK=(&CLK_LPASS_TEST|0x050)
&CLK_TEST_ATIME_CLK_SRC=(&CLK_LPASS_TEST|0x011)
&CLK_TEST_LPASS_CORE_AVSYNC_ATIME_CLK=(&CLK_LPASS_TEST|0x02F)
&CLK_TEST_AUD_SLIMBUS_CLK_SRC=(&CLK_LPASS_TEST|0x013)
&CLK_TEST_AUDIO_CORE_AUD_SLIMBUS_CLK=(&CLK_LPASS_TEST|0x032)
&CLK_TEST_AUDIO_CORE_PERIPHERAL_SMMU_CFG_CNOC_CLK=(&CLK_LPASS_TEST|0x03E)
&CLK_TEST_AUDIO_CORE_SYSNOC_SWAY_SNOC_CLK=(&CLK_LPASS_TEST|0x03F)
&CLK_TEST_AUDIO_WRAPPER_SYSNOC_SWAY_SNOC_CLK=(&CLK_LPASS_TEST|0x043)
&CLK_TEST_CORE_CLK_SRC=(&CLK_LPASS_TEST|0x015)
&CLK_TEST_AUDIO_CORE_AUD_SLIMBUS_CORE_CLK=(&CLK_LPASS_TEST|0x036)
&CLK_TEST_AUDIO_CORE_CORE_CLK=(&CLK_LPASS_TEST|0x034)
&CLK_TEST_AUDIO_CORE_LPM_CORE_CLK=(&CLK_LPASS_TEST|0x038)
&CLK_TEST_AUDIO_CORE_PERIPHERAL_SMMU_CLIENT_CORE_CLK=(&CLK_LPASS_TEST|0x03C)
&CLK_TEST_AUDIO_CORE_QCA_SLIMBUS_CORE_CLK=(&CLK_LPASS_TEST|0x037)
&CLK_TEST_AUDIO_CORE_SYSNOC_MPORT_CORE_CLK=(&CLK_LPASS_TEST|0x035)
&CLK_TEST_AUDIO_CORE_BUS_TIMEOUT_CORE_CLK=(&CLK_LPASS_TEST|0x056)
&CLK_TEST_EXT_MCLK0_CLK_SRC=(&CLK_LPASS_TEST|0x018)
&CLK_TEST_AUDIO_WRAPPER_EXT_MCLK0_CLK=(&CLK_LPASS_TEST|0x046)
&CLK_TEST_EXT_MCLK1_CLK_SRC=(&CLK_LPASS_TEST|0x019)
&CLK_TEST_AUDIO_WRAPPER_EXT_MCLK1_CLK=(&CLK_LPASS_TEST|0x047)
&CLK_TEST_EXT_MCLK2_CLK_SRC=(&CLK_LPASS_TEST|0x01A)
&CLK_TEST_AUDIO_WRAPPER_EXT_MCLK2_CLK=(&CLK_LPASS_TEST|0x048)
&CLK_TEST_LPAIF_PCMOE_CLK_SRC=(&CLK_LPASS_TEST|0x010)
&CLK_TEST_AUDIO_CORE_LPAIF_PCM_DATA_OE_CLK=(&CLK_LPASS_TEST|0x02E)
&CLK_TEST_LPAIF_PRI_CLK_SRC=(&CLK_LPASS_TEST|0x00C)
&CLK_TEST_AUDIO_CORE_LPAIF_PRI_IBIT_CLK=(&CLK_LPASS_TEST|0x027)
&CLK_TEST_LPAIF_QUAD_CLK_SRC=(&CLK_LPASS_TEST|0x00F)
&CLK_TEST_AUDIO_CORE_LPAIF_QUAD_IBIT_CLK=(&CLK_LPASS_TEST|0x02D)
&CLK_TEST_LPAIF_SEC_CLK_SRC=(&CLK_LPASS_TEST|0x00D)
&CLK_TEST_AUDIO_CORE_LPAIF_SEC_IBIT_CLK=(&CLK_LPASS_TEST|0x029)
&CLK_TEST_LPAIF_SPKR_CLK_SRC=(&CLK_LPASS_TEST|0x00B)
&CLK_TEST_AUDIO_CORE_LPAIF_CODEC_SPKR_IBIT_CLK=(&CLK_LPASS_TEST|0x025)
&CLK_TEST_AUDIO_CORE_LPAIF_CODEC_SPKR_OSR_CLK=(&CLK_LPASS_TEST|0x024)
&CLK_TEST_LPAIF_TER_CLK_SRC=(&CLK_LPASS_TEST|0x00E)
&CLK_TEST_AUDIO_CORE_LPAIF_TER_IBIT_CLK=(&CLK_LPASS_TEST|0x02B)
&CLK_TEST_QCA_SLIMBUS_CLK_SRC=(&CLK_LPASS_TEST|0x014)
&CLK_TEST_AUDIO_CORE_QCA_SLIMBUS_CLK=(&CLK_LPASS_TEST|0x033)
&CLK_TEST_QOS_FIXED_LAT_COUNTER_SRC=(&CLK_LPASS_TEST|0x022)
&CLK_TEST_AUDIO_CORE_QOS_DMONITOR_FIXED_LAT_COUNTER_CLK=(&CLK_LPASS_TEST|0x055)
&CLK_TEST_AUDIO_WRAPPER_QOS_DANGER_FIXED_LAT_COUNTER_CLK=(&CLK_LPASS_TEST|0x053)
&CLK_TEST_AUDIO_WRAPPER_QOS_DMONITOR_FIXED_LAT_COUNTER_CLK=(&CLK_LPASS_TEST|0x052)
&CLK_TEST_RESAMPLER_CLK_SRC=(&CLK_LPASS_TEST|0x012)
&CLK_TEST_AUDIO_CORE_RESAMPLER_CORE_CLK=(&CLK_LPASS_TEST|0x031)
&CLK_TEST_SLEEP_CLK_SRC=(&CLK_LPASS_TEST|0x00A)
&CLK_TEST_AUDIO_CORE_BCR_SLP_CLK=(&CLK_LPASS_TEST|0x040)
&CLK_TEST_Q6SS_BCR_SLP_CLK=(&CLK_LPASS_TEST|0x04B)
&CLK_TEST_XO_CLK_SRC=(&CLK_LPASS_TEST|0x01D)
&CLK_TEST_AUDIO_CORE_AVSYNC_STC_XO_CLK=(&CLK_LPASS_TEST|0x030)
&CLK_TEST_AUDIO_CORE_GDSC_XO_CLK=(&CLK_LPASS_TEST|0x023)
&CLK_TEST_AUDIO_WRAPPER_Q6_SMMU_GDSC_XO_CLK=(&CLK_LPASS_TEST|0x04C)
&CLK_TEST_AUDIO_WRAPPER_QOS_XO_LAT_COUNTER_CLK=(&CLK_LPASS_TEST|0x051)
&CLK_TEST_LPASS_QDSP6SS_Q6_CORE_CLK=(&CLK_LPASS_TEST|&CLK_LPASS_SUB_MUX_Q6|0x1)
&CLK_TEST_LPASS_QDSP6SS_AXI_M_CLK=(&CLK_LPASS_TEST|&CLK_LPASS_SUB_MUX_Q6|0x2)
&CLK_TEST_LPASS_QDSP6SS_LDO_NMO_OUT=(&CLK_LPASS_TEST|&CLK_LPASS_SUB_MUX_Q6|0x3)
&CLK_TEST_LPASS_QDSP6SS_AHB_M_CLK=(&CLK_LPASS_TEST|&CLK_LPASS_SUB_MUX_Q6|0x4)
&CLK_TEST_LPASS_QDSP6SS_AHB_S_CLK=(&CLK_LPASS_TEST|&CLK_LPASS_SUB_MUX_Q6|0x5)
&CLK_TEST_LPASS_QDSP6SS_XO_CLK=(&CLK_LPASS_TEST|&CLK_LPASS_SUB_MUX_Q6|0x6)
&CLK_TEST_LPASS_QDSP6SS_SLEEP_CLK=(&CLK_LPASS_TEST|&CLK_LPASS_SUB_MUX_Q6|0x7)
&CLK_TEST_LPASS_QDSP6SS_JTAG_TCK=(&CLK_LPASS_TEST|&CLK_LPASS_SUB_MUX_Q6|0x8)
&CLK_TEST_LPASS_QDSP6SS_ATB_CLK=(&CLK_LPASS_TEST|&CLK_LPASS_SUB_MUX_Q6|0x9)
&CLK_TEST_LPASS_QDSP6SS_APB_CLK=(&CLK_LPASS_TEST|&CLK_LPASS_SUB_MUX_Q6|0xA)
&CLK_TEST_LPASS_QDSP6SS_TIMESTAMP_CLK=(&CLK_LPASS_TEST|&CLK_LPASS_SUB_MUX_Q6|0xB)

; MMSS test clocks
&CLK_TEST_CAMSS_AHB_CLK=(&CLK_MMSS_TEST|0x037)
&CLK_TEST_CAMSS_CCI_AHB_CLK=(&CLK_MMSS_TEST|0x02E)
&CLK_TEST_CAMSS_CPP_AHB_CLK=(&CLK_MMSS_TEST|0x03B)
&CLK_TEST_CAMSS_CPP_VBIF_AHB_CLK=(&CLK_MMSS_TEST|0x073)
&CLK_TEST_CAMSS_CSI0_AHB_CLK=(&CLK_MMSS_TEST|0x042)
&CLK_TEST_CAMSS_CSI1_AHB_CLK=(&CLK_MMSS_TEST|0x047)
&CLK_TEST_CAMSS_CSI2_AHB_CLK=(&CLK_MMSS_TEST|0x04C)
&CLK_TEST_CAMSS_CSI3_AHB_CLK=(&CLK_MMSS_TEST|0x051)
&CLK_TEST_CAMSS_ISPIF_AHB_CLK=(&CLK_MMSS_TEST|0x033)
&CLK_TEST_CAMSS_JPEG_AHB_CLK=(&CLK_MMSS_TEST|0x035)
&CLK_TEST_CAMSS_MICRO_AHB_CLK=(&CLK_MMSS_TEST|0x026)
&CLK_TEST_CAMSS_TOP_AHB_CLK=(&CLK_MMSS_TEST|0x025)
&CLK_TEST_CAMSS_VFE0_AHB_CLK=(&CLK_MMSS_TEST|0x086)
&CLK_TEST_CAMSS_VFE1_AHB_CLK=(&CLK_MMSS_TEST|0x087)
&CLK_TEST_CAMSS_VFE_AHB_CLK=(&CLK_MMSS_TEST|0x03C)
&CLK_TEST_FD_AHB_CLK=(&CLK_MMSS_TEST|0x08C)
&CLK_TEST_GPU_AHB_CLK=(&CLK_MMSS_TEST|0x00C)
&CLK_TEST_MDSS_AHB_CLK=(&CLK_MMSS_TEST|0x022)
&CLK_TEST_MDSS_HDMI_AHB_CLK=(&CLK_MMSS_TEST|0x023)
&CLK_TEST_MMSS_BTO_AHB_CLK=(&CLK_MMSS_TEST|0x002)
&CLK_TEST_MMSS_MISC_AHB_CLK=(&CLK_MMSS_TEST|0x003)
&CLK_TEST_MMSS_MMAGIC_AHB_CLK=(&CLK_MMSS_TEST|0x001)
&CLK_TEST_MMSS_MMAGIC_CFG_AHB_CLK=(&CLK_MMSS_TEST|0x074)
&CLK_TEST_MMSS_RBCPR_AHB_CLK=(&CLK_MMSS_TEST|0x013)
&CLK_TEST_MMSS_SPDM_AHB_CLK=(&CLK_MMSS_TEST|0x060)
&CLK_TEST_SMMU_CPP_AHB_CLK=(&CLK_MMSS_TEST|0x096)
&CLK_TEST_SMMU_JPEG_AHB_CLK=(&CLK_MMSS_TEST|0x098)
&CLK_TEST_SMMU_MDP_AHB_CLK=(&CLK_MMSS_TEST|0x09D)
&CLK_TEST_SMMU_ROT_AHB_CLK=(&CLK_MMSS_TEST|0x09B)
&CLK_TEST_SMMU_VFE_AHB_CLK=(&CLK_MMSS_TEST|0x094)
&CLK_TEST_SMMU_VIDEO_AHB_CLK=(&CLK_MMSS_TEST|0x0A0)
&CLK_TEST_THROTTLE_CAMSS_AHB_CLK=(&CLK_MMSS_TEST|0x0A4)
&CLK_TEST_THROTTLE_MDSS_AHB_CLK=(&CLK_MMSS_TEST|0x0A5)
&CLK_TEST_THROTTLE_VIDEO_AHB_CLK=(&CLK_MMSS_TEST|0x0A6)
&CLK_TEST_VIDEO_AHB_CLK=(&CLK_MMSS_TEST|0x011)
&CLK_TEST_VMEM_AHB_CLK=(&CLK_MMSS_TEST|0x00A)
&CLK_TEST_CAMSS_CPP_AXI_CLK=(&CLK_MMSS_TEST|0x07A)
&CLK_TEST_CAMSS_JPEG_AXI_CLK=(&CLK_MMSS_TEST|0x036)
&CLK_TEST_CAMSS_VFE_AXI_CLK=(&CLK_MMSS_TEST|0x03D)
&CLK_TEST_MDSS_AXI_CLK=(&CLK_MMSS_TEST|0x024)
&CLK_TEST_MMAGIC_BIMC_AXI_CLK=(&CLK_MMSS_TEST|0x0A3)
&CLK_TEST_MMAGIC_CAMSS_AXI_CLK=(&CLK_MMSS_TEST|0x09A)
&CLK_TEST_MMAGIC_MDSS_AXI_CLK=(&CLK_MMSS_TEST|0x09F)
&CLK_TEST_MMAGIC_VIDEO_AXI_CLK=(&CLK_MMSS_TEST|0x0A2)
&CLK_TEST_MMSS_MMAGIC_AXI_CLK=(&CLK_MMSS_TEST|0x004)
&CLK_TEST_MMSS_S0_AXI_CLK=(&CLK_MMSS_TEST|0x005)
&CLK_TEST_MMSS_SPDM_AXI_CLK=(&CLK_MMSS_TEST|0x059)
&CLK_TEST_MMSS_SPDM_RM_AXI_CLK=(&CLK_MMSS_TEST|0x063)
&CLK_TEST_SMMU_CPP_AXI_CLK=(&CLK_MMSS_TEST|0x097)
&CLK_TEST_SMMU_JPEG_AXI_CLK=(&CLK_MMSS_TEST|0x099)
&CLK_TEST_SMMU_MDP_AXI_CLK=(&CLK_MMSS_TEST|0x09E)
&CLK_TEST_SMMU_ROT_AXI_CLK=(&CLK_MMSS_TEST|0x09C)
&CLK_TEST_SMMU_VFE_AXI_CLK=(&CLK_MMSS_TEST|0x095)
&CLK_TEST_SMMU_VIDEO_AXI_CLK=(&CLK_MMSS_TEST|0x0A1)
&CLK_TEST_THROTTLE_CAMSS_AXI_CLK=(&CLK_MMSS_TEST|0x0AA)
&CLK_TEST_THROTTLE_MDSS_AXI_CLK=(&CLK_MMSS_TEST|0x0AB)
&CLK_TEST_THROTTLE_VIDEO_AXI_CLK=(&CLK_MMSS_TEST|0x0AC)
&CLK_TEST_VIDEO_AXI_CLK=(&CLK_MMSS_TEST|0x00F)
&CLK_TEST_MDSS_BYTE0_CLK=(&CLK_MMSS_TEST|0x01E)
&CLK_TEST_MDSS_BYTE1_CLK=(&CLK_MMSS_TEST|0x01F)
&CLK_TEST_CAMSS_GP0_CLK=(&CLK_MMSS_TEST|0x027)
&CLK_TEST_CAMSS_GP1_CLK=(&CLK_MMSS_TEST|0x028)
&CLK_TEST_CAMSS_CCI_CLK=(&CLK_MMSS_TEST|0x02D)
&CLK_TEST_CAMSS_CPP_CLK=(&CLK_MMSS_TEST|0x03A)
&CLK_TEST_MMSS_SPDM_CPP_CLK=(&CLK_MMSS_TEST|0x055)
&CLK_TEST_CAMSS_CSI0_CLK=(&CLK_MMSS_TEST|0x041)
&CLK_TEST_CAMSS_CSI0PHY_CLK=(&CLK_MMSS_TEST|0x043)
&CLK_TEST_CAMSS_CSI0PIX_CLK=(&CLK_MMSS_TEST|0x045)
&CLK_TEST_CAMSS_CSI0RDI_CLK=(&CLK_MMSS_TEST|0x044)
&CLK_TEST_MMSS_SPDM_CSI0_CLK=(&CLK_MMSS_TEST|0x062)
&CLK_TEST_CAMSS_CSI0PHYTIMER_CLK=(&CLK_MMSS_TEST|0x02F)
&CLK_TEST_CAMSS_CSI1_CLK=(&CLK_MMSS_TEST|0x046)
&CLK_TEST_CAMSS_CSI1PHY_CLK=(&CLK_MMSS_TEST|0x048)
&CLK_TEST_CAMSS_CSI1PIX_CLK=(&CLK_MMSS_TEST|0x04A)
&CLK_TEST_CAMSS_CSI1RDI_CLK=(&CLK_MMSS_TEST|0x049)
&CLK_TEST_CAMSS_CSI1PHYTIMER_CLK=(&CLK_MMSS_TEST|0x030)
&CLK_TEST_CAMSS_CSI2_CLK=(&CLK_MMSS_TEST|0x04B)
&CLK_TEST_CAMSS_CSI2PHY_CLK=(&CLK_MMSS_TEST|0x04D)
&CLK_TEST_CAMSS_CSI2PIX_CLK=(&CLK_MMSS_TEST|0x04F)
&CLK_TEST_CAMSS_CSI2RDI_CLK=(&CLK_MMSS_TEST|0x04E)
&CLK_TEST_CAMSS_CSI2PHYTIMER_CLK=(&CLK_MMSS_TEST|0x031)
&CLK_TEST_CAMSS_CSI3_CLK=(&CLK_MMSS_TEST|0x050)
&CLK_TEST_CAMSS_CSI3PHY_CLK=(&CLK_MMSS_TEST|0x052)
&CLK_TEST_CAMSS_CSI3PIX_CLK=(&CLK_MMSS_TEST|0x054)
&CLK_TEST_CAMSS_CSI3RDI_CLK=(&CLK_MMSS_TEST|0x053)
&CLK_TEST_CAMSS_CSIPHY0_3P_CLK=(&CLK_MMSS_TEST|0x091)
&CLK_TEST_CAMSS_CSIPHY1_3P_CLK=(&CLK_MMSS_TEST|0x092)
&CLK_TEST_CAMSS_CSIPHY2_3P_CLK=(&CLK_MMSS_TEST|0x093)
&CLK_TEST_DSA_CORE_CLK=(&CLK_MMSS_TEST|0x075)
&CLK_TEST_MDSS_EDPAUX_CLK=(&CLK_MMSS_TEST|0x08F)
&CLK_TEST_MDSS_EDPGTC_CLK=(&CLK_MMSS_TEST|0x090)
&CLK_TEST_MDSS_EDPLINK_CLK=(&CLK_MMSS_TEST|0x08E)
&CLK_TEST_MDSS_EDPPIXEL_CLK=(&CLK_MMSS_TEST|0x08D)
&CLK_TEST_MDSS_ESC0_CLK=(&CLK_MMSS_TEST|0x020)
&CLK_TEST_MDSS_ESC1_CLK=(&CLK_MMSS_TEST|0x021)
&CLK_TEST_MDSS_EXTPCLK_CLK=(&CLK_MMSS_TEST|0x018)
&CLK_TEST_FD_CORE_CLK=(&CLK_MMSS_TEST|0x089)
&CLK_TEST_FD_CORE_UAR_CLK=(&CLK_MMSS_TEST|0x08A)
&CLK_TEST_DSA_NOC_CFG_AHB_CLK=(&CLK_MMSS_TEST|0x076)
&CLK_TEST_MMAGIC_BIMC_NOC_CFG_AHB_CLK=(&CLK_MMSS_TEST|0x0B0)
&CLK_TEST_MMAGIC_CAMSS_NOC_CFG_AHB_CLK=(&CLK_MMSS_TEST|0x0AD)
&CLK_TEST_MMAGIC_MDSS_NOC_CFG_AHB_CLK=(&CLK_MMSS_TEST|0x0AE)
&CLK_TEST_MMAGIC_VIDEO_NOC_CFG_AHB_CLK=(&CLK_MMSS_TEST|0x0AF)
&CLK_TEST_GPU_GX_GFX3D_CLK=(&CLK_MMSS_TEST|0x00D)
&CLK_TEST_MMSS_SPDM_GFX3D_CLK=(&CLK_MMSS_TEST|0x05F)
&CLK_TEST_MDSS_HDMI_CLK=(&CLK_MMSS_TEST|0x01D)
&CLK_TEST_GPU_AON_ISENSE_CLK=(&CLK_MMSS_TEST|0x088)
&CLK_TEST_CAMSS_JPEG0_CLK=(&CLK_MMSS_TEST|0x032)
&CLK_TEST_MMSS_SPDM_JPEG0_CLK=(&CLK_MMSS_TEST|0x056)
&CLK_TEST_CAMSS_JPEG2_CLK=(&CLK_MMSS_TEST|0x034)
&CLK_TEST_MMSS_SPDM_JPEG2_CLK=(&CLK_MMSS_TEST|0x05D)
&CLK_TEST_CAMSS_JPEG_DMA_CLK=(&CLK_MMSS_TEST|0x07B)
&CLK_TEST_MMSS_SPDM_JPEG_DMA_CLK=(&CLK_MMSS_TEST|0x057)
&CLK_TEST_MMSS_MMAGIC_MAXI_CLK=(&CLK_MMSS_TEST|0x070)
&CLK_TEST_MMSS_SPDM_RM_MAXI_CLK=(&CLK_MMSS_TEST|0x019)
&CLK_TEST_VIDEO_MAXI_CLK=(&CLK_MMSS_TEST|0x010)
&CLK_TEST_VMEM_MAXI_CLK=(&CLK_MMSS_TEST|0x009)
&CLK_TEST_CAMSS_MCLK0_CLK=(&CLK_MMSS_TEST|0x029)
&CLK_TEST_CAMSS_MCLK1_CLK=(&CLK_MMSS_TEST|0x02A)
&CLK_TEST_CAMSS_MCLK2_CLK=(&CLK_MMSS_TEST|0x02B)
&CLK_TEST_CAMSS_MCLK3_CLK=(&CLK_MMSS_TEST|0x02C)
&CLK_TEST_MDSS_MDP_CLK=(&CLK_MMSS_TEST|0x014)
&CLK_TEST_MMSS_SPDM_MDP_CLK=(&CLK_MMSS_TEST|0x058)
&CLK_TEST_MDSS_PCLK0_CLK=(&CLK_MMSS_TEST|0x016)
&CLK_TEST_MMSS_SPDM_PCLK0_CLK=(&CLK_MMSS_TEST|0x061)
&CLK_TEST_MDSS_PCLK1_CLK=(&CLK_MMSS_TEST|0x017)
&CLK_TEST_MMSS_SPDM_PCLK1_CLK=(&CLK_MMSS_TEST|0x05E)
&CLK_TEST_GPU_GX_RBBMTIMER_CLK=(&CLK_MMSS_TEST|0x03E)
&CLK_TEST_MMSS_RBCPR_CLK=(&CLK_MMSS_TEST|0x012)
&CLK_TEST_CAMSS_CSI_VFE0_CLK=(&CLK_MMSS_TEST|0x03F)
&CLK_TEST_CAMSS_VFE0_CLK=(&CLK_MMSS_TEST|0x038)
&CLK_TEST_CAMSS_VFE0_STREAM_CLK=(&CLK_MMSS_TEST|0x071)
&CLK_TEST_MMSS_SPDM_VFE0_CLK=(&CLK_MMSS_TEST|0x05B)
&CLK_TEST_CAMSS_CSI_VFE1_CLK=(&CLK_MMSS_TEST|0x040)
&CLK_TEST_CAMSS_VFE1_CLK=(&CLK_MMSS_TEST|0x039)
&CLK_TEST_CAMSS_VFE1_STREAM_CLK=(&CLK_MMSS_TEST|0x072)
&CLK_TEST_MMSS_SPDM_VFE1_CLK=(&CLK_MMSS_TEST|0x05C)
&CLK_TEST_MMSS_SPDM_VIDEO_CORE_CLK=(&CLK_MMSS_TEST|0x05A)
&CLK_TEST_VIDEO_CORE_CLK=(&CLK_MMSS_TEST|0x00E)
&CLK_TEST_VIDEO_SUBCORE0_CLK=(&CLK_MMSS_TEST|0x01A)
&CLK_TEST_VIDEO_SUBCORE1_CLK=(&CLK_MMSS_TEST|0x01B)
&CLK_TEST_MDSS_VSYNC_CLK=(&CLK_MMSS_TEST|0x01C)
&CLK_TEST_MMSS_MISC_CXO_CLK=(&CLK_MMSS_TEST|0x077)
&CLK_TEST_THROTTLE_CAMSS_CXO_CLK=(&CLK_MMSS_TEST|0x0A7)
&CLK_TEST_THROTTLE_MDSS_CXO_CLK=(&CLK_MMSS_TEST|0x0A8)
&CLK_TEST_THROTTLE_VIDEO_CXO_CLK=(&CLK_MMSS_TEST|0x0A9)
&CLK_TEST_MMPLL0_DTEST=(&CLK_MMSS_TEST|0x064)
&CLK_TEST_MMPLL0_ENABLE_STATUS=(&CLK_MMSS_TEST|0x07C)
&CLK_TEST_MMPLL0_LOCK_DET=(&CLK_MMSS_TEST|0x065)
&CLK_TEST_MMPLL1_DTEST=(&CLK_MMSS_TEST|0x066)
&CLK_TEST_MMPLL1_ENABLE_STATUS=(&CLK_MMSS_TEST|0x07D)
&CLK_TEST_MMPLL1_LOCK_DET=(&CLK_MMSS_TEST|0x067)
&CLK_TEST_MMPLL2_DTEST=(&CLK_MMSS_TEST|0x068)
&CLK_TEST_MMPLL2_ENABLE_STATUS=(&CLK_MMSS_TEST|0x07E)
&CLK_TEST_MMPLL2_LOCK_DET=(&CLK_MMSS_TEST|0x069)
&CLK_TEST_MMPLL3_DTEST=(&CLK_MMSS_TEST|0x06A)
&CLK_TEST_MMPLL3_ENABLE_STATUS=(&CLK_MMSS_TEST|0x07F)
&CLK_TEST_MMPLL3_LOCK_DET=(&CLK_MMSS_TEST|0x06B)
&CLK_TEST_MMPLL4_DTEST=(&CLK_MMSS_TEST|0x006)
&CLK_TEST_MMPLL4_ENABLE_STATUS=(&CLK_MMSS_TEST|0x080)
&CLK_TEST_MMPLL4_LOCK_DET=(&CLK_MMSS_TEST|0x007)
&CLK_TEST_MMPLL5_DTEST=(&CLK_MMSS_TEST|0x06C)
&CLK_TEST_MMPLL5_ENABLE_STATUS=(&CLK_MMSS_TEST|0x081)
&CLK_TEST_MMPLL5_LOCK_DET=(&CLK_MMSS_TEST|0x06D)
&CLK_TEST_MMPLL8_DTEST=(&CLK_MMSS_TEST|0x083)
&CLK_TEST_MMPLL8_ENABLE_STATUS=(&CLK_MMSS_TEST|0x085)
&CLK_TEST_MMPLL8_LOCK_DET=(&CLK_MMSS_TEST|0x084)
&CLK_TEST_MMPLL9_DTEST=(&CLK_MMSS_TEST|0x06E)
&CLK_TEST_MMPLL9_ENABLE_STATUS=(&CLK_MMSS_TEST|0x082)
&CLK_TEST_MMPLL9_LOCK_DET=(&CLK_MMSS_TEST|0x06F)

; MSS test clocks
&CLK_TEST_CLK_SRC_BIT_COXM_MND=(&CLK_MSS_TEST|0x041)
&CLK_TEST_CLK_BIT_COXM=(&CLK_MSS_TEST|0x043)
&CLK_TEST_CLK_SRC_BUS_MSS_CONFIG=(&CLK_MSS_TEST|0x100)
&CLK_TEST_CLK_BUS_CONFIG=(&CLK_MSS_TEST|0x049)
&CLK_TEST_CLK_BUS_COXM=(&CLK_MSS_TEST|0x04C)
&CLK_TEST_CLK_BUS_CRYPTO=(&CLK_MSS_TEST|0x04D)
&CLK_TEST_CLK_BUS_MGPI=(&CLK_MSS_TEST|0x04E)
&CLK_TEST_CLK_BUS_MVC=(&CLK_MSS_TEST|0x04F)
&CLK_TEST_CLK_BUS_NAV=(&CLK_MSS_TEST|0x2C0)
&CLK_TEST_CLK_BUS_PLL_OUTCTRL=(&CLK_MSS_TEST|0x04A)
&CLK_TEST_CLK_BUS_Q6=(&CLK_MSS_TEST|0x180)
&CLK_TEST_CLK_BUS_RBCPR=(&CLK_MSS_TEST|0x04B)
&CLK_TEST_CLK_BUS_RFC=(&CLK_MSS_TEST|0x077)
&CLK_TEST_CLK_BUS_SLAVE_TIMEOUT=(&CLK_MSS_TEST|0x052)
&CLK_TEST_CLK_BUS_STMR=(&CLK_MSS_TEST|0x051)
&CLK_TEST_CLK_BUS_UIM0=(&CLK_MSS_TEST|0x053)
&CLK_TEST_CLK_BUS_UIM1=(&CLK_MSS_TEST|0x054)
&CLK_TEST_CLK_BUS_UIM2=(&CLK_MSS_TEST|0x055)
&CLK_TEST_CLK_BUS_UIM3=(&CLK_MSS_TEST|0x056)
&CLK_TEST_MSS_DGR_AHB_CLK=(&CLK_MSS_TEST|0x380)
&CLK_TEST_CLK_XO=(&CLK_MSS_TEST|0x140)
&CLK_TEST_CLK_XO_MDM=(&CLK_MSS_TEST|0x240)
&CLK_TEST_CLK_XO_NAV=(&CLK_MSS_TEST|0x340)
&CLK_TEST_CLK_SRC_RBCPR_REF=(&CLK_MSS_TEST|0x042)
&CLK_TEST_CLK_RBCPR_REF=(&CLK_MSS_TEST|0x044)
&CLK_TEST_CLK_SRC_UIM=(&CLK_MSS_TEST|0x057)
&CLK_TEST_CLK_CARD_SRC_UIM0=(&CLK_MSS_TEST|0x05E)
&CLK_TEST_CLK_CARD_SRC_UIM1=(&CLK_MSS_TEST|0x05F)
&CLK_TEST_CLK_CARD_SRC_UIM2=(&CLK_MSS_TEST|0x061)
&CLK_TEST_CLK_CARD_SRC_UIM3=(&CLK_MSS_TEST|0x062)
&CLK_TEST_CLK_SRC_UIM0_MND=(&CLK_MSS_TEST|0x05A)
&CLK_TEST_CLK_UART_BIT_UIM0=(&CLK_MSS_TEST|0x063)
&CLK_TEST_CLK_SRC_UIM1_MND=(&CLK_MSS_TEST|0x05B)
&CLK_TEST_CLK_UART_BIT_UIM1=(&CLK_MSS_TEST|0x064)
&CLK_TEST_CLK_SRC_UIM2_MND=(&CLK_MSS_TEST|0x05C)
&CLK_TEST_CLK_UART_BIT_UIM2=(&CLK_MSS_TEST|0x065)
&CLK_TEST_CLK_SRC_UIM3_MND=(&CLK_MSS_TEST|0x05D)
&CLK_TEST_CLK_UART_BIT_UIM3=(&CLK_MSS_TEST|0x066)
&CLK_TEST_CLK_MDM=(&CLK_MSS_TEST|0x36)
&CLK_TEST_CLK_NAV_MAIN=(&CLK_MSS_TEST|&CLK_MSS_SUB_MUX_NAV|0x1)
&CLK_TEST_CLK_NAV_ADC1=(&CLK_MSS_TEST|&CLK_MSS_SUB_MUX_NAV|0x2)
&CLK_TEST_CLK_NAV_XO=(&CLK_MSS_TEST|&CLK_MSS_SUB_MUX_NAV|0x3)
&CLK_TEST_MSS_QDSP6SS_Q6_CORE_CLK=(&CLK_MSS_TEST|&CLK_MSS_SUB_MUX_Q6|0x1)
&CLK_TEST_MSS_QDSP6SS_AXI_M_CLK=(&CLK_MSS_TEST|&CLK_MSS_SUB_MUX_Q6|0x2)
&CLK_TEST_MSS_QDSP6SS_LDO_NMO_OUT=(&CLK_MSS_TEST|&CLK_MSS_SUB_MUX_Q6|0x3)
&CLK_TEST_MSS_QDSP6SS_AHB_M_CLK=(&CLK_MSS_TEST|&CLK_MSS_SUB_MUX_Q6|0x4)
&CLK_TEST_MSS_QDSP6SS_AHB_S_CLK=(&CLK_MSS_TEST|&CLK_MSS_SUB_MUX_Q6|0x5)
&CLK_TEST_MSS_QDSP6SS_XO_CLK=(&CLK_MSS_TEST|&CLK_MSS_SUB_MUX_Q6|0x6)
&CLK_TEST_MSS_QDSP6SS_SLEEP_CLK=(&CLK_MSS_TEST|&CLK_MSS_SUB_MUX_Q6|0x7)
&CLK_TEST_MSS_QDSP6SS_JTAG_TCK=(&CLK_MSS_TEST|&CLK_MSS_SUB_MUX_Q6|0x8)
&CLK_TEST_MSS_QDSP6SS_ATB_CLK=(&CLK_MSS_TEST|&CLK_MSS_SUB_MUX_Q6|0x9)
&CLK_TEST_MSS_QDSP6SS_APB_CLK=(&CLK_MSS_TEST|&CLK_MSS_SUB_MUX_Q6|0xA)
&CLK_TEST_MSS_QDSP6SS_TIMESTAMP_CLK=(&CLK_MSS_TEST|&CLK_MSS_SUB_MUX_Q6|0xB)
&CLK_TEST_CLK_AXI_CRYPTO=(&CLK_MSS_TEST|0x046)
&CLK_TEST_CLK_BUS_PSEUDO_HM_RCG=(&CLK_MSS_TEST|0x0C0)
&CLK_TEST_CLK_XO_CX=(&CLK_MSS_TEST|0x045)
&CLK_TEST_DBG_DTR_CLKSIG=(&CLK_MSS_TEST|0x067)
&CLK_TEST_DBG_MODEM_CLKSIG=(&CLK_MSS_TEST|0x06B)
&CLK_TEST_DBG_NAV_CLKSIG=(&CLK_MSS_TEST|0x06A)
&CLK_TEST_DBG_Q6_CLKSIG=(&CLK_MSS_TEST|0x069)
&CLK_TEST_DTR1_PLL_DTEST=(&CLK_MSS_TEST|0x06C)
&CLK_TEST_DTR1_PLL_LOCK_DET=(&CLK_MSS_TEST|0x072)
&CLK_TEST_DTR2_PLL_DTEST=(&CLK_MSS_TEST|0x06D)
&CLK_TEST_DTR2_PLL_LOCK_DET=(&CLK_MSS_TEST|0x073)
&CLK_TEST_MODEM_OFFLINE_PLL_DTEST=(&CLK_MSS_TEST|0x071)
&CLK_TEST_MSS_DGR_AXI_CLK=(&CLK_MSS_TEST|0x3C0)
&CLK_TEST_MSS_OFFLINE_PLL_LOCK_DET=(&CLK_MSS_TEST|0x076)
&CLK_TEST_NAV_PLL_DTEST=(&CLK_MSS_TEST|0x06F)
&CLK_TEST_NAV_PLL_LOCK_DET=(&CLK_MSS_TEST|0x075)
&CLK_TEST_Q6_PLL_DTEST=(&CLK_MSS_TEST|0x06E)
&CLK_TEST_Q6_PLL_LOCK_DET=(&CLK_MSS_TEST|0x074)

; SSC test clocks
&CLK_TEST_SCC_AHB_TIMEOUT_CLK=(&CLK_SSC_TEST|0x014)
&CLK_TEST_SCC_AT_CLK=(&CLK_SSC_TEST|0x017)
&CLK_TEST_SCC_BLSP_H_CLK=(&CLK_SSC_TEST|0x00E)
&CLK_TEST_SCC_CFG_AHB_CLK=(&CLK_SSC_TEST|0x012)
&CLK_TEST_SCC_CRIF_CLK=(&CLK_SSC_TEST|0x00C)
&CLK_TEST_SCC_CSR_H_CLK=(&CLK_SSC_TEST|0x00D)
&CLK_TEST_SCC_DATA_H_CLK=(&CLK_SSC_TEST|0x00F)
&CLK_TEST_SCC_DBG_TSCTR_CLK=(&CLK_SSC_TEST|0x00A)
&CLK_TEST_SCC_PCLKDBG_CLK=(&CLK_SSC_TEST|0x019)
&CLK_TEST_SCC_Q6_AHBM_CLK=(&CLK_SSC_TEST|0x010)
&CLK_TEST_SCC_Q6_AHBS_CLK=(&CLK_SSC_TEST|0x011)
&CLK_TEST_SCC_Q6_ATBM_CLK=(&CLK_SSC_TEST|0x018)
&CLK_TEST_SCC_Q6_SPM_CLK=(&CLK_SSC_TEST|0x00B)
&CLK_TEST_SCC_Q6_XPU2_CLIENT_CLK=(&CLK_SSC_TEST|0x015)
&CLK_TEST_SCC_Q6_XPU2_CONFIG_CLK=(&CLK_SSC_TEST|0x016)
&CLK_TEST_SCC_QUP_I2C1_CLK=(&CLK_SSC_TEST|0x002)
&CLK_TEST_SCC_QUP_I2C2_CLK=(&CLK_SSC_TEST|0x004)
&CLK_TEST_SCC_QUP_I2C3_CLK=(&CLK_SSC_TEST|0x006)
&CLK_TEST_SCC_QUP_SPI1_CLK=(&CLK_SSC_TEST|0x001)
&CLK_TEST_SCC_QUP_SPI2_CLK=(&CLK_SSC_TEST|0x003)
&CLK_TEST_SCC_QUP_SPI3_CLK=(&CLK_SSC_TEST|0x005)
&CLK_TEST_SCC_SMEM_CLK=(&CLK_SSC_TEST|0x013)
&CLK_TEST_SCC_UART_DM_UART1_CLK=(&CLK_SSC_TEST|0x007)
&CLK_TEST_SCC_UART_DM_UART2_CLK=(&CLK_SSC_TEST|0x008)
&CLK_TEST_SCC_UART_DM_UART3_CLK=(&CLK_SSC_TEST|0x009)
&CLK_TEST_SCC_VS_VDDCX_CLK=(&CLK_SSC_TEST|0x01B)
&CLK_TEST_SCC_VS_VDDMX_CLK=(&CLK_SSC_TEST|0x01A)
&CLK_TEST_SSC_QDSP6SS_Q6_CORE_CLK=(&CLK_SSC_TEST|&CLK_SSC_SUB_MUX_Q6|0x1)
&CLK_TEST_SSC_QDSP6SS_AXI_M_CLK=(&CLK_SSC_TEST|&CLK_SSC_SUB_MUX_Q6|0x2)
&CLK_TEST_SSC_QDSP6SS_LDO_NMO_OUT=(&CLK_SSC_TEST|&CLK_SSC_SUB_MUX_Q6|0x3)
&CLK_TEST_SSC_QDSP6SS_AHB_M_CLK=(&CLK_SSC_TEST|&CLK_SSC_SUB_MUX_Q6|0x4)
&CLK_TEST_SSC_QDSP6SS_AHB_S_CLK=(&CLK_SSC_TEST|&CLK_SSC_SUB_MUX_Q6|0x5)
&CLK_TEST_SSC_QDSP6SS_XO_CLK=(&CLK_SSC_TEST|&CLK_SSC_SUB_MUX_Q6|0x6)
&CLK_TEST_SSC_QDSP6SS_SLEEP_CLK=(&CLK_SSC_TEST|&CLK_SSC_SUB_MUX_Q6|0x7)
&CLK_TEST_SSC_QDSP6SS_JTAG_TCK=(&CLK_SSC_TEST|&CLK_SSC_SUB_MUX_Q6|0x8)
&CLK_TEST_SSC_QDSP6SS_ATB_CLK=(&CLK_SSC_TEST|&CLK_SSC_SUB_MUX_Q6|0x9)
&CLK_TEST_SSC_QDSP6SS_APB_CLK=(&CLK_SSC_TEST|&CLK_SSC_SUB_MUX_Q6|0xA)
&CLK_TEST_SSC_QDSP6SS_TIMESTAMP_CLK=(&CLK_SSC_TEST|&CLK_SSC_SUB_MUX_Q6|0xB)
&CLK_TEST_Q6_PLL_DTEST=(&CLK_SSC_TEST|0x01C)
&CLK_TEST_Q6_PLL_LOCK_DET=(&CLK_SSC_TEST|0x01D)
&CLK_TEST_Q6SS_DBG_CLK=(&CLK_SSC_TEST|0x01E)
&CLK_TEST_SCC_PEEL_PLL_LOCK_DET=(&CLK_SSC_TEST|0x01F)

;-----------------------------------------------------------------------------
; Define the window
;-----------------------------------------------------------------------------

&testclock_cmd_arg0=""
&testclock_cmd_arg1=""
&testclock_cmd_arg2=""
&testclock_cmd_arg3=""
&testclock_cmd_arg4=""

ENTRY &testclock_cmd_arg0 &testclock_cmd_arg1 &testclock_cmd_arg2 &testclock_cmd_arg3 &testclock_cmd_arg4

; Create a new area window if the script was not invoked in menu mode.
if ("&testclock_cmd_arg0"!="menu")
(
  AREA.RESet
  WINPOS 0. 0. 50% 100%
  AREA.Create CLOCK 120. 1000.
  AREA.view CLOCK
)

AREA.Select CLOCK
AREA.Clear CLOCK



;-----------------------------------------------------------------------------
; Print banner and go to main menu
;-----------------------------------------------------------------------------

print " "
print "[----------------------------------------------- Clock Test ----------------------------------------------]"
print " "

;-----------------------------------------------------------------------------
; Read input
;-----------------------------------------------------------------------------

ON ERROR gosub
(
  print "Error occurred processing &clk"
  return
)

&print_if_off=1
&print_menu=1

Main_Menu:
; Only print main menu when it isn't disabled
if (&print_menu!=0)
(
  print " "
  print "Clock (? for list): "
)
else
(
  ; re-enable the main menu after this choice is handled
  &print_menu=1
)

testclock_cmd_arg0:
  if ("&testclock_cmd_arg0"!="")&&(("&testclock_cmd_arg0"!="menu"))
  (
    &choice="&testclock_cmd_arg0"
    &testclock_cmd_arg0=""
    goto Handle_Choice
  )
  else if ("&testclock_cmd_arg0"=="menu")
  (
    goto Handle_Choice
  )
testclock_cmd_arg1:
  if ("&testclock_cmd_arg1"!="")
  (
    &choice="&testclock_cmd_arg1"
    &testclock_cmd_arg1=""
    goto Handle_Choice
  )
testclock_cmd_arg2:
  if ("&testclock_cmd_arg2"!="")
  (
    &choice="&testclock_cmd_arg2"
    &testclock_cmd_arg2=""
    goto Handle_Choice
  )
testclock_cmd_arg3:
  if ("&testclock_cmd_arg3"!="")
  (
    &choice="&testclock_cmd_arg3"
    &testclock_cmd_arg3=""
    goto Handle_Choice
  )
testclock_cmd_arg4:
  if ("&testclock_cmd_arg4"!="")
  (
    &choice="&testclock_cmd_arg4"
    &testclock_cmd_arg4=""
    goto Handle_Choice
  )



;-----------------------------------------------------------------------------
; Handle choice
;-----------------------------------------------------------------------------

Handle_Choice:

  if ("&choice"=="")
  (
    enter &choice
  )

  &header_printed=0
  &choice_handled=0
  &state_change=""
  &input_file_prompt=1

  ; Exit
  if "&choice"=="?"
  (
    gosub Help
    &choice_handled=1
    
    ; Disable the main menu when displaying the help window
    &print_menu=0
  )
  else if "&choice"=="x"
  (
    ; Close the window if the script was not invoked in menu mode.
    if "&testclock_cmd_arg0"=="menu"
    (
      enddo (0==0)
    )
    else
    (
      WINCLEAR TOP
      enddo (0==0)
    )
  )
  else if ("&choice"==".")||("&choice"=="")
  (
    if "&old_choice"==""
    (
      &old_choice="?"
      
      ; disable the main menu when displaying the help window
      &print_menu=0
    )
    &choice="&old_choice"
    gosub Handle_Choice
  )

  ;-----------------------------------------------------------------------------
  ; Check for enabling the clock test output on GPIOs
  ;-----------------------------------------------------------------------------

  if "&choice"=="gpio"
  (
    ; Configure HS GPIO
    ; data.set &access_mode:&HWIO_TLMM_GPIO_CFG0_ADDR %LONG 0x1D0
    ; print "GPIO 0 configured and output enabled"

    ; Enable the gcc_dbg_clk on PLLTEST.
    data.set &access_mode:&HWIO_GCC_PLLTEST_PAD_CFG_ADDR %LONG 0x1200
    print "PLLTEST_PAD configured for GCC debug clock output"

    &choice_handled=1
  )

  if ("&choice"=="on")||("&choice"=="off")||("&choice"=="set")
  (
    &state_change="&choice"
    &choice="&old_choice"
    
    ; do not prompt user for input file again for on/off choice
    if ("&choice"=="file")
    (
      &input_file_prompt=0
    )
  )

  ;-----------------------------------------------------------------------------
  ; Check for file input with a list of clocks
  ;-----------------------------------------------------------------------------

  if ("&choice"=="file")
  (
    if (&input_file_prompt==1)
    (
      print "Enter input file [c:\temp\testclock.txt]: "
      enter &input_file
      if "&input_file"==""
      (
        &input_file="c:\temp\testclock.txt"
      )
    )
    print "Operating on list of clocks from &input_file"
    OPEN #1 &input_file /Read
    READ #1 %line &input_line
    WHILE !EOF()
    (
      gosub Find_Print_Clock &input_line
      
      READ #1 %line &input_line
    )
    CLOSE #1
    
    &choice_handled=1
  )


  ;-----------------------------------------------------------------------------
  ; Check for dumping all or all/on clocks
  ;-----------------------------------------------------------------------------

  if ("&choice"=="all")||("&choice"=="all_on")||("&choice"=="all_off")
  (
    gosub Print_All
    &choice_handled=1
  )

  if (&choice_handled!=1)
  (
    gosub Print_All_SS
  )

  ;-----------------------------------------------------------------------------
  ; If nothing else, then assume it was a clock name
  ;-----------------------------------------------------------------------------

  if (&choice_handled!=1)
  (
    gosub Find_Print_Clock &choice
  )

  &old_choice="&choice"
  &choice=""
  goto Main_Menu




;-----------------------------------------------------------------------------
; Display help
;-----------------------------------------------------------------------------

Help:

  ;-----------------------------------------------------------------------------
  ; Display available clock sources that can be output to the clock test output
  ; and prompt for selection.
  ;-----------------------------------------------------------------------------

  AREA.Create HELP 130. 1000.
  AREA.View HELP
  AREA.Select HELP
  winresize 130. 24.

  print " "
  print " "
  gosub Print_Clock_Help
  print ""
  print "*** Clock groups***   "
  print "  all        - all clocks"
  print "  all_on     - all clocks that are on"
  print "  <ss>_all   - all subsystem clocks"
  print "  <wildcard> - search query"
  print "  file       - file specifying enumerated clocks (separated by newlines)"
  print "  on/off     - modifies on/off state of previously selected clock(s)"
  print "  set        - sets the clock to one of supported frequencies"
  print "  buses      - show all bus clocks"
  print "  cpus       - show all cpu clocks"
  
  print "*** Other options ***"
  print "  x   - exit"
  print "  ?   - help"
  print "  .   - repeat (also carriage return without any arguments)" 
  print "*** Debug options ***"
  print "   gpio       - enable GPIO's for clock output"
  print ""

  AREA.Select CLOCK

  return


;-----------------------------------------------------------------------------
; Determine clock frequency.
;-----------------------------------------------------------------------------

Calc_Clock_Freq:

  local &l2cpucpselr_val
  local &l2cpucpcpdr_val

  ; Disable auto-gating on L2 clock to get accurate frequency.
  ;if (cpu()=="KRAIT")&&(&clk_test==&CLK_TEST_APCS_L2_CLK)
  ;(
  ;  &l2cpucpselr_val=data.long(c15:0x360f)
  ;  data.set c15:0x360f %LONG 0x500
  ;  &l2cpucpcpdr_val=data.long(c15:0x370f)
  ;  data.set c15:0x370f %LONG (&l2cpucpcpdr_val|0xc00)
  ;)

  ; Set the divide by 4 in DEBUG_CLK_CTL
  &dbg_clk_ctl=data.long(&access_mode:&HWIO_GCC_GCC_DEBUG_CLK_CTL_ADDR)
  &dbg_clk_ctl=&dbg_clk_ctl|0x00003000
  data.set &access_mode:&HWIO_GCC_GCC_DEBUG_CLK_CTL_ADDR %LONG &dbg_clk_ctl

  ; Save current values
  &xo_div4_cbcr=data.long(&access_mode:&HWIO_GCC_GCC_XO_DIV4_CBCR_ADDR)
  
  ; Measure a short run
  &multiplier=4
  &tcxo_count=0x800
  
  ; Config XO DIV4 comparator clock
  data.set &access_mode:&HWIO_GCC_GCC_XO_DIV4_CBCR_ADDR %LONG data.long(&access_mode:&HWIO_GCC_GCC_XO_DIV4_CBCR_ADDR)|0x1
  
  ; Start with the counter disabled 
  &measure_ctl=data.long(&access_mode:&HWIO_GCC_CLOCK_FRQ_MEASURE_CTL_ADDR)
  &measure_ctl=&measure_ctl&~0x1FFFFF
  data.set &access_mode:&HWIO_GCC_CLOCK_FRQ_MEASURE_CTL_ADDR %LONG &measure_ctl
  
  ; Program the starting counter value, high enough to get good accuracy
  &measure_ctl=&measure_ctl|&tcxo_count
  
  ; Start the counting
  &measure_ctl=&measure_ctl|0x100000
  data.set &access_mode:&HWIO_GCC_CLOCK_FRQ_MEASURE_CTL_ADDR %LONG &measure_ctl
  
  ; Wait for the counters to finish
  wait 1.ms
  while (data.long(&access_mode:&HWIO_GCC_CLOCK_FRQ_MEASURE_STATUS_ADDR)&0x2000000)==0
  (
  )
  
  ; Turn off the test clock and read the clock count
  &measure_ctl=data.long(&access_mode:&HWIO_GCC_CLOCK_FRQ_MEASURE_CTL_ADDR)
  data.set &access_mode:&HWIO_GCC_CLOCK_FRQ_MEASURE_CTL_ADDR %LONG (&measure_ctl&~0x100000)
  
  &short_clock_count=data.long(&access_mode:&HWIO_GCC_CLOCK_FRQ_MEASURE_STATUS_ADDR)&0x1FFFFFF
  
  ; Restore the registers
  data.set &access_mode:&HWIO_GCC_GCC_XO_DIV4_CBCR_ADDR %LONG &xo_div4_cbcr
 
  ; Now do a longer count and compare
  ; Save current values
  &xo_div4_cbcr=data.long(&access_mode:&HWIO_GCC_GCC_XO_DIV4_CBCR_ADDR)
  
  &multiplier=4
  &tcxo_count=0x8000
  
  ; Config XO DIV4 comparator clock
  data.set &access_mode:&HWIO_GCC_GCC_XO_DIV4_CBCR_ADDR %LONG data.long(&access_mode:&HWIO_GCC_GCC_XO_DIV4_CBCR_ADDR)|0x1
  
  ; Start with the counter disabled 
  &measure_ctl=data.long(&access_mode:&HWIO_GCC_CLOCK_FRQ_MEASURE_CTL_ADDR)
  &measure_ctl=&measure_ctl&~0x1FFFFF
  data.set &access_mode:&HWIO_GCC_CLOCK_FRQ_MEASURE_CTL_ADDR %LONG &measure_ctl
  
  ; Program the starting counter value, high enough to get good accuracy
  &measure_ctl=&measure_ctl|&tcxo_count
  
  ; Start the counting
  &measure_ctl=&measure_ctl|0x100000
  data.set &access_mode:&HWIO_GCC_CLOCK_FRQ_MEASURE_CTL_ADDR %LONG &measure_ctl
  
  ; Wait for the counters to finish
  wait 1.ms
  while (data.long(&access_mode:&HWIO_GCC_CLOCK_FRQ_MEASURE_STATUS_ADDR)&0x2000000)==0
  (
  )
  
  ; Turn off the test clock and read the clock count
  &measure_ctl=data.long(&access_mode:&HWIO_GCC_CLOCK_FRQ_MEASURE_CTL_ADDR)
  data.set &access_mode:&HWIO_GCC_CLOCK_FRQ_MEASURE_CTL_ADDR %LONG (&measure_ctl&~0x100000)
  
  &clock_count=data.long(&access_mode:&HWIO_GCC_CLOCK_FRQ_MEASURE_STATUS_ADDR)&0x1FFFFFF
  
  ; Calculate the frequency.  Function is provided by
  ; Power Control 42.8.1.2 Measurement technique
  ; f ring = f tcxo/4 * (Nring + 1.5) / (TCtcxo + 3.5)
  ;
  ; The formula below is the equivalent one converted
  ; to integer arithmetic.
  ; 
  ; We add half of the denominator value to the dividend
  ; to guard against rounding errors inherent to
  ; integer arithmetic.
  ;
  
  if &clock_count==&short_clock_count
  (
    &clk_freq=0
  )
  else
  (
    &clk_freq=4.800*(&multiplier)*(&clock_count+1.5)/(&tcxo_count+3.5)
  )
  
  ; Restore the registers
  data.set &access_mode:&HWIO_GCC_GCC_XO_DIV4_CBCR_ADDR %LONG &xo_div4_cbcr
  
  ; Clear the divide by 4 in DEBUG_CLK_CTL to make the scope view of the clock
  ; the correct frequency
  &dbg_clk_ctl=data.long(&access_mode:&HWIO_GCC_GCC_DEBUG_CLK_CTL_ADDR)
  &dbg_clk_ctl=&dbg_clk_ctl&~0x00003000
  data.set &access_mode:&HWIO_GCC_GCC_DEBUG_CLK_CTL_ADDR %LONG &dbg_clk_ctl

  ; Restore the original auto-gating behavior.
  ;if (cpu()=="KRAIT")&&(&clk_test==&CLK_TEST_APCS_L2_CLK)
  ;(
  ;  data.set c15:0x370f %LONG &l2cpucpcpdr_val
  ;  data.set c15:0x360f %LONG &l2cpucpselr_val
  ;)

  return




PRINT_SET_CLOCK_FREQ_WARNING:

  print ""
  print "Warning: This feature is in beta and does not account for voltage requirements. Clock driver state will be out of sync."
  print ""

  return



;-----------------------------------------------------------------------------
; Set clock frequency.
;-----------------------------------------------------------------------------

Set_Clock_Freq:

  ; Use testpll.cmm to turn on required source
  do testpll.cmm on &clk_src_name

  ; Convert src divider to appropriate register value
  if (&clk_src_div!=0)
  (
    &clk_src_div=&clk_src_div-1
  )

  ; Read current cmd_rcgr and cfg_rcgr values
  &clk_cmd_rcgr_val=data.long(&access_mode:&clk_cmd_rcgr_addr)
  &clk_cfg_rcgr_val=data.long(&access_mode:&clk_cfg_rcgr_addr)

  ; Clear src_sel, src_div, and mode fields
  &clk_cfg_rcgr_val=&clk_cfg_rcgr_val&~(&HAL_CLK_CFG_CGR_SRC_SEL_FMSK|&HAL_CLK_CFG_CGR_SRC_DIV_FMSK|&HAL_CLK_CFG_CGR_MODE_FMSK)

  ; Program src_sel and src_div
  &clk_cfg_rcgr_val=&clk_cfg_rcgr_val|((&clk_src_sel<<&HAL_CLK_CFG_CGR_SRC_SEL_SHFT)&(&HAL_CLK_CFG_CGR_SRC_SEL_FMSK))
  &clk_cfg_rcgr_val=&clk_cfg_rcgr_val|((&clk_src_div<<&HAL_CLK_CFG_CGR_SRC_DIV_SHFT)&(&HAL_CLK_CFG_CGR_SRC_DIV_FMSK))

  ; Program M, N, D registers if necessary
  if (&clk_m_val!=0.)&&(&clk_m_val<&clk_n_val)
  (
    &clk_m_addr=&clk_cmd_rcgr_addr+&HAL_CLK_M_REG_OFFSET
    &clk_n_addr=&clk_cmd_rcgr_addr+&HAL_CLK_N_REG_OFFSET
    &clk_2d_addr=&clk_cmd_rcgr_addr+&HAL_CLK_D_REG_OFFSET

    ; Write to M register
    data.set &access_mode:&clk_m_addr %long &clk_m_val
    
    ; Write to N register
    data.set &access_mode:&clk_n_addr %long ~(&clk_n_val-&clk_m_val)
    
    ; Write to D register
    data.set &access_mode:&clk_2d_addr %long ~&clk_2d_val
    
    ; Dual edge mode
    &clk_cfg_rcgr_val=&clk_cfg_rcgr_val|((&HAL_CLK_CFG_CFG_DUAL_EDGE_MODE_VAL<<&HAL_CLK_CFG_CGR_MODE_SHFT)&(&HAL_CLK_CFG_CGR_MODE_FMSK))
  )
  
  ; Write to cfg_rcgr
  data.set &access_mode:&clk_cfg_rcgr_addr %long &clk_cfg_rcgr_val

  ; Write to cmd_rcgr to trigger update
  data.set &access_mode:&clk_cmd_rcgr_addr %long (&clk_cmd_rcgr_val|&HAL_CLK_CMD_CFG_UPDATE_FMSK)

  ; Wait for update to finish
  wait 1.ms
  while (data.long(&access_mode:&clk_cmd_rcgr_addr)&(&HAL_CLK_CMD_CFG_UPDATE_FMSK))!=0
  (
  )

  return




;-----------------------------------------------------------------------------
; Display clock info header
;-----------------------------------------------------------------------------

Print_Header:

  if &header_printed==0
  (
    print ""
    print "Clock                                      State      Frequency (MHz)         CBCR Addr : Value        CBCR Type "
    print "---------------------------------------------------------------------------------------------------------------- "

    &header_printed=1
  )

  return




;-----------------------------------------------------------------------------
; Display clock info line
;-----------------------------------------------------------------------------

Print_Clk_Info_Line:
  local &is_on &clk_freq &clk_reg_val &on_reg &on_mask

  ;-----------------------------------------------------------------------------
  ; Toggle clock state if requested
  ;-----------------------------------------------------------------------------
  if (&clk_reg!=0)
  (
    if &clk_vote_bit!=-1.
    (
      &vote_idx=&clk_vote_bit/32.
      &on_reg=v.value(\vote_regs[&vote_idx])
      &on_mask=(1<<(&clk_vote_bit-(32.*&vote_idx)))
    )
    else
    (
      &on_reg="&clk_reg"
      &on_mask=0x1
    )

    if "&state_change"=="on"
    (
      data.set &access_mode:&on_reg %LONG (data.long(&access_mode:&on_reg)|&on_mask)
    )
    else if "&state_change"=="off"
    (
      data.set &access_mode:&on_reg %LONG (data.long(&access_mode:&on_reg)&~(&on_mask))
    )
  )

  if "&state_change"=="set"
  (
    gosub Set_Clock_Freq_Enter
  )

  ;-----------------------------------------------------------------------------
  ; Print the clock header
  ;-----------------------------------------------------------------------------
  gosub Print_Header

  ;-----------------------------------------------------------------------------
  ; Test if clock is on
  ;-----------------------------------------------------------------------------
  
  if (&clk_reg!=0)
  (
    if (data.long(&access_mode:&clk_reg)&(0x80000000))==0x0
    (
      &clk_state="ON "
      &is_on=1
    )
    else
    (
      &clk_state="OFF"
      &is_on=0
    )
  )
  else
  (
    &clk_state=" ? " 
    &is_on=-1
  )
  
  ;-----------------------------------------------------------------------------
  ; Calculate the clock frequency based on the TCXO counter
  ;-----------------------------------------------------------------------------

  if (&clk_test!=0)&&((&is_on==1)||(&is_on==-1))
  (
    gosub Program_Clk_Test

    gosub Calc_Clock_Freq

    if (&clk_freq==0)
    (
      &clk_freq_str=FORMAT.DECIMAL(14., 0x0)
    )
    else
    (
      &clk_freq=&clk_freq*&clk_multiplier
      &clk_freq_str=FORMAT.FLOAT(12., 0x6, &clk_freq) 
    )

    if (&is_on==-1)
    (
      if (&clk_freq==0)
      (
        &is_on=0
      )
      else
      (
        &is_on=1
      )
    )
  )
  else if (&is_on==0)
  (
    &clk_freq_str=FORMAT.DECIMAL(14., 0x0)
  )
  else
  (
    &clk_freq_str="  Not Testable"
  )
  
  if ((("&choice"=="all_on")&&(&is_on==0))||(("&choice"=="all_off")&&(&is_on==1)))
  (
    return
  )

  if (&clk_reg!=0)
  (
    &clk_reg_val=FORMAT.HEX(0x8, data.long(&access_mode:&clk_reg))
    &clk_reg_val_str="0x&clk_reg_val"
    
    &clk_reg=FORMAT.HEX(0x8, &clk_reg)
    &clk_reg_str="0x&clk_reg"
  )
  else
  (
    &clk_reg_str="----------" 
    &clk_reg_val_str="----------"
  )

  ; Format clock name width

  &left_width="                                           "
  &padding=STRING.CUT("&left_width", STRING.LEN("&clk_name"))

  print "&clk_name&padding &clk_state       &clk_freq_str         &clk_reg_str : &clk_reg_val_str   &clk_reg_cbcr_type"

  return



;-----------------------------------------------------------------------------
; Program the clk_test register
;-----------------------------------------------------------------------------

Program_Clk_Test:

  &testval=&clk_test&(&CLK_TEST_TYPE_MASK)
  &selval=&clk_test&(&CLK_TEST_SEL_MASK)
  &submuxval=&clk_test&(&CLK_TEST_SUB_MUX_MASK)

  ; GCC
  if &selval==&CLK_GCC_TEST
  (

    ; Clear the debug field bits and set default register value
    &gcc_gcc_debug_clk_ctl_reg=&HWIO_GCC_GCC_DEBUG_CLK_CTL_ADDR
    &gcc_gcc_debug_clk_ctl_val=0x10000&~(0x3FF<<0x0)



    ; Program debug register to select test clock
    data.set &access_mode:&gcc_gcc_debug_clk_ctl_reg %long &gcc_gcc_debug_clk_ctl_val|(&testval&0x3FF)<<0x0

  )

  ; MSS
  else if &selval==&CLK_MSS_TEST
  (

    ; Default the top level GCC debug mux
    &gcc_gcc_debug_clk_ctl_reg=&HWIO_GCC_GCC_DEBUG_CLK_CTL_ADDR
    &gcc_gcc_debug_clk_ctl_val=0x10000&~(0x3FF<<0x0)

    ; Configure the top level GCC debug mux to select MSS
    data.set &access_mode:&gcc_gcc_debug_clk_ctl_reg %LONG &gcc_gcc_debug_clk_ctl_val|(0x32&0x3FF)

    ; Clear the debug field bits and set default register value
    &mss_debug_clock_ctl_reg=&HWIO_MSS_DEBUG_CLOCK_CTL_ADDR
    &mss_debug_clock_ctl_val=0x0&~(0x3FF<<0x0)


    if &submuxval==&CLK_MSS_SUB_MUX_Q6
    (
      ; Configure the MSS debug mux to select the Q6 submux
      data.set &access_mode:&mss_debug_clock_ctl_reg %long &mss_debug_clock_ctl_val|(0x39<<0x0)

      ; Default Q6 submux register
      &mss_qdsp6ss_test_clk_ctl_reg=&HWIO_MSS_QDSP6SS_TEST_CLK_CTL_ADDR
      &mss_qdsp6ss_test_clk_ctl_val=0x40&~(0x1F<<0x0)

      ; Configure Q6 submux to select test clock
      data.set &access_mode:&mss_qdsp6ss_test_clk_ctl_reg %long &mss_qdsp6ss_test_clk_ctl_val|(&testval&0x1F)<<0x0
    )

    else if &submuxval==&CLK_MSS_SUB_MUX_NAV
    (
      ; Configure the MSS debug mux to select the NAV submux
      data.set &access_mode:&mss_debug_clock_ctl_reg %long &mss_debug_clock_ctl_val|(0x37<<0x0)

      ; Default NAV submux register
      &mss_nav_clk_ctl_reg=&HWIO_MSS_NAV_CLK_CTL_ADDR
      &mss_nav_clk_ctl_val=0x0&~(0x3<<0xD)

      ; Configure NAV submux to select test clock
      data.set &access_mode:&mss_nav_clk_ctl_reg %long &mss_nav_clk_ctl_val|(&testval&0x3)<<0xD
    )

    ; No submuxes
    else
    (
      ; Program debug register to select test clock
      data.set &access_mode:&mss_debug_clock_ctl_reg %long &mss_debug_clock_ctl_val|(&testval&0x3FF)<<0x0
    )

  )

  ; MMSS
  else if &selval==&CLK_MMSS_TEST
  (

    ; Default the top level GCC debug mux
    &gcc_gcc_debug_clk_ctl_reg=&HWIO_GCC_GCC_DEBUG_CLK_CTL_ADDR
    &gcc_gcc_debug_clk_ctl_val=0x10000&~(0x3FF<<0x0)

    ; Configure the top level GCC debug mux to select MMSS
    data.set &access_mode:&gcc_gcc_debug_clk_ctl_reg %LONG &gcc_gcc_debug_clk_ctl_val|(0x1B&0x3FF)

    ; Clear the debug field bits and set default register value
    &mmss_mmss_debug_clk_ctl_reg=&HWIO_MMSS_MMSS_DEBUG_CLK_CTL_ADDR
    &mmss_mmss_debug_clk_ctl_val=0x50000&~(0xFFFF<<0x0)



    ; Program debug register to select test clock
    data.set &access_mode:&mmss_mmss_debug_clk_ctl_reg %long &mmss_mmss_debug_clk_ctl_val|(&testval&0xFFFF)<<0x0

  )

  ; APCS
  else if &selval==&CLK_APCS_TEST
  (

    ; Default the top level GCC debug mux
    &gcc_gcc_debug_clk_ctl_reg=&HWIO_GCC_GCC_DEBUG_CLK_CTL_ADDR
    &gcc_gcc_debug_clk_ctl_val=0x10000&~(0x3FF<<0x0)

    ; Configure the top level GCC debug mux to select APCS
    data.set &access_mode:&gcc_gcc_debug_clk_ctl_reg %LONG &gcc_gcc_debug_clk_ctl_val|(0xBB&0x3FF)

    ; Clear the debug field bits and set default register value
    &apcs_clk_diag_reg=&HWIO_APCS_CLK_DIAG_ADDR
    &apcs_clk_diag_val=0x0&~(0x37<<0x8)

    data.set &access_mode:0x6480048 %long 0xF00 ; APC1_QLL_CLKDIAG
    data.set &access_mode:0x6400048 %long 0xF00 ; APC0_QLL_CLKDIAG


    ; Program debug register to select test clock
    data.set &access_mode:&apcs_clk_diag_reg %long &apcs_clk_diag_val|(&testval&0x37)<<0x8

  )

  ; LPASS
  else if &selval==&CLK_LPASS_TEST
  (

    ; Default the top level GCC debug mux
    &gcc_gcc_debug_clk_ctl_reg=&HWIO_GCC_GCC_DEBUG_CLK_CTL_ADDR
    &gcc_gcc_debug_clk_ctl_val=0x10000&~(0x3FF<<0x0)

    ; Configure the top level GCC debug mux to select LPASS
    data.set &access_mode:&gcc_gcc_debug_clk_ctl_reg %LONG &gcc_gcc_debug_clk_ctl_val|(0xB6&0x3FF)

    ; Clear the debug field bits and set default register value
    &lpass_dbg_clk_reg=&HWIO_LPASS_DBG_CLK_ADDR
    &lpass_dbg_clk_val=0x100000&~(0xFFFF<<0x0)


    if &submuxval==&CLK_LPASS_SUB_MUX_Q6
    (
      ; Configure the LPASS debug mux to select the Q6 submux
      data.set &access_mode:&lpass_dbg_clk_reg %long &lpass_dbg_clk_val|(0x1<<0x0)

      ; Default Q6 submux register
      &lpass_qdsp6ss_test_clk_ctl_reg=&HWIO_LPASS_QDSP6SS_TEST_CLK_CTL_ADDR
      &lpass_qdsp6ss_test_clk_ctl_val=0x40&~(0x1F<<0x0)

      ; Configure Q6 submux to select test clock
      data.set &access_mode:&lpass_qdsp6ss_test_clk_ctl_reg %long &lpass_qdsp6ss_test_clk_ctl_val|(&testval&0x1F)<<0x0
    )

    ; No submuxes
    else
    (
      ; Program debug register to select test clock
      data.set &access_mode:&lpass_dbg_clk_reg %long &lpass_dbg_clk_val|(&testval&0xFFFF)<<0x0
    )

  )

  ; SSC
  else if &selval==&CLK_SSC_TEST
  (

    ; Default the top level GCC debug mux
    &gcc_gcc_debug_clk_ctl_reg=&HWIO_GCC_GCC_DEBUG_CLK_CTL_ADDR
    &gcc_gcc_debug_clk_ctl_val=0x10000&~(0x3FF<<0x0)

    ; Configure the top level GCC debug mux to select SSC
    data.set &access_mode:&gcc_gcc_debug_clk_ctl_reg %LONG &gcc_gcc_debug_clk_ctl_val|(0x111&0x3FF)

    ; Clear the debug field bits and set default register value
    &ssc_scc_scc_debug_clk_ctl_reg=&HWIO_SSC_SCC_SCC_DEBUG_CLK_CTL_ADDR
    &ssc_scc_scc_debug_clk_ctl_val=0x1&~(0x3F<<0x1)


    if &submuxval==&CLK_SSC_SUB_MUX_Q6
    (
      ; Configure the SSC debug mux to select the Q6 submux
      data.set &access_mode:&ssc_scc_scc_debug_clk_ctl_reg %long &ssc_scc_scc_debug_clk_ctl_val|(0x1E<<0x1)

      ; Default Q6 submux register
      &ssc_qdsp6ss_test_clk_ctl_reg=&HWIO_SSC_QDSP6SS_TEST_CLK_CTL_ADDR
      &ssc_qdsp6ss_test_clk_ctl_val=0x40&~(0x1F<<0x0)

      ; Configure Q6 submux to select test clock
      data.set &access_mode:&ssc_qdsp6ss_test_clk_ctl_reg %long &ssc_qdsp6ss_test_clk_ctl_val|(&testval&0x1F)<<0x0
    )

    ; No submuxes
    else
    (
      ; Program debug register to select test clock
      data.set &access_mode:&ssc_scc_scc_debug_clk_ctl_reg %long &ssc_scc_scc_debug_clk_ctl_val|(&testval&0x3F)<<0x1
    )

  )
 
  return
  


Print_Clock_Help:


  print ""
  print "*****************************************************  APCS  ******************************************************"

  print ""
  print "[ APCS ]" 
  print " im_cbfcdiv_clk                     apc0_leaf_clk                      apc1_leaf_clk                       " 
  print " sys_apcsqsbslv_clk                 sys_apcsqsbmstr_clk                sys_apcsahb_clk                     " 
  print " atb_apcs_clk                       apb_apcsdbg_clk                    im_refroot_clk                      " 
  print " im_ref_clk                         im_sleep_clk                        " 
  print ""
  print "[ EXT ]" 

  print ""
  print "*****************************************************  GCC   ******************************************************"

  print ""
  print "[ AGGRE0_NOC ]" 
  print "  " 
  print ""
  print "[ AGGRE1_NOC ]" 
  print "  " 
  print ""
  print "[ AGGRE2_NOC ]" 
  print "  " 
  print ""
  print "[ BIMC ]" 
  print " gcc_bimc_clk                       gcc_spdm_bimc_cy_clk               gcc_bimc_xo_clk                     " 
  print " gcc_cfg_noc_ddr_cfg_clk            gcc_cnoc_bus_timeout5_ahb_clk      gcc_ddr_dim_cfg_clk                 " 
  print " gcc_bimc_dtts_xo_clk                " 
  print ""
  print "[ BLSP1 ]" 
  print " gcc_blsp1_uart1_sim_clk            gcc_blsp1_uart2_sim_clk            gcc_blsp1_uart3_sim_clk             " 
  print " gcc_blsp1_uart4_sim_clk            gcc_blsp1_uart5_sim_clk            gcc_blsp1_uart6_sim_clk             " 
  print " gcc_blsp2_uart1_sim_clk            gcc_blsp2_uart2_sim_clk            gcc_blsp2_uart3_sim_clk             " 
  print " gcc_blsp2_uart4_sim_clk            gcc_blsp2_uart5_sim_clk            gcc_blsp2_uart6_sim_clk             " 
  print ""
  print "[ BLSP1_QUP1 ]" 
  print " gcc_blsp1_qup1_i2c_apps_clk        gcc_blsp1_qup1_spi_apps_clk         " 
  print ""
  print "[ BLSP1_QUP2 ]" 
  print " gcc_blsp1_qup2_i2c_apps_clk        gcc_blsp1_qup2_spi_apps_clk         " 
  print ""
  print "[ BLSP1_QUP3 ]" 
  print " gcc_blsp1_qup3_i2c_apps_clk        gcc_blsp1_qup3_spi_apps_clk         " 
  print ""
  print "[ BLSP1_QUP4 ]" 
  print " gcc_blsp1_qup4_i2c_apps_clk        gcc_blsp1_qup4_spi_apps_clk         " 
  print ""
  print "[ BLSP1_QUP5 ]" 
  print " gcc_blsp1_qup5_i2c_apps_clk        gcc_blsp1_qup5_spi_apps_clk         " 
  print ""
  print "[ BLSP1_QUP6 ]" 
  print " gcc_blsp1_qup6_i2c_apps_clk        gcc_blsp1_qup6_spi_apps_clk         " 
  print ""
  print "[ BLSP1_UART1 ]" 
  print " gcc_blsp1_uart1_apps_clk            " 
  print ""
  print "[ BLSP1_UART2 ]" 
  print " gcc_blsp1_uart2_apps_clk            " 
  print ""
  print "[ BLSP1_UART3 ]" 
  print " gcc_blsp1_uart3_apps_clk            " 
  print ""
  print "[ BLSP1_UART4 ]" 
  print " gcc_blsp1_uart4_apps_clk            " 
  print ""
  print "[ BLSP1_UART5 ]" 
  print " gcc_blsp1_uart5_apps_clk            " 
  print ""
  print "[ BLSP1_UART6 ]" 
  print " gcc_blsp1_uart6_apps_clk            " 
  print ""
  print "[ BLSP2_QUP1 ]" 
  print " gcc_blsp2_qup1_i2c_apps_clk        gcc_blsp2_qup1_spi_apps_clk         " 
  print ""
  print "[ BLSP2_QUP2 ]" 
  print " gcc_blsp2_qup2_i2c_apps_clk        gcc_blsp2_qup2_spi_apps_clk         " 
  print ""
  print "[ BLSP2_QUP3 ]" 
  print " gcc_blsp2_qup3_i2c_apps_clk        gcc_blsp2_qup3_spi_apps_clk         " 
  print ""
  print "[ BLSP2_QUP4 ]" 
  print " gcc_blsp2_qup4_i2c_apps_clk        gcc_blsp2_qup4_spi_apps_clk         " 
  print ""
  print "[ BLSP2_QUP5 ]" 
  print " gcc_blsp2_qup5_i2c_apps_clk        gcc_blsp2_qup5_spi_apps_clk         " 
  print ""
  print "[ BLSP2_QUP6 ]" 
  print " gcc_blsp2_qup6_i2c_apps_clk        gcc_blsp2_qup6_spi_apps_clk         " 
  print ""
  print "[ BLSP2_UART1 ]" 
  print " gcc_blsp2_uart1_apps_clk            " 
  print ""
  print "[ BLSP2_UART2 ]" 
  print " gcc_blsp2_uart2_apps_clk            " 
  print ""
  print "[ BLSP2_UART3 ]" 
  print " gcc_blsp2_uart3_apps_clk            " 
  print ""
  print "[ BLSP2_UART4 ]" 
  print " gcc_blsp2_uart4_apps_clk            " 
  print ""
  print "[ BLSP2_UART5 ]" 
  print " gcc_blsp2_uart5_apps_clk            " 
  print ""
  print "[ BLSP2_UART6 ]" 
  print " gcc_blsp2_uart6_apps_clk            " 
  print ""
  print "[ CE1 ]" 
  print " gcc_ce1_clk                         " 
  print ""
  print "[ CONFIG_NOC ]" 
  print " gcc_aggre0_cnoc_ahb_clk            gcc_aggre0_noc_mpu_cfg_ahb_clk     gcc_aggre1_cnoc_ahb_clk             " 
  print " gcc_aggre1_noc_mpu_cfg_ahb_clk     gcc_aggre2_cnoc_ahb_clk            gcc_aggre2_noc_mpu_cfg_ahb_clk      " 
  print " gcc_ahb_clk                        gcc_bimc_cfg_ahb_clk               gcc_bimc_nius_cfg_ahb_clk           " 
  print " gcc_boot_rom_ahb_clk               gcc_ce1_ahb_clk                    gcc_cfg_noc_ahb_clk                 " 
  print " gcc_cnoc_bus_timeout0_ahb_clk      gcc_cnoc_bus_timeout1_ahb_clk      gcc_cnoc_bus_timeout2_ahb_clk       " 
  print " gcc_cnoc_bus_timeout3_ahb_clk      gcc_cnoc_bus_timeout4_ahb_clk      gcc_cnoc_bus_timeout6_ahb_clk       " 
  print " gcc_cnoc_bus_timeout7_ahb_clk      gcc_cnoc_bus_timeout8_ahb_clk      gcc_cnoc_bus_timeout9_ahb_clk       " 
  print " gcc_cnoc_mst_rpm_ahb_clk           gcc_dcc_ahb_clk                    gcc_imem_cfg_ahb_clk                " 
  print " gcc_lpass_core_smmu_ahb_clk        gcc_lpass_q6_smmu_ahb_clk          gcc_lpass_smmu_aon_ahb_clk          " 
  print " gcc_mmss_noc_cfg_ahb_clk           gcc_mpm_ahb_clk                    gcc_msg_ram_ahb_clk                 " 
  print " gcc_noc_conf_xpu_ahb_clk           gcc_pcie_0_cfg_ahb_clk             gcc_pcie_1_cfg_ahb_clk              " 
  print " gcc_pcie_2_cfg_ahb_clk             gcc_pcie_phy_cfg_ahb_clk           gcc_periph_noc_cfg_ahb_clk          " 
  print " gcc_pimem_ahb_clk                  gcc_prng_ahb_clk                   gcc_qdss_cfg_ahb_clk                " 
  print " gcc_qdss_dap_ahb_clk               gcc_qdss_mpu_ahb_clk               gcc_rbcpr_cx_ahb_clk                " 
  print " gcc_rbcpr_mx_ahb_clk               gcc_rbcpr_xpu_ahb_clk              gcc_rpm_mst_m2_cnoc_ahb_clk         " 
  print " gcc_sec_ctrl_ahb_clk               gcc_sec_ctrl_boot_rom_patch_clk    gcc_smmu_aggre0_ahb_clk             " 
  print " gcc_smmu_aggre1_ahb_clk            gcc_smmu_aggre2_ahb_clk            gcc_snoc_cnoc_ahb_clk               " 
  print " gcc_spdm_cfg_ahb_clk               gcc_spdm_mstr_ahb_clk              gcc_spmi_cnoc_ahb_clk               " 
  print " gcc_ssc_cnoc_ahbs_clk              gcc_ssc_cnoc_mpu_clk               gcc_tcsr_ahb_clk                    " 
  print " gcc_tlmm_ahb_clk                   gcc_tlmm_clk                       gcc_ufs_ahb_clk                     " 
  print " gcc_aggre1_noc_msmpu_cfg_ahb_clk   gcc_aggre2_noc_msmpu_cfg_ahb_clk   gcc_ipa_ahb_clk                     " 
  print " gcc_mss_cfg_ahb_clk                gcc_mss_msmpu_cfg_ahb_clk          gcc_mss_q6_cfg_ahb_clk              " 
  print " gcc_mss_q6_msmpu_cfg_ahb_clk       gcc_skl_ahb_clk                     " 
  print ""
  print "[ DDR_DIM_WRAPPER ]" 
  print " gcc_bimc_ddr_ch0_clk               gcc_bimc_ddr_ch1_clk               gcc_bimc_ddr_cpll0_clk              " 
  print " gcc_bimc_ddr_cpll1_clk              " 
  print ""
  print "[ DEBUG ]" 
  print " gcc_spdm_debug_cy_clk               " 
  print ""
  print "[ EXTERNAL RAW CLOCKS ]" 
  print " gcc_cfg_noc_tic_clk                gcc_tic_clk                         " 
  print ""
  print "[ GCC ]" 
  print " gcc_bimc_sleep_clk                 gcc_blsp1_sleep_clk                gcc_blsp2_sleep_clk                 " 
  print " gcc_ddr_dim_sleep_clk              gcc_im_sleep_clk                   gcc_rpm_sleep_clk                   " 
  print " gcc_tsif_inactivity_timers_clk     gcc_usb20_sleep_clk                gcc_usb30_sleep_clk                 " 
  print " gcc_ipa_sleep_clk                  gcc_dcd_xo_clk                     gcc_pdm_xo4_clk                     " 
  print " gcc_rpm_timer_clk                  gcc_spdm_ff_clk                    gcc_ssc_xo_clk                      " 
  print " gcc_xo_clk                         gcc_xo_div4_clk                    gcc_qrefs_vbg_cal_clk               " 
  print ""
  print "[ GP1 ]" 
  print " gcc_gp1_clk                         " 
  print ""
  print "[ GP2 ]" 
  print " gcc_gp2_clk                         " 
  print ""
  print "[ GP3 ]" 
  print " gcc_gp3_clk                         " 
  print ""
  print "[ HMSS ]" 
  print " gcc_bimc_hmss_axi_clk              gcc_hmss_mstr_axi_clk              gcc_hmss_slv_axi_clk                " 
  print " gcc_hmss_ahb_clk                   gcc_snoc_bus_timeout0_ahb_clk      gcc_sys_noc_hmss_ahb_clk            " 
  print " gcc_hmss_rbcpr_clk                  " 
  print ""
  print "[ IPA ]" 
  print " gcc_aggre2_noc_ipa_clk             gcc_ipa_clk                         " 
  print ""
  print "[ MMSS ]" 
  print " gcc_bimc_gfx_clk                   gcc_mmss_bimc_gfx_clk               " 
  print ""
  print "[ MSS ]" 
  print " gcc_mss_q6_bimc_axi_clk            gcc_mss_q6_msmpu_client_axi_clk    gcc_mss_q6_smmu_clk                 " 
  print ""
  print "[ MSS_Q6 ]" 
  print "  " 
  print ""
  print "[ OBT_ODT ]" 
  print " gcc_obt_odt_clk                     " 
  print ""
  print "[ PCIE_0 ]" 
  print " gcc_pcie_0_pipe_clk                gcc_pcie_0_aux_clk                 gcc_pcie_1_aux_clk                  " 
  print " gcc_pcie_2_aux_clk                 gcc_pcie_phy_aux_clk                " 
  print ""
  print "[ PCIE_1 ]" 
  print " gcc_pcie_1_pipe_clk                 " 
  print ""
  print "[ PCIE_2 ]" 
  print " gcc_pcie_2_pipe_clk                 " 
  print ""
  print "[ PDM ]" 
  print " gcc_pdm2_clk                        " 
  print ""
  print "[ PERIPH_NOC ]" 
  print " gcc_aggre1_pnoc_ahb_clk            gcc_blsp1_ahb_clk                  gcc_blsp2_ahb_clk                   " 
  print " gcc_pdm_ahb_clk                    gcc_periph_noc_ahb_clk             gcc_periph_noc_mpu_cfg_ahb_clk      " 
  print " gcc_pnoc_bus_timeout1_ahb_clk      gcc_pnoc_bus_timeout2_ahb_clk      gcc_pnoc_bus_timeout3_ahb_clk       " 
  print " gcc_pnoc_bus_timeout4_ahb_clk      gcc_sdcc1_ahb_clk                  gcc_sdcc2_ahb_clk                   " 
  print " gcc_sdcc3_ahb_clk                  gcc_sdcc4_ahb_clk                  gcc_snoc_pnoc_ahb_clk               " 
  print " gcc_spdm_pnoc_cy_clk               gcc_tsif_ahb_clk                   gcc_usb_phy_cfg_ahb2phy_clk         " 
  print " gcc_qspi_ahb_clk                    " 
  print ""
  print "[ PIMEM ]" 
  print " gcc_bimc_pimem_axi_clk             gcc_pimem_axi_clk                  gcc_sys_noc_pimem_axi_clk           " 
  print ""
  print "[ QDSS ]" 
  print " gcc_aggre0_noc_at_clk              gcc_aggre1_noc_at_clk              gcc_aggre2_noc_at_clk               " 
  print " gcc_mmss_noc_at_clk                gcc_periph_noc_at_clk              gcc_qdss_at_clk                     " 
  print " gcc_ssc_at_clk                     gcc_sys_noc_at_clk                 gcc_qdss_stm_clk                    " 
  print " gcc_sys_noc_qdss_stm_axi_clk       gcc_qdss_traceclkin_clk            gcc_qdss_apb2jtag_clk               " 
  print " gcc_qdss_dap_clk                   gcc_qdss_tsctr_div16_clk           gcc_qdss_tsctr_div2_clk             " 
  print " gcc_qdss_tsctr_div3_clk            gcc_qdss_tsctr_div4_clk            gcc_qdss_tsctr_div8_clk             " 
  print " gcc_ssc_apb_clk                     " 
  print ""
  print "[ QSPI ]" 
  print " gcc_qspi_ser_clk                    " 
  print ""
  print "[ RBCPR_CX ]" 
  print " gcc_rbcpr_cx_clk                    " 
  print ""
  print "[ RBCPR_MX ]" 
  print " gcc_rbcpr_mx_clk                    " 
  print ""
  print "[ RPM ]" 
  print " gcc_rpm_bus_ahb_clk                gcc_rpm_proc_fclk                  gcc_rpm_proc_hclk                   " 
  print " gcc_spdm_rpm_cy_clk                 " 
  print ""
  print "[ SDCC1 ]" 
  print " gcc_sdcc1_apps_clk                 gcc_sdcc1_ice_core_clk              " 
  print ""
  print "[ SDCC2 ]" 
  print " gcc_sdcc2_apps_clk                  " 
  print ""
  print "[ SDCC3 ]" 
  print " gcc_sdcc3_apps_clk                  " 
  print ""
  print "[ SDCC4 ]" 
  print " gcc_sdcc4_apps_clk                  " 
  print ""
  print "[ SEC_CTRL ]" 
  print " gcc_sec_ctrl_acc_clk               gcc_sec_ctrl_clk                   gcc_sec_ctrl_sense_clk              " 
  print ""
  print "[ SPMI ]" 
  print " gcc_spmi_ahb_clk                   gcc_spmi_ser_clk                    " 
  print ""
  print "[ SYSTEM_NOC ]" 
  print " gcc_bimc_nius_hs_axi_clk           gcc_bimc_sysnoc_hs_axi_clk         gcc_lpass_q6_axi_clk                " 
  print " gcc_lpass_q6_smmu_axi_clk          gcc_sys_noc_hs_axi_clk             gcc_mss_mnoc_bimc_axi_clk           " 
  print " gcc_mss_msmpu_client_axi_clk       gcc_aggre0_snoc_axi_clk            gcc_aggre1_snoc_axi_clk             " 
  print " gcc_aggre2_snoc_axi_clk            gcc_bimc_nius_axi_clk              gcc_bimc_sysnoc_axi_clk             " 
  print " gcc_ce1_axi_clk                    gcc_imem_axi_clk                   gcc_lpass_sway_clk                  " 
  print " gcc_mmss_sys_noc_axi_clk           gcc_pcie_0_mstr_axi_clk            gcc_pcie_0_slv_axi_clk              " 
  print " gcc_pcie_1_mstr_axi_clk            gcc_pcie_1_slv_axi_clk             gcc_pcie_2_mstr_axi_clk             " 
  print " gcc_pcie_2_slv_axi_clk             gcc_qdss_etr_usb_clk               gcc_smmu_aggre0_axi_clk             " 
  print " gcc_smmu_aggre1_axi_clk            gcc_smmu_aggre2_axi_clk            gcc_snoc_bus_timeout1_ahb_clk       " 
  print " gcc_snoc_bus_timeout3_ahb_clk      gcc_spdm_snoc_cy_clk               gcc_ssc_snoc_ahbm_clk               " 
  print " gcc_sys_noc_axi_clk                gcc_sys_noc_ssc_q6_axi_clk         gcc_aggre1_snoc_msmpu_client_axi_clk " 
  print " gcc_aggre2_snoc_msmpu_client_axi_clkgcc_mss_snoc_axi_clk                " 
  print ""
  print "[ TSIF ]" 
  print " gcc_tsif_ref_clk                    " 
  print ""
  print "[ UFS ]" 
  print " gcc_aggre2_ufs_axi_clk             gcc_sys_noc_ufs_axi_clk            gcc_ufs_axi_clk                     " 
  print " gcc_ufs_rx_cfg_clk                 gcc_ufs_tx_cfg_clk                 gcc_ufs_ice_core_clk                " 
  print " gcc_ufs_unipro_core_clk            gcc_ufs_rx_symbol_0_clk            gcc_ufs_rx_symbol_1_clk             " 
  print " gcc_ufs_tx_symbol_0_clk             " 
  print ""
  print "[ USB_20 ]" 
  print " gcc_periph_noc_usb20_ahb_clk       gcc_pnoc_bus_timeout0_ahb_clk      gcc_usb20_master_clk                " 
  print " gcc_usb20_mock_utmi_clk             " 
  print ""
  print "[ USB_30 ]" 
  print " gcc_aggre2_usb3_axi_clk            gcc_snoc_bus_timeout2_ahb_clk      gcc_sys_noc_usb3_axi_clk            " 
  print " gcc_usb30_master_clk               gcc_usb30_mock_utmi_clk            gcc_usb3_phy_aux_clk                " 
  print " gcc_usb3_phy_pipe_clk               " 
  print ""
  print "[ VS ]" 
  print " gcc_mss_vs_clk                     gcc_vdda_vs_clk                    gcc_vddcx_vs_clk                    " 
  print " gcc_vddmx_vs_clk                   gcc_vs_ctrl_clk                     " 
  print ""
  print "[ EXT ]" 
  print " gcc_aggre0_noc_qosgen_extref       gcc_aggre1_noc_qosgen_extref       gcc_aggre2_noc_qosgen_extref        " 
  print " gcc_cnoc_bus_timeout_extref        gcc_snoc_bus_timeout_extref        gcc_snoc_qosgen_extref              " 
  print " gpll0_dtest                        gpll0_lock_det                     gpll1_dtest                         " 
  print " gpll1_lock_det                     gpll2_dtest                        gpll2_lock_det                      " 
  print " gpll3_dtest                        gpll3_lock_det                     gpll4_dtest                         " 
  print " gpll4_lock_det                     hmss_gcc_dbg_clk                   lpass_gcc_dbg_clk                   " 
  print " mmss_gcc_dbg_clk                   mpm_gcc_temp0_sensor_ringosc_clk   mpm_gcc_temp1_sensor_ringosc_clk    " 
  print " mpm_gcc_temp_sensor_ringosc_clk    mss_gcc_dbg_clk                    qusb2phy_gcc_clk_test_prim          " 
  print " qusb2phy_gcc_clk_test_sec          qusb2phy_prim_gcc_usb30_utmi_clk   qusb2phy_sec_gcc_usb20s_utmi_clk    " 
  print " ssc_gcc_dbg_clk                    ufs_rx_symbol_0_clk                ufs_rx_symbol_1_clk                 " 
  print " ufs_tx_symbol_0_clk                usb3_phy_wrapper_gcc_usb3_pipe_clk  " 

  print ""
  print "***************************************************** LPASS  ******************************************************"

  print ""
  print "[ AON BUS ]" 
  print " aon_clk_src                        audio_core_qdsp_sway_aon_clk       audio_wrapper_aon_clk               " 
  print " audio_wrapper_bus_timeout_aon_clk  audio_wrapper_mpu_cfg_aon_clk      audio_wrapper_q6_ahbm_mpu_aon_clk   " 
  print " audio_wrapper_qos_ahbs_aon_clk     audio_wrapper_sysnoc_sway_aon_clk  q6ss_ahbm_aon_clk                   " 
  print " q6ss_ahbs_aon_clk                   " 
  print ""
  print "[ ATIME ]" 
  print " atime_clk_src                      lpass_core_avsync_atime_clk         " 
  print ""
  print "[ AUD SLIMBUS ]" 
  print " aud_slimbus_clk_src                audio_core_aud_slimbus_clk          " 
  print ""
  print "[ AUDIO_CORE ]" 
  print "  " 
  print ""
  print "[ AUDIO_CORE_LPAIF_PCM_DATA_OE ]" 
  print " lpaif_pcmoe_clk_src                audio_core_lpaif_pcm_data_oe_clk    " 
  print ""
  print "[ AXI ]" 
  print " audio_wrapper_q6_smmu_axi_clk      q6ss_q6_axim_clk                    " 
  print ""
  print "[ CAMSS_STREAMING_0 ]" 
  print " q6ss_q6_camss_dsp_streaming_0_clk   " 
  print ""
  print "[ CAMSS_STREAMING_1 ]" 
  print " q6ss_q6_camss_dsp_streaming_1_clk   " 
  print ""
  print "[ CNOC ]" 
  print " audio_core_peripheral_smmu_cfg_cnoc_clkaudio_wrapper_q6_smmu_cfg_cnoc_clk  " 
  print ""
  print "[ CORE BUS ]" 
  print " core_clk_src                       audio_core_aud_slimbus_core_clk    audio_core_core_clk                 " 
  print " audio_core_lpm_core_clk            audio_core_peripheral_smmu_client_core_clkaudio_core_qca_slimbus_core_clk     " 
  print " audio_core_sysnoc_mport_core_clk   audio_core_bus_timeout_core_clk     " 
  print ""
  print "[ CXO ]" 
  print " xo_clk_src                         audio_core_avsync_stc_xo_clk       audio_core_gdsc_xo_clk              " 
  print " audio_wrapper_q6_smmu_gdsc_xo_clk  audio_wrapper_qos_xo_lat_counter_clkq6ss_xo_clk                         " 
  print ""
  print "[ DEBUG CLOCK MUX ]" 
  print "  " 
  print ""
  print "[ EXT MCLK0 ]" 
  print " ext_mclk0_clk_src                  audio_wrapper_ext_mclk0_clk         " 
  print ""
  print "[ EXT MCLK1 ]" 
  print " ext_mclk1_clk_src                  audio_wrapper_ext_mclk1_clk         " 
  print ""
  print "[ EXT MCLK2 ]" 
  print " ext_mclk2_clk_src                  audio_wrapper_ext_mclk2_clk         " 
  print ""
  print "[ PRIMARY PCM ]" 
  print " lpaif_pri_clk_src                  audio_core_lpaif_pri_ibit_clk      audio_core_lpaif_pri_ebit_clk       " 
  print ""
  print "[ Q6 CORE ]" 
  print "  " 
  print ""
  print "[ Q6_SMMU ]" 
  print "  " 
  print ""
  print "[ Q6SS ZMEAS & RCG ]" 
  print "  " 
  print ""
  print "[ QCA SLIMBUS ]" 
  print " qca_slimbus_clk_src                audio_core_qca_slimbus_clk          " 
  print ""
  print "[ QOS FIXED MONITOR ]" 
  print " qos_fixed_lat_counter_src          audio_core_qos_dmonitor_fixed_lat_counter_clkaudio_wrapper_qos_danger_fixed_lat_counter_clk " 
  print " audio_wrapper_qos_dmonitor_fixed_lat_counter_clk " 
  print ""
  print "[ QUATERNARY PCM ]" 
  print " lpaif_quad_clk_src                 audio_core_lpaif_quad_ibit_clk     audio_core_lpaif_quad_ebit_clk      " 
  print ""
  print "[ REF CLK MUX ]" 
  print "  " 
  print ""
  print "[ RESAMPLER ]" 
  print " resampler_clk_src                  audio_core_resampler_core_clk       " 
  print ""
  print "[ SECONDARY PCM ]" 
  print " lpaif_sec_clk_src                  audio_core_lpaif_sec_ibit_clk      audio_core_lpaif_sec_ebit_clk       " 
  print ""
  print "[ SLEEP ]" 
  print " sleep_clk_src                      audio_core_bcr_slp_clk             q6ss_bcr_slp_clk                    " 
  print " q6ss_slp_clk                        " 
  print ""
  print "[ SNOC ]" 
  print " audio_core_sysnoc_sway_snoc_clk    audio_wrapper_sysnoc_sway_snoc_clk  " 
  print ""
  print "[ SPEAKER I2S ]" 
  print " lpaif_spkr_clk_src                 audio_core_lpaif_codec_spkr_ibit_clkaudio_core_lpaif_codec_spkr_osr_clk " 
  print " audio_core_lpaif_codec_spkr_ebit_clk " 
  print ""
  print "[ TERTIARY PCM ]" 
  print " lpaif_ter_clk_src                  audio_core_lpaif_ter_ibit_clk      audio_core_lpaif_ter_ebit_clk       " 
  print ""
  print "[ LPASS_QDSP6_CORE ]" 
  print " lpass_qdsp6ss_q6_core_clk          lpass_qdsp6ss_axi_m_clk            lpass_qdsp6ss_ldo_nmo_out           " 
  print " lpass_qdsp6ss_ahb_m_clk            lpass_qdsp6ss_ahb_s_clk            lpass_qdsp6ss_xo_clk                " 
  print " lpass_qdsp6ss_sleep_clk            lpass_qdsp6ss_jtag_tck             lpass_qdsp6ss_atb_clk               " 
  print " lpass_qdsp6ss_apb_clk              lpass_qdsp6ss_timestamp_clk         " 
  print ""
  print "[ EXT ]" 
  print "  " 

  print ""
  print "*****************************************************  MMSS  ******************************************************"

  print ""
  print "[ CAMSS_CCI ]" 
  print " camss_cci_clk                       " 
  print ""
  print "[ CAMSS_CPP ]" 
  print " camss_cpp_clk                      mmss_spdm_cpp_clk                   " 
  print ""
  print "[ CAMSS_CSI0 ]" 
  print " camss_csi0_clk                     camss_csi0phy_clk                  camss_csi0pix_clk                   " 
  print " camss_csi0rdi_clk                  mmss_spdm_csi0_clk                  " 
  print ""
  print "[ CAMSS_CSI1 ]" 
  print " camss_csi1_clk                     camss_csi1phy_clk                  camss_csi1pix_clk                   " 
  print " camss_csi1rdi_clk                   " 
  print ""
  print "[ CAMSS_CSI2 ]" 
  print " camss_csi2_clk                     camss_csi2phy_clk                  camss_csi2pix_clk                   " 
  print " camss_csi2rdi_clk                   " 
  print ""
  print "[ CAMSS_CSI3 ]" 
  print " camss_csi3_clk                     camss_csi3phy_clk                  camss_csi3pix_clk                   " 
  print " camss_csi3rdi_clk                   " 
  print ""
  print "[ CAMSS_CSIPHY0_3P ]" 
  print " camss_csiphy0_3p_clk                " 
  print ""
  print "[ CAMSS_CSIPHY1_3P ]" 
  print " camss_csiphy1_3p_clk                " 
  print ""
  print "[ CAMSS_CSIPHY2_3P ]" 
  print " camss_csiphy2_3p_clk                " 
  print ""
  print "[ CAMSS_GP0 ]" 
  print " camss_gp0_clk                       " 
  print ""
  print "[ CAMSS_GP1 ]" 
  print " camss_gp1_clk                       " 
  print ""
  print "[ CAMSS_JPEG ]" 
  print " camss_jpeg0_clk                    mmss_spdm_jpeg0_clk                camss_jpeg2_clk                     " 
  print " mmss_spdm_jpeg2_clk                camss_jpeg_dma_clk                 mmss_spdm_jpeg_dma_clk              " 
  print ""
  print "[ CAMSS_MCLK0 ]" 
  print " camss_mclk0_clk                     " 
  print ""
  print "[ CAMSS_MCLK1 ]" 
  print " camss_mclk1_clk                     " 
  print ""
  print "[ CAMSS_MCLK2 ]" 
  print " camss_mclk2_clk                     " 
  print ""
  print "[ CAMSS_MCLK3 ]" 
  print " camss_mclk3_clk                     " 
  print ""
  print "[ CAMSS_PHY0 ]" 
  print " camss_csi0phytimer_clk              " 
  print ""
  print "[ CAMSS_PHY1 ]" 
  print " camss_csi1phytimer_clk              " 
  print ""
  print "[ CAMSS_PHY2 ]" 
  print " camss_csi2phytimer_clk              " 
  print ""
  print "[ CAMSS_TOP ]" 
  print "  " 
  print ""
  print "[ CAMSS_VFE0 ]" 
  print " camss_csi_vfe0_clk                 camss_vfe0_clk                     camss_vfe0_stream_clk               " 
  print " mmss_spdm_vfe0_clk                  " 
  print ""
  print "[ CAMSS_VFE1 ]" 
  print " camss_csi_vfe1_clk                 camss_vfe1_clk                     camss_vfe1_stream_clk               " 
  print " mmss_spdm_vfe1_clk                  " 
  print ""
  print "[ DSA ]" 
  print " dsa_core_clk                        " 
  print ""
  print "[ FD ]" 
  print " fd_core_clk                        fd_core_uar_clk                     " 
  print ""
  print "[ GCC CLOCKS ]" 
  print " dsa_noc_cfg_ahb_clk                mmagic_bimc_noc_cfg_ahb_clk        mmagic_camss_noc_cfg_ahb_clk        " 
  print " mmagic_mdss_noc_cfg_ahb_clk        mmagic_video_noc_cfg_ahb_clk        " 
  print ""
  print "[ GPU ]" 
  print "  " 
  print ""
  print "[ GPU_AON ]" 
  print " gpu_aon_isense_clk                  " 
  print ""
  print "[ GPU_GX ]" 
  print " gpu_gx_gfx3d_clk                   mmss_spdm_debug_clk                mmss_spdm_gfx3d_clk                 " 
  print " gpu_gx_rbbmtimer_clk                " 
  print ""
  print "[ MDSS ]" 
  print " mdss_byte0_clk                     mdss_byte1_clk                     mdss_edpaux_clk                     " 
  print " mdss_edpgtc_clk                    mdss_edplink_clk                   mdss_edppixel_clk                   " 
  print " mdss_esc0_clk                      mdss_esc1_clk                      mdss_extpclk_clk                    " 
  print " mdss_hdmi_clk                      mdss_mdp_clk                       mmss_spdm_mdp_clk                   " 
  print " mdss_pclk0_clk                     mmss_spdm_pclk0_clk                mdss_pclk1_clk                      " 
  print " mmss_spdm_pclk1_clk                mdss_vsync_clk                      " 
  print ""
  print "[ MMAGIC_BIMC ]" 
  print "  " 
  print ""
  print "[ MMAGIC_CAMSS ]" 
  print "  " 
  print ""
  print "[ MMAGIC_MDSS ]" 
  print "  " 
  print ""
  print "[ MMAGIC_VIDEO ]" 
  print "  " 
  print ""
  print "[ MMAGICAHB ]" 
  print " camss_ahb_clk                      camss_cci_ahb_clk                  camss_cpp_ahb_clk                   " 
  print " camss_cpp_vbif_ahb_clk             camss_csi0_ahb_clk                 camss_csi1_ahb_clk                  " 
  print " camss_csi2_ahb_clk                 camss_csi3_ahb_clk                 camss_ispif_ahb_clk                 " 
  print " camss_jpeg_ahb_clk                 camss_micro_ahb_clk                camss_top_ahb_clk                   " 
  print " camss_vfe0_ahb_clk                 camss_vfe1_ahb_clk                 camss_vfe_ahb_clk                   " 
  print " fd_ahb_clk                         gpu_ahb_clk                        mdss_ahb_clk                        " 
  print " mdss_hdmi_ahb_clk                  mmss_bto_ahb_clk                   mmss_misc_ahb_clk                   " 
  print " mmss_mmagic_ahb_clk                mmss_mmagic_cfg_ahb_clk            mmss_rbcpr_ahb_clk                  " 
  print " mmss_spdm_ahb_clk                  smmu_cpp_ahb_clk                   smmu_jpeg_ahb_clk                   " 
  print " smmu_mdp_ahb_clk                   smmu_rot_ahb_clk                   smmu_vfe_ahb_clk                    " 
  print " smmu_video_ahb_clk                 throttle_camss_ahb_clk             throttle_mdss_ahb_clk               " 
  print " throttle_video_ahb_clk             video_ahb_clk                      vmem_ahb_clk                        " 
  print ""
  print "[ MMAGICAXI ]" 
  print " camss_cpp_axi_clk                  camss_jpeg_axi_clk                 camss_vfe_axi_clk                   " 
  print " mdss_axi_clk                       mmagic_bimc_axi_clk                mmagic_camss_axi_clk                " 
  print " mmagic_mdss_axi_clk                mmagic_video_axi_clk               mmss_mmagic_axi_clk                 " 
  print " mmss_s0_axi_clk                    mmss_spdm_axi_clk                  mmss_spdm_rm_axi_clk                " 
  print " smmu_cpp_axi_clk                   smmu_jpeg_axi_clk                  smmu_mdp_axi_clk                    " 
  print " smmu_rot_axi_clk                   smmu_vfe_axi_clk                   smmu_video_axi_clk                  " 
  print " throttle_camss_axi_clk             throttle_mdss_axi_clk              throttle_video_axi_clk              " 
  print " video_axi_clk                       " 
  print ""
  print "[ MMAGICMAXI ]" 
  print " mmss_mmagic_maxi_clk               mmss_spdm_rm_maxi_clk              video_maxi_clk                      " 
  print " vmem_maxi_clk                       " 
  print ""
  print "[ MMSS_RBCPR ]" 
  print " mmss_rbcpr_clk                      " 
  print ""
  print "[ RAW ]" 
  print " mmss_sleepclk_clk                  mmss_cxo_clk                       mmss_misc_cxo_clk                   " 
  print " throttle_camss_cxo_clk             throttle_mdss_cxo_clk              throttle_video_cxo_clk              " 
  print ""
  print "[ VIDEO ]" 
  print " mmss_spdm_video_core_clk           video_core_clk                      " 
  print ""
  print "[ VIDEO_SUBCORE0 ]" 
  print " video_subcore0_clk                  " 
  print ""
  print "[ VIDEO_SUBCORE1 ]" 
  print " video_subcore1_clk                  " 
  print ""
  print "[ EXT ]" 
  print " mmpll0_dtest                       mmpll0_enable_status               mmpll0_lock_det                     " 
  print " mmpll1_dtest                       mmpll1_enable_status               mmpll1_lock_det                     " 
  print " mmpll2_dtest                       mmpll2_enable_status               mmpll2_lock_det                     " 
  print " mmpll3_dtest                       mmpll3_enable_status               mmpll3_lock_det                     " 
  print " mmpll4_dtest                       mmpll4_enable_status               mmpll4_lock_det                     " 
  print " mmpll5_dtest                       mmpll5_enable_status               mmpll5_lock_det                     " 
  print " mmpll8_dtest                       mmpll8_enable_status               mmpll8_lock_det                     " 
  print " mmpll9_dtest                       mmpll9_enable_status               mmpll9_lock_det                     " 

  print ""
  print "*****************************************************  MSS   ******************************************************"

  print ""
  print "[ BUS ]" 
  print " clk_src_bus_mss_config             clk_bus_config                     clk_bus_coxm                        " 
  print " clk_bus_crypto                     clk_bus_mgpi                       clk_bus_mvc                         " 
  print " clk_bus_nav                        clk_bus_pll_outctrl                clk_bus_q6                          " 
  print " clk_bus_rbcpr                      clk_bus_rfc                        clk_bus_slave_timeout               " 
  print " clk_bus_stmr                       clk_bus_uim0                       clk_bus_uim1                        " 
  print " clk_bus_uim2                       clk_bus_uim3                       mss_dgr_ahb_clk                     " 
  print " mss_dgr_freerun_ahb_clk             " 
  print ""
  print "[ COXM ]" 
  print " clk_src_bit_coxm_mnd               clk_bit_coxm                        " 
  print ""
  print "[ NAV SS ]" 
  print "  " 
  print ""
  print "[ Q6 ]" 
  print "  " 
  print ""
  print "[ RBCPR ]" 
  print " clk_src_rbcpr_ref                  clk_rbcpr_ref                       " 
  print ""
  print "[ UIM ]" 
  print " clk_src_uim                        clk_card_src_uim0                  clk_card_src_uim1                   " 
  print " clk_card_src_uim2                  clk_card_src_uim3                  clk_src_uim0_mnd                    " 
  print " clk_uart_bit_uim0                  clk_src_uim1_mnd                   clk_uart_bit_uim1                   " 
  print " clk_src_uim2_mnd                   clk_uart_bit_uim2                  clk_src_uim3_mnd                    " 
  print " clk_uart_bit_uim3                   " 
  print ""
  print "[ XO ]" 
  print " clk_xo                             clk_xo_mdm                         clk_xo_nav                          " 
  print ""
  print "[ MSS_MODEM_CORE ]" 
  print " clk_mdm                             " 
  print ""
  print "[ MSS_NAV_CORE ]" 
  print " clk_nav_main                       clk_nav_adc1                       clk_nav_xo                          " 
  print ""
  print "[ MSS_QDSP6_CORE ]" 
  print " mss_qdsp6ss_q6_core_clk            mss_qdsp6ss_axi_m_clk              mss_qdsp6ss_ldo_nmo_out             " 
  print " mss_qdsp6ss_ahb_m_clk              mss_qdsp6ss_ahb_s_clk              mss_qdsp6ss_xo_clk                  " 
  print " mss_qdsp6ss_sleep_clk              mss_qdsp6ss_jtag_tck               mss_qdsp6ss_atb_clk                 " 
  print " mss_qdsp6ss_apb_clk                mss_qdsp6ss_timestamp_clk           " 
  print ""
  print "[ EXT ]" 
  print " clk_axi_crypto                     clk_bus_pseudo_hm_rcg              clk_xo_cx                           " 
  print " dbg_dtr_clksig                     dbg_modem_clksig                   dbg_nav_clksig                      " 
  print " dbg_q6_clksig                      dtr1_pll_dtest                     dtr1_pll_lock_det                   " 
  print " dtr2_pll_dtest                     dtr2_pll_lock_det                  modem_offline_pll_dtest             " 
  print " mss_dgr_axi_clk                    mss_offline_pll_lock_det           nav_pll_dtest                       " 
  print " nav_pll_lock_det                   q6_pll_dtest                       q6_pll_lock_det                     " 

  print ""
  print "*****************************************************  SSC   ******************************************************"

  print ""
  print "[ SCC ]" 
  print " scc_ahb_timeout_clk                scc_at_clk                         scc_blsp_h_clk                      " 
  print " scc_cfg_ahb_clk                    scc_crif_clk                       scc_csr_h_clk                       " 
  print " scc_data_h_clk                     scc_dbg_tsctr_clk                  scc_pclkdbg_clk                     " 
  print " scc_q6_ahbm_clk                    scc_q6_ahbs_clk                    scc_q6_atbm_clk                     " 
  print " scc_q6_spm_clk                     scc_q6_xpu2_client_clk             scc_q6_xpu2_config_clk              " 
  print " scc_qup_i2c1_clk                   scc_qup_i2c2_clk                   scc_qup_i2c3_clk                    " 
  print " scc_qup_spi1_clk                   scc_qup_spi2_clk                   scc_qup_spi3_clk                    " 
  print " scc_smem_clk                       scc_uart_dm_uart1_clk              scc_uart_dm_uart2_clk               " 
  print " scc_uart_dm_uart3_clk               " 
  print ""
  print "[ SCC_MISC ]" 
  print " ssc_debug_clk                      ssc_pll_lv_test                     " 
  print ""
  print "[ SCC_VS ]" 
  print " scc_vs_vddcx_clk                   scc_vs_vddmx_clk                    " 
  print ""
  print "[ SSC_QDSP6_CORE ]" 
  print " ssc_qdsp6ss_q6_core_clk            ssc_qdsp6ss_axi_m_clk              ssc_qdsp6ss_ldo_nmo_out             " 
  print " ssc_qdsp6ss_ahb_m_clk              ssc_qdsp6ss_ahb_s_clk              ssc_qdsp6ss_xo_clk                  " 
  print " ssc_qdsp6ss_sleep_clk              ssc_qdsp6ss_jtag_tck               ssc_qdsp6ss_atb_clk                 " 
  print " ssc_qdsp6ss_apb_clk                ssc_qdsp6ss_timestamp_clk           " 
  print ""
  print "[ EXT ]" 
  print " q6_pll_dtest                       q6_pll_lock_det                    q6ss_dbg_clk                        " 
  print " scc_peel_pll_lock_det               " 

  return



Print_All:

  gosub Find_Print_Clock im_cbfcdiv_clk
  gosub Find_Print_Clock apc0_leaf_clk
  gosub Find_Print_Clock apc1_leaf_clk
  gosub Find_Print_Clock sys_apcsqsbslv_clk
  gosub Find_Print_Clock sys_apcsqsbmstr_clk
  gosub Find_Print_Clock sys_apcsahb_clk
  gosub Find_Print_Clock atb_apcs_clk
  gosub Find_Print_Clock apb_apcsdbg_clk
  gosub Find_Print_Clock im_refroot_clk
  gosub Find_Print_Clock im_ref_clk
  gosub Find_Print_Clock im_sleep_clk
  gosub Find_Print_Clock gcc_sec_ctrl_acc_clk
  gosub Find_Print_Clock gcc_bimc_clk
  gosub Find_Print_Clock gcc_spdm_bimc_cy_clk
  gosub Find_Print_Clock gcc_bimc_ddr_ch0_clk
  gosub Find_Print_Clock gcc_bimc_ddr_ch1_clk
  gosub Find_Print_Clock gcc_bimc_ddr_cpll0_clk
  gosub Find_Print_Clock gcc_bimc_ddr_cpll1_clk
  gosub Find_Print_Clock gcc_bimc_xo_clk
  gosub Find_Print_Clock gcc_cfg_noc_ddr_cfg_clk
  gosub Find_Print_Clock gcc_cnoc_bus_timeout5_ahb_clk
  gosub Find_Print_Clock gcc_ddr_dim_cfg_clk
  gosub Find_Print_Clock gcc_bimc_dtts_xo_clk
  gosub Find_Print_Clock gcc_bimc_hmss_axi_clk
  gosub Find_Print_Clock gcc_hmss_mstr_axi_clk
  gosub Find_Print_Clock gcc_hmss_slv_axi_clk
  gosub Find_Print_Clock gcc_blsp1_qup1_i2c_apps_clk
  gosub Find_Print_Clock gcc_blsp1_qup1_spi_apps_clk
  gosub Find_Print_Clock gcc_blsp1_qup2_i2c_apps_clk
  gosub Find_Print_Clock gcc_blsp1_qup2_spi_apps_clk
  gosub Find_Print_Clock gcc_blsp1_qup3_i2c_apps_clk
  gosub Find_Print_Clock gcc_blsp1_qup3_spi_apps_clk
  gosub Find_Print_Clock gcc_blsp1_qup4_i2c_apps_clk
  gosub Find_Print_Clock gcc_blsp1_qup4_spi_apps_clk
  gosub Find_Print_Clock gcc_blsp1_qup5_i2c_apps_clk
  gosub Find_Print_Clock gcc_blsp1_qup5_spi_apps_clk
  gosub Find_Print_Clock gcc_blsp1_qup6_i2c_apps_clk
  gosub Find_Print_Clock gcc_blsp1_qup6_spi_apps_clk
  gosub Find_Print_Clock gcc_blsp1_uart1_apps_clk
  gosub Find_Print_Clock gcc_blsp1_uart2_apps_clk
  gosub Find_Print_Clock gcc_blsp1_uart3_apps_clk
  gosub Find_Print_Clock gcc_blsp1_uart4_apps_clk
  gosub Find_Print_Clock gcc_blsp1_uart5_apps_clk
  gosub Find_Print_Clock gcc_blsp1_uart6_apps_clk
  gosub Find_Print_Clock gcc_blsp2_qup1_i2c_apps_clk
  gosub Find_Print_Clock gcc_blsp2_qup1_spi_apps_clk
  gosub Find_Print_Clock gcc_blsp2_qup2_i2c_apps_clk
  gosub Find_Print_Clock gcc_blsp2_qup2_spi_apps_clk
  gosub Find_Print_Clock gcc_blsp2_qup3_i2c_apps_clk
  gosub Find_Print_Clock gcc_blsp2_qup3_spi_apps_clk
  gosub Find_Print_Clock gcc_blsp2_qup4_i2c_apps_clk
  gosub Find_Print_Clock gcc_blsp2_qup4_spi_apps_clk
  gosub Find_Print_Clock gcc_blsp2_qup5_i2c_apps_clk
  gosub Find_Print_Clock gcc_blsp2_qup5_spi_apps_clk
  gosub Find_Print_Clock gcc_blsp2_qup6_i2c_apps_clk
  gosub Find_Print_Clock gcc_blsp2_qup6_spi_apps_clk
  gosub Find_Print_Clock gcc_blsp2_uart1_apps_clk
  gosub Find_Print_Clock gcc_blsp2_uart2_apps_clk
  gosub Find_Print_Clock gcc_blsp2_uart3_apps_clk
  gosub Find_Print_Clock gcc_blsp2_uart4_apps_clk
  gosub Find_Print_Clock gcc_blsp2_uart5_apps_clk
  gosub Find_Print_Clock gcc_blsp2_uart6_apps_clk
  gosub Find_Print_Clock gcc_blsp1_uart1_sim_clk
  gosub Find_Print_Clock gcc_blsp1_uart2_sim_clk
  gosub Find_Print_Clock gcc_blsp1_uart3_sim_clk
  gosub Find_Print_Clock gcc_blsp1_uart4_sim_clk
  gosub Find_Print_Clock gcc_blsp1_uart5_sim_clk
  gosub Find_Print_Clock gcc_blsp1_uart6_sim_clk
  gosub Find_Print_Clock gcc_blsp2_uart1_sim_clk
  gosub Find_Print_Clock gcc_blsp2_uart2_sim_clk
  gosub Find_Print_Clock gcc_blsp2_uart3_sim_clk
  gosub Find_Print_Clock gcc_blsp2_uart4_sim_clk
  gosub Find_Print_Clock gcc_blsp2_uart5_sim_clk
  gosub Find_Print_Clock gcc_blsp2_uart6_sim_clk
  gosub Find_Print_Clock gcc_ce1_clk
  gosub Find_Print_Clock gcc_aggre0_cnoc_ahb_clk
  gosub Find_Print_Clock gcc_aggre0_noc_mpu_cfg_ahb_clk
  gosub Find_Print_Clock gcc_aggre1_cnoc_ahb_clk
  gosub Find_Print_Clock gcc_aggre1_noc_mpu_cfg_ahb_clk
  gosub Find_Print_Clock gcc_aggre2_cnoc_ahb_clk
  gosub Find_Print_Clock gcc_aggre2_noc_mpu_cfg_ahb_clk
  gosub Find_Print_Clock gcc_ahb_clk
  gosub Find_Print_Clock gcc_bimc_cfg_ahb_clk
  gosub Find_Print_Clock gcc_bimc_nius_cfg_ahb_clk
  gosub Find_Print_Clock gcc_boot_rom_ahb_clk
  gosub Find_Print_Clock gcc_ce1_ahb_clk
  gosub Find_Print_Clock gcc_cfg_noc_ahb_clk
  gosub Find_Print_Clock gcc_cnoc_bus_timeout0_ahb_clk
  gosub Find_Print_Clock gcc_cnoc_bus_timeout1_ahb_clk
  gosub Find_Print_Clock gcc_cnoc_bus_timeout2_ahb_clk
  gosub Find_Print_Clock gcc_cnoc_bus_timeout3_ahb_clk
  gosub Find_Print_Clock gcc_cnoc_bus_timeout4_ahb_clk
  gosub Find_Print_Clock gcc_cnoc_bus_timeout6_ahb_clk
  gosub Find_Print_Clock gcc_cnoc_bus_timeout7_ahb_clk
  gosub Find_Print_Clock gcc_cnoc_bus_timeout8_ahb_clk
  gosub Find_Print_Clock gcc_cnoc_bus_timeout9_ahb_clk
  gosub Find_Print_Clock gcc_cnoc_mst_rpm_ahb_clk
  gosub Find_Print_Clock gcc_dcc_ahb_clk
  gosub Find_Print_Clock gcc_imem_cfg_ahb_clk
  gosub Find_Print_Clock gcc_lpass_core_smmu_ahb_clk
  gosub Find_Print_Clock gcc_lpass_q6_smmu_ahb_clk
  gosub Find_Print_Clock gcc_lpass_smmu_aon_ahb_clk
  gosub Find_Print_Clock gcc_mmss_noc_cfg_ahb_clk
  gosub Find_Print_Clock gcc_mpm_ahb_clk
  gosub Find_Print_Clock gcc_msg_ram_ahb_clk
  gosub Find_Print_Clock gcc_noc_conf_xpu_ahb_clk
  gosub Find_Print_Clock gcc_pcie_0_cfg_ahb_clk
  gosub Find_Print_Clock gcc_pcie_1_cfg_ahb_clk
  gosub Find_Print_Clock gcc_pcie_2_cfg_ahb_clk
  gosub Find_Print_Clock gcc_pcie_phy_cfg_ahb_clk
  gosub Find_Print_Clock gcc_periph_noc_cfg_ahb_clk
  gosub Find_Print_Clock gcc_pimem_ahb_clk
  gosub Find_Print_Clock gcc_prng_ahb_clk
  gosub Find_Print_Clock gcc_qdss_cfg_ahb_clk
  gosub Find_Print_Clock gcc_qdss_dap_ahb_clk
  gosub Find_Print_Clock gcc_qdss_mpu_ahb_clk
  gosub Find_Print_Clock gcc_rbcpr_cx_ahb_clk
  gosub Find_Print_Clock gcc_rbcpr_mx_ahb_clk
  gosub Find_Print_Clock gcc_rbcpr_xpu_ahb_clk
  gosub Find_Print_Clock gcc_rpm_mst_m2_cnoc_ahb_clk
  gosub Find_Print_Clock gcc_sec_ctrl_ahb_clk
  gosub Find_Print_Clock gcc_sec_ctrl_boot_rom_patch_clk
  gosub Find_Print_Clock gcc_smmu_aggre0_ahb_clk
  gosub Find_Print_Clock gcc_smmu_aggre1_ahb_clk
  gosub Find_Print_Clock gcc_smmu_aggre2_ahb_clk
  gosub Find_Print_Clock gcc_snoc_cnoc_ahb_clk
  gosub Find_Print_Clock gcc_spdm_cfg_ahb_clk
  gosub Find_Print_Clock gcc_spdm_mstr_ahb_clk
  gosub Find_Print_Clock gcc_spmi_cnoc_ahb_clk
  gosub Find_Print_Clock gcc_ssc_cnoc_ahbs_clk
  gosub Find_Print_Clock gcc_ssc_cnoc_mpu_clk
  gosub Find_Print_Clock gcc_tcsr_ahb_clk
  gosub Find_Print_Clock gcc_tlmm_ahb_clk
  gosub Find_Print_Clock gcc_tlmm_clk
  gosub Find_Print_Clock gcc_ufs_ahb_clk
  gosub Find_Print_Clock gcc_aggre1_noc_msmpu_cfg_ahb_clk
  gosub Find_Print_Clock gcc_aggre2_noc_msmpu_cfg_ahb_clk
  gosub Find_Print_Clock gcc_ipa_ahb_clk
  gosub Find_Print_Clock gcc_mss_cfg_ahb_clk
  gosub Find_Print_Clock gcc_mss_msmpu_cfg_ahb_clk
  gosub Find_Print_Clock gcc_mss_q6_cfg_ahb_clk
  gosub Find_Print_Clock gcc_mss_q6_msmpu_cfg_ahb_clk
  gosub Find_Print_Clock gcc_skl_ahb_clk
  gosub Find_Print_Clock gcc_spdm_debug_cy_clk
  gosub Find_Print_Clock gcc_bimc_sleep_clk
  gosub Find_Print_Clock gcc_blsp1_sleep_clk
  gosub Find_Print_Clock gcc_blsp2_sleep_clk
  gosub Find_Print_Clock gcc_ddr_dim_sleep_clk
  gosub Find_Print_Clock gcc_im_sleep_clk
  gosub Find_Print_Clock gcc_rpm_sleep_clk
  gosub Find_Print_Clock gcc_tsif_inactivity_timers_clk
  gosub Find_Print_Clock gcc_usb20_sleep_clk
  gosub Find_Print_Clock gcc_usb30_sleep_clk
  gosub Find_Print_Clock gcc_ipa_sleep_clk
  gosub Find_Print_Clock gcc_dcd_xo_clk
  gosub Find_Print_Clock gcc_pdm_xo4_clk
  gosub Find_Print_Clock gcc_rpm_timer_clk
  gosub Find_Print_Clock gcc_spdm_ff_clk
  gosub Find_Print_Clock gcc_ssc_xo_clk
  gosub Find_Print_Clock gcc_xo_clk
  gosub Find_Print_Clock gcc_xo_div4_clk
  gosub Find_Print_Clock gcc_qrefs_vbg_cal_clk
  gosub Find_Print_Clock gcc_gp1_clk
  gosub Find_Print_Clock gcc_gp2_clk
  gosub Find_Print_Clock gcc_gp3_clk
  gosub Find_Print_Clock gcc_hmss_ahb_clk
  gosub Find_Print_Clock gcc_snoc_bus_timeout0_ahb_clk
  gosub Find_Print_Clock gcc_sys_noc_hmss_ahb_clk
  gosub Find_Print_Clock gcc_hmss_rbcpr_clk
  gosub Find_Print_Clock gcc_aggre2_noc_ipa_clk
  gosub Find_Print_Clock gcc_ipa_clk
  gosub Find_Print_Clock gcc_bimc_gfx_clk
  gosub Find_Print_Clock gcc_mmss_bimc_gfx_clk
  gosub Find_Print_Clock gcc_mss_q6_bimc_axi_clk
  gosub Find_Print_Clock gcc_mss_q6_msmpu_client_axi_clk
  gosub Find_Print_Clock gcc_mss_q6_smmu_clk
  gosub Find_Print_Clock gcc_mss_vs_clk
  gosub Find_Print_Clock gcc_obt_odt_clk
  gosub Find_Print_Clock gcc_pcie_0_pipe_clk
  gosub Find_Print_Clock gcc_pcie_1_pipe_clk
  gosub Find_Print_Clock gcc_pcie_2_pipe_clk
  gosub Find_Print_Clock gcc_pcie_0_aux_clk
  gosub Find_Print_Clock gcc_pcie_1_aux_clk
  gosub Find_Print_Clock gcc_pcie_2_aux_clk
  gosub Find_Print_Clock gcc_pcie_phy_aux_clk
  gosub Find_Print_Clock gcc_pdm2_clk
  gosub Find_Print_Clock gcc_aggre1_pnoc_ahb_clk
  gosub Find_Print_Clock gcc_blsp1_ahb_clk
  gosub Find_Print_Clock gcc_blsp2_ahb_clk
  gosub Find_Print_Clock gcc_pdm_ahb_clk
  gosub Find_Print_Clock gcc_periph_noc_ahb_clk
  gosub Find_Print_Clock gcc_periph_noc_mpu_cfg_ahb_clk
  gosub Find_Print_Clock gcc_pnoc_bus_timeout1_ahb_clk
  gosub Find_Print_Clock gcc_pnoc_bus_timeout2_ahb_clk
  gosub Find_Print_Clock gcc_pnoc_bus_timeout3_ahb_clk
  gosub Find_Print_Clock gcc_pnoc_bus_timeout4_ahb_clk
  gosub Find_Print_Clock gcc_sdcc1_ahb_clk
  gosub Find_Print_Clock gcc_sdcc2_ahb_clk
  gosub Find_Print_Clock gcc_sdcc3_ahb_clk
  gosub Find_Print_Clock gcc_sdcc4_ahb_clk
  gosub Find_Print_Clock gcc_snoc_pnoc_ahb_clk
  gosub Find_Print_Clock gcc_spdm_pnoc_cy_clk
  gosub Find_Print_Clock gcc_tsif_ahb_clk
  gosub Find_Print_Clock gcc_usb_phy_cfg_ahb2phy_clk
  gosub Find_Print_Clock gcc_qspi_ahb_clk
  gosub Find_Print_Clock gcc_bimc_pimem_axi_clk
  gosub Find_Print_Clock gcc_pimem_axi_clk
  gosub Find_Print_Clock gcc_sys_noc_pimem_axi_clk
  gosub Find_Print_Clock gcc_aggre0_noc_at_clk
  gosub Find_Print_Clock gcc_aggre1_noc_at_clk
  gosub Find_Print_Clock gcc_aggre2_noc_at_clk
  gosub Find_Print_Clock gcc_mmss_noc_at_clk
  gosub Find_Print_Clock gcc_periph_noc_at_clk
  gosub Find_Print_Clock gcc_qdss_at_clk
  gosub Find_Print_Clock gcc_ssc_at_clk
  gosub Find_Print_Clock gcc_sys_noc_at_clk
  gosub Find_Print_Clock gcc_qdss_stm_clk
  gosub Find_Print_Clock gcc_sys_noc_qdss_stm_axi_clk
  gosub Find_Print_Clock gcc_qdss_traceclkin_clk
  gosub Find_Print_Clock gcc_qdss_apb2jtag_clk
  gosub Find_Print_Clock gcc_qdss_dap_clk
  gosub Find_Print_Clock gcc_qdss_tsctr_div16_clk
  gosub Find_Print_Clock gcc_qdss_tsctr_div2_clk
  gosub Find_Print_Clock gcc_qdss_tsctr_div3_clk
  gosub Find_Print_Clock gcc_qdss_tsctr_div4_clk
  gosub Find_Print_Clock gcc_qdss_tsctr_div8_clk
  gosub Find_Print_Clock gcc_ssc_apb_clk
  gosub Find_Print_Clock gcc_qspi_ser_clk
  gosub Find_Print_Clock gcc_rbcpr_cx_clk
  gosub Find_Print_Clock gcc_rbcpr_mx_clk
  gosub Find_Print_Clock gcc_rpm_bus_ahb_clk
  gosub Find_Print_Clock gcc_rpm_proc_fclk
  gosub Find_Print_Clock gcc_rpm_proc_hclk
  gosub Find_Print_Clock gcc_spdm_rpm_cy_clk
  gosub Find_Print_Clock gcc_sdcc1_apps_clk
  gosub Find_Print_Clock gcc_sdcc1_ice_core_clk
  gosub Find_Print_Clock gcc_sdcc2_apps_clk
  gosub Find_Print_Clock gcc_sdcc3_apps_clk
  gosub Find_Print_Clock gcc_sdcc4_apps_clk
  gosub Find_Print_Clock gcc_sec_ctrl_clk
  gosub Find_Print_Clock gcc_sec_ctrl_sense_clk
  gosub Find_Print_Clock gcc_spmi_ahb_clk
  gosub Find_Print_Clock gcc_spmi_ser_clk
  gosub Find_Print_Clock gcc_bimc_nius_hs_axi_clk
  gosub Find_Print_Clock gcc_bimc_sysnoc_hs_axi_clk
  gosub Find_Print_Clock gcc_lpass_q6_axi_clk
  gosub Find_Print_Clock gcc_lpass_q6_smmu_axi_clk
  gosub Find_Print_Clock gcc_sys_noc_hs_axi_clk
  gosub Find_Print_Clock gcc_mss_mnoc_bimc_axi_clk
  gosub Find_Print_Clock gcc_mss_msmpu_client_axi_clk
  gosub Find_Print_Clock gcc_aggre0_snoc_axi_clk
  gosub Find_Print_Clock gcc_aggre1_snoc_axi_clk
  gosub Find_Print_Clock gcc_aggre2_snoc_axi_clk
  gosub Find_Print_Clock gcc_bimc_nius_axi_clk
  gosub Find_Print_Clock gcc_bimc_sysnoc_axi_clk
  gosub Find_Print_Clock gcc_ce1_axi_clk
  gosub Find_Print_Clock gcc_imem_axi_clk
  gosub Find_Print_Clock gcc_lpass_sway_clk
  gosub Find_Print_Clock gcc_mmss_sys_noc_axi_clk
  gosub Find_Print_Clock gcc_pcie_0_mstr_axi_clk
  gosub Find_Print_Clock gcc_pcie_0_slv_axi_clk
  gosub Find_Print_Clock gcc_pcie_1_mstr_axi_clk
  gosub Find_Print_Clock gcc_pcie_1_slv_axi_clk
  gosub Find_Print_Clock gcc_pcie_2_mstr_axi_clk
  gosub Find_Print_Clock gcc_pcie_2_slv_axi_clk
  gosub Find_Print_Clock gcc_qdss_etr_usb_clk
  gosub Find_Print_Clock gcc_smmu_aggre0_axi_clk
  gosub Find_Print_Clock gcc_smmu_aggre1_axi_clk
  gosub Find_Print_Clock gcc_smmu_aggre2_axi_clk
  gosub Find_Print_Clock gcc_snoc_bus_timeout1_ahb_clk
  gosub Find_Print_Clock gcc_snoc_bus_timeout3_ahb_clk
  gosub Find_Print_Clock gcc_spdm_snoc_cy_clk
  gosub Find_Print_Clock gcc_ssc_snoc_ahbm_clk
  gosub Find_Print_Clock gcc_sys_noc_axi_clk
  gosub Find_Print_Clock gcc_sys_noc_ssc_q6_axi_clk
  gosub Find_Print_Clock gcc_aggre1_snoc_msmpu_client_axi_clk
  gosub Find_Print_Clock gcc_aggre2_snoc_msmpu_client_axi_clk
  gosub Find_Print_Clock gcc_mss_snoc_axi_clk
  gosub Find_Print_Clock gcc_cfg_noc_tic_clk
  gosub Find_Print_Clock gcc_tic_clk
  gosub Find_Print_Clock gcc_tsif_ref_clk
  gosub Find_Print_Clock gcc_aggre2_ufs_axi_clk
  gosub Find_Print_Clock gcc_sys_noc_ufs_axi_clk
  gosub Find_Print_Clock gcc_ufs_axi_clk
  gosub Find_Print_Clock gcc_ufs_rx_cfg_clk
  gosub Find_Print_Clock gcc_ufs_tx_cfg_clk
  gosub Find_Print_Clock gcc_ufs_ice_core_clk
  gosub Find_Print_Clock gcc_ufs_unipro_core_clk
  gosub Find_Print_Clock gcc_ufs_rx_symbol_0_clk
  gosub Find_Print_Clock gcc_ufs_rx_symbol_1_clk
  gosub Find_Print_Clock gcc_ufs_tx_symbol_0_clk
  gosub Find_Print_Clock gcc_periph_noc_usb20_ahb_clk
  gosub Find_Print_Clock gcc_pnoc_bus_timeout0_ahb_clk
  gosub Find_Print_Clock gcc_usb20_master_clk
  gosub Find_Print_Clock gcc_usb20_mock_utmi_clk
  gosub Find_Print_Clock gcc_aggre2_usb3_axi_clk
  gosub Find_Print_Clock gcc_snoc_bus_timeout2_ahb_clk
  gosub Find_Print_Clock gcc_sys_noc_usb3_axi_clk
  gosub Find_Print_Clock gcc_usb30_master_clk
  gosub Find_Print_Clock gcc_usb30_mock_utmi_clk
  gosub Find_Print_Clock gcc_usb3_phy_aux_clk
  gosub Find_Print_Clock gcc_usb3_phy_pipe_clk
  gosub Find_Print_Clock gcc_vdda_vs_clk
  gosub Find_Print_Clock gcc_vddcx_vs_clk
  gosub Find_Print_Clock gcc_vddmx_vs_clk
  gosub Find_Print_Clock gcc_vs_ctrl_clk
  gosub Find_Print_Clock gcc_aggre0_noc_qosgen_extref
  gosub Find_Print_Clock gcc_aggre1_noc_qosgen_extref
  gosub Find_Print_Clock gcc_aggre2_noc_qosgen_extref
  gosub Find_Print_Clock gcc_cnoc_bus_timeout_extref
  gosub Find_Print_Clock gcc_snoc_bus_timeout_extref
  gosub Find_Print_Clock gcc_snoc_qosgen_extref
  gosub Find_Print_Clock gpll0_dtest
  gosub Find_Print_Clock gpll0_lock_det
  gosub Find_Print_Clock gpll1_dtest
  gosub Find_Print_Clock gpll1_lock_det
  gosub Find_Print_Clock gpll2_dtest
  gosub Find_Print_Clock gpll2_lock_det
  gosub Find_Print_Clock gpll3_dtest
  gosub Find_Print_Clock gpll3_lock_det
  gosub Find_Print_Clock gpll4_dtest
  gosub Find_Print_Clock gpll4_lock_det
  gosub Find_Print_Clock hmss_gcc_dbg_clk
  gosub Find_Print_Clock lpass_gcc_dbg_clk
  gosub Find_Print_Clock mmss_gcc_dbg_clk
  gosub Find_Print_Clock mpm_gcc_temp0_sensor_ringosc_clk
  gosub Find_Print_Clock mpm_gcc_temp1_sensor_ringosc_clk
  gosub Find_Print_Clock mpm_gcc_temp_sensor_ringosc_clk
  gosub Find_Print_Clock mss_gcc_dbg_clk
  gosub Find_Print_Clock qusb2phy_gcc_clk_test_prim
  gosub Find_Print_Clock qusb2phy_gcc_clk_test_sec
  gosub Find_Print_Clock qusb2phy_prim_gcc_usb30_utmi_clk
  gosub Find_Print_Clock qusb2phy_sec_gcc_usb20s_utmi_clk
  gosub Find_Print_Clock ssc_gcc_dbg_clk
  gosub Find_Print_Clock ufs_rx_symbol_0_clk
  gosub Find_Print_Clock ufs_rx_symbol_1_clk
  gosub Find_Print_Clock ufs_tx_symbol_0_clk
  gosub Find_Print_Clock usb3_phy_wrapper_gcc_usb3_pipe_clk
  gosub Find_Print_Clock aon_clk_src
  gosub Find_Print_Clock audio_core_qdsp_sway_aon_clk
  gosub Find_Print_Clock audio_wrapper_aon_clk
  gosub Find_Print_Clock audio_wrapper_bus_timeout_aon_clk
  gosub Find_Print_Clock audio_wrapper_mpu_cfg_aon_clk
  gosub Find_Print_Clock audio_wrapper_q6_ahbm_mpu_aon_clk
  gosub Find_Print_Clock audio_wrapper_qos_ahbs_aon_clk
  gosub Find_Print_Clock audio_wrapper_sysnoc_sway_aon_clk
  gosub Find_Print_Clock q6ss_ahbm_aon_clk
  gosub Find_Print_Clock q6ss_ahbs_aon_clk
  gosub Find_Print_Clock atime_clk_src
  gosub Find_Print_Clock lpass_core_avsync_atime_clk
  gosub Find_Print_Clock aud_slimbus_clk_src
  gosub Find_Print_Clock audio_core_aud_slimbus_clk
  gosub Find_Print_Clock audio_core_peripheral_smmu_cfg_cnoc_clk
  gosub Find_Print_Clock audio_wrapper_q6_smmu_cfg_cnoc_clk
  gosub Find_Print_Clock audio_wrapper_q6_smmu_axi_clk
  gosub Find_Print_Clock q6ss_q6_axim_clk
  gosub Find_Print_Clock audio_core_sysnoc_sway_snoc_clk
  gosub Find_Print_Clock audio_wrapper_sysnoc_sway_snoc_clk
  gosub Find_Print_Clock core_clk_src
  gosub Find_Print_Clock audio_core_aud_slimbus_core_clk
  gosub Find_Print_Clock audio_core_core_clk
  gosub Find_Print_Clock audio_core_lpm_core_clk
  gosub Find_Print_Clock audio_core_peripheral_smmu_client_core_clk
  gosub Find_Print_Clock audio_core_qca_slimbus_core_clk
  gosub Find_Print_Clock audio_core_sysnoc_mport_core_clk
  gosub Find_Print_Clock audio_core_bus_timeout_core_clk
  gosub Find_Print_Clock ext_mclk0_clk_src
  gosub Find_Print_Clock audio_wrapper_ext_mclk0_clk
  gosub Find_Print_Clock ext_mclk1_clk_src
  gosub Find_Print_Clock audio_wrapper_ext_mclk1_clk
  gosub Find_Print_Clock ext_mclk2_clk_src
  gosub Find_Print_Clock audio_wrapper_ext_mclk2_clk
  gosub Find_Print_Clock q6ss_q6_camss_dsp_streaming_0_clk
  gosub Find_Print_Clock q6ss_q6_camss_dsp_streaming_1_clk
  gosub Find_Print_Clock lpaif_pcmoe_clk_src
  gosub Find_Print_Clock audio_core_lpaif_pcm_data_oe_clk
  gosub Find_Print_Clock lpaif_pri_clk_src
  gosub Find_Print_Clock audio_core_lpaif_pri_ibit_clk
  gosub Find_Print_Clock lpaif_quad_clk_src
  gosub Find_Print_Clock audio_core_lpaif_quad_ibit_clk
  gosub Find_Print_Clock lpaif_sec_clk_src
  gosub Find_Print_Clock audio_core_lpaif_sec_ibit_clk
  gosub Find_Print_Clock lpaif_spkr_clk_src
  gosub Find_Print_Clock audio_core_lpaif_codec_spkr_ibit_clk
  gosub Find_Print_Clock audio_core_lpaif_codec_spkr_osr_clk
  gosub Find_Print_Clock lpaif_ter_clk_src
  gosub Find_Print_Clock audio_core_lpaif_ter_ibit_clk
  gosub Find_Print_Clock audio_core_lpaif_pri_ebit_clk
  gosub Find_Print_Clock qca_slimbus_clk_src
  gosub Find_Print_Clock audio_core_qca_slimbus_clk
  gosub Find_Print_Clock qos_fixed_lat_counter_src
  gosub Find_Print_Clock audio_core_qos_dmonitor_fixed_lat_counter_clk
  gosub Find_Print_Clock audio_wrapper_qos_danger_fixed_lat_counter_clk
  gosub Find_Print_Clock audio_wrapper_qos_dmonitor_fixed_lat_counter_clk
  gosub Find_Print_Clock audio_core_lpaif_quad_ebit_clk
  gosub Find_Print_Clock resampler_clk_src
  gosub Find_Print_Clock audio_core_resampler_core_clk
  gosub Find_Print_Clock audio_core_lpaif_sec_ebit_clk
  gosub Find_Print_Clock sleep_clk_src
  gosub Find_Print_Clock audio_core_bcr_slp_clk
  gosub Find_Print_Clock q6ss_bcr_slp_clk
  gosub Find_Print_Clock q6ss_slp_clk
  gosub Find_Print_Clock audio_core_lpaif_codec_spkr_ebit_clk
  gosub Find_Print_Clock audio_core_lpaif_ter_ebit_clk
  gosub Find_Print_Clock xo_clk_src
  gosub Find_Print_Clock audio_core_avsync_stc_xo_clk
  gosub Find_Print_Clock audio_core_gdsc_xo_clk
  gosub Find_Print_Clock audio_wrapper_q6_smmu_gdsc_xo_clk
  gosub Find_Print_Clock audio_wrapper_qos_xo_lat_counter_clk
  gosub Find_Print_Clock q6ss_xo_clk
  gosub Find_Print_Clock lpass_qdsp6ss_q6_core_clk
  gosub Find_Print_Clock lpass_qdsp6ss_axi_m_clk
  gosub Find_Print_Clock lpass_qdsp6ss_ldo_nmo_out
  gosub Find_Print_Clock lpass_qdsp6ss_ahb_m_clk
  gosub Find_Print_Clock lpass_qdsp6ss_ahb_s_clk
  gosub Find_Print_Clock lpass_qdsp6ss_xo_clk
  gosub Find_Print_Clock lpass_qdsp6ss_sleep_clk
  gosub Find_Print_Clock lpass_qdsp6ss_jtag_tck
  gosub Find_Print_Clock lpass_qdsp6ss_atb_clk
  gosub Find_Print_Clock lpass_qdsp6ss_apb_clk
  gosub Find_Print_Clock lpass_qdsp6ss_timestamp_clk
  gosub Find_Print_Clock camss_ahb_clk
  gosub Find_Print_Clock camss_cci_ahb_clk
  gosub Find_Print_Clock camss_cpp_ahb_clk
  gosub Find_Print_Clock camss_cpp_vbif_ahb_clk
  gosub Find_Print_Clock camss_csi0_ahb_clk
  gosub Find_Print_Clock camss_csi1_ahb_clk
  gosub Find_Print_Clock camss_csi2_ahb_clk
  gosub Find_Print_Clock camss_csi3_ahb_clk
  gosub Find_Print_Clock camss_ispif_ahb_clk
  gosub Find_Print_Clock camss_jpeg_ahb_clk
  gosub Find_Print_Clock camss_micro_ahb_clk
  gosub Find_Print_Clock camss_top_ahb_clk
  gosub Find_Print_Clock camss_vfe0_ahb_clk
  gosub Find_Print_Clock camss_vfe1_ahb_clk
  gosub Find_Print_Clock camss_vfe_ahb_clk
  gosub Find_Print_Clock fd_ahb_clk
  gosub Find_Print_Clock gpu_ahb_clk
  gosub Find_Print_Clock mdss_ahb_clk
  gosub Find_Print_Clock mdss_hdmi_ahb_clk
  gosub Find_Print_Clock mmss_bto_ahb_clk
  gosub Find_Print_Clock mmss_misc_ahb_clk
  gosub Find_Print_Clock mmss_mmagic_ahb_clk
  gosub Find_Print_Clock mmss_mmagic_cfg_ahb_clk
  gosub Find_Print_Clock mmss_rbcpr_ahb_clk
  gosub Find_Print_Clock mmss_spdm_ahb_clk
  gosub Find_Print_Clock smmu_cpp_ahb_clk
  gosub Find_Print_Clock smmu_jpeg_ahb_clk
  gosub Find_Print_Clock smmu_mdp_ahb_clk
  gosub Find_Print_Clock smmu_rot_ahb_clk
  gosub Find_Print_Clock smmu_vfe_ahb_clk
  gosub Find_Print_Clock smmu_video_ahb_clk
  gosub Find_Print_Clock throttle_camss_ahb_clk
  gosub Find_Print_Clock throttle_mdss_ahb_clk
  gosub Find_Print_Clock throttle_video_ahb_clk
  gosub Find_Print_Clock video_ahb_clk
  gosub Find_Print_Clock vmem_ahb_clk
  gosub Find_Print_Clock camss_cpp_axi_clk
  gosub Find_Print_Clock camss_jpeg_axi_clk
  gosub Find_Print_Clock camss_vfe_axi_clk
  gosub Find_Print_Clock mdss_axi_clk
  gosub Find_Print_Clock mmagic_bimc_axi_clk
  gosub Find_Print_Clock mmagic_camss_axi_clk
  gosub Find_Print_Clock mmagic_mdss_axi_clk
  gosub Find_Print_Clock mmagic_video_axi_clk
  gosub Find_Print_Clock mmss_mmagic_axi_clk
  gosub Find_Print_Clock mmss_s0_axi_clk
  gosub Find_Print_Clock mmss_spdm_axi_clk
  gosub Find_Print_Clock mmss_spdm_rm_axi_clk
  gosub Find_Print_Clock smmu_cpp_axi_clk
  gosub Find_Print_Clock smmu_jpeg_axi_clk
  gosub Find_Print_Clock smmu_mdp_axi_clk
  gosub Find_Print_Clock smmu_rot_axi_clk
  gosub Find_Print_Clock smmu_vfe_axi_clk
  gosub Find_Print_Clock smmu_video_axi_clk
  gosub Find_Print_Clock throttle_camss_axi_clk
  gosub Find_Print_Clock throttle_mdss_axi_clk
  gosub Find_Print_Clock throttle_video_axi_clk
  gosub Find_Print_Clock video_axi_clk
  gosub Find_Print_Clock mdss_byte0_clk
  gosub Find_Print_Clock mdss_byte1_clk
  gosub Find_Print_Clock camss_gp0_clk
  gosub Find_Print_Clock camss_gp1_clk
  gosub Find_Print_Clock camss_cci_clk
  gosub Find_Print_Clock mmss_sleepclk_clk
  gosub Find_Print_Clock camss_cpp_clk
  gosub Find_Print_Clock mmss_spdm_cpp_clk
  gosub Find_Print_Clock camss_csi0_clk
  gosub Find_Print_Clock camss_csi0phy_clk
  gosub Find_Print_Clock camss_csi0pix_clk
  gosub Find_Print_Clock camss_csi0rdi_clk
  gosub Find_Print_Clock mmss_spdm_csi0_clk
  gosub Find_Print_Clock camss_csi0phytimer_clk
  gosub Find_Print_Clock camss_csi1_clk
  gosub Find_Print_Clock camss_csi1phy_clk
  gosub Find_Print_Clock camss_csi1pix_clk
  gosub Find_Print_Clock camss_csi1rdi_clk
  gosub Find_Print_Clock camss_csi1phytimer_clk
  gosub Find_Print_Clock camss_csi2_clk
  gosub Find_Print_Clock camss_csi2phy_clk
  gosub Find_Print_Clock camss_csi2pix_clk
  gosub Find_Print_Clock camss_csi2rdi_clk
  gosub Find_Print_Clock camss_csi2phytimer_clk
  gosub Find_Print_Clock camss_csi3_clk
  gosub Find_Print_Clock camss_csi3phy_clk
  gosub Find_Print_Clock camss_csi3pix_clk
  gosub Find_Print_Clock camss_csi3rdi_clk
  gosub Find_Print_Clock camss_csiphy0_3p_clk
  gosub Find_Print_Clock camss_csiphy1_3p_clk
  gosub Find_Print_Clock camss_csiphy2_3p_clk
  gosub Find_Print_Clock dsa_core_clk
  gosub Find_Print_Clock mdss_edpaux_clk
  gosub Find_Print_Clock mdss_edpgtc_clk
  gosub Find_Print_Clock mdss_edplink_clk
  gosub Find_Print_Clock mdss_edppixel_clk
  gosub Find_Print_Clock mdss_esc0_clk
  gosub Find_Print_Clock mdss_esc1_clk
  gosub Find_Print_Clock mdss_extpclk_clk
  gosub Find_Print_Clock fd_core_clk
  gosub Find_Print_Clock fd_core_uar_clk
  gosub Find_Print_Clock dsa_noc_cfg_ahb_clk
  gosub Find_Print_Clock mmagic_bimc_noc_cfg_ahb_clk
  gosub Find_Print_Clock mmagic_camss_noc_cfg_ahb_clk
  gosub Find_Print_Clock mmagic_mdss_noc_cfg_ahb_clk
  gosub Find_Print_Clock mmagic_video_noc_cfg_ahb_clk
  gosub Find_Print_Clock gpu_gx_gfx3d_clk
  gosub Find_Print_Clock mmss_spdm_debug_clk
  gosub Find_Print_Clock mmss_spdm_gfx3d_clk
  gosub Find_Print_Clock mdss_hdmi_clk
  gosub Find_Print_Clock gpu_aon_isense_clk
  gosub Find_Print_Clock camss_jpeg0_clk
  gosub Find_Print_Clock mmss_spdm_jpeg0_clk
  gosub Find_Print_Clock camss_jpeg2_clk
  gosub Find_Print_Clock mmss_spdm_jpeg2_clk
  gosub Find_Print_Clock camss_jpeg_dma_clk
  gosub Find_Print_Clock mmss_spdm_jpeg_dma_clk
  gosub Find_Print_Clock mmss_mmagic_maxi_clk
  gosub Find_Print_Clock mmss_spdm_rm_maxi_clk
  gosub Find_Print_Clock video_maxi_clk
  gosub Find_Print_Clock vmem_maxi_clk
  gosub Find_Print_Clock camss_mclk0_clk
  gosub Find_Print_Clock camss_mclk1_clk
  gosub Find_Print_Clock camss_mclk2_clk
  gosub Find_Print_Clock camss_mclk3_clk
  gosub Find_Print_Clock mdss_mdp_clk
  gosub Find_Print_Clock mmss_spdm_mdp_clk
  gosub Find_Print_Clock mdss_pclk0_clk
  gosub Find_Print_Clock mmss_spdm_pclk0_clk
  gosub Find_Print_Clock mdss_pclk1_clk
  gosub Find_Print_Clock mmss_spdm_pclk1_clk
  gosub Find_Print_Clock gpu_gx_rbbmtimer_clk
  gosub Find_Print_Clock mmss_rbcpr_clk
  gosub Find_Print_Clock camss_csi_vfe0_clk
  gosub Find_Print_Clock camss_vfe0_clk
  gosub Find_Print_Clock camss_vfe0_stream_clk
  gosub Find_Print_Clock mmss_spdm_vfe0_clk
  gosub Find_Print_Clock camss_csi_vfe1_clk
  gosub Find_Print_Clock camss_vfe1_clk
  gosub Find_Print_Clock camss_vfe1_stream_clk
  gosub Find_Print_Clock mmss_spdm_vfe1_clk
  gosub Find_Print_Clock mmss_spdm_video_core_clk
  gosub Find_Print_Clock video_core_clk
  gosub Find_Print_Clock video_subcore0_clk
  gosub Find_Print_Clock video_subcore1_clk
  gosub Find_Print_Clock mdss_vsync_clk
  gosub Find_Print_Clock mmss_cxo_clk
  gosub Find_Print_Clock mmss_misc_cxo_clk
  gosub Find_Print_Clock throttle_camss_cxo_clk
  gosub Find_Print_Clock throttle_mdss_cxo_clk
  gosub Find_Print_Clock throttle_video_cxo_clk
  gosub Find_Print_Clock mmpll0_dtest
  gosub Find_Print_Clock mmpll0_enable_status
  gosub Find_Print_Clock mmpll0_lock_det
  gosub Find_Print_Clock mmpll1_dtest
  gosub Find_Print_Clock mmpll1_enable_status
  gosub Find_Print_Clock mmpll1_lock_det
  gosub Find_Print_Clock mmpll2_dtest
  gosub Find_Print_Clock mmpll2_enable_status
  gosub Find_Print_Clock mmpll2_lock_det
  gosub Find_Print_Clock mmpll3_dtest
  gosub Find_Print_Clock mmpll3_enable_status
  gosub Find_Print_Clock mmpll3_lock_det
  gosub Find_Print_Clock mmpll4_dtest
  gosub Find_Print_Clock mmpll4_enable_status
  gosub Find_Print_Clock mmpll4_lock_det
  gosub Find_Print_Clock mmpll5_dtest
  gosub Find_Print_Clock mmpll5_enable_status
  gosub Find_Print_Clock mmpll5_lock_det
  gosub Find_Print_Clock mmpll8_dtest
  gosub Find_Print_Clock mmpll8_enable_status
  gosub Find_Print_Clock mmpll8_lock_det
  gosub Find_Print_Clock mmpll9_dtest
  gosub Find_Print_Clock mmpll9_enable_status
  gosub Find_Print_Clock mmpll9_lock_det
  gosub Find_Print_Clock clk_src_bit_coxm_mnd
  gosub Find_Print_Clock clk_bit_coxm
  gosub Find_Print_Clock clk_src_bus_mss_config
  gosub Find_Print_Clock clk_bus_config
  gosub Find_Print_Clock clk_bus_coxm
  gosub Find_Print_Clock clk_bus_crypto
  gosub Find_Print_Clock clk_bus_mgpi
  gosub Find_Print_Clock clk_bus_mvc
  gosub Find_Print_Clock clk_bus_nav
  gosub Find_Print_Clock clk_bus_pll_outctrl
  gosub Find_Print_Clock clk_bus_q6
  gosub Find_Print_Clock clk_bus_rbcpr
  gosub Find_Print_Clock clk_bus_rfc
  gosub Find_Print_Clock clk_bus_slave_timeout
  gosub Find_Print_Clock clk_bus_stmr
  gosub Find_Print_Clock clk_bus_uim0
  gosub Find_Print_Clock clk_bus_uim1
  gosub Find_Print_Clock clk_bus_uim2
  gosub Find_Print_Clock clk_bus_uim3
  gosub Find_Print_Clock mss_dgr_ahb_clk
  gosub Find_Print_Clock mss_dgr_freerun_ahb_clk
  gosub Find_Print_Clock clk_xo
  gosub Find_Print_Clock clk_xo_mdm
  gosub Find_Print_Clock clk_xo_nav
  gosub Find_Print_Clock clk_src_rbcpr_ref
  gosub Find_Print_Clock clk_rbcpr_ref
  gosub Find_Print_Clock clk_src_uim
  gosub Find_Print_Clock clk_card_src_uim0
  gosub Find_Print_Clock clk_card_src_uim1
  gosub Find_Print_Clock clk_card_src_uim2
  gosub Find_Print_Clock clk_card_src_uim3
  gosub Find_Print_Clock clk_src_uim0_mnd
  gosub Find_Print_Clock clk_uart_bit_uim0
  gosub Find_Print_Clock clk_src_uim1_mnd
  gosub Find_Print_Clock clk_uart_bit_uim1
  gosub Find_Print_Clock clk_src_uim2_mnd
  gosub Find_Print_Clock clk_uart_bit_uim2
  gosub Find_Print_Clock clk_src_uim3_mnd
  gosub Find_Print_Clock clk_uart_bit_uim3
  gosub Find_Print_Clock clk_mdm
  gosub Find_Print_Clock clk_nav_main
  gosub Find_Print_Clock clk_nav_adc1
  gosub Find_Print_Clock clk_nav_xo
  gosub Find_Print_Clock mss_qdsp6ss_q6_core_clk
  gosub Find_Print_Clock mss_qdsp6ss_axi_m_clk
  gosub Find_Print_Clock mss_qdsp6ss_ldo_nmo_out
  gosub Find_Print_Clock mss_qdsp6ss_ahb_m_clk
  gosub Find_Print_Clock mss_qdsp6ss_ahb_s_clk
  gosub Find_Print_Clock mss_qdsp6ss_xo_clk
  gosub Find_Print_Clock mss_qdsp6ss_sleep_clk
  gosub Find_Print_Clock mss_qdsp6ss_jtag_tck
  gosub Find_Print_Clock mss_qdsp6ss_atb_clk
  gosub Find_Print_Clock mss_qdsp6ss_apb_clk
  gosub Find_Print_Clock mss_qdsp6ss_timestamp_clk
  gosub Find_Print_Clock clk_axi_crypto
  gosub Find_Print_Clock clk_bus_pseudo_hm_rcg
  gosub Find_Print_Clock clk_xo_cx
  gosub Find_Print_Clock dbg_dtr_clksig
  gosub Find_Print_Clock dbg_modem_clksig
  gosub Find_Print_Clock dbg_nav_clksig
  gosub Find_Print_Clock dbg_q6_clksig
  gosub Find_Print_Clock dtr1_pll_dtest
  gosub Find_Print_Clock dtr1_pll_lock_det
  gosub Find_Print_Clock dtr2_pll_dtest
  gosub Find_Print_Clock dtr2_pll_lock_det
  gosub Find_Print_Clock modem_offline_pll_dtest
  gosub Find_Print_Clock mss_dgr_axi_clk
  gosub Find_Print_Clock mss_offline_pll_lock_det
  gosub Find_Print_Clock nav_pll_dtest
  gosub Find_Print_Clock nav_pll_lock_det
  gosub Find_Print_Clock q6_pll_dtest
  gosub Find_Print_Clock q6_pll_lock_det
  gosub Find_Print_Clock scc_ahb_timeout_clk
  gosub Find_Print_Clock scc_at_clk
  gosub Find_Print_Clock scc_blsp_h_clk
  gosub Find_Print_Clock scc_cfg_ahb_clk
  gosub Find_Print_Clock scc_crif_clk
  gosub Find_Print_Clock scc_csr_h_clk
  gosub Find_Print_Clock scc_data_h_clk
  gosub Find_Print_Clock scc_dbg_tsctr_clk
  gosub Find_Print_Clock scc_pclkdbg_clk
  gosub Find_Print_Clock scc_q6_ahbm_clk
  gosub Find_Print_Clock scc_q6_ahbs_clk
  gosub Find_Print_Clock scc_q6_atbm_clk
  gosub Find_Print_Clock scc_q6_spm_clk
  gosub Find_Print_Clock scc_q6_xpu2_client_clk
  gosub Find_Print_Clock scc_q6_xpu2_config_clk
  gosub Find_Print_Clock scc_qup_i2c1_clk
  gosub Find_Print_Clock scc_qup_i2c2_clk
  gosub Find_Print_Clock scc_qup_i2c3_clk
  gosub Find_Print_Clock scc_qup_spi1_clk
  gosub Find_Print_Clock scc_qup_spi2_clk
  gosub Find_Print_Clock scc_qup_spi3_clk
  gosub Find_Print_Clock scc_smem_clk
  gosub Find_Print_Clock scc_uart_dm_uart1_clk
  gosub Find_Print_Clock scc_uart_dm_uart2_clk
  gosub Find_Print_Clock scc_uart_dm_uart3_clk
  gosub Find_Print_Clock scc_vs_vddcx_clk
  gosub Find_Print_Clock scc_vs_vddmx_clk
  gosub Find_Print_Clock ssc_debug_clk
  gosub Find_Print_Clock ssc_pll_lv_test
  gosub Find_Print_Clock ssc_qdsp6ss_q6_core_clk
  gosub Find_Print_Clock ssc_qdsp6ss_axi_m_clk
  gosub Find_Print_Clock ssc_qdsp6ss_ldo_nmo_out
  gosub Find_Print_Clock ssc_qdsp6ss_ahb_m_clk
  gosub Find_Print_Clock ssc_qdsp6ss_ahb_s_clk
  gosub Find_Print_Clock ssc_qdsp6ss_xo_clk
  gosub Find_Print_Clock ssc_qdsp6ss_sleep_clk
  gosub Find_Print_Clock ssc_qdsp6ss_jtag_tck
  gosub Find_Print_Clock ssc_qdsp6ss_atb_clk
  gosub Find_Print_Clock ssc_qdsp6ss_apb_clk
  gosub Find_Print_Clock ssc_qdsp6ss_timestamp_clk
  gosub Find_Print_Clock q6_pll_dtest
  gosub Find_Print_Clock q6_pll_lock_det
  gosub Find_Print_Clock q6ss_dbg_clk
  gosub Find_Print_Clock scc_peel_pll_lock_det

  return



Print_All_SS:

  if ("&choice"=="bimc")
  (
  gosub Find_Print_Clock gcc_bimc_ddr_ch0_clk
  gosub Find_Print_Clock gcc_bimc_clk
  gosub Find_Print_Clock gcc_bimc_hmss_axi_clk
  gosub Find_Print_Clock gcc_bimc_gfx_clk
  gosub Find_Print_Clock gcc_mss_q6_bimc_axi_clk
    &choice_handled=1
    return
  )
  if ("&choice"=="apcs_all")
  (
  gosub Find_Print_Clock im_cbfcdiv_clk
  gosub Find_Print_Clock apc0_leaf_clk
  gosub Find_Print_Clock apc1_leaf_clk
  gosub Find_Print_Clock sys_apcsqsbslv_clk
  gosub Find_Print_Clock sys_apcsqsbmstr_clk
  gosub Find_Print_Clock sys_apcsahb_clk
  gosub Find_Print_Clock atb_apcs_clk
  gosub Find_Print_Clock apb_apcsdbg_clk
  gosub Find_Print_Clock im_refroot_clk
  gosub Find_Print_Clock im_ref_clk
  gosub Find_Print_Clock im_sleep_clk
    &choice_handled=1
    return
  )
  if ("&choice"=="gcc_all")
  (
  gosub Find_Print_Clock gcc_sec_ctrl_acc_clk
  gosub Find_Print_Clock gcc_bimc_clk
  gosub Find_Print_Clock gcc_spdm_bimc_cy_clk
  gosub Find_Print_Clock gcc_bimc_ddr_ch0_clk
  gosub Find_Print_Clock bimc_ddr_ch0_clk_src
  gosub Find_Print_Clock gcc_bimc_ddr_ch1_clk
  gosub Find_Print_Clock bimc_ddr_ch1_clk_src
  gosub Find_Print_Clock gcc_bimc_ddr_cpll0_clk
  gosub Find_Print_Clock gcc_bimc_ddr_cpll1_clk
  gosub Find_Print_Clock gcc_bimc_xo_clk
  gosub Find_Print_Clock gcc_cfg_noc_ddr_cfg_clk
  gosub Find_Print_Clock gcc_cnoc_bus_timeout5_ahb_clk
  gosub Find_Print_Clock gcc_ddr_dim_cfg_clk
  gosub Find_Print_Clock gcc_bimc_dtts_xo_clk
  gosub Find_Print_Clock bimc_fsm_ddr_clk_src
  gosub Find_Print_Clock gcc_bimc_hmss_axi_clk
  gosub Find_Print_Clock gcc_hmss_mstr_axi_clk
  gosub Find_Print_Clock gcc_hmss_slv_axi_clk
  gosub Find_Print_Clock gcc_blsp1_qup1_i2c_apps_clk
  gosub Find_Print_Clock gcc_blsp1_qup1_spi_apps_clk
  gosub Find_Print_Clock gcc_blsp1_qup2_i2c_apps_clk
  gosub Find_Print_Clock gcc_blsp1_qup2_spi_apps_clk
  gosub Find_Print_Clock gcc_blsp1_qup3_i2c_apps_clk
  gosub Find_Print_Clock gcc_blsp1_qup3_spi_apps_clk
  gosub Find_Print_Clock gcc_blsp1_qup4_i2c_apps_clk
  gosub Find_Print_Clock gcc_blsp1_qup4_spi_apps_clk
  gosub Find_Print_Clock gcc_blsp1_qup5_i2c_apps_clk
  gosub Find_Print_Clock gcc_blsp1_qup5_spi_apps_clk
  gosub Find_Print_Clock gcc_blsp1_qup6_i2c_apps_clk
  gosub Find_Print_Clock gcc_blsp1_qup6_spi_apps_clk
  gosub Find_Print_Clock gcc_blsp1_uart1_apps_clk
  gosub Find_Print_Clock gcc_blsp1_uart2_apps_clk
  gosub Find_Print_Clock gcc_blsp1_uart3_apps_clk
  gosub Find_Print_Clock gcc_blsp1_uart4_apps_clk
  gosub Find_Print_Clock gcc_blsp1_uart5_apps_clk
  gosub Find_Print_Clock gcc_blsp1_uart6_apps_clk
  gosub Find_Print_Clock gcc_blsp2_qup1_i2c_apps_clk
  gosub Find_Print_Clock gcc_blsp2_qup1_spi_apps_clk
  gosub Find_Print_Clock gcc_blsp2_qup2_i2c_apps_clk
  gosub Find_Print_Clock gcc_blsp2_qup2_spi_apps_clk
  gosub Find_Print_Clock gcc_blsp2_qup3_i2c_apps_clk
  gosub Find_Print_Clock gcc_blsp2_qup3_spi_apps_clk
  gosub Find_Print_Clock gcc_blsp2_qup4_i2c_apps_clk
  gosub Find_Print_Clock gcc_blsp2_qup4_spi_apps_clk
  gosub Find_Print_Clock gcc_blsp2_qup5_i2c_apps_clk
  gosub Find_Print_Clock gcc_blsp2_qup5_spi_apps_clk
  gosub Find_Print_Clock gcc_blsp2_qup6_i2c_apps_clk
  gosub Find_Print_Clock gcc_blsp2_qup6_spi_apps_clk
  gosub Find_Print_Clock gcc_blsp2_uart1_apps_clk
  gosub Find_Print_Clock gcc_blsp2_uart2_apps_clk
  gosub Find_Print_Clock gcc_blsp2_uart3_apps_clk
  gosub Find_Print_Clock gcc_blsp2_uart4_apps_clk
  gosub Find_Print_Clock gcc_blsp2_uart5_apps_clk
  gosub Find_Print_Clock gcc_blsp2_uart6_apps_clk
  gosub Find_Print_Clock gcc_blsp1_uart1_sim_clk
  gosub Find_Print_Clock gcc_blsp1_uart2_sim_clk
  gosub Find_Print_Clock gcc_blsp1_uart3_sim_clk
  gosub Find_Print_Clock gcc_blsp1_uart4_sim_clk
  gosub Find_Print_Clock gcc_blsp1_uart5_sim_clk
  gosub Find_Print_Clock gcc_blsp1_uart6_sim_clk
  gosub Find_Print_Clock gcc_blsp2_uart1_sim_clk
  gosub Find_Print_Clock gcc_blsp2_uart2_sim_clk
  gosub Find_Print_Clock gcc_blsp2_uart3_sim_clk
  gosub Find_Print_Clock gcc_blsp2_uart4_sim_clk
  gosub Find_Print_Clock gcc_blsp2_uart5_sim_clk
  gosub Find_Print_Clock gcc_blsp2_uart6_sim_clk
  gosub Find_Print_Clock gcc_ce1_clk
  gosub Find_Print_Clock gcc_aggre0_cnoc_ahb_clk
  gosub Find_Print_Clock gcc_aggre0_noc_mpu_cfg_ahb_clk
  gosub Find_Print_Clock gcc_aggre1_cnoc_ahb_clk
  gosub Find_Print_Clock gcc_aggre1_noc_mpu_cfg_ahb_clk
  gosub Find_Print_Clock gcc_aggre2_cnoc_ahb_clk
  gosub Find_Print_Clock gcc_aggre2_noc_mpu_cfg_ahb_clk
  gosub Find_Print_Clock gcc_ahb_clk
  gosub Find_Print_Clock gcc_bimc_cfg_ahb_clk
  gosub Find_Print_Clock gcc_bimc_nius_cfg_ahb_clk
  gosub Find_Print_Clock gcc_boot_rom_ahb_clk
  gosub Find_Print_Clock gcc_ce1_ahb_clk
  gosub Find_Print_Clock gcc_cfg_noc_ahb_clk
  gosub Find_Print_Clock gcc_cnoc_bus_timeout0_ahb_clk
  gosub Find_Print_Clock gcc_cnoc_bus_timeout1_ahb_clk
  gosub Find_Print_Clock gcc_cnoc_bus_timeout2_ahb_clk
  gosub Find_Print_Clock gcc_cnoc_bus_timeout3_ahb_clk
  gosub Find_Print_Clock gcc_cnoc_bus_timeout4_ahb_clk
  gosub Find_Print_Clock gcc_cnoc_bus_timeout6_ahb_clk
  gosub Find_Print_Clock gcc_cnoc_bus_timeout7_ahb_clk
  gosub Find_Print_Clock gcc_cnoc_bus_timeout8_ahb_clk
  gosub Find_Print_Clock gcc_cnoc_bus_timeout9_ahb_clk
  gosub Find_Print_Clock gcc_cnoc_mst_rpm_ahb_clk
  gosub Find_Print_Clock gcc_dcc_ahb_clk
  gosub Find_Print_Clock gcc_imem_cfg_ahb_clk
  gosub Find_Print_Clock gcc_lpass_core_smmu_ahb_clk
  gosub Find_Print_Clock gcc_lpass_q6_smmu_ahb_clk
  gosub Find_Print_Clock gcc_lpass_smmu_aon_ahb_clk
  gosub Find_Print_Clock gcc_mmss_noc_cfg_ahb_clk
  gosub Find_Print_Clock gcc_mpm_ahb_clk
  gosub Find_Print_Clock gcc_msg_ram_ahb_clk
  gosub Find_Print_Clock gcc_noc_conf_xpu_ahb_clk
  gosub Find_Print_Clock gcc_pcie_0_cfg_ahb_clk
  gosub Find_Print_Clock gcc_pcie_1_cfg_ahb_clk
  gosub Find_Print_Clock gcc_pcie_2_cfg_ahb_clk
  gosub Find_Print_Clock gcc_pcie_phy_cfg_ahb_clk
  gosub Find_Print_Clock gcc_periph_noc_cfg_ahb_clk
  gosub Find_Print_Clock gcc_pimem_ahb_clk
  gosub Find_Print_Clock gcc_prng_ahb_clk
  gosub Find_Print_Clock gcc_qdss_cfg_ahb_clk
  gosub Find_Print_Clock gcc_qdss_dap_ahb_clk
  gosub Find_Print_Clock gcc_qdss_mpu_ahb_clk
  gosub Find_Print_Clock gcc_rbcpr_cx_ahb_clk
  gosub Find_Print_Clock gcc_rbcpr_mx_ahb_clk
  gosub Find_Print_Clock gcc_rbcpr_xpu_ahb_clk
  gosub Find_Print_Clock gcc_rpm_mst_m2_cnoc_ahb_clk
  gosub Find_Print_Clock gcc_sec_ctrl_ahb_clk
  gosub Find_Print_Clock gcc_sec_ctrl_boot_rom_patch_clk
  gosub Find_Print_Clock gcc_smmu_aggre0_ahb_clk
  gosub Find_Print_Clock gcc_smmu_aggre1_ahb_clk
  gosub Find_Print_Clock gcc_smmu_aggre2_ahb_clk
  gosub Find_Print_Clock gcc_snoc_cnoc_ahb_clk
  gosub Find_Print_Clock gcc_spdm_cfg_ahb_clk
  gosub Find_Print_Clock gcc_spdm_mstr_ahb_clk
  gosub Find_Print_Clock gcc_spmi_cnoc_ahb_clk
  gosub Find_Print_Clock gcc_ssc_cnoc_ahbs_clk
  gosub Find_Print_Clock gcc_ssc_cnoc_mpu_clk
  gosub Find_Print_Clock gcc_tcsr_ahb_clk
  gosub Find_Print_Clock gcc_tlmm_ahb_clk
  gosub Find_Print_Clock gcc_tlmm_clk
  gosub Find_Print_Clock gcc_ufs_ahb_clk
  gosub Find_Print_Clock gcc_aggre1_noc_msmpu_cfg_ahb_clk
  gosub Find_Print_Clock gcc_aggre2_noc_msmpu_cfg_ahb_clk
  gosub Find_Print_Clock gcc_ipa_ahb_clk
  gosub Find_Print_Clock gcc_mss_cfg_ahb_clk
  gosub Find_Print_Clock gcc_mss_msmpu_cfg_ahb_clk
  gosub Find_Print_Clock gcc_mss_q6_cfg_ahb_clk
  gosub Find_Print_Clock gcc_mss_q6_msmpu_cfg_ahb_clk
  gosub Find_Print_Clock gcc_skl_ahb_clk
  gosub Find_Print_Clock gcc_spdm_debug_cy_clk
  gosub Find_Print_Clock gcc_bimc_sleep_clk
  gosub Find_Print_Clock gcc_blsp1_sleep_clk
  gosub Find_Print_Clock gcc_blsp2_sleep_clk
  gosub Find_Print_Clock gcc_ddr_dim_sleep_clk
  gosub Find_Print_Clock gcc_im_sleep_clk
  gosub Find_Print_Clock gcc_rpm_sleep_clk
  gosub Find_Print_Clock gcc_tsif_inactivity_timers_clk
  gosub Find_Print_Clock gcc_usb20_sleep_clk
  gosub Find_Print_Clock gcc_usb30_sleep_clk
  gosub Find_Print_Clock gcc_ipa_sleep_clk
  gosub Find_Print_Clock gcc_dcd_xo_clk
  gosub Find_Print_Clock gcc_pdm_xo4_clk
  gosub Find_Print_Clock gcc_rpm_timer_clk
  gosub Find_Print_Clock gcc_spdm_ff_clk
  gosub Find_Print_Clock gcc_ssc_xo_clk
  gosub Find_Print_Clock gcc_xo_clk
  gosub Find_Print_Clock gcc_xo_div4_clk
  gosub Find_Print_Clock gcc_qrefs_vbg_cal_clk
  gosub Find_Print_Clock gcc_gp1_clk
  gosub Find_Print_Clock gcc_gp2_clk
  gosub Find_Print_Clock gcc_gp3_clk
  gosub Find_Print_Clock gcc_hmss_ahb_clk
  gosub Find_Print_Clock gcc_snoc_bus_timeout0_ahb_clk
  gosub Find_Print_Clock gcc_sys_noc_hmss_ahb_clk
  gosub Find_Print_Clock gcc_hmss_rbcpr_clk
  gosub Find_Print_Clock gcc_aggre2_noc_ipa_clk
  gosub Find_Print_Clock gcc_ipa_clk
  gosub Find_Print_Clock gcc_bimc_gfx_clk
  gosub Find_Print_Clock gcc_mmss_bimc_gfx_clk
  gosub Find_Print_Clock gcc_mss_q6_bimc_axi_clk
  gosub Find_Print_Clock gcc_mss_q6_msmpu_client_axi_clk
  gosub Find_Print_Clock gcc_mss_q6_smmu_clk
  gosub Find_Print_Clock gcc_mss_vs_clk
  gosub Find_Print_Clock gcc_obt_odt_clk
  gosub Find_Print_Clock gcc_pcie_0_pipe_clk
  gosub Find_Print_Clock pcie_0_pipe_clk_src
  gosub Find_Print_Clock gcc_pcie_1_pipe_clk
  gosub Find_Print_Clock pcie_1_pipe_clk_src
  gosub Find_Print_Clock gcc_pcie_2_pipe_clk
  gosub Find_Print_Clock pcie_2_pipe_clk_src
  gosub Find_Print_Clock gcc_pcie_0_aux_clk
  gosub Find_Print_Clock gcc_pcie_1_aux_clk
  gosub Find_Print_Clock gcc_pcie_2_aux_clk
  gosub Find_Print_Clock gcc_pcie_phy_aux_clk
  gosub Find_Print_Clock gcc_pdm2_clk
  gosub Find_Print_Clock gcc_aggre1_pnoc_ahb_clk
  gosub Find_Print_Clock gcc_blsp1_ahb_clk
  gosub Find_Print_Clock gcc_blsp2_ahb_clk
  gosub Find_Print_Clock gcc_pdm_ahb_clk
  gosub Find_Print_Clock gcc_periph_noc_ahb_clk
  gosub Find_Print_Clock gcc_periph_noc_mpu_cfg_ahb_clk
  gosub Find_Print_Clock gcc_pnoc_bus_timeout1_ahb_clk
  gosub Find_Print_Clock gcc_pnoc_bus_timeout2_ahb_clk
  gosub Find_Print_Clock gcc_pnoc_bus_timeout3_ahb_clk
  gosub Find_Print_Clock gcc_pnoc_bus_timeout4_ahb_clk
  gosub Find_Print_Clock gcc_sdcc1_ahb_clk
  gosub Find_Print_Clock gcc_sdcc2_ahb_clk
  gosub Find_Print_Clock gcc_sdcc3_ahb_clk
  gosub Find_Print_Clock gcc_sdcc4_ahb_clk
  gosub Find_Print_Clock gcc_snoc_pnoc_ahb_clk
  gosub Find_Print_Clock gcc_spdm_pnoc_cy_clk
  gosub Find_Print_Clock gcc_tsif_ahb_clk
  gosub Find_Print_Clock gcc_usb_phy_cfg_ahb2phy_clk
  gosub Find_Print_Clock gcc_qspi_ahb_clk
  gosub Find_Print_Clock gcc_bimc_pimem_axi_clk
  gosub Find_Print_Clock gcc_pimem_axi_clk
  gosub Find_Print_Clock gcc_sys_noc_pimem_axi_clk
  gosub Find_Print_Clock gcc_aggre0_noc_at_clk
  gosub Find_Print_Clock gcc_aggre1_noc_at_clk
  gosub Find_Print_Clock gcc_aggre2_noc_at_clk
  gosub Find_Print_Clock gcc_mmss_noc_at_clk
  gosub Find_Print_Clock gcc_periph_noc_at_clk
  gosub Find_Print_Clock gcc_qdss_at_clk
  gosub Find_Print_Clock gcc_ssc_at_clk
  gosub Find_Print_Clock gcc_sys_noc_at_clk
  gosub Find_Print_Clock gcc_qdss_stm_clk
  gosub Find_Print_Clock gcc_sys_noc_qdss_stm_axi_clk
  gosub Find_Print_Clock gcc_qdss_traceclkin_clk
  gosub Find_Print_Clock gcc_qdss_apb2jtag_clk
  gosub Find_Print_Clock gcc_qdss_dap_clk
  gosub Find_Print_Clock gcc_qdss_tsctr_div16_clk
  gosub Find_Print_Clock gcc_qdss_tsctr_div2_clk
  gosub Find_Print_Clock gcc_qdss_tsctr_div3_clk
  gosub Find_Print_Clock gcc_qdss_tsctr_div4_clk
  gosub Find_Print_Clock gcc_qdss_tsctr_div8_clk
  gosub Find_Print_Clock gcc_ssc_apb_clk
  gosub Find_Print_Clock gcc_qspi_ser_clk
  gosub Find_Print_Clock gcc_rbcpr_cx_clk
  gosub Find_Print_Clock gcc_rbcpr_mx_clk
  gosub Find_Print_Clock gcc_rpm_bus_ahb_clk
  gosub Find_Print_Clock gcc_rpm_proc_fclk
  gosub Find_Print_Clock gcc_rpm_proc_hclk
  gosub Find_Print_Clock gcc_spdm_rpm_cy_clk
  gosub Find_Print_Clock gcc_sdcc1_apps_clk
  gosub Find_Print_Clock gcc_sdcc1_ice_core_clk
  gosub Find_Print_Clock gcc_sdcc2_apps_clk
  gosub Find_Print_Clock gcc_sdcc3_apps_clk
  gosub Find_Print_Clock gcc_sdcc4_apps_clk
  gosub Find_Print_Clock gcc_sec_ctrl_clk
  gosub Find_Print_Clock gcc_sec_ctrl_sense_clk
  gosub Find_Print_Clock sec_ctrl_acc_clk_src
  gosub Find_Print_Clock gcc_spmi_ahb_clk
  gosub Find_Print_Clock gcc_spmi_ser_clk
  gosub Find_Print_Clock gcc_bimc_nius_hs_axi_clk
  gosub Find_Print_Clock gcc_bimc_sysnoc_hs_axi_clk
  gosub Find_Print_Clock gcc_lpass_q6_axi_clk
  gosub Find_Print_Clock gcc_lpass_q6_smmu_axi_clk
  gosub Find_Print_Clock gcc_sys_noc_hs_axi_clk
  gosub Find_Print_Clock gcc_mss_mnoc_bimc_axi_clk
  gosub Find_Print_Clock gcc_mss_msmpu_client_axi_clk
  gosub Find_Print_Clock gcc_aggre0_snoc_axi_clk
  gosub Find_Print_Clock gcc_aggre1_snoc_axi_clk
  gosub Find_Print_Clock gcc_aggre2_snoc_axi_clk
  gosub Find_Print_Clock gcc_bimc_nius_axi_clk
  gosub Find_Print_Clock gcc_bimc_sysnoc_axi_clk
  gosub Find_Print_Clock gcc_ce1_axi_clk
  gosub Find_Print_Clock gcc_imem_axi_clk
  gosub Find_Print_Clock gcc_lpass_sway_clk
  gosub Find_Print_Clock gcc_mmss_sys_noc_axi_clk
  gosub Find_Print_Clock gcc_pcie_0_mstr_axi_clk
  gosub Find_Print_Clock gcc_pcie_0_slv_axi_clk
  gosub Find_Print_Clock gcc_pcie_1_mstr_axi_clk
  gosub Find_Print_Clock gcc_pcie_1_slv_axi_clk
  gosub Find_Print_Clock gcc_pcie_2_mstr_axi_clk
  gosub Find_Print_Clock gcc_pcie_2_slv_axi_clk
  gosub Find_Print_Clock gcc_qdss_etr_usb_clk
  gosub Find_Print_Clock gcc_smmu_aggre0_axi_clk
  gosub Find_Print_Clock gcc_smmu_aggre1_axi_clk
  gosub Find_Print_Clock gcc_smmu_aggre2_axi_clk
  gosub Find_Print_Clock gcc_snoc_bus_timeout1_ahb_clk
  gosub Find_Print_Clock gcc_snoc_bus_timeout3_ahb_clk
  gosub Find_Print_Clock gcc_spdm_snoc_cy_clk
  gosub Find_Print_Clock gcc_ssc_snoc_ahbm_clk
  gosub Find_Print_Clock gcc_sys_noc_axi_clk
  gosub Find_Print_Clock gcc_sys_noc_ssc_q6_axi_clk
  gosub Find_Print_Clock gcc_aggre1_snoc_msmpu_client_axi_clk
  gosub Find_Print_Clock gcc_aggre2_snoc_msmpu_client_axi_clk
  gosub Find_Print_Clock gcc_mss_snoc_axi_clk
  gosub Find_Print_Clock gcc_cfg_noc_tic_clk
  gosub Find_Print_Clock gcc_tic_clk
  gosub Find_Print_Clock gcc_tsif_ref_clk
  gosub Find_Print_Clock gcc_aggre2_ufs_axi_clk
  gosub Find_Print_Clock gcc_sys_noc_ufs_axi_clk
  gosub Find_Print_Clock gcc_ufs_axi_clk
  gosub Find_Print_Clock gcc_ufs_rx_cfg_clk
  gosub Find_Print_Clock gcc_ufs_tx_cfg_clk
  gosub Find_Print_Clock gcc_ufs_ice_core_clk
  gosub Find_Print_Clock gcc_ufs_unipro_core_clk
  gosub Find_Print_Clock gcc_ufs_rx_symbol_0_clk
  gosub Find_Print_Clock ufs_rx_symbol_0_clk_src
  gosub Find_Print_Clock gcc_ufs_rx_symbol_1_clk
  gosub Find_Print_Clock ufs_rx_symbol_1_clk_src
  gosub Find_Print_Clock gcc_ufs_tx_symbol_0_clk
  gosub Find_Print_Clock ufs_tx_symbol_0_clk_src
  gosub Find_Print_Clock gcc_periph_noc_usb20_ahb_clk
  gosub Find_Print_Clock gcc_pnoc_bus_timeout0_ahb_clk
  gosub Find_Print_Clock gcc_usb20_master_clk
  gosub Find_Print_Clock gcc_usb20_mock_utmi_clk
  gosub Find_Print_Clock gcc_aggre2_usb3_axi_clk
  gosub Find_Print_Clock gcc_snoc_bus_timeout2_ahb_clk
  gosub Find_Print_Clock gcc_sys_noc_usb3_axi_clk
  gosub Find_Print_Clock gcc_usb30_master_clk
  gosub Find_Print_Clock gcc_usb30_mock_utmi_clk
  gosub Find_Print_Clock gcc_usb3_phy_aux_clk
  gosub Find_Print_Clock gcc_usb3_phy_pipe_clk
  gosub Find_Print_Clock usb3_phy_pipe_clk_src
  gosub Find_Print_Clock gcc_vdda_vs_clk
  gosub Find_Print_Clock gcc_vddcx_vs_clk
  gosub Find_Print_Clock gcc_vddmx_vs_clk
  gosub Find_Print_Clock gcc_vs_ctrl_clk
  gosub Find_Print_Clock gcc_aggre0_noc_qosgen_extref
  gosub Find_Print_Clock gcc_aggre1_noc_qosgen_extref
  gosub Find_Print_Clock gcc_aggre2_noc_qosgen_extref
  gosub Find_Print_Clock gcc_cnoc_bus_timeout_extref
  gosub Find_Print_Clock gcc_snoc_bus_timeout_extref
  gosub Find_Print_Clock gcc_snoc_qosgen_extref
  gosub Find_Print_Clock gpll0_dtest
  gosub Find_Print_Clock gpll0_lock_det
  gosub Find_Print_Clock gpll1_dtest
  gosub Find_Print_Clock gpll1_lock_det
  gosub Find_Print_Clock gpll2_dtest
  gosub Find_Print_Clock gpll2_lock_det
  gosub Find_Print_Clock gpll3_dtest
  gosub Find_Print_Clock gpll3_lock_det
  gosub Find_Print_Clock gpll4_dtest
  gosub Find_Print_Clock gpll4_lock_det
  gosub Find_Print_Clock hmss_gcc_dbg_clk
  gosub Find_Print_Clock lpass_gcc_dbg_clk
  gosub Find_Print_Clock mmss_gcc_dbg_clk
  gosub Find_Print_Clock mpm_gcc_temp0_sensor_ringosc_clk
  gosub Find_Print_Clock mpm_gcc_temp1_sensor_ringosc_clk
  gosub Find_Print_Clock mpm_gcc_temp_sensor_ringosc_clk
  gosub Find_Print_Clock mss_gcc_dbg_clk
  gosub Find_Print_Clock qusb2phy_gcc_clk_test_prim
  gosub Find_Print_Clock qusb2phy_gcc_clk_test_sec
  gosub Find_Print_Clock qusb2phy_prim_gcc_usb30_utmi_clk
  gosub Find_Print_Clock qusb2phy_sec_gcc_usb20s_utmi_clk
  gosub Find_Print_Clock ssc_gcc_dbg_clk
  gosub Find_Print_Clock ufs_rx_symbol_0_clk
  gosub Find_Print_Clock ufs_rx_symbol_1_clk
  gosub Find_Print_Clock ufs_tx_symbol_0_clk
  gosub Find_Print_Clock usb3_phy_wrapper_gcc_usb3_pipe_clk
    &choice_handled=1
    return
  )
  if ("&choice"=="lpass_all")
  (
  gosub Find_Print_Clock aon_clk_src
  gosub Find_Print_Clock audio_core_qdsp_sway_aon_clk
  gosub Find_Print_Clock audio_wrapper_aon_clk
  gosub Find_Print_Clock audio_wrapper_bus_timeout_aon_clk
  gosub Find_Print_Clock audio_wrapper_mpu_cfg_aon_clk
  gosub Find_Print_Clock audio_wrapper_q6_ahbm_mpu_aon_clk
  gosub Find_Print_Clock audio_wrapper_qos_ahbs_aon_clk
  gosub Find_Print_Clock audio_wrapper_sysnoc_sway_aon_clk
  gosub Find_Print_Clock q6ss_ahbm_aon_clk
  gosub Find_Print_Clock q6ss_ahbs_aon_clk
  gosub Find_Print_Clock atime_clk_src
  gosub Find_Print_Clock lpass_core_avsync_atime_clk
  gosub Find_Print_Clock audio_core_lpaif_codec_spkr_bit_clk
  gosub Find_Print_Clock audio_core_lpaif_pri_bit_clk
  gosub Find_Print_Clock audio_core_lpaif_quad_bit_clk
  gosub Find_Print_Clock audio_core_lpaif_sec_bit_clk
  gosub Find_Print_Clock audio_core_lpaif_ter_bit_clk
  gosub Find_Print_Clock aud_slimbus_clk_src
  gosub Find_Print_Clock audio_core_aud_slimbus_clk
  gosub Find_Print_Clock audio_core_peripheral_smmu_cfg_cnoc_clk
  gosub Find_Print_Clock audio_wrapper_q6_smmu_cfg_cnoc_clk
  gosub Find_Print_Clock audio_wrapper_q6_smmu_axi_clk
  gosub Find_Print_Clock q6ss_q6_axim_clk
  gosub Find_Print_Clock audio_core_sysnoc_sway_snoc_clk
  gosub Find_Print_Clock audio_wrapper_sysnoc_sway_snoc_clk
  gosub Find_Print_Clock core_clk_src
  gosub Find_Print_Clock audio_core_aud_slimbus_core_clk
  gosub Find_Print_Clock audio_core_core_clk
  gosub Find_Print_Clock audio_core_lpm_core_clk
  gosub Find_Print_Clock audio_core_peripheral_smmu_client_core_clk
  gosub Find_Print_Clock audio_core_qca_slimbus_core_clk
  gosub Find_Print_Clock audio_core_sysnoc_mport_core_clk
  gosub Find_Print_Clock audio_core_bus_timeout_core_clk
  gosub Find_Print_Clock ext_mclk0_clk_src
  gosub Find_Print_Clock audio_wrapper_ext_mclk0_clk
  gosub Find_Print_Clock ext_mclk1_clk_src
  gosub Find_Print_Clock audio_wrapper_ext_mclk1_clk
  gosub Find_Print_Clock ext_mclk2_clk_src
  gosub Find_Print_Clock audio_wrapper_ext_mclk2_clk
  gosub Find_Print_Clock q6ss_q6_camss_dsp_streaming_0_clk
  gosub Find_Print_Clock q6ss_q6_camss_dsp_streaming_1_clk
  gosub Find_Print_Clock lpaif_pcmoe_clk_src
  gosub Find_Print_Clock audio_core_lpaif_pcm_data_oe_clk
  gosub Find_Print_Clock lpaif_pri_clk_src
  gosub Find_Print_Clock audio_core_lpaif_pri_ibit_clk
  gosub Find_Print_Clock lpaif_quad_clk_src
  gosub Find_Print_Clock audio_core_lpaif_quad_ibit_clk
  gosub Find_Print_Clock lpaif_sec_clk_src
  gosub Find_Print_Clock audio_core_lpaif_sec_ibit_clk
  gosub Find_Print_Clock lpaif_spkr_clk_src
  gosub Find_Print_Clock audio_core_lpaif_codec_spkr_ibit_clk
  gosub Find_Print_Clock audio_core_lpaif_codec_spkr_osr_clk
  gosub Find_Print_Clock lpaif_ter_clk_src
  gosub Find_Print_Clock audio_core_lpaif_ter_ibit_clk
  gosub Find_Print_Clock lpass_gcc_dbg_clk
  gosub Find_Print_Clock lpass_lpaaudio_dig_pll_ref_clk_mux
  gosub Find_Print_Clock lpass_lpaaudio_pll_ref_clk_mux
  gosub Find_Print_Clock lpass_q6ss_gfmux_clk_src
  gosub Find_Print_Clock lpass_q6ss_zmeas_clk_mux
  gosub Find_Print_Clock lpass_qdsp6ss_pll_ref_clk_mux
  gosub Find_Print_Clock audio_core_lpaif_pri_ebit_clk
  gosub Find_Print_Clock qca_slimbus_clk_src
  gosub Find_Print_Clock audio_core_qca_slimbus_clk
  gosub Find_Print_Clock qos_fixed_lat_counter_src
  gosub Find_Print_Clock audio_core_qos_dmonitor_fixed_lat_counter_clk
  gosub Find_Print_Clock audio_wrapper_qos_danger_fixed_lat_counter_clk
  gosub Find_Print_Clock audio_wrapper_qos_dmonitor_fixed_lat_counter_clk
  gosub Find_Print_Clock audio_core_lpaif_quad_ebit_clk
  gosub Find_Print_Clock resampler_clk_src
  gosub Find_Print_Clock audio_core_resampler_core_clk
  gosub Find_Print_Clock audio_core_lpaif_sec_ebit_clk
  gosub Find_Print_Clock sleep_clk_src
  gosub Find_Print_Clock audio_core_bcr_slp_clk
  gosub Find_Print_Clock q6ss_bcr_slp_clk
  gosub Find_Print_Clock q6ss_slp_clk
  gosub Find_Print_Clock audio_core_lpaif_codec_spkr_ebit_clk
  gosub Find_Print_Clock audio_core_lpaif_ter_ebit_clk
  gosub Find_Print_Clock xo_clk_src
  gosub Find_Print_Clock audio_core_avsync_stc_xo_clk
  gosub Find_Print_Clock audio_core_gdsc_xo_clk
  gosub Find_Print_Clock audio_wrapper_q6_smmu_gdsc_xo_clk
  gosub Find_Print_Clock audio_wrapper_qos_xo_lat_counter_clk
  gosub Find_Print_Clock q6ss_xo_clk
  gosub Find_Print_Clock lpass_qdsp6ss_q6_core_clk
  gosub Find_Print_Clock lpass_qdsp6ss_axi_m_clk
  gosub Find_Print_Clock lpass_qdsp6ss_ldo_nmo_out
  gosub Find_Print_Clock lpass_qdsp6ss_ahb_m_clk
  gosub Find_Print_Clock lpass_qdsp6ss_ahb_s_clk
  gosub Find_Print_Clock lpass_qdsp6ss_xo_clk
  gosub Find_Print_Clock lpass_qdsp6ss_sleep_clk
  gosub Find_Print_Clock lpass_qdsp6ss_jtag_tck
  gosub Find_Print_Clock lpass_qdsp6ss_atb_clk
  gosub Find_Print_Clock lpass_qdsp6ss_apb_clk
  gosub Find_Print_Clock lpass_qdsp6ss_timestamp_clk
    &choice_handled=1
    return
  )
  if ("&choice"=="mmss_all")
  (
  gosub Find_Print_Clock camss_ahb_clk
  gosub Find_Print_Clock camss_cci_ahb_clk
  gosub Find_Print_Clock camss_cpp_ahb_clk
  gosub Find_Print_Clock camss_cpp_vbif_ahb_clk
  gosub Find_Print_Clock camss_csi0_ahb_clk
  gosub Find_Print_Clock camss_csi1_ahb_clk
  gosub Find_Print_Clock camss_csi2_ahb_clk
  gosub Find_Print_Clock camss_csi3_ahb_clk
  gosub Find_Print_Clock camss_ispif_ahb_clk
  gosub Find_Print_Clock camss_jpeg_ahb_clk
  gosub Find_Print_Clock camss_micro_ahb_clk
  gosub Find_Print_Clock camss_top_ahb_clk
  gosub Find_Print_Clock camss_vfe0_ahb_clk
  gosub Find_Print_Clock camss_vfe1_ahb_clk
  gosub Find_Print_Clock camss_vfe_ahb_clk
  gosub Find_Print_Clock fd_ahb_clk
  gosub Find_Print_Clock gpu_ahb_clk
  gosub Find_Print_Clock mdss_ahb_clk
  gosub Find_Print_Clock mdss_hdmi_ahb_clk
  gosub Find_Print_Clock mmss_bto_ahb_clk
  gosub Find_Print_Clock mmss_misc_ahb_clk
  gosub Find_Print_Clock mmss_mmagic_ahb_clk
  gosub Find_Print_Clock mmss_mmagic_cfg_ahb_clk
  gosub Find_Print_Clock mmss_rbcpr_ahb_clk
  gosub Find_Print_Clock mmss_spdm_ahb_clk
  gosub Find_Print_Clock smmu_cpp_ahb_clk
  gosub Find_Print_Clock smmu_jpeg_ahb_clk
  gosub Find_Print_Clock smmu_mdp_ahb_clk
  gosub Find_Print_Clock smmu_rot_ahb_clk
  gosub Find_Print_Clock smmu_vfe_ahb_clk
  gosub Find_Print_Clock smmu_video_ahb_clk
  gosub Find_Print_Clock throttle_camss_ahb_clk
  gosub Find_Print_Clock throttle_mdss_ahb_clk
  gosub Find_Print_Clock throttle_video_ahb_clk
  gosub Find_Print_Clock video_ahb_clk
  gosub Find_Print_Clock vmem_ahb_clk
  gosub Find_Print_Clock camss_cpp_axi_clk
  gosub Find_Print_Clock camss_jpeg_axi_clk
  gosub Find_Print_Clock camss_vfe_axi_clk
  gosub Find_Print_Clock mdss_axi_clk
  gosub Find_Print_Clock mmagic_bimc_axi_clk
  gosub Find_Print_Clock mmagic_camss_axi_clk
  gosub Find_Print_Clock mmagic_mdss_axi_clk
  gosub Find_Print_Clock mmagic_video_axi_clk
  gosub Find_Print_Clock mmss_mmagic_axi_clk
  gosub Find_Print_Clock mmss_s0_axi_clk
  gosub Find_Print_Clock mmss_spdm_axi_clk
  gosub Find_Print_Clock mmss_spdm_rm_axi_clk
  gosub Find_Print_Clock smmu_cpp_axi_clk
  gosub Find_Print_Clock smmu_jpeg_axi_clk
  gosub Find_Print_Clock smmu_mdp_axi_clk
  gosub Find_Print_Clock smmu_rot_axi_clk
  gosub Find_Print_Clock smmu_vfe_axi_clk
  gosub Find_Print_Clock smmu_video_axi_clk
  gosub Find_Print_Clock throttle_camss_axi_clk
  gosub Find_Print_Clock throttle_mdss_axi_clk
  gosub Find_Print_Clock throttle_video_axi_clk
  gosub Find_Print_Clock video_axi_clk
  gosub Find_Print_Clock mdss_byte0_clk
  gosub Find_Print_Clock mdss_byte1_clk
  gosub Find_Print_Clock camss_gp0_clk
  gosub Find_Print_Clock camss_gp1_clk
  gosub Find_Print_Clock camss_cci_clk
  gosub Find_Print_Clock mmss_sleepclk_clk
  gosub Find_Print_Clock camss_cpp_clk
  gosub Find_Print_Clock mmss_spdm_cpp_clk
  gosub Find_Print_Clock camss_csi0_clk
  gosub Find_Print_Clock camss_csi0phy_clk
  gosub Find_Print_Clock camss_csi0pix_clk
  gosub Find_Print_Clock camss_csi0rdi_clk
  gosub Find_Print_Clock mmss_spdm_csi0_clk
  gosub Find_Print_Clock camss_csi0phytimer_clk
  gosub Find_Print_Clock camss_csi1_clk
  gosub Find_Print_Clock camss_csi1phy_clk
  gosub Find_Print_Clock camss_csi1pix_clk
  gosub Find_Print_Clock camss_csi1rdi_clk
  gosub Find_Print_Clock camss_csi1phytimer_clk
  gosub Find_Print_Clock camss_csi2_clk
  gosub Find_Print_Clock camss_csi2phy_clk
  gosub Find_Print_Clock camss_csi2pix_clk
  gosub Find_Print_Clock camss_csi2rdi_clk
  gosub Find_Print_Clock camss_csi2phytimer_clk
  gosub Find_Print_Clock camss_csi3_clk
  gosub Find_Print_Clock camss_csi3phy_clk
  gosub Find_Print_Clock camss_csi3pix_clk
  gosub Find_Print_Clock camss_csi3rdi_clk
  gosub Find_Print_Clock camss_csiphy0_3p_clk
  gosub Find_Print_Clock camss_csiphy1_3p_clk
  gosub Find_Print_Clock camss_csiphy2_3p_clk
  gosub Find_Print_Clock dsa_core_clk
  gosub Find_Print_Clock mdss_edpaux_clk
  gosub Find_Print_Clock mdss_edpgtc_clk
  gosub Find_Print_Clock mdss_edplink_clk
  gosub Find_Print_Clock mdss_edppixel_clk
  gosub Find_Print_Clock mdss_esc0_clk
  gosub Find_Print_Clock mdss_esc1_clk
  gosub Find_Print_Clock mdss_extpclk_clk
  gosub Find_Print_Clock fd_core_clk
  gosub Find_Print_Clock fd_core_uar_clk
  gosub Find_Print_Clock dsa_noc_cfg_ahb_clk
  gosub Find_Print_Clock mmagic_bimc_noc_cfg_ahb_clk
  gosub Find_Print_Clock mmagic_camss_noc_cfg_ahb_clk
  gosub Find_Print_Clock mmagic_mdss_noc_cfg_ahb_clk
  gosub Find_Print_Clock mmagic_video_noc_cfg_ahb_clk
  gosub Find_Print_Clock gpu_gx_gfx3d_clk
  gosub Find_Print_Clock mmss_spdm_debug_clk
  gosub Find_Print_Clock mmss_spdm_gfx3d_clk
  gosub Find_Print_Clock mdss_hdmi_clk
  gosub Find_Print_Clock gpu_aon_isense_clk
  gosub Find_Print_Clock camss_jpeg0_clk
  gosub Find_Print_Clock mmss_spdm_jpeg0_clk
  gosub Find_Print_Clock camss_jpeg2_clk
  gosub Find_Print_Clock mmss_spdm_jpeg2_clk
  gosub Find_Print_Clock camss_jpeg_dma_clk
  gosub Find_Print_Clock mmss_spdm_jpeg_dma_clk
  gosub Find_Print_Clock mmss_mmagic_maxi_clk
  gosub Find_Print_Clock mmss_spdm_rm_maxi_clk
  gosub Find_Print_Clock video_maxi_clk
  gosub Find_Print_Clock vmem_maxi_clk
  gosub Find_Print_Clock camss_mclk0_clk
  gosub Find_Print_Clock camss_mclk1_clk
  gosub Find_Print_Clock camss_mclk2_clk
  gosub Find_Print_Clock camss_mclk3_clk
  gosub Find_Print_Clock mdss_mdp_clk
  gosub Find_Print_Clock mmss_spdm_mdp_clk
  gosub Find_Print_Clock mdss_pclk0_clk
  gosub Find_Print_Clock mmss_spdm_pclk0_clk
  gosub Find_Print_Clock mdss_pclk1_clk
  gosub Find_Print_Clock mmss_spdm_pclk1_clk
  gosub Find_Print_Clock gpu_gx_rbbmtimer_clk
  gosub Find_Print_Clock mmss_rbcpr_clk
  gosub Find_Print_Clock camss_csi_vfe0_clk
  gosub Find_Print_Clock camss_vfe0_clk
  gosub Find_Print_Clock camss_vfe0_stream_clk
  gosub Find_Print_Clock mmss_spdm_vfe0_clk
  gosub Find_Print_Clock camss_csi_vfe1_clk
  gosub Find_Print_Clock camss_vfe1_clk
  gosub Find_Print_Clock camss_vfe1_stream_clk
  gosub Find_Print_Clock mmss_spdm_vfe1_clk
  gosub Find_Print_Clock mmss_spdm_video_core_clk
  gosub Find_Print_Clock video_core_clk
  gosub Find_Print_Clock video_subcore0_clk
  gosub Find_Print_Clock video_subcore1_clk
  gosub Find_Print_Clock mdss_vsync_clk
  gosub Find_Print_Clock mmss_cxo_clk
  gosub Find_Print_Clock mmss_misc_cxo_clk
  gosub Find_Print_Clock throttle_camss_cxo_clk
  gosub Find_Print_Clock throttle_mdss_cxo_clk
  gosub Find_Print_Clock throttle_video_cxo_clk
  gosub Find_Print_Clock mmpll0_dtest
  gosub Find_Print_Clock mmpll0_enable_status
  gosub Find_Print_Clock mmpll0_lock_det
  gosub Find_Print_Clock mmpll1_dtest
  gosub Find_Print_Clock mmpll1_enable_status
  gosub Find_Print_Clock mmpll1_lock_det
  gosub Find_Print_Clock mmpll2_dtest
  gosub Find_Print_Clock mmpll2_enable_status
  gosub Find_Print_Clock mmpll2_lock_det
  gosub Find_Print_Clock mmpll3_dtest
  gosub Find_Print_Clock mmpll3_enable_status
  gosub Find_Print_Clock mmpll3_lock_det
  gosub Find_Print_Clock mmpll4_dtest
  gosub Find_Print_Clock mmpll4_enable_status
  gosub Find_Print_Clock mmpll4_lock_det
  gosub Find_Print_Clock mmpll5_dtest
  gosub Find_Print_Clock mmpll5_enable_status
  gosub Find_Print_Clock mmpll5_lock_det
  gosub Find_Print_Clock mmpll8_dtest
  gosub Find_Print_Clock mmpll8_enable_status
  gosub Find_Print_Clock mmpll8_lock_det
  gosub Find_Print_Clock mmpll9_dtest
  gosub Find_Print_Clock mmpll9_enable_status
  gosub Find_Print_Clock mmpll9_lock_det
    &choice_handled=1
    return
  )
  if ("&choice"=="mss_all")
  (
  gosub Find_Print_Clock clk_src_bit_coxm_mnd
  gosub Find_Print_Clock clk_bit_coxm
  gosub Find_Print_Clock clk_src_bus_mss_config
  gosub Find_Print_Clock clk_bus_config
  gosub Find_Print_Clock clk_bus_coxm
  gosub Find_Print_Clock clk_bus_crypto
  gosub Find_Print_Clock clk_bus_mgpi
  gosub Find_Print_Clock clk_bus_mvc
  gosub Find_Print_Clock clk_bus_nav
  gosub Find_Print_Clock clk_bus_pll_outctrl
  gosub Find_Print_Clock clk_bus_q6
  gosub Find_Print_Clock clk_bus_rbcpr
  gosub Find_Print_Clock clk_bus_rfc
  gosub Find_Print_Clock clk_bus_slave_timeout
  gosub Find_Print_Clock clk_bus_stmr
  gosub Find_Print_Clock clk_bus_uim0
  gosub Find_Print_Clock clk_bus_uim1
  gosub Find_Print_Clock clk_bus_uim2
  gosub Find_Print_Clock clk_bus_uim3
  gosub Find_Print_Clock mss_dgr_ahb_clk
  gosub Find_Print_Clock mss_dgr_freerun_ahb_clk
  gosub Find_Print_Clock clk_q6
  gosub Find_Print_Clock clk_xo
  gosub Find_Print_Clock clk_xo_mdm
  gosub Find_Print_Clock clk_xo_nav
  gosub Find_Print_Clock gpsadc_aclk_out
  gosub Find_Print_Clock clk_src_rbcpr_ref
  gosub Find_Print_Clock clk_rbcpr_ref
  gosub Find_Print_Clock clk_src_uim
  gosub Find_Print_Clock clk_card_src_uim0
  gosub Find_Print_Clock clk_card_src_uim1
  gosub Find_Print_Clock clk_card_src_uim2
  gosub Find_Print_Clock clk_card_src_uim3
  gosub Find_Print_Clock clk_src_uim0_mnd
  gosub Find_Print_Clock clk_uart_bit_uim0
  gosub Find_Print_Clock clk_src_uim1_mnd
  gosub Find_Print_Clock clk_uart_bit_uim1
  gosub Find_Print_Clock clk_src_uim2_mnd
  gosub Find_Print_Clock clk_uart_bit_uim2
  gosub Find_Print_Clock clk_src_uim3_mnd
  gosub Find_Print_Clock clk_uart_bit_uim3
  gosub Find_Print_Clock clk_mdm
  gosub Find_Print_Clock clk_nav_main
  gosub Find_Print_Clock clk_nav_adc1
  gosub Find_Print_Clock clk_nav_xo
  gosub Find_Print_Clock mss_qdsp6ss_q6_core_clk
  gosub Find_Print_Clock mss_qdsp6ss_axi_m_clk
  gosub Find_Print_Clock mss_qdsp6ss_ldo_nmo_out
  gosub Find_Print_Clock mss_qdsp6ss_ahb_m_clk
  gosub Find_Print_Clock mss_qdsp6ss_ahb_s_clk
  gosub Find_Print_Clock mss_qdsp6ss_xo_clk
  gosub Find_Print_Clock mss_qdsp6ss_sleep_clk
  gosub Find_Print_Clock mss_qdsp6ss_jtag_tck
  gosub Find_Print_Clock mss_qdsp6ss_atb_clk
  gosub Find_Print_Clock mss_qdsp6ss_apb_clk
  gosub Find_Print_Clock mss_qdsp6ss_timestamp_clk
  gosub Find_Print_Clock clk_axi_crypto
  gosub Find_Print_Clock clk_bus_pseudo_hm_rcg
  gosub Find_Print_Clock clk_xo_cx
  gosub Find_Print_Clock dbg_dtr_clksig
  gosub Find_Print_Clock dbg_modem_clksig
  gosub Find_Print_Clock dbg_nav_clksig
  gosub Find_Print_Clock dbg_q6_clksig
  gosub Find_Print_Clock dtr1_pll_dtest
  gosub Find_Print_Clock dtr1_pll_lock_det
  gosub Find_Print_Clock dtr2_pll_dtest
  gosub Find_Print_Clock dtr2_pll_lock_det
  gosub Find_Print_Clock modem_offline_pll_dtest
  gosub Find_Print_Clock mss_dgr_axi_clk
  gosub Find_Print_Clock mss_offline_pll_lock_det
  gosub Find_Print_Clock nav_pll_dtest
  gosub Find_Print_Clock nav_pll_lock_det
  gosub Find_Print_Clock q6_pll_dtest
  gosub Find_Print_Clock q6_pll_lock_det
    &choice_handled=1
    return
  )
  if ("&choice"=="ssc_all")
  (
  gosub Find_Print_Clock q6_core_clk_src
  gosub Find_Print_Clock q6_pll_ref_clk
  gosub Find_Print_Clock scc_ahb_timeout_clk
  gosub Find_Print_Clock scc_at_clk
  gosub Find_Print_Clock scc_blsp_h_clk
  gosub Find_Print_Clock scc_cfg_ahb_clk
  gosub Find_Print_Clock scc_crif_clk
  gosub Find_Print_Clock scc_csr_h_clk
  gosub Find_Print_Clock scc_data_h_clk
  gosub Find_Print_Clock scc_dbg_tsctr_clk
  gosub Find_Print_Clock scc_pclkdbg_clk
  gosub Find_Print_Clock scc_q6_ahbm_clk
  gosub Find_Print_Clock scc_q6_ahbs_clk
  gosub Find_Print_Clock scc_q6_atbm_clk
  gosub Find_Print_Clock scc_q6_spm_clk
  gosub Find_Print_Clock scc_q6_xpu2_client_clk
  gosub Find_Print_Clock scc_q6_xpu2_config_clk
  gosub Find_Print_Clock scc_qup_i2c1_clk
  gosub Find_Print_Clock scc_qup_i2c2_clk
  gosub Find_Print_Clock scc_qup_i2c3_clk
  gosub Find_Print_Clock scc_qup_spi1_clk
  gosub Find_Print_Clock scc_qup_spi2_clk
  gosub Find_Print_Clock scc_qup_spi3_clk
  gosub Find_Print_Clock scc_smem_clk
  gosub Find_Print_Clock scc_uart_dm_uart1_clk
  gosub Find_Print_Clock scc_uart_dm_uart2_clk
  gosub Find_Print_Clock scc_uart_dm_uart3_clk
  gosub Find_Print_Clock scc_100m_mux_clk_src
  gosub Find_Print_Clock scc_vs_vddcx_clk
  gosub Find_Print_Clock scc_vs_vddmx_clk
  gosub Find_Print_Clock ssc_debug_clk
  gosub Find_Print_Clock ssc_debug_mux_clk_src
  gosub Find_Print_Clock ssc_pll_lv_test
  gosub Find_Print_Clock ssc_pll_lv_test_prediv_clk_src
  gosub Find_Print_Clock ssc_qdsp6ss_q6_core_clk
  gosub Find_Print_Clock ssc_qdsp6ss_axi_m_clk
  gosub Find_Print_Clock ssc_qdsp6ss_ldo_nmo_out
  gosub Find_Print_Clock ssc_qdsp6ss_ahb_m_clk
  gosub Find_Print_Clock ssc_qdsp6ss_ahb_s_clk
  gosub Find_Print_Clock ssc_qdsp6ss_xo_clk
  gosub Find_Print_Clock ssc_qdsp6ss_sleep_clk
  gosub Find_Print_Clock ssc_qdsp6ss_jtag_tck
  gosub Find_Print_Clock ssc_qdsp6ss_atb_clk
  gosub Find_Print_Clock ssc_qdsp6ss_apb_clk
  gosub Find_Print_Clock ssc_qdsp6ss_timestamp_clk
  gosub Find_Print_Clock q6_pll_dtest
  gosub Find_Print_Clock q6_pll_lock_det
  gosub Find_Print_Clock q6ss_dbg_clk
  gosub Find_Print_Clock scc_peel_pll_lock_det
    &choice_handled=1
    return
  )

  return



;-----------------------------------------------------------------------------
; Find clocks that match what the user entered and print their information 
;-----------------------------------------------------------------------------

Find_Print_Clock:

ENTRY &clk

&clk_test=0
&clk_reg=0
&clk_reg_name=""


  ; Set appropriate access mode for APCS registers 
  &clk_access_mode="&apcs_access_mode"

  &match=0
  &wild_head=0
  &wild_tail=0
  &clk_input_length=STRING.LENGTH("&clk")
  &clk_itr_length=STRING.LENGTH("im_cbfcdiv_clk")

  if (STRING.SCAN("&clk", "*", 0)==0)
  (
    &wild_head=1
  )
  if (STRING.SCAN("&clk", "*", 1)==(STRING.LENGTH("&clk")-1))
  (
    &wild_tail=1
  )

  if ((&wild_head==1)&&(&wild_tail==1))
  (
    if (STRING.SCAN("im_cbfcdiv_clk", STRING.MID("&clk", 1, &clk_input_length-2), 0)!=-1)
    ( 
      &match=1
    )
  )
  else if (&wild_head==1)
  (
    if (STRING.MID("im_cbfcdiv_clk", &clk_itr_length-&clk_input_length+1, &clk_input_length-1)==STRING.CUT("&clk", 1))
    ( 
      &match=1
    )
  )
  else if (&wild_tail==1)
  (
    if (STRING.MID("im_cbfcdiv_clk", 0, &clk_input_length-1)==STRING.CUT("&clk", -1))
    ( 
      &match=1
    )
  )
  else if ("im_cbfcdiv_clk"=="&clk")||("buses"=="&clk")
  (
    &match=1
  )
  
  if (&match==1)
  (
    &clk_test=&CLK_TEST_IM_CBFCDIV_CLK
    &clk_reg=0
    &clk_reg_name="No CBCR"
    &clk_name="im_cbfcdiv_clk"
    &clk_reg_cbcr_type=""
    &clk_vote_bit=-1.
    &clk_multiplier=1.

    gosub Print_Clk_Info_Line
  )

  &match=0
  &wild_head=0
  &wild_tail=0
  &clk_input_length=STRING.LENGTH("&clk")
  &clk_itr_length=STRING.LENGTH("apc0_leaf_clk")

  if (STRING.SCAN("&clk", "*", 0)==0)
  (
    &wild_head=1
  )
  if (STRING.SCAN("&clk", "*", 1)==(STRING.LENGTH("&clk")-1))
  (
    &wild_tail=1
  )

  if ((&wild_head==1)&&(&wild_tail==1))
  (
    if (STRING.SCAN("apc0_leaf_clk", STRING.MID("&clk", 1, &clk_input_length-2), 0)!=-1)
    ( 
      &match=1
    )
  )
  else if (&wild_head==1)
  (
    if (STRING.MID("apc0_leaf_clk", &clk_itr_length-&clk_input_length+1, &clk_input_length-1)==STRING.CUT("&clk", 1))
    ( 
      &match=1
    )
  )
  else if (&wild_tail==1)
  (
    if (STRING.MID("apc0_leaf_clk", 0, &clk_input_length-1)==STRING.CUT("&clk", -1))
    ( 
      &match=1
    )
  )
  else if ("apc0_leaf_clk"=="&clk")||("cpus"=="&clk")
  (
    &match=1
  )
  
  if (&match==1)
  (
    &clk_test=&CLK_TEST_APC0_LEAF_CLK
    &clk_reg=0
    &clk_reg_name="No CBCR"
    &clk_name="apc0_leaf_clk"
    &clk_reg_cbcr_type=""
    &clk_vote_bit=-1.
    &clk_multiplier=16.

    gosub Print_Clk_Info_Line
  )

  &match=0
  &wild_head=0
  &wild_tail=0
  &clk_input_length=STRING.LENGTH("&clk")
  &clk_itr_length=STRING.LENGTH("apc1_leaf_clk")

  if (STRING.SCAN("&clk", "*", 0)==0)
  (
    &wild_head=1
  )
  if (STRING.SCAN("&clk", "*", 1)==(STRING.LENGTH("&clk")-1))
  (
    &wild_tail=1
  )

  if ((&wild_head==1)&&(&wild_tail==1))
  (
    if (STRING.SCAN("apc1_leaf_clk", STRING.MID("&clk", 1, &clk_input_length-2), 0)!=-1)
    ( 
      &match=1
    )
  )
  else if (&wild_head==1)
  (
    if (STRING.MID("apc1_leaf_clk", &clk_itr_length-&clk_input_length+1, &clk_input_length-1)==STRING.CUT("&clk", 1))
    ( 
      &match=1
    )
  )
  else if (&wild_tail==1)
  (
    if (STRING.MID("apc1_leaf_clk", 0, &clk_input_length-1)==STRING.CUT("&clk", -1))
    ( 
      &match=1
    )
  )
  else if ("apc1_leaf_clk"=="&clk")||("cpus"=="&clk")
  (
    &match=1
  )
  
  if (&match==1)
  (
    &clk_test=&CLK_TEST_APC1_LEAF_CLK
    &clk_reg=0
    &clk_reg_name="No CBCR"
    &clk_name="apc1_leaf_clk"
    &clk_reg_cbcr_type=""
    &clk_vote_bit=-1.
    &clk_multiplier=16.

    gosub Print_Clk_Info_Line
  )

  &match=0
  &wild_head=0
  &wild_tail=0
  &clk_input_length=STRING.LENGTH("&clk")
  &clk_itr_length=STRING.LENGTH("sys_apcsqsbslv_clk")

  if (STRING.SCAN("&clk", "*", 0)==0)
  (
    &wild_head=1
  )
  if (STRING.SCAN("&clk", "*", 1)==(STRING.LENGTH("&clk")-1))
  (
    &wild_tail=1
  )

  if ((&wild_head==1)&&(&wild_tail==1))
  (
    if (STRING.SCAN("sys_apcsqsbslv_clk", STRING.MID("&clk", 1, &clk_input_length-2), 0)!=-1)
    ( 
      &match=1
    )
  )
  else if (&wild_head==1)
  (
    if (STRING.MID("sys_apcsqsbslv_clk", &clk_itr_length-&clk_input_length+1, &clk_input_length-1)==STRING.CUT("&clk", 1))
    ( 
      &match=1
    )
  )
  else if (&wild_tail==1)
  (
    if (STRING.MID("sys_apcsqsbslv_clk", 0, &clk_input_length-1)==STRING.CUT("&clk", -1))
    ( 
      &match=1
    )
  )
  else if ("sys_apcsqsbslv_clk"=="&clk")
  (
    &match=1
  )
  
  if (&match==1)
  (
    &clk_test=&CLK_TEST_SYS_APCSQSBSLV_CLK
    &clk_reg=0
    &clk_reg_name="No CBCR"
    &clk_name="sys_apcsqsbslv_clk"
    &clk_reg_cbcr_type=""
    &clk_vote_bit=-1.
    &clk_multiplier=1.

    gosub Print_Clk_Info_Line
  )

  &match=0
  &wild_head=0
  &wild_tail=0
  &clk_input_length=STRING.LENGTH("&clk")
  &clk_itr_length=STRING.LENGTH("sys_apcsqsbmstr_clk")

  if (STRING.SCAN("&clk", "*", 0)==0)
  (
    &wild_head=1
  )
  if (STRING.SCAN("&clk", "*", 1)==(STRING.LENGTH("&clk")-1))
  (
    &wild_tail=1
  )

  if ((&wild_head==1)&&(&wild_tail==1))
  (
    if (STRING.SCAN("sys_apcsqsbmstr_clk", STRING.MID("&clk", 1, &clk_input_length-2), 0)!=-1)
    ( 
      &match=1
    )
  )
  else if (&wild_head==1)
  (
    if (STRING.MID("sys_apcsqsbmstr_clk", &clk_itr_length-&clk_input_length+1, &clk_input_length-1)==STRING.CUT("&clk", 1))
    ( 
      &match=1
    )
  )
  else if (&wild_tail==1)
  (
    if (STRING.MID("sys_apcsqsbmstr_clk", 0, &clk_input_length-1)==STRING.CUT("&clk", -1))
    ( 
      &match=1
    )
  )
  else if ("sys_apcsqsbmstr_clk"=="&clk")
  (
    &match=1
  )
  
  if (&match==1)
  (
    &clk_test=&CLK_TEST_SYS_APCSQSBMSTR_CLK
    &clk_reg=0
    &clk_reg_name="No CBCR"
    &clk_name="sys_apcsqsbmstr_clk"
    &clk_reg_cbcr_type=""
    &clk_vote_bit=-1.
    &clk_multiplier=1.

    gosub Print_Clk_Info_Line
  )

  &match=0
  &wild_head=0
  &wild_tail=0
  &clk_input_length=STRING.LENGTH("&clk")
  &clk_itr_length=STRING.LENGTH("sys_apcsahb_clk")

  if (STRING.SCAN("&clk", "*", 0)==0)
  (
    &wild_head=1
  )
  if (STRING.SCAN("&clk", "*", 1)==(STRING.LENGTH("&clk")-1))
  (
    &wild_tail=1
  )

  if ((&wild_head==1)&&(&wild_tail==1))
  (
    if (STRING.SCAN("sys_apcsahb_clk", STRING.MID("&clk", 1, &clk_input_length-2), 0)!=-1)
    ( 
      &match=1
    )
  )
  else if (&wild_head==1)
  (
    if (STRING.MID("sys_apcsahb_clk", &clk_itr_length-&clk_input_length+1, &clk_input_length-1)==STRING.CUT("&clk", 1))
    ( 
      &match=1
    )
  )
  else if (&wild_tail==1)
  (
    if (STRING.MID("sys_apcsahb_clk", 0, &clk_input_length-1)==STRING.CUT("&clk", -1))
    ( 
      &match=1
    )
  )
  else if ("sys_apcsahb_clk"=="&clk")
  (
    &match=1
  )
  
  if (&match==1)
  (
    &clk_test=&CLK_TEST_SYS_APCSAHB_CLK
    &clk_reg=0
    &clk_reg_name="No CBCR"
    &clk_name="sys_apcsahb_clk"
    &clk_reg_cbcr_type=""
    &clk_vote_bit=-1.
    &clk_multiplier=1.

    gosub Print_Clk_Info_Line
  )

  &match=0
  &wild_head=0
  &wild_tail=0
  &clk_input_length=STRING.LENGTH("&clk")
  &clk_itr_length=STRING.LENGTH("atb_apcs_clk")

  if (STRING.SCAN("&clk", "*", 0)==0)
  (
    &wild_head=1
  )
  if (STRING.SCAN("&clk", "*", 1)==(STRING.LENGTH("&clk")-1))
  (
    &wild_tail=1
  )

  if ((&wild_head==1)&&(&wild_tail==1))
  (
    if (STRING.SCAN("atb_apcs_clk", STRING.MID("&clk", 1, &clk_input_length-2), 0)!=-1)
    ( 
      &match=1
    )
  )
  else if (&wild_head==1)
  (
    if (STRING.MID("atb_apcs_clk", &clk_itr_length-&clk_input_length+1, &clk_input_length-1)==STRING.CUT("&clk", 1))
    ( 
      &match=1
    )
  )
  else if (&wild_tail==1)
  (
    if (STRING.MID("atb_apcs_clk", 0, &clk_input_length-1)==STRING.CUT("&clk", -1))
    ( 
      &match=1
    )
  )
  else if ("atb_apcs_clk"=="&clk")
  (
    &match=1
  )
  
  if (&match==1)
  (
    &clk_test=&CLK_TEST_ATB_APCS_CLK
    &clk_reg=0
    &clk_reg_name="No CBCR"
    &clk_name="atb_apcs_clk"
    &clk_reg_cbcr_type=""
    &clk_vote_bit=-1.
    &clk_multiplier=1.

    gosub Print_Clk_Info_Line
  )

  &match=0
  &wild_head=0
  &wild_tail=0
  &clk_input_length=STRING.LENGTH("&clk")
  &clk_itr_length=STRING.LENGTH("apb_apcsdbg_clk")

  if (STRING.SCAN("&clk", "*", 0)==0)
  (
    &wild_head=1
  )
  if (STRING.SCAN("&clk", "*", 1)==(STRING.LENGTH("&clk")-1))
  (
    &wild_tail=1
  )

  if ((&wild_head==1)&&(&wild_tail==1))
  (
    if (STRING.SCAN("apb_apcsdbg_clk", STRING.MID("&clk", 1, &clk_input_length-2), 0)!=-1)
    ( 
      &match=1
    )
  )
  else if (&wild_head==1)
  (
    if (STRING.MID("apb_apcsdbg_clk", &clk_itr_length-&clk_input_length+1, &clk_input_length-1)==STRING.CUT("&clk", 1))
    ( 
      &match=1
    )
  )
  else if (&wild_tail==1)
  (
    if (STRING.MID("apb_apcsdbg_clk", 0, &clk_input_length-1)==STRING.CUT("&clk", -1))
    ( 
      &match=1
    )
  )
  else if ("apb_apcsdbg_clk"=="&clk")
  (
    &match=1
  )
  
  if (&match==1)
  (
    &clk_test=&CLK_TEST_APB_APCSDBG_CLK
    &clk_reg=0
    &clk_reg_name="No CBCR"
    &clk_name="apb_apcsdbg_clk"
    &clk_reg_cbcr_type=""
    &clk_vote_bit=-1.
    &clk_multiplier=1.

    gosub Print_Clk_Info_Line
  )

  &match=0
  &wild_head=0
  &wild_tail=0
  &clk_input_length=STRING.LENGTH("&clk")
  &clk_itr_length=STRING.LENGTH("im_refroot_clk")

  if (STRING.SCAN("&clk", "*", 0)==0)
  (
    &wild_head=1
  )
  if (STRING.SCAN("&clk", "*", 1)==(STRING.LENGTH("&clk")-1))
  (
    &wild_tail=1
  )

  if ((&wild_head==1)&&(&wild_tail==1))
  (
    if (STRING.SCAN("im_refroot_clk", STRING.MID("&clk", 1, &clk_input_length-2), 0)!=-1)
    ( 
      &match=1
    )
  )
  else if (&wild_head==1)
  (
    if (STRING.MID("im_refroot_clk", &clk_itr_length-&clk_input_length+1, &clk_input_length-1)==STRING.CUT("&clk", 1))
    ( 
      &match=1
    )
  )
  else if (&wild_tail==1)
  (
    if (STRING.MID("im_refroot_clk", 0, &clk_input_length-1)==STRING.CUT("&clk", -1))
    ( 
      &match=1
    )
  )
  else if ("im_refroot_clk"=="&clk")
  (
    &match=1
  )
  
  if (&match==1)
  (
    &clk_test=&CLK_TEST_IM_REFROOT_CLK
    &clk_reg=0
    &clk_reg_name="No CBCR"
    &clk_name="im_refroot_clk"
    &clk_reg_cbcr_type=""
    &clk_vote_bit=-1.
    &clk_multiplier=1.

    gosub Print_Clk_Info_Line
  )

  &match=0
  &wild_head=0
  &wild_tail=0
  &clk_input_length=STRING.LENGTH("&clk")
  &clk_itr_length=STRING.LENGTH("im_ref_clk")

  if (STRING.SCAN("&clk", "*", 0)==0)
  (
    &wild_head=1
  )
  if (STRING.SCAN("&clk", "*", 1)==(STRING.LENGTH("&clk")-1))
  (
    &wild_tail=1
  )

  if ((&wild_head==1)&&(&wild_tail==1))
  (
    if (STRING.SCAN("im_ref_clk", STRING.MID("&clk", 1, &clk_input_length-2), 0)!=-1)
    ( 
      &match=1
    )
  )
  else if (&wild_head==1)
  (
    if (STRING.MID("im_ref_clk", &clk_itr_length-&clk_input_length+1, &clk_input_length-1)==STRING.CUT("&clk", 1))
    ( 
      &match=1
    )
  )
  else if (&wild_tail==1)
  (
    if (STRING.MID("im_ref_clk", 0, &clk_input_length-1)==STRING.CUT("&clk", -1))
    ( 
      &match=1
    )
  )
  else if ("im_ref_clk"=="&clk")
  (
    &match=1
  )
  
  if (&match==1)
  (
    &clk_test=&CLK_TEST_IM_REF_CLK
    &clk_reg=0
    &clk_reg_name="No CBCR"
    &clk_name="im_ref_clk"
    &clk_reg_cbcr_type=""
    &clk_vote_bit=-1.
    &clk_multiplier=1.

    gosub Print_Clk_Info_Line
  )

  &match=0
  &wild_head=0
  &wild_tail=0
  &clk_input_length=STRING.LENGTH("&clk")
  &clk_itr_length=STRING.LENGTH("im_sleep_clk")

  if (STRING.SCAN("&clk", "*", 0)==0)
  (
    &wild_head=1
  )
  if (STRING.SCAN("&clk", "*", 1)==(STRING.LENGTH("&clk")-1))
  (
    &wild_tail=1
  )

  if ((&wild_head==1)&&(&wild_tail==1))
  (
    if (STRING.SCAN("im_sleep_clk", STRING.MID("&clk", 1, &clk_input_length-2), 0)!=-1)
    ( 
      &match=1
    )
  )
  else if (&wild_head==1)
  (
    if (STRING.MID("im_sleep_clk", &clk_itr_length-&clk_input_length+1, &clk_input_length-1)==STRING.CUT("&clk", 1))
    ( 
      &match=1
    )
  )
  else if (&wild_tail==1)
  (
    if (STRING.MID("im_sleep_clk", 0, &clk_input_length-1)==STRING.CUT("&clk", -1))
    ( 
      &match=1
    )
  )
  else if ("im_sleep_clk"=="&clk")
  (
    &match=1
  )
  
  if (&match==1)
  (
    &clk_test=&CLK_TEST_IM_SLEEP_CLK
    &clk_reg=0
    &clk_reg_name="No CBCR"
    &clk_name="im_sleep_clk"
    &clk_reg_cbcr_type=""
    &clk_vote_bit=-1.
    &clk_multiplier=1.

    gosub Print_Clk_Info_Line
  )


  ; Set appropriate access mode for GCC registers 
  &clk_access_mode="&gcc_access_mode"

  &match=0
  &wild_head=0
  &wild_tail=0
  &clk_input_length=STRING.LENGTH("&clk")
  &clk_itr_length=STRING.LENGTH("gcc_sec_ctrl_acc_clk")

  if (STRING.SCAN("&clk", "*", 0)==0)
  (
    &wild_head=1
  )
  if (STRING.SCAN("&clk", "*", 1)==(STRING.LENGTH("&clk")-1))
  (
    &wild_tail=1
  )

  if ((&wild_head==1)&&(&wild_tail==1))
  (
    if (STRING.SCAN("gcc_sec_ctrl_acc_clk", STRING.MID("&clk", 1, &clk_input_length-2), 0)!=-1)
    ( 
      &match=1
    )
  )
  else if (&wild_head==1)
  (
    if (STRING.MID("gcc_sec_ctrl_acc_clk", &clk_itr_length-&clk_input_length+1, &clk_input_length-1)==STRING.CUT("&clk", 1))
    ( 
      &match=1
    )
  )
  else if (&wild_tail==1)
  (
    if (STRING.MID("gcc_sec_ctrl_acc_clk", 0, &clk_input_length-1)==STRING.CUT("&clk", -1))
    ( 
      &match=1
    )
  )
  else if ("gcc_sec_ctrl_acc_clk"=="&clk")
  (
    &match=1
  )
  
  if (&match==1)
  (
    &clk_test=&CLK_TEST_GCC_SEC_CTRL_ACC_CLK
    &clk_reg=&HWIO_GCC_SEC_CTRL_ACC_CBCR_ADDR
    &clk_reg_name="GCC_SEC_CTRL_ACC_CBCR"
    &clk_name="gcc_sec_ctrl_acc_clk"
    &clk_reg_cbcr_type="sm_pscbc"
    &clk_vote_bit=-1.
    &clk_multiplier=1.

    gosub Print_Clk_Info_Line
  )

  &match=0
  &wild_head=0
  &wild_tail=0
  &clk_input_length=STRING.LENGTH("&clk")
  &clk_itr_length=STRING.LENGTH("gcc_bimc_clk")

  if (STRING.SCAN("&clk", "*", 0)==0)
  (
    &wild_head=1
  )
  if (STRING.SCAN("&clk", "*", 1)==(STRING.LENGTH("&clk")-1))
  (
    &wild_tail=1
  )

  if ((&wild_head==1)&&(&wild_tail==1))
  (
    if (STRING.SCAN("gcc_bimc_clk", STRING.MID("&clk", 1, &clk_input_length-2), 0)!=-1)
    ( 
      &match=1
    )
  )
  else if (&wild_head==1)
  (
    if (STRING.MID("gcc_bimc_clk", &clk_itr_length-&clk_input_length+1, &clk_input_length-1)==STRING.CUT("&clk", 1))
    ( 
      &match=1
    )
  )
  else if (&wild_tail==1)
  (
    if (STRING.MID("gcc_bimc_clk", 0, &clk_input_length-1)==STRING.CUT("&clk", -1))
    ( 
      &match=1
    )
  )
  else if ("gcc_bimc_clk"=="&clk")||("buses"=="&clk")
  (
    &match=1
  )
  
  if (&match==1)
  (
    &clk_test=&CLK_TEST_GCC_BIMC_CLK
    &clk_reg=&HWIO_GCC_BIMC_CBCR_ADDR
    &clk_reg_name="GCC_BIMC_CBCR"
    &clk_name="gcc_bimc_clk"
    &clk_reg_cbcr_type="sm_cbc"
    &clk_vote_bit=-1.
    &clk_multiplier=1.

    gosub Print_Clk_Info_Line
  )

  &match=0
  &wild_head=0
  &wild_tail=0
  &clk_input_length=STRING.LENGTH("&clk")
  &clk_itr_length=STRING.LENGTH("gcc_spdm_bimc_cy_clk")

  if (STRING.SCAN("&clk", "*", 0)==0)
  (
    &wild_head=1
  )
  if (STRING.SCAN("&clk", "*", 1)==(STRING.LENGTH("&clk")-1))
  (
    &wild_tail=1
  )

  if ((&wild_head==1)&&(&wild_tail==1))
  (
    if (STRING.SCAN("gcc_spdm_bimc_cy_clk", STRING.MID("&clk", 1, &clk_input_length-2), 0)!=-1)
    ( 
      &match=1
    )
  )
  else if (&wild_head==1)
  (
    if (STRING.MID("gcc_spdm_bimc_cy_clk", &clk_itr_length-&clk_input_length+1, &clk_input_length-1)==STRING.CUT("&clk", 1))
    ( 
      &match=1
    )
  )
  else if (&wild_tail==1)
  (
    if (STRING.MID("gcc_spdm_bimc_cy_clk", 0, &clk_input_length-1)==STRING.CUT("&clk", -1))
    ( 
      &match=1
    )
  )
  else if ("gcc_spdm_bimc_cy_clk"=="&clk")
  (
    &match=1
  )
  
  if (&match==1)
  (
    &clk_test=&CLK_TEST_GCC_SPDM_BIMC_CY_CLK
    &clk_reg=&HWIO_GCC_SPDM_BIMC_CY_CBCR_ADDR
    &clk_reg_name="GCC_SPDM_BIMC_CY_CBCR"
    &clk_name="gcc_spdm_bimc_cy_clk"
    &clk_reg_cbcr_type="sm_cbc"
    &clk_vote_bit=-1.
    &clk_multiplier=1.

    gosub Print_Clk_Info_Line
  )

  &match=0
  &wild_head=0
  &wild_tail=0
  &clk_input_length=STRING.LENGTH("&clk")
  &clk_itr_length=STRING.LENGTH("gcc_bimc_ddr_ch0_clk")

  if (STRING.SCAN("&clk", "*", 0)==0)
  (
    &wild_head=1
  )
  if (STRING.SCAN("&clk", "*", 1)==(STRING.LENGTH("&clk")-1))
  (
    &wild_tail=1
  )

  if ((&wild_head==1)&&(&wild_tail==1))
  (
    if (STRING.SCAN("gcc_bimc_ddr_ch0_clk", STRING.MID("&clk", 1, &clk_input_length-2), 0)!=-1)
    ( 
      &match=1
    )
  )
  else if (&wild_head==1)
  (
    if (STRING.MID("gcc_bimc_ddr_ch0_clk", &clk_itr_length-&clk_input_length+1, &clk_input_length-1)==STRING.CUT("&clk", 1))
    ( 
      &match=1
    )
  )
  else if (&wild_tail==1)
  (
    if (STRING.MID("gcc_bimc_ddr_ch0_clk", 0, &clk_input_length-1)==STRING.CUT("&clk", -1))
    ( 
      &match=1
    )
  )
  else if ("gcc_bimc_ddr_ch0_clk"=="&clk")
  (
    &match=1
  )
  
  if (&match==1)
  (
    &clk_test=&CLK_TEST_GCC_BIMC_DDR_CH0_CLK
    &clk_reg=&HWIO_GCC_BIMC_DDR_CH0_CBCR_ADDR
    &clk_reg_name="GCC_BIMC_DDR_CH0_CBCR"
    &clk_name="gcc_bimc_ddr_ch0_clk"
    &clk_reg_cbcr_type="sm_pscbc"
    &clk_vote_bit=-1.
    &clk_multiplier=1.

    gosub Print_Clk_Info_Line
  )

  &match=0
  &wild_head=0
  &wild_tail=0
  &clk_input_length=STRING.LENGTH("&clk")
  &clk_itr_length=STRING.LENGTH("gcc_bimc_ddr_ch1_clk")

  if (STRING.SCAN("&clk", "*", 0)==0)
  (
    &wild_head=1
  )
  if (STRING.SCAN("&clk", "*", 1)==(STRING.LENGTH("&clk")-1))
  (
    &wild_tail=1
  )

  if ((&wild_head==1)&&(&wild_tail==1))
  (
    if (STRING.SCAN("gcc_bimc_ddr_ch1_clk", STRING.MID("&clk", 1, &clk_input_length-2), 0)!=-1)
    ( 
      &match=1
    )
  )
  else if (&wild_head==1)
  (
    if (STRING.MID("gcc_bimc_ddr_ch1_clk", &clk_itr_length-&clk_input_length+1, &clk_input_length-1)==STRING.CUT("&clk", 1))
    ( 
      &match=1
    )
  )
  else if (&wild_tail==1)
  (
    if (STRING.MID("gcc_bimc_ddr_ch1_clk", 0, &clk_input_length-1)==STRING.CUT("&clk", -1))
    ( 
      &match=1
    )
  )
  else if ("gcc_bimc_ddr_ch1_clk"=="&clk")
  (
    &match=1
  )
  
  if (&match==1)
  (
    &clk_test=&CLK_TEST_GCC_BIMC_DDR_CH1_CLK
    &clk_reg=&HWIO_GCC_BIMC_DDR_CH1_CBCR_ADDR
    &clk_reg_name="GCC_BIMC_DDR_CH1_CBCR"
    &clk_name="gcc_bimc_ddr_ch1_clk"
    &clk_reg_cbcr_type="sm_pscbc"
    &clk_vote_bit=-1.
    &clk_multiplier=1.

    gosub Print_Clk_Info_Line
  )

  &match=0
  &wild_head=0
  &wild_tail=0
  &clk_input_length=STRING.LENGTH("&clk")
  &clk_itr_length=STRING.LENGTH("gcc_bimc_ddr_cpll0_clk")

  if (STRING.SCAN("&clk", "*", 0)==0)
  (
    &wild_head=1
  )
  if (STRING.SCAN("&clk", "*", 1)==(STRING.LENGTH("&clk")-1))
  (
    &wild_tail=1
  )

  if ((&wild_head==1)&&(&wild_tail==1))
  (
    if (STRING.SCAN("gcc_bimc_ddr_cpll0_clk", STRING.MID("&clk", 1, &clk_input_length-2), 0)!=-1)
    ( 
      &match=1
    )
  )
  else if (&wild_head==1)
  (
    if (STRING.MID("gcc_bimc_ddr_cpll0_clk", &clk_itr_length-&clk_input_length+1, &clk_input_length-1)==STRING.CUT("&clk", 1))
    ( 
      &match=1
    )
  )
  else if (&wild_tail==1)
  (
    if (STRING.MID("gcc_bimc_ddr_cpll0_clk", 0, &clk_input_length-1)==STRING.CUT("&clk", -1))
    ( 
      &match=1
    )
  )
  else if ("gcc_bimc_ddr_cpll0_clk"=="&clk")
  (
    &match=1
  )
  
  if (&match==1)
  (
    &clk_test=&CLK_TEST_GCC_BIMC_DDR_CPLL0_CLK
    &clk_reg=&HWIO_GCC_BIMC_DDR_CPLL0_CBCR_ADDR
    &clk_reg_name="GCC_BIMC_DDR_CPLL0_CBCR"
    &clk_name="gcc_bimc_ddr_cpll0_clk"
    &clk_reg_cbcr_type="sm_cbc"
    &clk_vote_bit=-1.
    &clk_multiplier=1.

    gosub Print_Clk_Info_Line
  )

  &match=0
  &wild_head=0
  &wild_tail=0
  &clk_input_length=STRING.LENGTH("&clk")
  &clk_itr_length=STRING.LENGTH("gcc_bimc_ddr_cpll1_clk")

  if (STRING.SCAN("&clk", "*", 0)==0)
  (
    &wild_head=1
  )
  if (STRING.SCAN("&clk", "*", 1)==(STRING.LENGTH("&clk")-1))
  (
    &wild_tail=1
  )

  if ((&wild_head==1)&&(&wild_tail==1))
  (
    if (STRING.SCAN("gcc_bimc_ddr_cpll1_clk", STRING.MID("&clk", 1, &clk_input_length-2), 0)!=-1)
    ( 
      &match=1
    )
  )
  else if (&wild_head==1)
  (
    if (STRING.MID("gcc_bimc_ddr_cpll1_clk", &clk_itr_length-&clk_input_length+1, &clk_input_length-1)==STRING.CUT("&clk", 1))
    ( 
      &match=1
    )
  )
  else if (&wild_tail==1)
  (
    if (STRING.MID("gcc_bimc_ddr_cpll1_clk", 0, &clk_input_length-1)==STRING.CUT("&clk", -1))
    ( 
      &match=1
    )
  )
  else if ("gcc_bimc_ddr_cpll1_clk"=="&clk")
  (
    &match=1
  )
  
  if (&match==1)
  (
    &clk_test=&CLK_TEST_GCC_BIMC_DDR_CPLL1_CLK
    &clk_reg=&HWIO_GCC_BIMC_DDR_CPLL1_CBCR_ADDR
    &clk_reg_name="GCC_BIMC_DDR_CPLL1_CBCR"
    &clk_name="gcc_bimc_ddr_cpll1_clk"
    &clk_reg_cbcr_type="sm_cbc"
    &clk_vote_bit=-1.
    &clk_multiplier=1.

    gosub Print_Clk_Info_Line
  )

  &match=0
  &wild_head=0
  &wild_tail=0
  &clk_input_length=STRING.LENGTH("&clk")
  &clk_itr_length=STRING.LENGTH("gcc_bimc_xo_clk")

  if (STRING.SCAN("&clk", "*", 0)==0)
  (
    &wild_head=1
  )
  if (STRING.SCAN("&clk", "*", 1)==(STRING.LENGTH("&clk")-1))
  (
    &wild_tail=1
  )

  if ((&wild_head==1)&&(&wild_tail==1))
  (
    if (STRING.SCAN("gcc_bimc_xo_clk", STRING.MID("&clk", 1, &clk_input_length-2), 0)!=-1)
    ( 
      &match=1
    )
  )
  else if (&wild_head==1)
  (
    if (STRING.MID("gcc_bimc_xo_clk", &clk_itr_length-&clk_input_length+1, &clk_input_length-1)==STRING.CUT("&clk", 1))
    ( 
      &match=1
    )
  )
  else if (&wild_tail==1)
  (
    if (STRING.MID("gcc_bimc_xo_clk", 0, &clk_input_length-1)==STRING.CUT("&clk", -1))
    ( 
      &match=1
    )
  )
  else if ("gcc_bimc_xo_clk"=="&clk")
  (
    &match=1
  )
  
  if (&match==1)
  (
    &clk_test=&CLK_TEST_GCC_BIMC_XO_CLK
    &clk_reg=&HWIO_GCC_BIMC_XO_CBCR_ADDR
    &clk_reg_name="GCC_BIMC_XO_CBCR"
    &clk_name="gcc_bimc_xo_clk"
    &clk_reg_cbcr_type="sm_cbc"
    &clk_vote_bit=-1.
    &clk_multiplier=1.

    gosub Print_Clk_Info_Line
  )

  &match=0
  &wild_head=0
  &wild_tail=0
  &clk_input_length=STRING.LENGTH("&clk")
  &clk_itr_length=STRING.LENGTH("gcc_cfg_noc_ddr_cfg_clk")

  if (STRING.SCAN("&clk", "*", 0)==0)
  (
    &wild_head=1
  )
  if (STRING.SCAN("&clk", "*", 1)==(STRING.LENGTH("&clk")-1))
  (
    &wild_tail=1
  )

  if ((&wild_head==1)&&(&wild_tail==1))
  (
    if (STRING.SCAN("gcc_cfg_noc_ddr_cfg_clk", STRING.MID("&clk", 1, &clk_input_length-2), 0)!=-1)
    ( 
      &match=1
    )
  )
  else if (&wild_head==1)
  (
    if (STRING.MID("gcc_cfg_noc_ddr_cfg_clk", &clk_itr_length-&clk_input_length+1, &clk_input_length-1)==STRING.CUT("&clk", 1))
    ( 
      &match=1
    )
  )
  else if (&wild_tail==1)
  (
    if (STRING.MID("gcc_cfg_noc_ddr_cfg_clk", 0, &clk_input_length-1)==STRING.CUT("&clk", -1))
    ( 
      &match=1
    )
  )
  else if ("gcc_cfg_noc_ddr_cfg_clk"=="&clk")
  (
    &match=1
  )
  
  if (&match==1)
  (
    &clk_test=&CLK_TEST_GCC_CFG_NOC_DDR_CFG_CLK
    &clk_reg=&HWIO_GCC_CFG_NOC_DDR_CFG_CBCR_ADDR
    &clk_reg_name="GCC_CFG_NOC_DDR_CFG_CBCR"
    &clk_name="gcc_cfg_noc_ddr_cfg_clk"
    &clk_reg_cbcr_type="sm_cbc"
    &clk_vote_bit=-1.
    &clk_multiplier=1.

    gosub Print_Clk_Info_Line
  )

  &match=0
  &wild_head=0
  &wild_tail=0
  &clk_input_length=STRING.LENGTH("&clk")
  &clk_itr_length=STRING.LENGTH("gcc_cnoc_bus_timeout5_ahb_clk")

  if (STRING.SCAN("&clk", "*", 0)==0)
  (
    &wild_head=1
  )
  if (STRING.SCAN("&clk", "*", 1)==(STRING.LENGTH("&clk")-1))
  (
    &wild_tail=1
  )

  if ((&wild_head==1)&&(&wild_tail==1))
  (
    if (STRING.SCAN("gcc_cnoc_bus_timeout5_ahb_clk", STRING.MID("&clk", 1, &clk_input_length-2), 0)!=-1)
    ( 
      &match=1
    )
  )
  else if (&wild_head==1)
  (
    if (STRING.MID("gcc_cnoc_bus_timeout5_ahb_clk", &clk_itr_length-&clk_input_length+1, &clk_input_length-1)==STRING.CUT("&clk", 1))
    ( 
      &match=1
    )
  )
  else if (&wild_tail==1)
  (
    if (STRING.MID("gcc_cnoc_bus_timeout5_ahb_clk", 0, &clk_input_length-1)==STRING.CUT("&clk", -1))
    ( 
      &match=1
    )
  )
  else if ("gcc_cnoc_bus_timeout5_ahb_clk"=="&clk")
  (
    &match=1
  )
  
  if (&match==1)
  (
    &clk_test=&CLK_TEST_GCC_CNOC_BUS_TIMEOUT5_AHB_CLK
    &clk_reg=&HWIO_GCC_CNOC_BUS_TIMEOUT5_AHB_CBCR_ADDR
    &clk_reg_name="GCC_CNOC_BUS_TIMEOUT5_AHB_CBCR"
    &clk_name="gcc_cnoc_bus_timeout5_ahb_clk"
    &clk_reg_cbcr_type="sm_cbc"
    &clk_vote_bit=-1.
    &clk_multiplier=1.

    gosub Print_Clk_Info_Line
  )

  &match=0
  &wild_head=0
  &wild_tail=0
  &clk_input_length=STRING.LENGTH("&clk")
  &clk_itr_length=STRING.LENGTH("gcc_ddr_dim_cfg_clk")

  if (STRING.SCAN("&clk", "*", 0)==0)
  (
    &wild_head=1
  )
  if (STRING.SCAN("&clk", "*", 1)==(STRING.LENGTH("&clk")-1))
  (
    &wild_tail=1
  )

  if ((&wild_head==1)&&(&wild_tail==1))
  (
    if (STRING.SCAN("gcc_ddr_dim_cfg_clk", STRING.MID("&clk", 1, &clk_input_length-2), 0)!=-1)
    ( 
      &match=1
    )
  )
  else if (&wild_head==1)
  (
    if (STRING.MID("gcc_ddr_dim_cfg_clk", &clk_itr_length-&clk_input_length+1, &clk_input_length-1)==STRING.CUT("&clk", 1))
    ( 
      &match=1
    )
  )
  else if (&wild_tail==1)
  (
    if (STRING.MID("gcc_ddr_dim_cfg_clk", 0, &clk_input_length-1)==STRING.CUT("&clk", -1))
    ( 
      &match=1
    )
  )
  else if ("gcc_ddr_dim_cfg_clk"=="&clk")
  (
    &match=1
  )
  
  if (&match==1)
  (
    &clk_test=&CLK_TEST_GCC_DDR_DIM_CFG_CLK
    &clk_reg=&HWIO_GCC_DDR_DIM_CFG_CBCR_ADDR
    &clk_reg_name="GCC_DDR_DIM_CFG_CBCR"
    &clk_name="gcc_ddr_dim_cfg_clk"
    &clk_reg_cbcr_type="sm_cbc"
    &clk_vote_bit=-1.
    &clk_multiplier=1.

    gosub Print_Clk_Info_Line
  )

  &match=0
  &wild_head=0
  &wild_tail=0
  &clk_input_length=STRING.LENGTH("&clk")
  &clk_itr_length=STRING.LENGTH("gcc_bimc_dtts_xo_clk")

  if (STRING.SCAN("&clk", "*", 0)==0)
  (
    &wild_head=1
  )
  if (STRING.SCAN("&clk", "*", 1)==(STRING.LENGTH("&clk")-1))
  (
    &wild_tail=1
  )

  if ((&wild_head==1)&&(&wild_tail==1))
  (
    if (STRING.SCAN("gcc_bimc_dtts_xo_clk", STRING.MID("&clk", 1, &clk_input_length-2), 0)!=-1)
    ( 
      &match=1
    )
  )
  else if (&wild_head==1)
  (
    if (STRING.MID("gcc_bimc_dtts_xo_clk", &clk_itr_length-&clk_input_length+1, &clk_input_length-1)==STRING.CUT("&clk", 1))
    ( 
      &match=1
    )
  )
  else if (&wild_tail==1)
  (
    if (STRING.MID("gcc_bimc_dtts_xo_clk", 0, &clk_input_length-1)==STRING.CUT("&clk", -1))
    ( 
      &match=1
    )
  )
  else if ("gcc_bimc_dtts_xo_clk"=="&clk")
  (
    &match=1
  )
  
  if (&match==1)
  (
    &clk_test=&CLK_TEST_GCC_BIMC_DTTS_XO_CLK
    &clk_reg=&HWIO_GCC_BIMC_DTTS_XO_CBCR_ADDR
    &clk_reg_name="GCC_BIMC_DTTS_XO_CBCR"
    &clk_name="gcc_bimc_dtts_xo_clk"
    &clk_reg_cbcr_type="sm_cbc"
    &clk_vote_bit=-1.
    &clk_multiplier=1.

    gosub Print_Clk_Info_Line
  )

  &match=0
  &wild_head=0
  &wild_tail=0
  &clk_input_length=STRING.LENGTH("&clk")
  &clk_itr_length=STRING.LENGTH("gcc_bimc_hmss_axi_clk")

  if (STRING.SCAN("&clk", "*", 0)==0)
  (
    &wild_head=1
  )
  if (STRING.SCAN("&clk", "*", 1)==(STRING.LENGTH("&clk")-1))
  (
    &wild_tail=1
  )

  if ((&wild_head==1)&&(&wild_tail==1))
  (
    if (STRING.SCAN("gcc_bimc_hmss_axi_clk", STRING.MID("&clk", 1, &clk_input_length-2), 0)!=-1)
    ( 
      &match=1
    )
  )
  else if (&wild_head==1)
  (
    if (STRING.MID("gcc_bimc_hmss_axi_clk", &clk_itr_length-&clk_input_length+1, &clk_input_length-1)==STRING.CUT("&clk", 1))
    ( 
      &match=1
    )
  )
  else if (&wild_tail==1)
  (
    if (STRING.MID("gcc_bimc_hmss_axi_clk", 0, &clk_input_length-1)==STRING.CUT("&clk", -1))
    ( 
      &match=1
    )
  )
  else if ("gcc_bimc_hmss_axi_clk"=="&clk")
  (
    &match=1
  )
  
  if (&match==1)
  (
    &clk_test=&CLK_TEST_GCC_BIMC_HMSS_AXI_CLK
    &clk_reg=&HWIO_GCC_BIMC_HMSS_AXI_CBCR_ADDR
    &clk_reg_name="GCC_BIMC_HMSS_AXI_CBCR"
    &clk_name="gcc_bimc_hmss_axi_clk"
    &clk_reg_cbcr_type="sm_cbc"
    &clk_vote_bit=22.
    &clk_multiplier=1.

    gosub Print_Clk_Info_Line
  )

  &match=0
  &wild_head=0
  &wild_tail=0
  &clk_input_length=STRING.LENGTH("&clk")
  &clk_itr_length=STRING.LENGTH("gcc_hmss_mstr_axi_clk")

  if (STRING.SCAN("&clk", "*", 0)==0)
  (
    &wild_head=1
  )
  if (STRING.SCAN("&clk", "*", 1)==(STRING.LENGTH("&clk")-1))
  (
    &wild_tail=1
  )

  if ((&wild_head==1)&&(&wild_tail==1))
  (
    if (STRING.SCAN("gcc_hmss_mstr_axi_clk", STRING.MID("&clk", 1, &clk_input_length-2), 0)!=-1)
    ( 
      &match=1
    )
  )
  else if (&wild_head==1)
  (
    if (STRING.MID("gcc_hmss_mstr_axi_clk", &clk_itr_length-&clk_input_length+1, &clk_input_length-1)==STRING.CUT("&clk", 1))
    ( 
      &match=1
    )
  )
  else if (&wild_tail==1)
  (
    if (STRING.MID("gcc_hmss_mstr_axi_clk", 0, &clk_input_length-1)==STRING.CUT("&clk", -1))
    ( 
      &match=1
    )
  )
  else if ("gcc_hmss_mstr_axi_clk"=="&clk")
  (
    &match=1
  )
  
  if (&match==1)
  (
    &clk_test=&CLK_TEST_GCC_HMSS_MSTR_AXI_CLK
    &clk_reg=&HWIO_GCC_HMSS_MSTR_AXI_CBCR_ADDR
    &clk_reg_name="GCC_HMSS_MSTR_AXI_CBCR"
    &clk_name="gcc_hmss_mstr_axi_clk"
    &clk_reg_cbcr_type="sm_cbc"
    &clk_vote_bit=27.
    &clk_multiplier=1.

    gosub Print_Clk_Info_Line
  )

  &match=0
  &wild_head=0
  &wild_tail=0
  &clk_input_length=STRING.LENGTH("&clk")
  &clk_itr_length=STRING.LENGTH("gcc_hmss_slv_axi_clk")

  if (STRING.SCAN("&clk", "*", 0)==0)
  (
    &wild_head=1
  )
  if (STRING.SCAN("&clk", "*", 1)==(STRING.LENGTH("&clk")-1))
  (
    &wild_tail=1
  )

  if ((&wild_head==1)&&(&wild_tail==1))
  (
    if (STRING.SCAN("gcc_hmss_slv_axi_clk", STRING.MID("&clk", 1, &clk_input_length-2), 0)!=-1)
    ( 
      &match=1
    )
  )
  else if (&wild_head==1)
  (
    if (STRING.MID("gcc_hmss_slv_axi_clk", &clk_itr_length-&clk_input_length+1, &clk_input_length-1)==STRING.CUT("&clk", 1))
    ( 
      &match=1
    )
  )
  else if (&wild_tail==1)
  (
    if (STRING.MID("gcc_hmss_slv_axi_clk", 0, &clk_input_length-1)==STRING.CUT("&clk", -1))
    ( 
      &match=1
    )
  )
  else if ("gcc_hmss_slv_axi_clk"=="&clk")
  (
    &match=1
  )
  
  if (&match==1)
  (
    &clk_test=&CLK_TEST_GCC_HMSS_SLV_AXI_CLK
    &clk_reg=&HWIO_GCC_HMSS_SLV_AXI_CBCR_ADDR
    &clk_reg_name="GCC_HMSS_SLV_AXI_CBCR"
    &clk_name="gcc_hmss_slv_axi_clk"
    &clk_reg_cbcr_type="sm_cbc"
    &clk_vote_bit=20.
    &clk_multiplier=1.

    gosub Print_Clk_Info_Line
  )

  &match=0
  &wild_head=0
  &wild_tail=0
  &clk_input_length=STRING.LENGTH("&clk")
  &clk_itr_length=STRING.LENGTH("gcc_blsp1_qup1_i2c_apps_clk")

  if (STRING.SCAN("&clk", "*", 0)==0)
  (
    &wild_head=1
  )
  if (STRING.SCAN("&clk", "*", 1)==(STRING.LENGTH("&clk")-1))
  (
    &wild_tail=1
  )

  if ((&wild_head==1)&&(&wild_tail==1))
  (
    if (STRING.SCAN("gcc_blsp1_qup1_i2c_apps_clk", STRING.MID("&clk", 1, &clk_input_length-2), 0)!=-1)
    ( 
      &match=1
    )
  )
  else if (&wild_head==1)
  (
    if (STRING.MID("gcc_blsp1_qup1_i2c_apps_clk", &clk_itr_length-&clk_input_length+1, &clk_input_length-1)==STRING.CUT("&clk", 1))
    ( 
      &match=1
    )
  )
  else if (&wild_tail==1)
  (
    if (STRING.MID("gcc_blsp1_qup1_i2c_apps_clk", 0, &clk_input_length-1)==STRING.CUT("&clk", -1))
    ( 
      &match=1
    )
  )
  else if ("gcc_blsp1_qup1_i2c_apps_clk"=="&clk")
  (
    &match=1
  )
  
  if (&match==1)
  (
    &clk_test=&CLK_TEST_GCC_BLSP1_QUP1_I2C_APPS_CLK
    &clk_reg=&HWIO_GCC_BLSP1_QUP1_I2C_APPS_CBCR_ADDR
    &clk_reg_name="GCC_BLSP1_QUP1_I2C_APPS_CBCR"
    &clk_name="gcc_blsp1_qup1_i2c_apps_clk"
    &clk_reg_cbcr_type="sm_cbc"
    &clk_vote_bit=-1.
    &clk_multiplier=1.

    gosub Print_Clk_Info_Line
  )

  &match=0
  &wild_head=0
  &wild_tail=0
  &clk_input_length=STRING.LENGTH("&clk")
  &clk_itr_length=STRING.LENGTH("gcc_blsp1_qup1_spi_apps_clk")

  if (STRING.SCAN("&clk", "*", 0)==0)
  (
    &wild_head=1
  )
  if (STRING.SCAN("&clk", "*", 1)==(STRING.LENGTH("&clk")-1))
  (
    &wild_tail=1
  )

  if ((&wild_head==1)&&(&wild_tail==1))
  (
    if (STRING.SCAN("gcc_blsp1_qup1_spi_apps_clk", STRING.MID("&clk", 1, &clk_input_length-2), 0)!=-1)
    ( 
      &match=1
    )
  )
  else if (&wild_head==1)
  (
    if (STRING.MID("gcc_blsp1_qup1_spi_apps_clk", &clk_itr_length-&clk_input_length+1, &clk_input_length-1)==STRING.CUT("&clk", 1))
    ( 
      &match=1
    )
  )
  else if (&wild_tail==1)
  (
    if (STRING.MID("gcc_blsp1_qup1_spi_apps_clk", 0, &clk_input_length-1)==STRING.CUT("&clk", -1))
    ( 
      &match=1
    )
  )
  else if ("gcc_blsp1_qup1_spi_apps_clk"=="&clk")
  (
    &match=1
  )
  
  if (&match==1)
  (
    &clk_test=&CLK_TEST_GCC_BLSP1_QUP1_SPI_APPS_CLK
    &clk_reg=&HWIO_GCC_BLSP1_QUP1_SPI_APPS_CBCR_ADDR
    &clk_reg_name="GCC_BLSP1_QUP1_SPI_APPS_CBCR"
    &clk_name="gcc_blsp1_qup1_spi_apps_clk"
    &clk_reg_cbcr_type="sm_cbc"
    &clk_vote_bit=-1.
    &clk_multiplier=1.

    gosub Print_Clk_Info_Line
  )

  &match=0
  &wild_head=0
  &wild_tail=0
  &clk_input_length=STRING.LENGTH("&clk")
  &clk_itr_length=STRING.LENGTH("gcc_blsp1_qup2_i2c_apps_clk")

  if (STRING.SCAN("&clk", "*", 0)==0)
  (
    &wild_head=1
  )
  if (STRING.SCAN("&clk", "*", 1)==(STRING.LENGTH("&clk")-1))
  (
    &wild_tail=1
  )

  if ((&wild_head==1)&&(&wild_tail==1))
  (
    if (STRING.SCAN("gcc_blsp1_qup2_i2c_apps_clk", STRING.MID("&clk", 1, &clk_input_length-2), 0)!=-1)
    ( 
      &match=1
    )
  )
  else if (&wild_head==1)
  (
    if (STRING.MID("gcc_blsp1_qup2_i2c_apps_clk", &clk_itr_length-&clk_input_length+1, &clk_input_length-1)==STRING.CUT("&clk", 1))
    ( 
      &match=1
    )
  )
  else if (&wild_tail==1)
  (
    if (STRING.MID("gcc_blsp1_qup2_i2c_apps_clk", 0, &clk_input_length-1)==STRING.CUT("&clk", -1))
    ( 
      &match=1
    )
  )
  else if ("gcc_blsp1_qup2_i2c_apps_clk"=="&clk")
  (
    &match=1
  )
  
  if (&match==1)
  (
    &clk_test=&CLK_TEST_GCC_BLSP1_QUP2_I2C_APPS_CLK
    &clk_reg=&HWIO_GCC_BLSP1_QUP2_I2C_APPS_CBCR_ADDR
    &clk_reg_name="GCC_BLSP1_QUP2_I2C_APPS_CBCR"
    &clk_name="gcc_blsp1_qup2_i2c_apps_clk"
    &clk_reg_cbcr_type="sm_cbc"
    &clk_vote_bit=-1.
    &clk_multiplier=1.

    gosub Print_Clk_Info_Line
  )

  &match=0
  &wild_head=0
  &wild_tail=0
  &clk_input_length=STRING.LENGTH("&clk")
  &clk_itr_length=STRING.LENGTH("gcc_blsp1_qup2_spi_apps_clk")

  if (STRING.SCAN("&clk", "*", 0)==0)
  (
    &wild_head=1
  )
  if (STRING.SCAN("&clk", "*", 1)==(STRING.LENGTH("&clk")-1))
  (
    &wild_tail=1
  )

  if ((&wild_head==1)&&(&wild_tail==1))
  (
    if (STRING.SCAN("gcc_blsp1_qup2_spi_apps_clk", STRING.MID("&clk", 1, &clk_input_length-2), 0)!=-1)
    ( 
      &match=1
    )
  )
  else if (&wild_head==1)
  (
    if (STRING.MID("gcc_blsp1_qup2_spi_apps_clk", &clk_itr_length-&clk_input_length+1, &clk_input_length-1)==STRING.CUT("&clk", 1))
    ( 
      &match=1
    )
  )
  else if (&wild_tail==1)
  (
    if (STRING.MID("gcc_blsp1_qup2_spi_apps_clk", 0, &clk_input_length-1)==STRING.CUT("&clk", -1))
    ( 
      &match=1
    )
  )
  else if ("gcc_blsp1_qup2_spi_apps_clk"=="&clk")
  (
    &match=1
  )
  
  if (&match==1)
  (
    &clk_test=&CLK_TEST_GCC_BLSP1_QUP2_SPI_APPS_CLK
    &clk_reg=&HWIO_GCC_BLSP1_QUP2_SPI_APPS_CBCR_ADDR
    &clk_reg_name="GCC_BLSP1_QUP2_SPI_APPS_CBCR"
    &clk_name="gcc_blsp1_qup2_spi_apps_clk"
    &clk_reg_cbcr_type="sm_cbc"
    &clk_vote_bit=-1.
    &clk_multiplier=1.

    gosub Print_Clk_Info_Line
  )

  &match=0
  &wild_head=0
  &wild_tail=0
  &clk_input_length=STRING.LENGTH("&clk")
  &clk_itr_length=STRING.LENGTH("gcc_blsp1_qup3_i2c_apps_clk")

  if (STRING.SCAN("&clk", "*", 0)==0)
  (
    &wild_head=1
  )
  if (STRING.SCAN("&clk", "*", 1)==(STRING.LENGTH("&clk")-1))
  (
    &wild_tail=1
  )

  if ((&wild_head==1)&&(&wild_tail==1))
  (
    if (STRING.SCAN("gcc_blsp1_qup3_i2c_apps_clk", STRING.MID("&clk", 1, &clk_input_length-2), 0)!=-1)
    ( 
      &match=1
    )
  )
  else if (&wild_head==1)
  (
    if (STRING.MID("gcc_blsp1_qup3_i2c_apps_clk", &clk_itr_length-&clk_input_length+1, &clk_input_length-1)==STRING.CUT("&clk", 1))
    ( 
      &match=1
    )
  )
  else if (&wild_tail==1)
  (
    if (STRING.MID("gcc_blsp1_qup3_i2c_apps_clk", 0, &clk_input_length-1)==STRING.CUT("&clk", -1))
    ( 
      &match=1
    )
  )
  else if ("gcc_blsp1_qup3_i2c_apps_clk"=="&clk")
  (
    &match=1
  )
  
  if (&match==1)
  (
    &clk_test=&CLK_TEST_GCC_BLSP1_QUP3_I2C_APPS_CLK
    &clk_reg=&HWIO_GCC_BLSP1_QUP3_I2C_APPS_CBCR_ADDR
    &clk_reg_name="GCC_BLSP1_QUP3_I2C_APPS_CBCR"
    &clk_name="gcc_blsp1_qup3_i2c_apps_clk"
    &clk_reg_cbcr_type="sm_cbc"
    &clk_vote_bit=-1.
    &clk_multiplier=1.

    gosub Print_Clk_Info_Line
  )

  &match=0
  &wild_head=0
  &wild_tail=0
  &clk_input_length=STRING.LENGTH("&clk")
  &clk_itr_length=STRING.LENGTH("gcc_blsp1_qup3_spi_apps_clk")

  if (STRING.SCAN("&clk", "*", 0)==0)
  (
    &wild_head=1
  )
  if (STRING.SCAN("&clk", "*", 1)==(STRING.LENGTH("&clk")-1))
  (
    &wild_tail=1
  )

  if ((&wild_head==1)&&(&wild_tail==1))
  (
    if (STRING.SCAN("gcc_blsp1_qup3_spi_apps_clk", STRING.MID("&clk", 1, &clk_input_length-2), 0)!=-1)
    ( 
      &match=1
    )
  )
  else if (&wild_head==1)
  (
    if (STRING.MID("gcc_blsp1_qup3_spi_apps_clk", &clk_itr_length-&clk_input_length+1, &clk_input_length-1)==STRING.CUT("&clk", 1))
    ( 
      &match=1
    )
  )
  else if (&wild_tail==1)
  (
    if (STRING.MID("gcc_blsp1_qup3_spi_apps_clk", 0, &clk_input_length-1)==STRING.CUT("&clk", -1))
    ( 
      &match=1
    )
  )
  else if ("gcc_blsp1_qup3_spi_apps_clk"=="&clk")
  (
    &match=1
  )
  
  if (&match==1)
  (
    &clk_test=&CLK_TEST_GCC_BLSP1_QUP3_SPI_APPS_CLK
    &clk_reg=&HWIO_GCC_BLSP1_QUP3_SPI_APPS_CBCR_ADDR
    &clk_reg_name="GCC_BLSP1_QUP3_SPI_APPS_CBCR"
    &clk_name="gcc_blsp1_qup3_spi_apps_clk"
    &clk_reg_cbcr_type="sm_cbc"
    &clk_vote_bit=-1.
    &clk_multiplier=1.

    gosub Print_Clk_Info_Line
  )

  &match=0
  &wild_head=0
  &wild_tail=0
  &clk_input_length=STRING.LENGTH("&clk")
  &clk_itr_length=STRING.LENGTH("gcc_blsp1_qup4_i2c_apps_clk")

  if (STRING.SCAN("&clk", "*", 0)==0)
  (
    &wild_head=1
  )
  if (STRING.SCAN("&clk", "*", 1)==(STRING.LENGTH("&clk")-1))
  (
    &wild_tail=1
  )

  if ((&wild_head==1)&&(&wild_tail==1))
  (
    if (STRING.SCAN("gcc_blsp1_qup4_i2c_apps_clk", STRING.MID("&clk", 1, &clk_input_length-2), 0)!=-1)
    ( 
      &match=1
    )
  )
  else if (&wild_head==1)
  (
    if (STRING.MID("gcc_blsp1_qup4_i2c_apps_clk", &clk_itr_length-&clk_input_length+1, &clk_input_length-1)==STRING.CUT("&clk", 1))
    ( 
      &match=1
    )
  )
  else if (&wild_tail==1)
  (
    if (STRING.MID("gcc_blsp1_qup4_i2c_apps_clk", 0, &clk_input_length-1)==STRING.CUT("&clk", -1))
    ( 
      &match=1
    )
  )
  else if ("gcc_blsp1_qup4_i2c_apps_clk"=="&clk")
  (
    &match=1
  )
  
  if (&match==1)
  (
    &clk_test=&CLK_TEST_GCC_BLSP1_QUP4_I2C_APPS_CLK
    &clk_reg=&HWIO_GCC_BLSP1_QUP4_I2C_APPS_CBCR_ADDR
    &clk_reg_name="GCC_BLSP1_QUP4_I2C_APPS_CBCR"
    &clk_name="gcc_blsp1_qup4_i2c_apps_clk"
    &clk_reg_cbcr_type="sm_cbc"
    &clk_vote_bit=-1.
    &clk_multiplier=1.

    gosub Print_Clk_Info_Line
  )

  &match=0
  &wild_head=0
  &wild_tail=0
  &clk_input_length=STRING.LENGTH("&clk")
  &clk_itr_length=STRING.LENGTH("gcc_blsp1_qup4_spi_apps_clk")

  if (STRING.SCAN("&clk", "*", 0)==0)
  (
    &wild_head=1
  )
  if (STRING.SCAN("&clk", "*", 1)==(STRING.LENGTH("&clk")-1))
  (
    &wild_tail=1
  )

  if ((&wild_head==1)&&(&wild_tail==1))
  (
    if (STRING.SCAN("gcc_blsp1_qup4_spi_apps_clk", STRING.MID("&clk", 1, &clk_input_length-2), 0)!=-1)
    ( 
      &match=1
    )
  )
  else if (&wild_head==1)
  (
    if (STRING.MID("gcc_blsp1_qup4_spi_apps_clk", &clk_itr_length-&clk_input_length+1, &clk_input_length-1)==STRING.CUT("&clk", 1))
    ( 
      &match=1
    )
  )
  else if (&wild_tail==1)
  (
    if (STRING.MID("gcc_blsp1_qup4_spi_apps_clk", 0, &clk_input_length-1)==STRING.CUT("&clk", -1))
    ( 
      &match=1
    )
  )
  else if ("gcc_blsp1_qup4_spi_apps_clk"=="&clk")
  (
    &match=1
  )
  
  if (&match==1)
  (
    &clk_test=&CLK_TEST_GCC_BLSP1_QUP4_SPI_APPS_CLK
    &clk_reg=&HWIO_GCC_BLSP1_QUP4_SPI_APPS_CBCR_ADDR
    &clk_reg_name="GCC_BLSP1_QUP4_SPI_APPS_CBCR"
    &clk_name="gcc_blsp1_qup4_spi_apps_clk"
    &clk_reg_cbcr_type="sm_cbc"
    &clk_vote_bit=-1.
    &clk_multiplier=1.

    gosub Print_Clk_Info_Line
  )

  &match=0
  &wild_head=0
  &wild_tail=0
  &clk_input_length=STRING.LENGTH("&clk")
  &clk_itr_length=STRING.LENGTH("gcc_blsp1_qup5_i2c_apps_clk")

  if (STRING.SCAN("&clk", "*", 0)==0)
  (
    &wild_head=1
  )
  if (STRING.SCAN("&clk", "*", 1)==(STRING.LENGTH("&clk")-1))
  (
    &wild_tail=1
  )

  if ((&wild_head==1)&&(&wild_tail==1))
  (
    if (STRING.SCAN("gcc_blsp1_qup5_i2c_apps_clk", STRING.MID("&clk", 1, &clk_input_length-2), 0)!=-1)
    ( 
      &match=1
    )
  )
  else if (&wild_head==1)
  (
    if (STRING.MID("gcc_blsp1_qup5_i2c_apps_clk", &clk_itr_length-&clk_input_length+1, &clk_input_length-1)==STRING.CUT("&clk", 1))
    ( 
      &match=1
    )
  )
  else if (&wild_tail==1)
  (
    if (STRING.MID("gcc_blsp1_qup5_i2c_apps_clk", 0, &clk_input_length-1)==STRING.CUT("&clk", -1))
    ( 
      &match=1
    )
  )
  else if ("gcc_blsp1_qup5_i2c_apps_clk"=="&clk")
  (
    &match=1
  )
  
  if (&match==1)
  (
    &clk_test=&CLK_TEST_GCC_BLSP1_QUP5_I2C_APPS_CLK
    &clk_reg=&HWIO_GCC_BLSP1_QUP5_I2C_APPS_CBCR_ADDR
    &clk_reg_name="GCC_BLSP1_QUP5_I2C_APPS_CBCR"
    &clk_name="gcc_blsp1_qup5_i2c_apps_clk"
    &clk_reg_cbcr_type="sm_cbc"
    &clk_vote_bit=-1.
    &clk_multiplier=1.

    gosub Print_Clk_Info_Line
  )

  &match=0
  &wild_head=0
  &wild_tail=0
  &clk_input_length=STRING.LENGTH("&clk")
  &clk_itr_length=STRING.LENGTH("gcc_blsp1_qup5_spi_apps_clk")

  if (STRING.SCAN("&clk", "*", 0)==0)
  (
    &wild_head=1
  )
  if (STRING.SCAN("&clk", "*", 1)==(STRING.LENGTH("&clk")-1))
  (
    &wild_tail=1
  )

  if ((&wild_head==1)&&(&wild_tail==1))
  (
    if (STRING.SCAN("gcc_blsp1_qup5_spi_apps_clk", STRING.MID("&clk", 1, &clk_input_length-2), 0)!=-1)
    ( 
      &match=1
    )
  )
  else if (&wild_head==1)
  (
    if (STRING.MID("gcc_blsp1_qup5_spi_apps_clk", &clk_itr_length-&clk_input_length+1, &clk_input_length-1)==STRING.CUT("&clk", 1))
    ( 
      &match=1
    )
  )
  else if (&wild_tail==1)
  (
    if (STRING.MID("gcc_blsp1_qup5_spi_apps_clk", 0, &clk_input_length-1)==STRING.CUT("&clk", -1))
    ( 
      &match=1
    )
  )
  else if ("gcc_blsp1_qup5_spi_apps_clk"=="&clk")
  (
    &match=1
  )
  
  if (&match==1)
  (
    &clk_test=&CLK_TEST_GCC_BLSP1_QUP5_SPI_APPS_CLK
    &clk_reg=&HWIO_GCC_BLSP1_QUP5_SPI_APPS_CBCR_ADDR
    &clk_reg_name="GCC_BLSP1_QUP5_SPI_APPS_CBCR"
    &clk_name="gcc_blsp1_qup5_spi_apps_clk"
    &clk_reg_cbcr_type="sm_cbc"
    &clk_vote_bit=-1.
    &clk_multiplier=1.

    gosub Print_Clk_Info_Line
  )

  &match=0
  &wild_head=0
  &wild_tail=0
  &clk_input_length=STRING.LENGTH("&clk")
  &clk_itr_length=STRING.LENGTH("gcc_blsp1_qup6_i2c_apps_clk")

  if (STRING.SCAN("&clk", "*", 0)==0)
  (
    &wild_head=1
  )
  if (STRING.SCAN("&clk", "*", 1)==(STRING.LENGTH("&clk")-1))
  (
    &wild_tail=1
  )

  if ((&wild_head==1)&&(&wild_tail==1))
  (
    if (STRING.SCAN("gcc_blsp1_qup6_i2c_apps_clk", STRING.MID("&clk", 1, &clk_input_length-2), 0)!=-1)
    ( 
      &match=1
    )
  )
  else if (&wild_head==1)
  (
    if (STRING.MID("gcc_blsp1_qup6_i2c_apps_clk", &clk_itr_length-&clk_input_length+1, &clk_input_length-1)==STRING.CUT("&clk", 1))
    ( 
      &match=1
    )
  )
  else if (&wild_tail==1)
  (
    if (STRING.MID("gcc_blsp1_qup6_i2c_apps_clk", 0, &clk_input_length-1)==STRING.CUT("&clk", -1))
    ( 
      &match=1
    )
  )
  else if ("gcc_blsp1_qup6_i2c_apps_clk"=="&clk")
  (
    &match=1
  )
  
  if (&match==1)
  (
    &clk_test=&CLK_TEST_GCC_BLSP1_QUP6_I2C_APPS_CLK
    &clk_reg=&HWIO_GCC_BLSP1_QUP6_I2C_APPS_CBCR_ADDR
    &clk_reg_name="GCC_BLSP1_QUP6_I2C_APPS_CBCR"
    &clk_name="gcc_blsp1_qup6_i2c_apps_clk"
    &clk_reg_cbcr_type="sm_cbc"
    &clk_vote_bit=-1.
    &clk_multiplier=1.

    gosub Print_Clk_Info_Line
  )

  &match=0
  &wild_head=0
  &wild_tail=0
  &clk_input_length=STRING.LENGTH("&clk")
  &clk_itr_length=STRING.LENGTH("gcc_blsp1_qup6_spi_apps_clk")

  if (STRING.SCAN("&clk", "*", 0)==0)
  (
    &wild_head=1
  )
  if (STRING.SCAN("&clk", "*", 1)==(STRING.LENGTH("&clk")-1))
  (
    &wild_tail=1
  )

  if ((&wild_head==1)&&(&wild_tail==1))
  (
    if (STRING.SCAN("gcc_blsp1_qup6_spi_apps_clk", STRING.MID("&clk", 1, &clk_input_length-2), 0)!=-1)
    ( 
      &match=1
    )
  )
  else if (&wild_head==1)
  (
    if (STRING.MID("gcc_blsp1_qup6_spi_apps_clk", &clk_itr_length-&clk_input_length+1, &clk_input_length-1)==STRING.CUT("&clk", 1))
    ( 
      &match=1
    )
  )
  else if (&wild_tail==1)
  (
    if (STRING.MID("gcc_blsp1_qup6_spi_apps_clk", 0, &clk_input_length-1)==STRING.CUT("&clk", -1))
    ( 
      &match=1
    )
  )
  else if ("gcc_blsp1_qup6_spi_apps_clk"=="&clk")
  (
    &match=1
  )
  
  if (&match==1)
  (
    &clk_test=&CLK_TEST_GCC_BLSP1_QUP6_SPI_APPS_CLK
    &clk_reg=&HWIO_GCC_BLSP1_QUP6_SPI_APPS_CBCR_ADDR
    &clk_reg_name="GCC_BLSP1_QUP6_SPI_APPS_CBCR"
    &clk_name="gcc_blsp1_qup6_spi_apps_clk"
    &clk_reg_cbcr_type="sm_cbc"
    &clk_vote_bit=-1.
    &clk_multiplier=1.

    gosub Print_Clk_Info_Line
  )

  &match=0
  &wild_head=0
  &wild_tail=0
  &clk_input_length=STRING.LENGTH("&clk")
  &clk_itr_length=STRING.LENGTH("gcc_blsp1_uart1_apps_clk")

  if (STRING.SCAN("&clk", "*", 0)==0)
  (
    &wild_head=1
  )
  if (STRING.SCAN("&clk", "*", 1)==(STRING.LENGTH("&clk")-1))
  (
    &wild_tail=1
  )

  if ((&wild_head==1)&&(&wild_tail==1))
  (
    if (STRING.SCAN("gcc_blsp1_uart1_apps_clk", STRING.MID("&clk", 1, &clk_input_length-2), 0)!=-1)
    ( 
      &match=1
    )
  )
  else if (&wild_head==1)
  (
    if (STRING.MID("gcc_blsp1_uart1_apps_clk", &clk_itr_length-&clk_input_length+1, &clk_input_length-1)==STRING.CUT("&clk", 1))
    ( 
      &match=1
    )
  )
  else if (&wild_tail==1)
  (
    if (STRING.MID("gcc_blsp1_uart1_apps_clk", 0, &clk_input_length-1)==STRING.CUT("&clk", -1))
    ( 
      &match=1
    )
  )
  else if ("gcc_blsp1_uart1_apps_clk"=="&clk")
  (
    &match=1
  )
  
  if (&match==1)
  (
    &clk_test=&CLK_TEST_GCC_BLSP1_UART1_APPS_CLK
    &clk_reg=&HWIO_GCC_BLSP1_UART1_APPS_CBCR_ADDR
    &clk_reg_name="GCC_BLSP1_UART1_APPS_CBCR"
    &clk_name="gcc_blsp1_uart1_apps_clk"
    &clk_reg_cbcr_type="sm_cbc"
    &clk_vote_bit=-1.
    &clk_multiplier=1.

    gosub Print_Clk_Info_Line
  )

  &match=0
  &wild_head=0
  &wild_tail=0
  &clk_input_length=STRING.LENGTH("&clk")
  &clk_itr_length=STRING.LENGTH("gcc_blsp1_uart2_apps_clk")

  if (STRING.SCAN("&clk", "*", 0)==0)
  (
    &wild_head=1
  )
  if (STRING.SCAN("&clk", "*", 1)==(STRING.LENGTH("&clk")-1))
  (
    &wild_tail=1
  )

  if ((&wild_head==1)&&(&wild_tail==1))
  (
    if (STRING.SCAN("gcc_blsp1_uart2_apps_clk", STRING.MID("&clk", 1, &clk_input_length-2), 0)!=-1)
    ( 
      &match=1
    )
  )
  else if (&wild_head==1)
  (
    if (STRING.MID("gcc_blsp1_uart2_apps_clk", &clk_itr_length-&clk_input_length+1, &clk_input_length-1)==STRING.CUT("&clk", 1))
    ( 
      &match=1
    )
  )
  else if (&wild_tail==1)
  (
    if (STRING.MID("gcc_blsp1_uart2_apps_clk", 0, &clk_input_length-1)==STRING.CUT("&clk", -1))
    ( 
      &match=1
    )
  )
  else if ("gcc_blsp1_uart2_apps_clk"=="&clk")
  (
    &match=1
  )
  
  if (&match==1)
  (
    &clk_test=&CLK_TEST_GCC_BLSP1_UART2_APPS_CLK
    &clk_reg=&HWIO_GCC_BLSP1_UART2_APPS_CBCR_ADDR
    &clk_reg_name="GCC_BLSP1_UART2_APPS_CBCR"
    &clk_name="gcc_blsp1_uart2_apps_clk"
    &clk_reg_cbcr_type="sm_cbc"
    &clk_vote_bit=-1.
    &clk_multiplier=1.

    gosub Print_Clk_Info_Line
  )

  &match=0
  &wild_head=0
  &wild_tail=0
  &clk_input_length=STRING.LENGTH("&clk")
  &clk_itr_length=STRING.LENGTH("gcc_blsp1_uart3_apps_clk")

  if (STRING.SCAN("&clk", "*", 0)==0)
  (
    &wild_head=1
  )
  if (STRING.SCAN("&clk", "*", 1)==(STRING.LENGTH("&clk")-1))
  (
    &wild_tail=1
  )

  if ((&wild_head==1)&&(&wild_tail==1))
  (
    if (STRING.SCAN("gcc_blsp1_uart3_apps_clk", STRING.MID("&clk", 1, &clk_input_length-2), 0)!=-1)
    ( 
      &match=1
    )
  )
  else if (&wild_head==1)
  (
    if (STRING.MID("gcc_blsp1_uart3_apps_clk", &clk_itr_length-&clk_input_length+1, &clk_input_length-1)==STRING.CUT("&clk", 1))
    ( 
      &match=1
    )
  )
  else if (&wild_tail==1)
  (
    if (STRING.MID("gcc_blsp1_uart3_apps_clk", 0, &clk_input_length-1)==STRING.CUT("&clk", -1))
    ( 
      &match=1
    )
  )
  else if ("gcc_blsp1_uart3_apps_clk"=="&clk")
  (
    &match=1
  )
  
  if (&match==1)
  (
    &clk_test=&CLK_TEST_GCC_BLSP1_UART3_APPS_CLK
    &clk_reg=&HWIO_GCC_BLSP1_UART3_APPS_CBCR_ADDR
    &clk_reg_name="GCC_BLSP1_UART3_APPS_CBCR"
    &clk_name="gcc_blsp1_uart3_apps_clk"
    &clk_reg_cbcr_type="sm_cbc"
    &clk_vote_bit=-1.
    &clk_multiplier=1.

    gosub Print_Clk_Info_Line
  )

  &match=0
  &wild_head=0
  &wild_tail=0
  &clk_input_length=STRING.LENGTH("&clk")
  &clk_itr_length=STRING.LENGTH("gcc_blsp1_uart4_apps_clk")

  if (STRING.SCAN("&clk", "*", 0)==0)
  (
    &wild_head=1
  )
  if (STRING.SCAN("&clk", "*", 1)==(STRING.LENGTH("&clk")-1))
  (
    &wild_tail=1
  )

  if ((&wild_head==1)&&(&wild_tail==1))
  (
    if (STRING.SCAN("gcc_blsp1_uart4_apps_clk", STRING.MID("&clk", 1, &clk_input_length-2), 0)!=-1)
    ( 
      &match=1
    )
  )
  else if (&wild_head==1)
  (
    if (STRING.MID("gcc_blsp1_uart4_apps_clk", &clk_itr_length-&clk_input_length+1, &clk_input_length-1)==STRING.CUT("&clk", 1))
    ( 
      &match=1
    )
  )
  else if (&wild_tail==1)
  (
    if (STRING.MID("gcc_blsp1_uart4_apps_clk", 0, &clk_input_length-1)==STRING.CUT("&clk", -1))
    ( 
      &match=1
    )
  )
  else if ("gcc_blsp1_uart4_apps_clk"=="&clk")
  (
    &match=1
  )
  
  if (&match==1)
  (
    &clk_test=&CLK_TEST_GCC_BLSP1_UART4_APPS_CLK
    &clk_reg=&HWIO_GCC_BLSP1_UART4_APPS_CBCR_ADDR
    &clk_reg_name="GCC_BLSP1_UART4_APPS_CBCR"
    &clk_name="gcc_blsp1_uart4_apps_clk"
    &clk_reg_cbcr_type="sm_cbc"
    &clk_vote_bit=-1.
    &clk_multiplier=1.

    gosub Print_Clk_Info_Line
  )

  &match=0
  &wild_head=0
  &wild_tail=0
  &clk_input_length=STRING.LENGTH("&clk")
  &clk_itr_length=STRING.LENGTH("gcc_blsp1_uart5_apps_clk")

  if (STRING.SCAN("&clk", "*", 0)==0)
  (
    &wild_head=1
  )
  if (STRING.SCAN("&clk", "*", 1)==(STRING.LENGTH("&clk")-1))
  (
    &wild_tail=1
  )

  if ((&wild_head==1)&&(&wild_tail==1))
  (
    if (STRING.SCAN("gcc_blsp1_uart5_apps_clk", STRING.MID("&clk", 1, &clk_input_length-2), 0)!=-1)
    ( 
      &match=1
    )
  )
  else if (&wild_head==1)
  (
    if (STRING.MID("gcc_blsp1_uart5_apps_clk", &clk_itr_length-&clk_input_length+1, &clk_input_length-1)==STRING.CUT("&clk", 1))
    ( 
      &match=1
    )
  )
  else if (&wild_tail==1)
  (
    if (STRING.MID("gcc_blsp1_uart5_apps_clk", 0, &clk_input_length-1)==STRING.CUT("&clk", -1))
    ( 
      &match=1
    )
  )
  else if ("gcc_blsp1_uart5_apps_clk"=="&clk")
  (
    &match=1
  )
  
  if (&match==1)
  (
    &clk_test=&CLK_TEST_GCC_BLSP1_UART5_APPS_CLK
    &clk_reg=&HWIO_GCC_BLSP1_UART5_APPS_CBCR_ADDR
    &clk_reg_name="GCC_BLSP1_UART5_APPS_CBCR"
    &clk_name="gcc_blsp1_uart5_apps_clk"
    &clk_reg_cbcr_type="sm_cbc"
    &clk_vote_bit=-1.
    &clk_multiplier=1.

    gosub Print_Clk_Info_Line
  )

  &match=0
  &wild_head=0
  &wild_tail=0
  &clk_input_length=STRING.LENGTH("&clk")
  &clk_itr_length=STRING.LENGTH("gcc_blsp1_uart6_apps_clk")

  if (STRING.SCAN("&clk", "*", 0)==0)
  (
    &wild_head=1
  )
  if (STRING.SCAN("&clk", "*", 1)==(STRING.LENGTH("&clk")-1))
  (
    &wild_tail=1
  )

  if ((&wild_head==1)&&(&wild_tail==1))
  (
    if (STRING.SCAN("gcc_blsp1_uart6_apps_clk", STRING.MID("&clk", 1, &clk_input_length-2), 0)!=-1)
    ( 
      &match=1
    )
  )
  else if (&wild_head==1)
  (
    if (STRING.MID("gcc_blsp1_uart6_apps_clk", &clk_itr_length-&clk_input_length+1, &clk_input_length-1)==STRING.CUT("&clk", 1))
    ( 
      &match=1
    )
  )
  else if (&wild_tail==1)
  (
    if (STRING.MID("gcc_blsp1_uart6_apps_clk", 0, &clk_input_length-1)==STRING.CUT("&clk", -1))
    ( 
      &match=1
    )
  )
  else if ("gcc_blsp1_uart6_apps_clk"=="&clk")
  (
    &match=1
  )
  
  if (&match==1)
  (
    &clk_test=&CLK_TEST_GCC_BLSP1_UART6_APPS_CLK
    &clk_reg=&HWIO_GCC_BLSP1_UART6_APPS_CBCR_ADDR
    &clk_reg_name="GCC_BLSP1_UART6_APPS_CBCR"
    &clk_name="gcc_blsp1_uart6_apps_clk"
    &clk_reg_cbcr_type="sm_cbc"
    &clk_vote_bit=-1.
    &clk_multiplier=1.

    gosub Print_Clk_Info_Line
  )

  &match=0
  &wild_head=0
  &wild_tail=0
  &clk_input_length=STRING.LENGTH("&clk")
  &clk_itr_length=STRING.LENGTH("gcc_blsp2_qup1_i2c_apps_clk")

  if (STRING.SCAN("&clk", "*", 0)==0)
  (
    &wild_head=1
  )
  if (STRING.SCAN("&clk", "*", 1)==(STRING.LENGTH("&clk")-1))
  (
    &wild_tail=1
  )

  if ((&wild_head==1)&&(&wild_tail==1))
  (
    if (STRING.SCAN("gcc_blsp2_qup1_i2c_apps_clk", STRING.MID("&clk", 1, &clk_input_length-2), 0)!=-1)
    ( 
      &match=1
    )
  )
  else if (&wild_head==1)
  (
    if (STRING.MID("gcc_blsp2_qup1_i2c_apps_clk", &clk_itr_length-&clk_input_length+1, &clk_input_length-1)==STRING.CUT("&clk", 1))
    ( 
      &match=1
    )
  )
  else if (&wild_tail==1)
  (
    if (STRING.MID("gcc_blsp2_qup1_i2c_apps_clk", 0, &clk_input_length-1)==STRING.CUT("&clk", -1))
    ( 
      &match=1
    )
  )
  else if ("gcc_blsp2_qup1_i2c_apps_clk"=="&clk")
  (
    &match=1
  )
  
  if (&match==1)
  (
    &clk_test=&CLK_TEST_GCC_BLSP2_QUP1_I2C_APPS_CLK
    &clk_reg=&HWIO_GCC_BLSP2_QUP1_I2C_APPS_CBCR_ADDR
    &clk_reg_name="GCC_BLSP2_QUP1_I2C_APPS_CBCR"
    &clk_name="gcc_blsp2_qup1_i2c_apps_clk"
    &clk_reg_cbcr_type="sm_cbc"
    &clk_vote_bit=-1.
    &clk_multiplier=1.

    gosub Print_Clk_Info_Line
  )

  &match=0
  &wild_head=0
  &wild_tail=0
  &clk_input_length=STRING.LENGTH("&clk")
  &clk_itr_length=STRING.LENGTH("gcc_blsp2_qup1_spi_apps_clk")

  if (STRING.SCAN("&clk", "*", 0)==0)
  (
    &wild_head=1
  )
  if (STRING.SCAN("&clk", "*", 1)==(STRING.LENGTH("&clk")-1))
  (
    &wild_tail=1
  )

  if ((&wild_head==1)&&(&wild_tail==1))
  (
    if (STRING.SCAN("gcc_blsp2_qup1_spi_apps_clk", STRING.MID("&clk", 1, &clk_input_length-2), 0)!=-1)
    ( 
      &match=1
    )
  )
  else if (&wild_head==1)
  (
    if (STRING.MID("gcc_blsp2_qup1_spi_apps_clk", &clk_itr_length-&clk_input_length+1, &clk_input_length-1)==STRING.CUT("&clk", 1))
    ( 
      &match=1
    )
  )
  else if (&wild_tail==1)
  (
    if (STRING.MID("gcc_blsp2_qup1_spi_apps_clk", 0, &clk_input_length-1)==STRING.CUT("&clk", -1))
    ( 
      &match=1
    )
  )
  else if ("gcc_blsp2_qup1_spi_apps_clk"=="&clk")
  (
    &match=1
  )
  
  if (&match==1)
  (
    &clk_test=&CLK_TEST_GCC_BLSP2_QUP1_SPI_APPS_CLK
    &clk_reg=&HWIO_GCC_BLSP2_QUP1_SPI_APPS_CBCR_ADDR
    &clk_reg_name="GCC_BLSP2_QUP1_SPI_APPS_CBCR"
    &clk_name="gcc_blsp2_qup1_spi_apps_clk"
    &clk_reg_cbcr_type="sm_cbc"
    &clk_vote_bit=-1.
    &clk_multiplier=1.

    gosub Print_Clk_Info_Line
  )

  &match=0
  &wild_head=0
  &wild_tail=0
  &clk_input_length=STRING.LENGTH("&clk")
  &clk_itr_length=STRING.LENGTH("gcc_blsp2_qup2_i2c_apps_clk")

  if (STRING.SCAN("&clk", "*", 0)==0)
  (
    &wild_head=1
  )
  if (STRING.SCAN("&clk", "*", 1)==(STRING.LENGTH("&clk")-1))
  (
    &wild_tail=1
  )

  if ((&wild_head==1)&&(&wild_tail==1))
  (
    if (STRING.SCAN("gcc_blsp2_qup2_i2c_apps_clk", STRING.MID("&clk", 1, &clk_input_length-2), 0)!=-1)
    ( 
      &match=1
    )
  )
  else if (&wild_head==1)
  (
    if (STRING.MID("gcc_blsp2_qup2_i2c_apps_clk", &clk_itr_length-&clk_input_length+1, &clk_input_length-1)==STRING.CUT("&clk", 1))
    ( 
      &match=1
    )
  )
  else if (&wild_tail==1)
  (
    if (STRING.MID("gcc_blsp2_qup2_i2c_apps_clk", 0, &clk_input_length-1)==STRING.CUT("&clk", -1))
    ( 
      &match=1
    )
  )
  else if ("gcc_blsp2_qup2_i2c_apps_clk"=="&clk")
  (
    &match=1
  )
  
  if (&match==1)
  (
    &clk_test=&CLK_TEST_GCC_BLSP2_QUP2_I2C_APPS_CLK
    &clk_reg=&HWIO_GCC_BLSP2_QUP2_I2C_APPS_CBCR_ADDR
    &clk_reg_name="GCC_BLSP2_QUP2_I2C_APPS_CBCR"
    &clk_name="gcc_blsp2_qup2_i2c_apps_clk"
    &clk_reg_cbcr_type="sm_cbc"
    &clk_vote_bit=-1.
    &clk_multiplier=1.

    gosub Print_Clk_Info_Line
  )

  &match=0
  &wild_head=0
  &wild_tail=0
  &clk_input_length=STRING.LENGTH("&clk")
  &clk_itr_length=STRING.LENGTH("gcc_blsp2_qup2_spi_apps_clk")

  if (STRING.SCAN("&clk", "*", 0)==0)
  (
    &wild_head=1
  )
  if (STRING.SCAN("&clk", "*", 1)==(STRING.LENGTH("&clk")-1))
  (
    &wild_tail=1
  )

  if ((&wild_head==1)&&(&wild_tail==1))
  (
    if (STRING.SCAN("gcc_blsp2_qup2_spi_apps_clk", STRING.MID("&clk", 1, &clk_input_length-2), 0)!=-1)
    ( 
      &match=1
    )
  )
  else if (&wild_head==1)
  (
    if (STRING.MID("gcc_blsp2_qup2_spi_apps_clk", &clk_itr_length-&clk_input_length+1, &clk_input_length-1)==STRING.CUT("&clk", 1))
    ( 
      &match=1
    )
  )
  else if (&wild_tail==1)
  (
    if (STRING.MID("gcc_blsp2_qup2_spi_apps_clk", 0, &clk_input_length-1)==STRING.CUT("&clk", -1))
    ( 
      &match=1
    )
  )
  else if ("gcc_blsp2_qup2_spi_apps_clk"=="&clk")
  (
    &match=1
  )
  
  if (&match==1)
  (
    &clk_test=&CLK_TEST_GCC_BLSP2_QUP2_SPI_APPS_CLK
    &clk_reg=&HWIO_GCC_BLSP2_QUP2_SPI_APPS_CBCR_ADDR
    &clk_reg_name="GCC_BLSP2_QUP2_SPI_APPS_CBCR"
    &clk_name="gcc_blsp2_qup2_spi_apps_clk"
    &clk_reg_cbcr_type="sm_cbc"
    &clk_vote_bit=-1.
    &clk_multiplier=1.

    gosub Print_Clk_Info_Line
  )

  &match=0
  &wild_head=0
  &wild_tail=0
  &clk_input_length=STRING.LENGTH("&clk")
  &clk_itr_length=STRING.LENGTH("gcc_blsp2_qup3_i2c_apps_clk")

  if (STRING.SCAN("&clk", "*", 0)==0)
  (
    &wild_head=1
  )
  if (STRING.SCAN("&clk", "*", 1)==(STRING.LENGTH("&clk")-1))
  (
    &wild_tail=1
  )

  if ((&wild_head==1)&&(&wild_tail==1))
  (
    if (STRING.SCAN("gcc_blsp2_qup3_i2c_apps_clk", STRING.MID("&clk", 1, &clk_input_length-2), 0)!=-1)
    ( 
      &match=1
    )
  )
  else if (&wild_head==1)
  (
    if (STRING.MID("gcc_blsp2_qup3_i2c_apps_clk", &clk_itr_length-&clk_input_length+1, &clk_input_length-1)==STRING.CUT("&clk", 1))
    ( 
      &match=1
    )
  )
  else if (&wild_tail==1)
  (
    if (STRING.MID("gcc_blsp2_qup3_i2c_apps_clk", 0, &clk_input_length-1)==STRING.CUT("&clk", -1))
    ( 
      &match=1
    )
  )
  else if ("gcc_blsp2_qup3_i2c_apps_clk"=="&clk")
  (
    &match=1
  )
  
  if (&match==1)
  (
    &clk_test=&CLK_TEST_GCC_BLSP2_QUP3_I2C_APPS_CLK
    &clk_reg=&HWIO_GCC_BLSP2_QUP3_I2C_APPS_CBCR_ADDR
    &clk_reg_name="GCC_BLSP2_QUP3_I2C_APPS_CBCR"
    &clk_name="gcc_blsp2_qup3_i2c_apps_clk"
    &clk_reg_cbcr_type="sm_cbc"
    &clk_vote_bit=-1.
    &clk_multiplier=1.

    gosub Print_Clk_Info_Line
  )

  &match=0
  &wild_head=0
  &wild_tail=0
  &clk_input_length=STRING.LENGTH("&clk")
  &clk_itr_length=STRING.LENGTH("gcc_blsp2_qup3_spi_apps_clk")

  if (STRING.SCAN("&clk", "*", 0)==0)
  (
    &wild_head=1
  )
  if (STRING.SCAN("&clk", "*", 1)==(STRING.LENGTH("&clk")-1))
  (
    &wild_tail=1
  )

  if ((&wild_head==1)&&(&wild_tail==1))
  (
    if (STRING.SCAN("gcc_blsp2_qup3_spi_apps_clk", STRING.MID("&clk", 1, &clk_input_length-2), 0)!=-1)
    ( 
      &match=1
    )
  )
  else if (&wild_head==1)
  (
    if (STRING.MID("gcc_blsp2_qup3_spi_apps_clk", &clk_itr_length-&clk_input_length+1, &clk_input_length-1)==STRING.CUT("&clk", 1))
    ( 
      &match=1
    )
  )
  else if (&wild_tail==1)
  (
    if (STRING.MID("gcc_blsp2_qup3_spi_apps_clk", 0, &clk_input_length-1)==STRING.CUT("&clk", -1))
    ( 
      &match=1
    )
  )
  else if ("gcc_blsp2_qup3_spi_apps_clk"=="&clk")
  (
    &match=1
  )
  
  if (&match==1)
  (
    &clk_test=&CLK_TEST_GCC_BLSP2_QUP3_SPI_APPS_CLK
    &clk_reg=&HWIO_GCC_BLSP2_QUP3_SPI_APPS_CBCR_ADDR
    &clk_reg_name="GCC_BLSP2_QUP3_SPI_APPS_CBCR"
    &clk_name="gcc_blsp2_qup3_spi_apps_clk"
    &clk_reg_cbcr_type="sm_cbc"
    &clk_vote_bit=-1.
    &clk_multiplier=1.

    gosub Print_Clk_Info_Line
  )

  &match=0
  &wild_head=0
  &wild_tail=0
  &clk_input_length=STRING.LENGTH("&clk")
  &clk_itr_length=STRING.LENGTH("gcc_blsp2_qup4_i2c_apps_clk")

  if (STRING.SCAN("&clk", "*", 0)==0)
  (
    &wild_head=1
  )
  if (STRING.SCAN("&clk", "*", 1)==(STRING.LENGTH("&clk")-1))
  (
    &wild_tail=1
  )

  if ((&wild_head==1)&&(&wild_tail==1))
  (
    if (STRING.SCAN("gcc_blsp2_qup4_i2c_apps_clk", STRING.MID("&clk", 1, &clk_input_length-2), 0)!=-1)
    ( 
      &match=1
    )
  )
  else if (&wild_head==1)
  (
    if (STRING.MID("gcc_blsp2_qup4_i2c_apps_clk", &clk_itr_length-&clk_input_length+1, &clk_input_length-1)==STRING.CUT("&clk", 1))
    ( 
      &match=1
    )
  )
  else if (&wild_tail==1)
  (
    if (STRING.MID("gcc_blsp2_qup4_i2c_apps_clk", 0, &clk_input_length-1)==STRING.CUT("&clk", -1))
    ( 
      &match=1
    )
  )
  else if ("gcc_blsp2_qup4_i2c_apps_clk"=="&clk")
  (
    &match=1
  )
  
  if (&match==1)
  (
    &clk_test=&CLK_TEST_GCC_BLSP2_QUP4_I2C_APPS_CLK
    &clk_reg=&HWIO_GCC_BLSP2_QUP4_I2C_APPS_CBCR_ADDR
    &clk_reg_name="GCC_BLSP2_QUP4_I2C_APPS_CBCR"
    &clk_name="gcc_blsp2_qup4_i2c_apps_clk"
    &clk_reg_cbcr_type="sm_cbc"
    &clk_vote_bit=-1.
    &clk_multiplier=1.

    gosub Print_Clk_Info_Line
  )

  &match=0
  &wild_head=0
  &wild_tail=0
  &clk_input_length=STRING.LENGTH("&clk")
  &clk_itr_length=STRING.LENGTH("gcc_blsp2_qup4_spi_apps_clk")

  if (STRING.SCAN("&clk", "*", 0)==0)
  (
    &wild_head=1
  )
  if (STRING.SCAN("&clk", "*", 1)==(STRING.LENGTH("&clk")-1))
  (
    &wild_tail=1
  )

  if ((&wild_head==1)&&(&wild_tail==1))
  (
    if (STRING.SCAN("gcc_blsp2_qup4_spi_apps_clk", STRING.MID("&clk", 1, &clk_input_length-2), 0)!=-1)
    ( 
      &match=1
    )
  )
  else if (&wild_head==1)
  (
    if (STRING.MID("gcc_blsp2_qup4_spi_apps_clk", &clk_itr_length-&clk_input_length+1, &clk_input_length-1)==STRING.CUT("&clk", 1))
    ( 
      &match=1
    )
  )
  else if (&wild_tail==1)
  (
    if (STRING.MID("gcc_blsp2_qup4_spi_apps_clk", 0, &clk_input_length-1)==STRING.CUT("&clk", -1))
    ( 
      &match=1
    )
  )
  else if ("gcc_blsp2_qup4_spi_apps_clk"=="&clk")
  (
    &match=1
  )
  
  if (&match==1)
  (
    &clk_test=&CLK_TEST_GCC_BLSP2_QUP4_SPI_APPS_CLK
    &clk_reg=&HWIO_GCC_BLSP2_QUP4_SPI_APPS_CBCR_ADDR
    &clk_reg_name="GCC_BLSP2_QUP4_SPI_APPS_CBCR"
    &clk_name="gcc_blsp2_qup4_spi_apps_clk"
    &clk_reg_cbcr_type="sm_cbc"
    &clk_vote_bit=-1.
    &clk_multiplier=1.

    gosub Print_Clk_Info_Line
  )

  &match=0
  &wild_head=0
  &wild_tail=0
  &clk_input_length=STRING.LENGTH("&clk")
  &clk_itr_length=STRING.LENGTH("gcc_blsp2_qup5_i2c_apps_clk")

  if (STRING.SCAN("&clk", "*", 0)==0)
  (
    &wild_head=1
  )
  if (STRING.SCAN("&clk", "*", 1)==(STRING.LENGTH("&clk")-1))
  (
    &wild_tail=1
  )

  if ((&wild_head==1)&&(&wild_tail==1))
  (
    if (STRING.SCAN("gcc_blsp2_qup5_i2c_apps_clk", STRING.MID("&clk", 1, &clk_input_length-2), 0)!=-1)
    ( 
      &match=1
    )
  )
  else if (&wild_head==1)
  (
    if (STRING.MID("gcc_blsp2_qup5_i2c_apps_clk", &clk_itr_length-&clk_input_length+1, &clk_input_length-1)==STRING.CUT("&clk", 1))
    ( 
      &match=1
    )
  )
  else if (&wild_tail==1)
  (
    if (STRING.MID("gcc_blsp2_qup5_i2c_apps_clk", 0, &clk_input_length-1)==STRING.CUT("&clk", -1))
    ( 
      &match=1
    )
  )
  else if ("gcc_blsp2_qup5_i2c_apps_clk"=="&clk")
  (
    &match=1
  )
  
  if (&match==1)
  (
    &clk_test=&CLK_TEST_GCC_BLSP2_QUP5_I2C_APPS_CLK
    &clk_reg=&HWIO_GCC_BLSP2_QUP5_I2C_APPS_CBCR_ADDR
    &clk_reg_name="GCC_BLSP2_QUP5_I2C_APPS_CBCR"
    &clk_name="gcc_blsp2_qup5_i2c_apps_clk"
    &clk_reg_cbcr_type="sm_cbc"
    &clk_vote_bit=-1.
    &clk_multiplier=1.

    gosub Print_Clk_Info_Line
  )

  &match=0
  &wild_head=0
  &wild_tail=0
  &clk_input_length=STRING.LENGTH("&clk")
  &clk_itr_length=STRING.LENGTH("gcc_blsp2_qup5_spi_apps_clk")

  if (STRING.SCAN("&clk", "*", 0)==0)
  (
    &wild_head=1
  )
  if (STRING.SCAN("&clk", "*", 1)==(STRING.LENGTH("&clk")-1))
  (
    &wild_tail=1
  )

  if ((&wild_head==1)&&(&wild_tail==1))
  (
    if (STRING.SCAN("gcc_blsp2_qup5_spi_apps_clk", STRING.MID("&clk", 1, &clk_input_length-2), 0)!=-1)
    ( 
      &match=1
    )
  )
  else if (&wild_head==1)
  (
    if (STRING.MID("gcc_blsp2_qup5_spi_apps_clk", &clk_itr_length-&clk_input_length+1, &clk_input_length-1)==STRING.CUT("&clk", 1))
    ( 
      &match=1
    )
  )
  else if (&wild_tail==1)
  (
    if (STRING.MID("gcc_blsp2_qup5_spi_apps_clk", 0, &clk_input_length-1)==STRING.CUT("&clk", -1))
    ( 
      &match=1
    )
  )
  else if ("gcc_blsp2_qup5_spi_apps_clk"=="&clk")
  (
    &match=1
  )
  
  if (&match==1)
  (
    &clk_test=&CLK_TEST_GCC_BLSP2_QUP5_SPI_APPS_CLK
    &clk_reg=&HWIO_GCC_BLSP2_QUP5_SPI_APPS_CBCR_ADDR
    &clk_reg_name="GCC_BLSP2_QUP5_SPI_APPS_CBCR"
    &clk_name="gcc_blsp2_qup5_spi_apps_clk"
    &clk_reg_cbcr_type="sm_cbc"
    &clk_vote_bit=-1.
    &clk_multiplier=1.

    gosub Print_Clk_Info_Line
  )

  &match=0
  &wild_head=0
  &wild_tail=0
  &clk_input_length=STRING.LENGTH("&clk")
  &clk_itr_length=STRING.LENGTH("gcc_blsp2_qup6_i2c_apps_clk")

  if (STRING.SCAN("&clk", "*", 0)==0)
  (
    &wild_head=1
  )
  if (STRING.SCAN("&clk", "*", 1)==(STRING.LENGTH("&clk")-1))
  (
    &wild_tail=1
  )

  if ((&wild_head==1)&&(&wild_tail==1))
  (
    if (STRING.SCAN("gcc_blsp2_qup6_i2c_apps_clk", STRING.MID("&clk", 1, &clk_input_length-2), 0)!=-1)
    ( 
      &match=1
    )
  )
  else if (&wild_head==1)
  (
    if (STRING.MID("gcc_blsp2_qup6_i2c_apps_clk", &clk_itr_length-&clk_input_length+1, &clk_input_length-1)==STRING.CUT("&clk", 1))
    ( 
      &match=1
    )
  )
  else if (&wild_tail==1)
  (
    if (STRING.MID("gcc_blsp2_qup6_i2c_apps_clk", 0, &clk_input_length-1)==STRING.CUT("&clk", -1))
    ( 
      &match=1
    )
  )
  else if ("gcc_blsp2_qup6_i2c_apps_clk"=="&clk")
  (
    &match=1
  )
  
  if (&match==1)
  (
    &clk_test=&CLK_TEST_GCC_BLSP2_QUP6_I2C_APPS_CLK
    &clk_reg=&HWIO_GCC_BLSP2_QUP6_I2C_APPS_CBCR_ADDR
    &clk_reg_name="GCC_BLSP2_QUP6_I2C_APPS_CBCR"
    &clk_name="gcc_blsp2_qup6_i2c_apps_clk"
    &clk_reg_cbcr_type="sm_cbc"
    &clk_vote_bit=-1.
    &clk_multiplier=1.

    gosub Print_Clk_Info_Line
  )

  &match=0
  &wild_head=0
  &wild_tail=0
  &clk_input_length=STRING.LENGTH("&clk")
  &clk_itr_length=STRING.LENGTH("gcc_blsp2_qup6_spi_apps_clk")

  if (STRING.SCAN("&clk", "*", 0)==0)
  (
    &wild_head=1
  )
  if (STRING.SCAN("&clk", "*", 1)==(STRING.LENGTH("&clk")-1))
  (
    &wild_tail=1
  )

  if ((&wild_head==1)&&(&wild_tail==1))
  (
    if (STRING.SCAN("gcc_blsp2_qup6_spi_apps_clk", STRING.MID("&clk", 1, &clk_input_length-2), 0)!=-1)
    ( 
      &match=1
    )
  )
  else if (&wild_head==1)
  (
    if (STRING.MID("gcc_blsp2_qup6_spi_apps_clk", &clk_itr_length-&clk_input_length+1, &clk_input_length-1)==STRING.CUT("&clk", 1))
    ( 
      &match=1
    )
  )
  else if (&wild_tail==1)
  (
    if (STRING.MID("gcc_blsp2_qup6_spi_apps_clk", 0, &clk_input_length-1)==STRING.CUT("&clk", -1))
    ( 
      &match=1
    )
  )
  else if ("gcc_blsp2_qup6_spi_apps_clk"=="&clk")
  (
    &match=1
  )
  
  if (&match==1)
  (
    &clk_test=&CLK_TEST_GCC_BLSP2_QUP6_SPI_APPS_CLK
    &clk_reg=&HWIO_GCC_BLSP2_QUP6_SPI_APPS_CBCR_ADDR
    &clk_reg_name="GCC_BLSP2_QUP6_SPI_APPS_CBCR"
    &clk_name="gcc_blsp2_qup6_spi_apps_clk"
    &clk_reg_cbcr_type="sm_cbc"
    &clk_vote_bit=-1.
    &clk_multiplier=1.

    gosub Print_Clk_Info_Line
  )

  &match=0
  &wild_head=0
  &wild_tail=0
  &clk_input_length=STRING.LENGTH("&clk")
  &clk_itr_length=STRING.LENGTH("gcc_blsp2_uart1_apps_clk")

  if (STRING.SCAN("&clk", "*", 0)==0)
  (
    &wild_head=1
  )
  if (STRING.SCAN("&clk", "*", 1)==(STRING.LENGTH("&clk")-1))
  (
    &wild_tail=1
  )

  if ((&wild_head==1)&&(&wild_tail==1))
  (
    if (STRING.SCAN("gcc_blsp2_uart1_apps_clk", STRING.MID("&clk", 1, &clk_input_length-2), 0)!=-1)
    ( 
      &match=1
    )
  )
  else if (&wild_head==1)
  (
    if (STRING.MID("gcc_blsp2_uart1_apps_clk", &clk_itr_length-&clk_input_length+1, &clk_input_length-1)==STRING.CUT("&clk", 1))
    ( 
      &match=1
    )
  )
  else if (&wild_tail==1)
  (
    if (STRING.MID("gcc_blsp2_uart1_apps_clk", 0, &clk_input_length-1)==STRING.CUT("&clk", -1))
    ( 
      &match=1
    )
  )
  else if ("gcc_blsp2_uart1_apps_clk"=="&clk")
  (
    &match=1
  )
  
  if (&match==1)
  (
    &clk_test=&CLK_TEST_GCC_BLSP2_UART1_APPS_CLK
    &clk_reg=&HWIO_GCC_BLSP2_UART1_APPS_CBCR_ADDR
    &clk_reg_name="GCC_BLSP2_UART1_APPS_CBCR"
    &clk_name="gcc_blsp2_uart1_apps_clk"
    &clk_reg_cbcr_type="sm_cbc"
    &clk_vote_bit=-1.
    &clk_multiplier=1.

    gosub Print_Clk_Info_Line
  )

  &match=0
  &wild_head=0
  &wild_tail=0
  &clk_input_length=STRING.LENGTH("&clk")
  &clk_itr_length=STRING.LENGTH("gcc_blsp2_uart2_apps_clk")

  if (STRING.SCAN("&clk", "*", 0)==0)
  (
    &wild_head=1
  )
  if (STRING.SCAN("&clk", "*", 1)==(STRING.LENGTH("&clk")-1))
  (
    &wild_tail=1
  )

  if ((&wild_head==1)&&(&wild_tail==1))
  (
    if (STRING.SCAN("gcc_blsp2_uart2_apps_clk", STRING.MID("&clk", 1, &clk_input_length-2), 0)!=-1)
    ( 
      &match=1
    )
  )
  else if (&wild_head==1)
  (
    if (STRING.MID("gcc_blsp2_uart2_apps_clk", &clk_itr_length-&clk_input_length+1, &clk_input_length-1)==STRING.CUT("&clk", 1))
    ( 
      &match=1
    )
  )
  else if (&wild_tail==1)
  (
    if (STRING.MID("gcc_blsp2_uart2_apps_clk", 0, &clk_input_length-1)==STRING.CUT("&clk", -1))
    ( 
      &match=1
    )
  )
  else if ("gcc_blsp2_uart2_apps_clk"=="&clk")
  (
    &match=1
  )
  
  if (&match==1)
  (
    &clk_test=&CLK_TEST_GCC_BLSP2_UART2_APPS_CLK
    &clk_reg=&HWIO_GCC_BLSP2_UART2_APPS_CBCR_ADDR
    &clk_reg_name="GCC_BLSP2_UART2_APPS_CBCR"
    &clk_name="gcc_blsp2_uart2_apps_clk"
    &clk_reg_cbcr_type="sm_cbc"
    &clk_vote_bit=-1.
    &clk_multiplier=1.

    gosub Print_Clk_Info_Line
  )

  &match=0
  &wild_head=0
  &wild_tail=0
  &clk_input_length=STRING.LENGTH("&clk")
  &clk_itr_length=STRING.LENGTH("gcc_blsp2_uart3_apps_clk")

  if (STRING.SCAN("&clk", "*", 0)==0)
  (
    &wild_head=1
  )
  if (STRING.SCAN("&clk", "*", 1)==(STRING.LENGTH("&clk")-1))
  (
    &wild_tail=1
  )

  if ((&wild_head==1)&&(&wild_tail==1))
  (
    if (STRING.SCAN("gcc_blsp2_uart3_apps_clk", STRING.MID("&clk", 1, &clk_input_length-2), 0)!=-1)
    ( 
      &match=1
    )
  )
  else if (&wild_head==1)
  (
    if (STRING.MID("gcc_blsp2_uart3_apps_clk", &clk_itr_length-&clk_input_length+1, &clk_input_length-1)==STRING.CUT("&clk", 1))
    ( 
      &match=1
    )
  )
  else if (&wild_tail==1)
  (
    if (STRING.MID("gcc_blsp2_uart3_apps_clk", 0, &clk_input_length-1)==STRING.CUT("&clk", -1))
    ( 
      &match=1
    )
  )
  else if ("gcc_blsp2_uart3_apps_clk"=="&clk")
  (
    &match=1
  )
  
  if (&match==1)
  (
    &clk_test=&CLK_TEST_GCC_BLSP2_UART3_APPS_CLK
    &clk_reg=&HWIO_GCC_BLSP2_UART3_APPS_CBCR_ADDR
    &clk_reg_name="GCC_BLSP2_UART3_APPS_CBCR"
    &clk_name="gcc_blsp2_uart3_apps_clk"
    &clk_reg_cbcr_type="sm_cbc"
    &clk_vote_bit=-1.
    &clk_multiplier=1.

    gosub Print_Clk_Info_Line
  )

  &match=0
  &wild_head=0
  &wild_tail=0
  &clk_input_length=STRING.LENGTH("&clk")
  &clk_itr_length=STRING.LENGTH("gcc_blsp2_uart4_apps_clk")

  if (STRING.SCAN("&clk", "*", 0)==0)
  (
    &wild_head=1
  )
  if (STRING.SCAN("&clk", "*", 1)==(STRING.LENGTH("&clk")-1))
  (
    &wild_tail=1
  )

  if ((&wild_head==1)&&(&wild_tail==1))
  (
    if (STRING.SCAN("gcc_blsp2_uart4_apps_clk", STRING.MID("&clk", 1, &clk_input_length-2), 0)!=-1)
    ( 
      &match=1
    )
  )
  else if (&wild_head==1)
  (
    if (STRING.MID("gcc_blsp2_uart4_apps_clk", &clk_itr_length-&clk_input_length+1, &clk_input_length-1)==STRING.CUT("&clk", 1))
    ( 
      &match=1
    )
  )
  else if (&wild_tail==1)
  (
    if (STRING.MID("gcc_blsp2_uart4_apps_clk", 0, &clk_input_length-1)==STRING.CUT("&clk", -1))
    ( 
      &match=1
    )
  )
  else if ("gcc_blsp2_uart4_apps_clk"=="&clk")
  (
    &match=1
  )
  
  if (&match==1)
  (
    &clk_test=&CLK_TEST_GCC_BLSP2_UART4_APPS_CLK
    &clk_reg=&HWIO_GCC_BLSP2_UART4_APPS_CBCR_ADDR
    &clk_reg_name="GCC_BLSP2_UART4_APPS_CBCR"
    &clk_name="gcc_blsp2_uart4_apps_clk"
    &clk_reg_cbcr_type="sm_cbc"
    &clk_vote_bit=-1.
    &clk_multiplier=1.

    gosub Print_Clk_Info_Line
  )

  &match=0
  &wild_head=0
  &wild_tail=0
  &clk_input_length=STRING.LENGTH("&clk")
  &clk_itr_length=STRING.LENGTH("gcc_blsp2_uart5_apps_clk")

  if (STRING.SCAN("&clk", "*", 0)==0)
  (
    &wild_head=1
  )
  if (STRING.SCAN("&clk", "*", 1)==(STRING.LENGTH("&clk")-1))
  (
    &wild_tail=1
  )

  if ((&wild_head==1)&&(&wild_tail==1))
  (
    if (STRING.SCAN("gcc_blsp2_uart5_apps_clk", STRING.MID("&clk", 1, &clk_input_length-2), 0)!=-1)
    ( 
      &match=1
    )
  )
  else if (&wild_head==1)
  (
    if (STRING.MID("gcc_blsp2_uart5_apps_clk", &clk_itr_length-&clk_input_length+1, &clk_input_length-1)==STRING.CUT("&clk", 1))
    ( 
      &match=1
    )
  )
  else if (&wild_tail==1)
  (
    if (STRING.MID("gcc_blsp2_uart5_apps_clk", 0, &clk_input_length-1)==STRING.CUT("&clk", -1))
    ( 
      &match=1
    )
  )
  else if ("gcc_blsp2_uart5_apps_clk"=="&clk")
  (
    &match=1
  )
  
  if (&match==1)
  (
    &clk_test=&CLK_TEST_GCC_BLSP2_UART5_APPS_CLK
    &clk_reg=&HWIO_GCC_BLSP2_UART5_APPS_CBCR_ADDR
    &clk_reg_name="GCC_BLSP2_UART5_APPS_CBCR"
    &clk_name="gcc_blsp2_uart5_apps_clk"
    &clk_reg_cbcr_type="sm_cbc"
    &clk_vote_bit=-1.
    &clk_multiplier=1.

    gosub Print_Clk_Info_Line
  )

  &match=0
  &wild_head=0
  &wild_tail=0
  &clk_input_length=STRING.LENGTH("&clk")
  &clk_itr_length=STRING.LENGTH("gcc_blsp2_uart6_apps_clk")

  if (STRING.SCAN("&clk", "*", 0)==0)
  (
    &wild_head=1
  )
  if (STRING.SCAN("&clk", "*", 1)==(STRING.LENGTH("&clk")-1))
  (
    &wild_tail=1
  )

  if ((&wild_head==1)&&(&wild_tail==1))
  (
    if (STRING.SCAN("gcc_blsp2_uart6_apps_clk", STRING.MID("&clk", 1, &clk_input_length-2), 0)!=-1)
    ( 
      &match=1
    )
  )
  else if (&wild_head==1)
  (
    if (STRING.MID("gcc_blsp2_uart6_apps_clk", &clk_itr_length-&clk_input_length+1, &clk_input_length-1)==STRING.CUT("&clk", 1))
    ( 
      &match=1
    )
  )
  else if (&wild_tail==1)
  (
    if (STRING.MID("gcc_blsp2_uart6_apps_clk", 0, &clk_input_length-1)==STRING.CUT("&clk", -1))
    ( 
      &match=1
    )
  )
  else if ("gcc_blsp2_uart6_apps_clk"=="&clk")
  (
    &match=1
  )
  
  if (&match==1)
  (
    &clk_test=&CLK_TEST_GCC_BLSP2_UART6_APPS_CLK
    &clk_reg=&HWIO_GCC_BLSP2_UART6_APPS_CBCR_ADDR
    &clk_reg_name="GCC_BLSP2_UART6_APPS_CBCR"
    &clk_name="gcc_blsp2_uart6_apps_clk"
    &clk_reg_cbcr_type="sm_cbc"
    &clk_vote_bit=-1.
    &clk_multiplier=1.

    gosub Print_Clk_Info_Line
  )

  &match=0
  &wild_head=0
  &wild_tail=0
  &clk_input_length=STRING.LENGTH("&clk")
  &clk_itr_length=STRING.LENGTH("gcc_blsp1_uart1_sim_clk")

  if (STRING.SCAN("&clk", "*", 0)==0)
  (
    &wild_head=1
  )
  if (STRING.SCAN("&clk", "*", 1)==(STRING.LENGTH("&clk")-1))
  (
    &wild_tail=1
  )

  if ((&wild_head==1)&&(&wild_tail==1))
  (
    if (STRING.SCAN("gcc_blsp1_uart1_sim_clk", STRING.MID("&clk", 1, &clk_input_length-2), 0)!=-1)
    ( 
      &match=1
    )
  )
  else if (&wild_head==1)
  (
    if (STRING.MID("gcc_blsp1_uart1_sim_clk", &clk_itr_length-&clk_input_length+1, &clk_input_length-1)==STRING.CUT("&clk", 1))
    ( 
      &match=1
    )
  )
  else if (&wild_tail==1)
  (
    if (STRING.MID("gcc_blsp1_uart1_sim_clk", 0, &clk_input_length-1)==STRING.CUT("&clk", -1))
    ( 
      &match=1
    )
  )
  else if ("gcc_blsp1_uart1_sim_clk"=="&clk")
  (
    &match=1
  )
  
  if (&match==1)
  (
    &clk_test=&CLK_TEST_GCC_BLSP1_UART1_SIM_CLK
    &clk_reg=&HWIO_GCC_BLSP1_UART1_SIM_CBCR_ADDR
    &clk_reg_name="GCC_BLSP1_UART1_SIM_CBCR"
    &clk_name="gcc_blsp1_uart1_sim_clk"
    &clk_reg_cbcr_type="sm_cbc"
    &clk_vote_bit=-1.
    &clk_multiplier=1.

    gosub Print_Clk_Info_Line
  )

  &match=0
  &wild_head=0
  &wild_tail=0
  &clk_input_length=STRING.LENGTH("&clk")
  &clk_itr_length=STRING.LENGTH("gcc_blsp1_uart2_sim_clk")

  if (STRING.SCAN("&clk", "*", 0)==0)
  (
    &wild_head=1
  )
  if (STRING.SCAN("&clk", "*", 1)==(STRING.LENGTH("&clk")-1))
  (
    &wild_tail=1
  )

  if ((&wild_head==1)&&(&wild_tail==1))
  (
    if (STRING.SCAN("gcc_blsp1_uart2_sim_clk", STRING.MID("&clk", 1, &clk_input_length-2), 0)!=-1)
    ( 
      &match=1
    )
  )
  else if (&wild_head==1)
  (
    if (STRING.MID("gcc_blsp1_uart2_sim_clk", &clk_itr_length-&clk_input_length+1, &clk_input_length-1)==STRING.CUT("&clk", 1))
    ( 
      &match=1
    )
  )
  else if (&wild_tail==1)
  (
    if (STRING.MID("gcc_blsp1_uart2_sim_clk", 0, &clk_input_length-1)==STRING.CUT("&clk", -1))
    ( 
      &match=1
    )
  )
  else if ("gcc_blsp1_uart2_sim_clk"=="&clk")
  (
    &match=1
  )
  
  if (&match==1)
  (
    &clk_test=&CLK_TEST_GCC_BLSP1_UART2_SIM_CLK
    &clk_reg=&HWIO_GCC_BLSP1_UART2_SIM_CBCR_ADDR
    &clk_reg_name="GCC_BLSP1_UART2_SIM_CBCR"
    &clk_name="gcc_blsp1_uart2_sim_clk"
    &clk_reg_cbcr_type="sm_cbc"
    &clk_vote_bit=-1.
    &clk_multiplier=1.

    gosub Print_Clk_Info_Line
  )

  &match=0
  &wild_head=0
  &wild_tail=0
  &clk_input_length=STRING.LENGTH("&clk")
  &clk_itr_length=STRING.LENGTH("gcc_blsp1_uart3_sim_clk")

  if (STRING.SCAN("&clk", "*", 0)==0)
  (
    &wild_head=1
  )
  if (STRING.SCAN("&clk", "*", 1)==(STRING.LENGTH("&clk")-1))
  (
    &wild_tail=1
  )

  if ((&wild_head==1)&&(&wild_tail==1))
  (
    if (STRING.SCAN("gcc_blsp1_uart3_sim_clk", STRING.MID("&clk", 1, &clk_input_length-2), 0)!=-1)
    ( 
      &match=1
    )
  )
  else if (&wild_head==1)
  (
    if (STRING.MID("gcc_blsp1_uart3_sim_clk", &clk_itr_length-&clk_input_length+1, &clk_input_length-1)==STRING.CUT("&clk", 1))
    ( 
      &match=1
    )
  )
  else if (&wild_tail==1)
  (
    if (STRING.MID("gcc_blsp1_uart3_sim_clk", 0, &clk_input_length-1)==STRING.CUT("&clk", -1))
    ( 
      &match=1
    )
  )
  else if ("gcc_blsp1_uart3_sim_clk"=="&clk")
  (
    &match=1
  )
  
  if (&match==1)
  (
    &clk_test=&CLK_TEST_GCC_BLSP1_UART3_SIM_CLK
    &clk_reg=&HWIO_GCC_BLSP1_UART3_SIM_CBCR_ADDR
    &clk_reg_name="GCC_BLSP1_UART3_SIM_CBCR"
    &clk_name="gcc_blsp1_uart3_sim_clk"
    &clk_reg_cbcr_type="sm_cbc"
    &clk_vote_bit=-1.
    &clk_multiplier=1.

    gosub Print_Clk_Info_Line
  )

  &match=0
  &wild_head=0
  &wild_tail=0
  &clk_input_length=STRING.LENGTH("&clk")
  &clk_itr_length=STRING.LENGTH("gcc_blsp1_uart4_sim_clk")

  if (STRING.SCAN("&clk", "*", 0)==0)
  (
    &wild_head=1
  )
  if (STRING.SCAN("&clk", "*", 1)==(STRING.LENGTH("&clk")-1))
  (
    &wild_tail=1
  )

  if ((&wild_head==1)&&(&wild_tail==1))
  (
    if (STRING.SCAN("gcc_blsp1_uart4_sim_clk", STRING.MID("&clk", 1, &clk_input_length-2), 0)!=-1)
    ( 
      &match=1
    )
  )
  else if (&wild_head==1)
  (
    if (STRING.MID("gcc_blsp1_uart4_sim_clk", &clk_itr_length-&clk_input_length+1, &clk_input_length-1)==STRING.CUT("&clk", 1))
    ( 
      &match=1
    )
  )
  else if (&wild_tail==1)
  (
    if (STRING.MID("gcc_blsp1_uart4_sim_clk", 0, &clk_input_length-1)==STRING.CUT("&clk", -1))
    ( 
      &match=1
    )
  )
  else if ("gcc_blsp1_uart4_sim_clk"=="&clk")
  (
    &match=1
  )
  
  if (&match==1)
  (
    &clk_test=&CLK_TEST_GCC_BLSP1_UART4_SIM_CLK
    &clk_reg=&HWIO_GCC_BLSP1_UART4_SIM_CBCR_ADDR
    &clk_reg_name="GCC_BLSP1_UART4_SIM_CBCR"
    &clk_name="gcc_blsp1_uart4_sim_clk"
    &clk_reg_cbcr_type="sm_cbc"
    &clk_vote_bit=-1.
    &clk_multiplier=1.

    gosub Print_Clk_Info_Line
  )

  &match=0
  &wild_head=0
  &wild_tail=0
  &clk_input_length=STRING.LENGTH("&clk")
  &clk_itr_length=STRING.LENGTH("gcc_blsp1_uart5_sim_clk")

  if (STRING.SCAN("&clk", "*", 0)==0)
  (
    &wild_head=1
  )
  if (STRING.SCAN("&clk", "*", 1)==(STRING.LENGTH("&clk")-1))
  (
    &wild_tail=1
  )

  if ((&wild_head==1)&&(&wild_tail==1))
  (
    if (STRING.SCAN("gcc_blsp1_uart5_sim_clk", STRING.MID("&clk", 1, &clk_input_length-2), 0)!=-1)
    ( 
      &match=1
    )
  )
  else if (&wild_head==1)
  (
    if (STRING.MID("gcc_blsp1_uart5_sim_clk", &clk_itr_length-&clk_input_length+1, &clk_input_length-1)==STRING.CUT("&clk", 1))
    ( 
      &match=1
    )
  )
  else if (&wild_tail==1)
  (
    if (STRING.MID("gcc_blsp1_uart5_sim_clk", 0, &clk_input_length-1)==STRING.CUT("&clk", -1))
    ( 
      &match=1
    )
  )
  else if ("gcc_blsp1_uart5_sim_clk"=="&clk")
  (
    &match=1
  )
  
  if (&match==1)
  (
    &clk_test=&CLK_TEST_GCC_BLSP1_UART5_SIM_CLK
    &clk_reg=&HWIO_GCC_BLSP1_UART5_SIM_CBCR_ADDR
    &clk_reg_name="GCC_BLSP1_UART5_SIM_CBCR"
    &clk_name="gcc_blsp1_uart5_sim_clk"
    &clk_reg_cbcr_type="sm_cbc"
    &clk_vote_bit=-1.
    &clk_multiplier=1.

    gosub Print_Clk_Info_Line
  )

  &match=0
  &wild_head=0
  &wild_tail=0
  &clk_input_length=STRING.LENGTH("&clk")
  &clk_itr_length=STRING.LENGTH("gcc_blsp1_uart6_sim_clk")

  if (STRING.SCAN("&clk", "*", 0)==0)
  (
    &wild_head=1
  )
  if (STRING.SCAN("&clk", "*", 1)==(STRING.LENGTH("&clk")-1))
  (
    &wild_tail=1
  )

  if ((&wild_head==1)&&(&wild_tail==1))
  (
    if (STRING.SCAN("gcc_blsp1_uart6_sim_clk", STRING.MID("&clk", 1, &clk_input_length-2), 0)!=-1)
    ( 
      &match=1
    )
  )
  else if (&wild_head==1)
  (
    if (STRING.MID("gcc_blsp1_uart6_sim_clk", &clk_itr_length-&clk_input_length+1, &clk_input_length-1)==STRING.CUT("&clk", 1))
    ( 
      &match=1
    )
  )
  else if (&wild_tail==1)
  (
    if (STRING.MID("gcc_blsp1_uart6_sim_clk", 0, &clk_input_length-1)==STRING.CUT("&clk", -1))
    ( 
      &match=1
    )
  )
  else if ("gcc_blsp1_uart6_sim_clk"=="&clk")
  (
    &match=1
  )
  
  if (&match==1)
  (
    &clk_test=&CLK_TEST_GCC_BLSP1_UART6_SIM_CLK
    &clk_reg=&HWIO_GCC_BLSP1_UART6_SIM_CBCR_ADDR
    &clk_reg_name="GCC_BLSP1_UART6_SIM_CBCR"
    &clk_name="gcc_blsp1_uart6_sim_clk"
    &clk_reg_cbcr_type="sm_cbc"
    &clk_vote_bit=-1.
    &clk_multiplier=1.

    gosub Print_Clk_Info_Line
  )

  &match=0
  &wild_head=0
  &wild_tail=0
  &clk_input_length=STRING.LENGTH("&clk")
  &clk_itr_length=STRING.LENGTH("gcc_blsp2_uart1_sim_clk")

  if (STRING.SCAN("&clk", "*", 0)==0)
  (
    &wild_head=1
  )
  if (STRING.SCAN("&clk", "*", 1)==(STRING.LENGTH("&clk")-1))
  (
    &wild_tail=1
  )

  if ((&wild_head==1)&&(&wild_tail==1))
  (
    if (STRING.SCAN("gcc_blsp2_uart1_sim_clk", STRING.MID("&clk", 1, &clk_input_length-2), 0)!=-1)
    ( 
      &match=1
    )
  )
  else if (&wild_head==1)
  (
    if (STRING.MID("gcc_blsp2_uart1_sim_clk", &clk_itr_length-&clk_input_length+1, &clk_input_length-1)==STRING.CUT("&clk", 1))
    ( 
      &match=1
    )
  )
  else if (&wild_tail==1)
  (
    if (STRING.MID("gcc_blsp2_uart1_sim_clk", 0, &clk_input_length-1)==STRING.CUT("&clk", -1))
    ( 
      &match=1
    )
  )
  else if ("gcc_blsp2_uart1_sim_clk"=="&clk")
  (
    &match=1
  )
  
  if (&match==1)
  (
    &clk_test=&CLK_TEST_GCC_BLSP2_UART1_SIM_CLK
    &clk_reg=&HWIO_GCC_BLSP2_UART1_SIM_CBCR_ADDR
    &clk_reg_name="GCC_BLSP2_UART1_SIM_CBCR"
    &clk_name="gcc_blsp2_uart1_sim_clk"
    &clk_reg_cbcr_type="sm_cbc"
    &clk_vote_bit=-1.
    &clk_multiplier=1.

    gosub Print_Clk_Info_Line
  )

  &match=0
  &wild_head=0
  &wild_tail=0
  &clk_input_length=STRING.LENGTH("&clk")
  &clk_itr_length=STRING.LENGTH("gcc_blsp2_uart2_sim_clk")

  if (STRING.SCAN("&clk", "*", 0)==0)
  (
    &wild_head=1
  )
  if (STRING.SCAN("&clk", "*", 1)==(STRING.LENGTH("&clk")-1))
  (
    &wild_tail=1
  )

  if ((&wild_head==1)&&(&wild_tail==1))
  (
    if (STRING.SCAN("gcc_blsp2_uart2_sim_clk", STRING.MID("&clk", 1, &clk_input_length-2), 0)!=-1)
    ( 
      &match=1
    )
  )
  else if (&wild_head==1)
  (
    if (STRING.MID("gcc_blsp2_uart2_sim_clk", &clk_itr_length-&clk_input_length+1, &clk_input_length-1)==STRING.CUT("&clk", 1))
    ( 
      &match=1
    )
  )
  else if (&wild_tail==1)
  (
    if (STRING.MID("gcc_blsp2_uart2_sim_clk", 0, &clk_input_length-1)==STRING.CUT("&clk", -1))
    ( 
      &match=1
    )
  )
  else if ("gcc_blsp2_uart2_sim_clk"=="&clk")
  (
    &match=1
  )
  
  if (&match==1)
  (
    &clk_test=&CLK_TEST_GCC_BLSP2_UART2_SIM_CLK
    &clk_reg=&HWIO_GCC_BLSP2_UART2_SIM_CBCR_ADDR
    &clk_reg_name="GCC_BLSP2_UART2_SIM_CBCR"
    &clk_name="gcc_blsp2_uart2_sim_clk"
    &clk_reg_cbcr_type="sm_cbc"
    &clk_vote_bit=-1.
    &clk_multiplier=1.

    gosub Print_Clk_Info_Line
  )

  &match=0
  &wild_head=0
  &wild_tail=0
  &clk_input_length=STRING.LENGTH("&clk")
  &clk_itr_length=STRING.LENGTH("gcc_blsp2_uart3_sim_clk")

  if (STRING.SCAN("&clk", "*", 0)==0)
  (
    &wild_head=1
  )
  if (STRING.SCAN("&clk", "*", 1)==(STRING.LENGTH("&clk")-1))
  (
    &wild_tail=1
  )

  if ((&wild_head==1)&&(&wild_tail==1))
  (
    if (STRING.SCAN("gcc_blsp2_uart3_sim_clk", STRING.MID("&clk", 1, &clk_input_length-2), 0)!=-1)
    ( 
      &match=1
    )
  )
  else if (&wild_head==1)
  (
    if (STRING.MID("gcc_blsp2_uart3_sim_clk", &clk_itr_length-&clk_input_length+1, &clk_input_length-1)==STRING.CUT("&clk", 1))
    ( 
      &match=1
    )
  )
  else if (&wild_tail==1)
  (
    if (STRING.MID("gcc_blsp2_uart3_sim_clk", 0, &clk_input_length-1)==STRING.CUT("&clk", -1))
    ( 
      &match=1
    )
  )
  else if ("gcc_blsp2_uart3_sim_clk"=="&clk")
  (
    &match=1
  )
  
  if (&match==1)
  (
    &clk_test=&CLK_TEST_GCC_BLSP2_UART3_SIM_CLK
    &clk_reg=&HWIO_GCC_BLSP2_UART3_SIM_CBCR_ADDR
    &clk_reg_name="GCC_BLSP2_UART3_SIM_CBCR"
    &clk_name="gcc_blsp2_uart3_sim_clk"
    &clk_reg_cbcr_type="sm_cbc"
    &clk_vote_bit=-1.
    &clk_multiplier=1.

    gosub Print_Clk_Info_Line
  )

  &match=0
  &wild_head=0
  &wild_tail=0
  &clk_input_length=STRING.LENGTH("&clk")
  &clk_itr_length=STRING.LENGTH("gcc_blsp2_uart4_sim_clk")

  if (STRING.SCAN("&clk", "*", 0)==0)
  (
    &wild_head=1
  )
  if (STRING.SCAN("&clk", "*", 1)==(STRING.LENGTH("&clk")-1))
  (
    &wild_tail=1
  )

  if ((&wild_head==1)&&(&wild_tail==1))
  (
    if (STRING.SCAN("gcc_blsp2_uart4_sim_clk", STRING.MID("&clk", 1, &clk_input_length-2), 0)!=-1)
    ( 
      &match=1
    )
  )
  else if (&wild_head==1)
  (
    if (STRING.MID("gcc_blsp2_uart4_sim_clk", &clk_itr_length-&clk_input_length+1, &clk_input_length-1)==STRING.CUT("&clk", 1))
    ( 
      &match=1
    )
  )
  else if (&wild_tail==1)
  (
    if (STRING.MID("gcc_blsp2_uart4_sim_clk", 0, &clk_input_length-1)==STRING.CUT("&clk", -1))
    ( 
      &match=1
    )
  )
  else if ("gcc_blsp2_uart4_sim_clk"=="&clk")
  (
    &match=1
  )
  
  if (&match==1)
  (
    &clk_test=&CLK_TEST_GCC_BLSP2_UART4_SIM_CLK
    &clk_reg=&HWIO_GCC_BLSP2_UART4_SIM_CBCR_ADDR
    &clk_reg_name="GCC_BLSP2_UART4_SIM_CBCR"
    &clk_name="gcc_blsp2_uart4_sim_clk"
    &clk_reg_cbcr_type="sm_cbc"
    &clk_vote_bit=-1.
    &clk_multiplier=1.

    gosub Print_Clk_Info_Line
  )

  &match=0
  &wild_head=0
  &wild_tail=0
  &clk_input_length=STRING.LENGTH("&clk")
  &clk_itr_length=STRING.LENGTH("gcc_blsp2_uart5_sim_clk")

  if (STRING.SCAN("&clk", "*", 0)==0)
  (
    &wild_head=1
  )
  if (STRING.SCAN("&clk", "*", 1)==(STRING.LENGTH("&clk")-1))
  (
    &wild_tail=1
  )

  if ((&wild_head==1)&&(&wild_tail==1))
  (
    if (STRING.SCAN("gcc_blsp2_uart5_sim_clk", STRING.MID("&clk", 1, &clk_input_length-2), 0)!=-1)
    ( 
      &match=1
    )
  )
  else if (&wild_head==1)
  (
    if (STRING.MID("gcc_blsp2_uart5_sim_clk", &clk_itr_length-&clk_input_length+1, &clk_input_length-1)==STRING.CUT("&clk", 1))
    ( 
      &match=1
    )
  )
  else if (&wild_tail==1)
  (
    if (STRING.MID("gcc_blsp2_uart5_sim_clk", 0, &clk_input_length-1)==STRING.CUT("&clk", -1))
    ( 
      &match=1
    )
  )
  else if ("gcc_blsp2_uart5_sim_clk"=="&clk")
  (
    &match=1
  )
  
  if (&match==1)
  (
    &clk_test=&CLK_TEST_GCC_BLSP2_UART5_SIM_CLK
    &clk_reg=&HWIO_GCC_BLSP2_UART5_SIM_CBCR_ADDR
    &clk_reg_name="GCC_BLSP2_UART5_SIM_CBCR"
    &clk_name="gcc_blsp2_uart5_sim_clk"
    &clk_reg_cbcr_type="sm_cbc"
    &clk_vote_bit=-1.
    &clk_multiplier=1.

    gosub Print_Clk_Info_Line
  )

  &match=0
  &wild_head=0
  &wild_tail=0
  &clk_input_length=STRING.LENGTH("&clk")
  &clk_itr_length=STRING.LENGTH("gcc_blsp2_uart6_sim_clk")

  if (STRING.SCAN("&clk", "*", 0)==0)
  (
    &wild_head=1
  )
  if (STRING.SCAN("&clk", "*", 1)==(STRING.LENGTH("&clk")-1))
  (
    &wild_tail=1
  )

  if ((&wild_head==1)&&(&wild_tail==1))
  (
    if (STRING.SCAN("gcc_blsp2_uart6_sim_clk", STRING.MID("&clk", 1, &clk_input_length-2), 0)!=-1)
    ( 
      &match=1
    )
  )
  else if (&wild_head==1)
  (
    if (STRING.MID("gcc_blsp2_uart6_sim_clk", &clk_itr_length-&clk_input_length+1, &clk_input_length-1)==STRING.CUT("&clk", 1))
    ( 
      &match=1
    )
  )
  else if (&wild_tail==1)
  (
    if (STRING.MID("gcc_blsp2_uart6_sim_clk", 0, &clk_input_length-1)==STRING.CUT("&clk", -1))
    ( 
      &match=1
    )
  )
  else if ("gcc_blsp2_uart6_sim_clk"=="&clk")
  (
    &match=1
  )
  
  if (&match==1)
  (
    &clk_test=&CLK_TEST_GCC_BLSP2_UART6_SIM_CLK
    &clk_reg=&HWIO_GCC_BLSP2_UART6_SIM_CBCR_ADDR
    &clk_reg_name="GCC_BLSP2_UART6_SIM_CBCR"
    &clk_name="gcc_blsp2_uart6_sim_clk"
    &clk_reg_cbcr_type="sm_cbc"
    &clk_vote_bit=-1.
    &clk_multiplier=1.

    gosub Print_Clk_Info_Line
  )

  &match=0
  &wild_head=0
  &wild_tail=0
  &clk_input_length=STRING.LENGTH("&clk")
  &clk_itr_length=STRING.LENGTH("gcc_ce1_clk")

  if (STRING.SCAN("&clk", "*", 0)==0)
  (
    &wild_head=1
  )
  if (STRING.SCAN("&clk", "*", 1)==(STRING.LENGTH("&clk")-1))
  (
    &wild_tail=1
  )

  if ((&wild_head==1)&&(&wild_tail==1))
  (
    if (STRING.SCAN("gcc_ce1_clk", STRING.MID("&clk", 1, &clk_input_length-2), 0)!=-1)
    ( 
      &match=1
    )
  )
  else if (&wild_head==1)
  (
    if (STRING.MID("gcc_ce1_clk", &clk_itr_length-&clk_input_length+1, &clk_input_length-1)==STRING.CUT("&clk", 1))
    ( 
      &match=1
    )
  )
  else if (&wild_tail==1)
  (
    if (STRING.MID("gcc_ce1_clk", 0, &clk_input_length-1)==STRING.CUT("&clk", -1))
    ( 
      &match=1
    )
  )
  else if ("gcc_ce1_clk"=="&clk")
  (
    &match=1
  )
  
  if (&match==1)
  (
    &clk_test=&CLK_TEST_GCC_CE1_CLK
    &clk_reg=&HWIO_GCC_CE1_CBCR_ADDR
    &clk_reg_name="GCC_CE1_CBCR"
    &clk_name="gcc_ce1_clk"
    &clk_reg_cbcr_type="sm_pscbc"
    &clk_vote_bit=5.
    &clk_multiplier=1.

    gosub Print_Clk_Info_Line
  )

  &match=0
  &wild_head=0
  &wild_tail=0
  &clk_input_length=STRING.LENGTH("&clk")
  &clk_itr_length=STRING.LENGTH("gcc_aggre0_cnoc_ahb_clk")

  if (STRING.SCAN("&clk", "*", 0)==0)
  (
    &wild_head=1
  )
  if (STRING.SCAN("&clk", "*", 1)==(STRING.LENGTH("&clk")-1))
  (
    &wild_tail=1
  )

  if ((&wild_head==1)&&(&wild_tail==1))
  (
    if (STRING.SCAN("gcc_aggre0_cnoc_ahb_clk", STRING.MID("&clk", 1, &clk_input_length-2), 0)!=-1)
    ( 
      &match=1
    )
  )
  else if (&wild_head==1)
  (
    if (STRING.MID("gcc_aggre0_cnoc_ahb_clk", &clk_itr_length-&clk_input_length+1, &clk_input_length-1)==STRING.CUT("&clk", 1))
    ( 
      &match=1
    )
  )
  else if (&wild_tail==1)
  (
    if (STRING.MID("gcc_aggre0_cnoc_ahb_clk", 0, &clk_input_length-1)==STRING.CUT("&clk", -1))
    ( 
      &match=1
    )
  )
  else if ("gcc_aggre0_cnoc_ahb_clk"=="&clk")
  (
    &match=1
  )
  
  if (&match==1)
  (
    &clk_test=&CLK_TEST_GCC_AGGRE0_CNOC_AHB_CLK
    &clk_reg=&HWIO_GCC_AGGRE0_CNOC_AHB_CBCR_ADDR
    &clk_reg_name="GCC_AGGRE0_CNOC_AHB_CBCR"
    &clk_name="gcc_aggre0_cnoc_ahb_clk"
    &clk_reg_cbcr_type="sm_cbc"
    &clk_vote_bit=-1.
    &clk_multiplier=1.

    gosub Print_Clk_Info_Line
  )

  &match=0
  &wild_head=0
  &wild_tail=0
  &clk_input_length=STRING.LENGTH("&clk")
  &clk_itr_length=STRING.LENGTH("gcc_aggre0_noc_mpu_cfg_ahb_clk")

  if (STRING.SCAN("&clk", "*", 0)==0)
  (
    &wild_head=1
  )
  if (STRING.SCAN("&clk", "*", 1)==(STRING.LENGTH("&clk")-1))
  (
    &wild_tail=1
  )

  if ((&wild_head==1)&&(&wild_tail==1))
  (
    if (STRING.SCAN("gcc_aggre0_noc_mpu_cfg_ahb_clk", STRING.MID("&clk", 1, &clk_input_length-2), 0)!=-1)
    ( 
      &match=1
    )
  )
  else if (&wild_head==1)
  (
    if (STRING.MID("gcc_aggre0_noc_mpu_cfg_ahb_clk", &clk_itr_length-&clk_input_length+1, &clk_input_length-1)==STRING.CUT("&clk", 1))
    ( 
      &match=1
    )
  )
  else if (&wild_tail==1)
  (
    if (STRING.MID("gcc_aggre0_noc_mpu_cfg_ahb_clk", 0, &clk_input_length-1)==STRING.CUT("&clk", -1))
    ( 
      &match=1
    )
  )
  else if ("gcc_aggre0_noc_mpu_cfg_ahb_clk"=="&clk")
  (
    &match=1
  )
  
  if (&match==1)
  (
    &clk_test=&CLK_TEST_GCC_AGGRE0_NOC_MPU_CFG_AHB_CLK
    &clk_reg=&HWIO_GCC_AGGRE0_NOC_MPU_CFG_AHB_CBCR_ADDR
    &clk_reg_name="GCC_AGGRE0_NOC_MPU_CFG_AHB_CBCR"
    &clk_name="gcc_aggre0_noc_mpu_cfg_ahb_clk"
    &clk_reg_cbcr_type="sm_cbc"
    &clk_vote_bit=-1.
    &clk_multiplier=1.

    gosub Print_Clk_Info_Line
  )

  &match=0
  &wild_head=0
  &wild_tail=0
  &clk_input_length=STRING.LENGTH("&clk")
  &clk_itr_length=STRING.LENGTH("gcc_aggre1_cnoc_ahb_clk")

  if (STRING.SCAN("&clk", "*", 0)==0)
  (
    &wild_head=1
  )
  if (STRING.SCAN("&clk", "*", 1)==(STRING.LENGTH("&clk")-1))
  (
    &wild_tail=1
  )

  if ((&wild_head==1)&&(&wild_tail==1))
  (
    if (STRING.SCAN("gcc_aggre1_cnoc_ahb_clk", STRING.MID("&clk", 1, &clk_input_length-2), 0)!=-1)
    ( 
      &match=1
    )
  )
  else if (&wild_head==1)
  (
    if (STRING.MID("gcc_aggre1_cnoc_ahb_clk", &clk_itr_length-&clk_input_length+1, &clk_input_length-1)==STRING.CUT("&clk", 1))
    ( 
      &match=1
    )
  )
  else if (&wild_tail==1)
  (
    if (STRING.MID("gcc_aggre1_cnoc_ahb_clk", 0, &clk_input_length-1)==STRING.CUT("&clk", -1))
    ( 
      &match=1
    )
  )
  else if ("gcc_aggre1_cnoc_ahb_clk"=="&clk")
  (
    &match=1
  )
  
  if (&match==1)
  (
    &clk_test=&CLK_TEST_GCC_AGGRE1_CNOC_AHB_CLK
    &clk_reg=&HWIO_GCC_AGGRE1_CNOC_AHB_CBCR_ADDR
    &clk_reg_name="GCC_AGGRE1_CNOC_AHB_CBCR"
    &clk_name="gcc_aggre1_cnoc_ahb_clk"
    &clk_reg_cbcr_type="sm_cbc"
    &clk_vote_bit=-1.
    &clk_multiplier=1.

    gosub Print_Clk_Info_Line
  )

  &match=0
  &wild_head=0
  &wild_tail=0
  &clk_input_length=STRING.LENGTH("&clk")
  &clk_itr_length=STRING.LENGTH("gcc_aggre1_noc_mpu_cfg_ahb_clk")

  if (STRING.SCAN("&clk", "*", 0)==0)
  (
    &wild_head=1
  )
  if (STRING.SCAN("&clk", "*", 1)==(STRING.LENGTH("&clk")-1))
  (
    &wild_tail=1
  )

  if ((&wild_head==1)&&(&wild_tail==1))
  (
    if (STRING.SCAN("gcc_aggre1_noc_mpu_cfg_ahb_clk", STRING.MID("&clk", 1, &clk_input_length-2), 0)!=-1)
    ( 
      &match=1
    )
  )
  else if (&wild_head==1)
  (
    if (STRING.MID("gcc_aggre1_noc_mpu_cfg_ahb_clk", &clk_itr_length-&clk_input_length+1, &clk_input_length-1)==STRING.CUT("&clk", 1))
    ( 
      &match=1
    )
  )
  else if (&wild_tail==1)
  (
    if (STRING.MID("gcc_aggre1_noc_mpu_cfg_ahb_clk", 0, &clk_input_length-1)==STRING.CUT("&clk", -1))
    ( 
      &match=1
    )
  )
  else if ("gcc_aggre1_noc_mpu_cfg_ahb_clk"=="&clk")
  (
    &match=1
  )
  
  if (&match==1)
  (
    &clk_test=&CLK_TEST_GCC_AGGRE1_NOC_MPU_CFG_AHB_CLK
    &clk_reg=&HWIO_GCC_AGGRE1_NOC_MPU_CFG_AHB_CBCR_ADDR
    &clk_reg_name="GCC_AGGRE1_NOC_MPU_CFG_AHB_CBCR"
    &clk_name="gcc_aggre1_noc_mpu_cfg_ahb_clk"
    &clk_reg_cbcr_type="sm_cbc"
    &clk_vote_bit=-1.
    &clk_multiplier=1.

    gosub Print_Clk_Info_Line
  )

  &match=0
  &wild_head=0
  &wild_tail=0
  &clk_input_length=STRING.LENGTH("&clk")
  &clk_itr_length=STRING.LENGTH("gcc_aggre2_cnoc_ahb_clk")

  if (STRING.SCAN("&clk", "*", 0)==0)
  (
    &wild_head=1
  )
  if (STRING.SCAN("&clk", "*", 1)==(STRING.LENGTH("&clk")-1))
  (
    &wild_tail=1
  )

  if ((&wild_head==1)&&(&wild_tail==1))
  (
    if (STRING.SCAN("gcc_aggre2_cnoc_ahb_clk", STRING.MID("&clk", 1, &clk_input_length-2), 0)!=-1)
    ( 
      &match=1
    )
  )
  else if (&wild_head==1)
  (
    if (STRING.MID("gcc_aggre2_cnoc_ahb_clk", &clk_itr_length-&clk_input_length+1, &clk_input_length-1)==STRING.CUT("&clk", 1))
    ( 
      &match=1
    )
  )
  else if (&wild_tail==1)
  (
    if (STRING.MID("gcc_aggre2_cnoc_ahb_clk", 0, &clk_input_length-1)==STRING.CUT("&clk", -1))
    ( 
      &match=1
    )
  )
  else if ("gcc_aggre2_cnoc_ahb_clk"=="&clk")
  (
    &match=1
  )
  
  if (&match==1)
  (
    &clk_test=&CLK_TEST_GCC_AGGRE2_CNOC_AHB_CLK
    &clk_reg=&HWIO_GCC_AGGRE2_CNOC_AHB_CBCR_ADDR
    &clk_reg_name="GCC_AGGRE2_CNOC_AHB_CBCR"
    &clk_name="gcc_aggre2_cnoc_ahb_clk"
    &clk_reg_cbcr_type="sm_cbc"
    &clk_vote_bit=-1.
    &clk_multiplier=1.

    gosub Print_Clk_Info_Line
  )

  &match=0
  &wild_head=0
  &wild_tail=0
  &clk_input_length=STRING.LENGTH("&clk")
  &clk_itr_length=STRING.LENGTH("gcc_aggre2_noc_mpu_cfg_ahb_clk")

  if (STRING.SCAN("&clk", "*", 0)==0)
  (
    &wild_head=1
  )
  if (STRING.SCAN("&clk", "*", 1)==(STRING.LENGTH("&clk")-1))
  (
    &wild_tail=1
  )

  if ((&wild_head==1)&&(&wild_tail==1))
  (
    if (STRING.SCAN("gcc_aggre2_noc_mpu_cfg_ahb_clk", STRING.MID("&clk", 1, &clk_input_length-2), 0)!=-1)
    ( 
      &match=1
    )
  )
  else if (&wild_head==1)
  (
    if (STRING.MID("gcc_aggre2_noc_mpu_cfg_ahb_clk", &clk_itr_length-&clk_input_length+1, &clk_input_length-1)==STRING.CUT("&clk", 1))
    ( 
      &match=1
    )
  )
  else if (&wild_tail==1)
  (
    if (STRING.MID("gcc_aggre2_noc_mpu_cfg_ahb_clk", 0, &clk_input_length-1)==STRING.CUT("&clk", -1))
    ( 
      &match=1
    )
  )
  else if ("gcc_aggre2_noc_mpu_cfg_ahb_clk"=="&clk")
  (
    &match=1
  )
  
  if (&match==1)
  (
    &clk_test=&CLK_TEST_GCC_AGGRE2_NOC_MPU_CFG_AHB_CLK
    &clk_reg=&HWIO_GCC_AGGRE2_NOC_MPU_CFG_AHB_CBCR_ADDR
    &clk_reg_name="GCC_AGGRE2_NOC_MPU_CFG_AHB_CBCR"
    &clk_name="gcc_aggre2_noc_mpu_cfg_ahb_clk"
    &clk_reg_cbcr_type="sm_cbc"
    &clk_vote_bit=-1.
    &clk_multiplier=1.

    gosub Print_Clk_Info_Line
  )

  &match=0
  &wild_head=0
  &wild_tail=0
  &clk_input_length=STRING.LENGTH("&clk")
  &clk_itr_length=STRING.LENGTH("gcc_ahb_clk")

  if (STRING.SCAN("&clk", "*", 0)==0)
  (
    &wild_head=1
  )
  if (STRING.SCAN("&clk", "*", 1)==(STRING.LENGTH("&clk")-1))
  (
    &wild_tail=1
  )

  if ((&wild_head==1)&&(&wild_tail==1))
  (
    if (STRING.SCAN("gcc_ahb_clk", STRING.MID("&clk", 1, &clk_input_length-2), 0)!=-1)
    ( 
      &match=1
    )
  )
  else if (&wild_head==1)
  (
    if (STRING.MID("gcc_ahb_clk", &clk_itr_length-&clk_input_length+1, &clk_input_length-1)==STRING.CUT("&clk", 1))
    ( 
      &match=1
    )
  )
  else if (&wild_tail==1)
  (
    if (STRING.MID("gcc_ahb_clk", 0, &clk_input_length-1)==STRING.CUT("&clk", -1))
    ( 
      &match=1
    )
  )
  else if ("gcc_ahb_clk"=="&clk")
  (
    &match=1
  )
  
  if (&match==1)
  (
    &clk_test=&CLK_TEST_GCC_AHB_CLK
    &clk_reg=&HWIO_GCC_GCC_AHB_CBCR_ADDR
    &clk_reg_name="GCC_GCC_AHB_CBCR"
    &clk_name="gcc_ahb_clk"
    &clk_reg_cbcr_type="sm_cbc"
    &clk_vote_bit=-1.
    &clk_multiplier=1.

    gosub Print_Clk_Info_Line
  )

  &match=0
  &wild_head=0
  &wild_tail=0
  &clk_input_length=STRING.LENGTH("&clk")
  &clk_itr_length=STRING.LENGTH("gcc_bimc_cfg_ahb_clk")

  if (STRING.SCAN("&clk", "*", 0)==0)
  (
    &wild_head=1
  )
  if (STRING.SCAN("&clk", "*", 1)==(STRING.LENGTH("&clk")-1))
  (
    &wild_tail=1
  )

  if ((&wild_head==1)&&(&wild_tail==1))
  (
    if (STRING.SCAN("gcc_bimc_cfg_ahb_clk", STRING.MID("&clk", 1, &clk_input_length-2), 0)!=-1)
    ( 
      &match=1
    )
  )
  else if (&wild_head==1)
  (
    if (STRING.MID("gcc_bimc_cfg_ahb_clk", &clk_itr_length-&clk_input_length+1, &clk_input_length-1)==STRING.CUT("&clk", 1))
    ( 
      &match=1
    )
  )
  else if (&wild_tail==1)
  (
    if (STRING.MID("gcc_bimc_cfg_ahb_clk", 0, &clk_input_length-1)==STRING.CUT("&clk", -1))
    ( 
      &match=1
    )
  )
  else if ("gcc_bimc_cfg_ahb_clk"=="&clk")
  (
    &match=1
  )
  
  if (&match==1)
  (
    &clk_test=&CLK_TEST_GCC_BIMC_CFG_AHB_CLK
    &clk_reg=&HWIO_GCC_BIMC_CFG_AHB_CBCR_ADDR
    &clk_reg_name="GCC_BIMC_CFG_AHB_CBCR"
    &clk_name="gcc_bimc_cfg_ahb_clk"
    &clk_reg_cbcr_type="sm_cbc"
    &clk_vote_bit=-1.
    &clk_multiplier=1.

    gosub Print_Clk_Info_Line
  )

  &match=0
  &wild_head=0
  &wild_tail=0
  &clk_input_length=STRING.LENGTH("&clk")
  &clk_itr_length=STRING.LENGTH("gcc_bimc_nius_cfg_ahb_clk")

  if (STRING.SCAN("&clk", "*", 0)==0)
  (
    &wild_head=1
  )
  if (STRING.SCAN("&clk", "*", 1)==(STRING.LENGTH("&clk")-1))
  (
    &wild_tail=1
  )

  if ((&wild_head==1)&&(&wild_tail==1))
  (
    if (STRING.SCAN("gcc_bimc_nius_cfg_ahb_clk", STRING.MID("&clk", 1, &clk_input_length-2), 0)!=-1)
    ( 
      &match=1
    )
  )
  else if (&wild_head==1)
  (
    if (STRING.MID("gcc_bimc_nius_cfg_ahb_clk", &clk_itr_length-&clk_input_length+1, &clk_input_length-1)==STRING.CUT("&clk", 1))
    ( 
      &match=1
    )
  )
  else if (&wild_tail==1)
  (
    if (STRING.MID("gcc_bimc_nius_cfg_ahb_clk", 0, &clk_input_length-1)==STRING.CUT("&clk", -1))
    ( 
      &match=1
    )
  )
  else if ("gcc_bimc_nius_cfg_ahb_clk"=="&clk")
  (
    &match=1
  )
  
  if (&match==1)
  (
    &clk_test=&CLK_TEST_GCC_BIMC_NIUS_CFG_AHB_CLK
    &clk_reg=&HWIO_GCC_BIMC_NIUS_CFG_AHB_CBCR_ADDR
    &clk_reg_name="GCC_BIMC_NIUS_CFG_AHB_CBCR"
    &clk_name="gcc_bimc_nius_cfg_ahb_clk"
    &clk_reg_cbcr_type="sm_cbc"
    &clk_vote_bit=-1.
    &clk_multiplier=1.

    gosub Print_Clk_Info_Line
  )

  &match=0
  &wild_head=0
  &wild_tail=0
  &clk_input_length=STRING.LENGTH("&clk")
  &clk_itr_length=STRING.LENGTH("gcc_boot_rom_ahb_clk")

  if (STRING.SCAN("&clk", "*", 0)==0)
  (
    &wild_head=1
  )
  if (STRING.SCAN("&clk", "*", 1)==(STRING.LENGTH("&clk")-1))
  (
    &wild_tail=1
  )

  if ((&wild_head==1)&&(&wild_tail==1))
  (
    if (STRING.SCAN("gcc_boot_rom_ahb_clk", STRING.MID("&clk", 1, &clk_input_length-2), 0)!=-1)
    ( 
      &match=1
    )
  )
  else if (&wild_head==1)
  (
    if (STRING.MID("gcc_boot_rom_ahb_clk", &clk_itr_length-&clk_input_length+1, &clk_input_length-1)==STRING.CUT("&clk", 1))
    ( 
      &match=1
    )
  )
  else if (&wild_tail==1)
  (
    if (STRING.MID("gcc_boot_rom_ahb_clk", 0, &clk_input_length-1)==STRING.CUT("&clk", -1))
    ( 
      &match=1
    )
  )
  else if ("gcc_boot_rom_ahb_clk"=="&clk")
  (
    &match=1
  )
  
  if (&match==1)
  (
    &clk_test=&CLK_TEST_GCC_BOOT_ROM_AHB_CLK
    &clk_reg=&HWIO_GCC_BOOT_ROM_AHB_CBCR_ADDR
    &clk_reg_name="GCC_BOOT_ROM_AHB_CBCR"
    &clk_name="gcc_boot_rom_ahb_clk"
    &clk_reg_cbcr_type="sm_pscbc"
    &clk_vote_bit=10.
    &clk_multiplier=1.

    gosub Print_Clk_Info_Line
  )

  &match=0
  &wild_head=0
  &wild_tail=0
  &clk_input_length=STRING.LENGTH("&clk")
  &clk_itr_length=STRING.LENGTH("gcc_ce1_ahb_clk")

  if (STRING.SCAN("&clk", "*", 0)==0)
  (
    &wild_head=1
  )
  if (STRING.SCAN("&clk", "*", 1)==(STRING.LENGTH("&clk")-1))
  (
    &wild_tail=1
  )

  if ((&wild_head==1)&&(&wild_tail==1))
  (
    if (STRING.SCAN("gcc_ce1_ahb_clk", STRING.MID("&clk", 1, &clk_input_length-2), 0)!=-1)
    ( 
      &match=1
    )
  )
  else if (&wild_head==1)
  (
    if (STRING.MID("gcc_ce1_ahb_clk", &clk_itr_length-&clk_input_length+1, &clk_input_length-1)==STRING.CUT("&clk", 1))
    ( 
      &match=1
    )
  )
  else if (&wild_tail==1)
  (
    if (STRING.MID("gcc_ce1_ahb_clk", 0, &clk_input_length-1)==STRING.CUT("&clk", -1))
    ( 
      &match=1
    )
  )
  else if ("gcc_ce1_ahb_clk"=="&clk")
  (
    &match=1
  )
  
  if (&match==1)
  (
    &clk_test=&CLK_TEST_GCC_CE1_AHB_CLK
    &clk_reg=&HWIO_GCC_CE1_AHB_CBCR_ADDR
    &clk_reg_name="GCC_CE1_AHB_CBCR"
    &clk_name="gcc_ce1_ahb_clk"
    &clk_reg_cbcr_type="sm_cbc"
    &clk_vote_bit=3.
    &clk_multiplier=1.

    gosub Print_Clk_Info_Line
  )

  &match=0
  &wild_head=0
  &wild_tail=0
  &clk_input_length=STRING.LENGTH("&clk")
  &clk_itr_length=STRING.LENGTH("gcc_cfg_noc_ahb_clk")

  if (STRING.SCAN("&clk", "*", 0)==0)
  (
    &wild_head=1
  )
  if (STRING.SCAN("&clk", "*", 1)==(STRING.LENGTH("&clk")-1))
  (
    &wild_tail=1
  )

  if ((&wild_head==1)&&(&wild_tail==1))
  (
    if (STRING.SCAN("gcc_cfg_noc_ahb_clk", STRING.MID("&clk", 1, &clk_input_length-2), 0)!=-1)
    ( 
      &match=1
    )
  )
  else if (&wild_head==1)
  (
    if (STRING.MID("gcc_cfg_noc_ahb_clk", &clk_itr_length-&clk_input_length+1, &clk_input_length-1)==STRING.CUT("&clk", 1))
    ( 
      &match=1
    )
  )
  else if (&wild_tail==1)
  (
    if (STRING.MID("gcc_cfg_noc_ahb_clk", 0, &clk_input_length-1)==STRING.CUT("&clk", -1))
    ( 
      &match=1
    )
  )
  else if ("gcc_cfg_noc_ahb_clk"=="&clk")||("buses"=="&clk")
  (
    &match=1
  )
  
  if (&match==1)
  (
    &clk_test=&CLK_TEST_GCC_CFG_NOC_AHB_CLK
    &clk_reg=&HWIO_GCC_CFG_NOC_AHB_CBCR_ADDR
    &clk_reg_name="GCC_CFG_NOC_AHB_CBCR"
    &clk_name="gcc_cfg_noc_ahb_clk"
    &clk_reg_cbcr_type="sm_cbc"
    &clk_vote_bit=-1.
    &clk_multiplier=1.

    gosub Print_Clk_Info_Line
  )

  &match=0
  &wild_head=0
  &wild_tail=0
  &clk_input_length=STRING.LENGTH("&clk")
  &clk_itr_length=STRING.LENGTH("gcc_cnoc_bus_timeout0_ahb_clk")

  if (STRING.SCAN("&clk", "*", 0)==0)
  (
    &wild_head=1
  )
  if (STRING.SCAN("&clk", "*", 1)==(STRING.LENGTH("&clk")-1))
  (
    &wild_tail=1
  )

  if ((&wild_head==1)&&(&wild_tail==1))
  (
    if (STRING.SCAN("gcc_cnoc_bus_timeout0_ahb_clk", STRING.MID("&clk", 1, &clk_input_length-2), 0)!=-1)
    ( 
      &match=1
    )
  )
  else if (&wild_head==1)
  (
    if (STRING.MID("gcc_cnoc_bus_timeout0_ahb_clk", &clk_itr_length-&clk_input_length+1, &clk_input_length-1)==STRING.CUT("&clk", 1))
    ( 
      &match=1
    )
  )
  else if (&wild_tail==1)
  (
    if (STRING.MID("gcc_cnoc_bus_timeout0_ahb_clk", 0, &clk_input_length-1)==STRING.CUT("&clk", -1))
    ( 
      &match=1
    )
  )
  else if ("gcc_cnoc_bus_timeout0_ahb_clk"=="&clk")
  (
    &match=1
  )
  
  if (&match==1)
  (
    &clk_test=&CLK_TEST_GCC_CNOC_BUS_TIMEOUT0_AHB_CLK
    &clk_reg=&HWIO_GCC_CNOC_BUS_TIMEOUT0_AHB_CBCR_ADDR
    &clk_reg_name="GCC_CNOC_BUS_TIMEOUT0_AHB_CBCR"
    &clk_name="gcc_cnoc_bus_timeout0_ahb_clk"
    &clk_reg_cbcr_type="sm_cbc"
    &clk_vote_bit=-1.
    &clk_multiplier=1.

    gosub Print_Clk_Info_Line
  )

  &match=0
  &wild_head=0
  &wild_tail=0
  &clk_input_length=STRING.LENGTH("&clk")
  &clk_itr_length=STRING.LENGTH("gcc_cnoc_bus_timeout1_ahb_clk")

  if (STRING.SCAN("&clk", "*", 0)==0)
  (
    &wild_head=1
  )
  if (STRING.SCAN("&clk", "*", 1)==(STRING.LENGTH("&clk")-1))
  (
    &wild_tail=1
  )

  if ((&wild_head==1)&&(&wild_tail==1))
  (
    if (STRING.SCAN("gcc_cnoc_bus_timeout1_ahb_clk", STRING.MID("&clk", 1, &clk_input_length-2), 0)!=-1)
    ( 
      &match=1
    )
  )
  else if (&wild_head==1)
  (
    if (STRING.MID("gcc_cnoc_bus_timeout1_ahb_clk", &clk_itr_length-&clk_input_length+1, &clk_input_length-1)==STRING.CUT("&clk", 1))
    ( 
      &match=1
    )
  )
  else if (&wild_tail==1)
  (
    if (STRING.MID("gcc_cnoc_bus_timeout1_ahb_clk", 0, &clk_input_length-1)==STRING.CUT("&clk", -1))
    ( 
      &match=1
    )
  )
  else if ("gcc_cnoc_bus_timeout1_ahb_clk"=="&clk")
  (
    &match=1
  )
  
  if (&match==1)
  (
    &clk_test=&CLK_TEST_GCC_CNOC_BUS_TIMEOUT1_AHB_CLK
    &clk_reg=&HWIO_GCC_CNOC_BUS_TIMEOUT1_AHB_CBCR_ADDR
    &clk_reg_name="GCC_CNOC_BUS_TIMEOUT1_AHB_CBCR"
    &clk_name="gcc_cnoc_bus_timeout1_ahb_clk"
    &clk_reg_cbcr_type="sm_cbc"
    &clk_vote_bit=-1.
    &clk_multiplier=1.

    gosub Print_Clk_Info_Line
  )

  &match=0
  &wild_head=0
  &wild_tail=0
  &clk_input_length=STRING.LENGTH("&clk")
  &clk_itr_length=STRING.LENGTH("gcc_cnoc_bus_timeout2_ahb_clk")

  if (STRING.SCAN("&clk", "*", 0)==0)
  (
    &wild_head=1
  )
  if (STRING.SCAN("&clk", "*", 1)==(STRING.LENGTH("&clk")-1))
  (
    &wild_tail=1
  )

  if ((&wild_head==1)&&(&wild_tail==1))
  (
    if (STRING.SCAN("gcc_cnoc_bus_timeout2_ahb_clk", STRING.MID("&clk", 1, &clk_input_length-2), 0)!=-1)
    ( 
      &match=1
    )
  )
  else if (&wild_head==1)
  (
    if (STRING.MID("gcc_cnoc_bus_timeout2_ahb_clk", &clk_itr_length-&clk_input_length+1, &clk_input_length-1)==STRING.CUT("&clk", 1))
    ( 
      &match=1
    )
  )
  else if (&wild_tail==1)
  (
    if (STRING.MID("gcc_cnoc_bus_timeout2_ahb_clk", 0, &clk_input_length-1)==STRING.CUT("&clk", -1))
    ( 
      &match=1
    )
  )
  else if ("gcc_cnoc_bus_timeout2_ahb_clk"=="&clk")
  (
    &match=1
  )
  
  if (&match==1)
  (
    &clk_test=&CLK_TEST_GCC_CNOC_BUS_TIMEOUT2_AHB_CLK
    &clk_reg=&HWIO_GCC_CNOC_BUS_TIMEOUT2_AHB_CBCR_ADDR
    &clk_reg_name="GCC_CNOC_BUS_TIMEOUT2_AHB_CBCR"
    &clk_name="gcc_cnoc_bus_timeout2_ahb_clk"
    &clk_reg_cbcr_type="sm_cbc"
    &clk_vote_bit=-1.
    &clk_multiplier=1.

    gosub Print_Clk_Info_Line
  )

  &match=0
  &wild_head=0
  &wild_tail=0
  &clk_input_length=STRING.LENGTH("&clk")
  &clk_itr_length=STRING.LENGTH("gcc_cnoc_bus_timeout3_ahb_clk")

  if (STRING.SCAN("&clk", "*", 0)==0)
  (
    &wild_head=1
  )
  if (STRING.SCAN("&clk", "*", 1)==(STRING.LENGTH("&clk")-1))
  (
    &wild_tail=1
  )

  if ((&wild_head==1)&&(&wild_tail==1))
  (
    if (STRING.SCAN("gcc_cnoc_bus_timeout3_ahb_clk", STRING.MID("&clk", 1, &clk_input_length-2), 0)!=-1)
    ( 
      &match=1
    )
  )
  else if (&wild_head==1)
  (
    if (STRING.MID("gcc_cnoc_bus_timeout3_ahb_clk", &clk_itr_length-&clk_input_length+1, &clk_input_length-1)==STRING.CUT("&clk", 1))
    ( 
      &match=1
    )
  )
  else if (&wild_tail==1)
  (
    if (STRING.MID("gcc_cnoc_bus_timeout3_ahb_clk", 0, &clk_input_length-1)==STRING.CUT("&clk", -1))
    ( 
      &match=1
    )
  )
  else if ("gcc_cnoc_bus_timeout3_ahb_clk"=="&clk")
  (
    &match=1
  )
  
  if (&match==1)
  (
    &clk_test=&CLK_TEST_GCC_CNOC_BUS_TIMEOUT3_AHB_CLK
    &clk_reg=&HWIO_GCC_CNOC_BUS_TIMEOUT3_AHB_CBCR_ADDR
    &clk_reg_name="GCC_CNOC_BUS_TIMEOUT3_AHB_CBCR"
    &clk_name="gcc_cnoc_bus_timeout3_ahb_clk"
    &clk_reg_cbcr_type="sm_cbc"
    &clk_vote_bit=-1.
    &clk_multiplier=1.

    gosub Print_Clk_Info_Line
  )

  &match=0
  &wild_head=0
  &wild_tail=0
  &clk_input_length=STRING.LENGTH("&clk")
  &clk_itr_length=STRING.LENGTH("gcc_cnoc_bus_timeout4_ahb_clk")

  if (STRING.SCAN("&clk", "*", 0)==0)
  (
    &wild_head=1
  )
  if (STRING.SCAN("&clk", "*", 1)==(STRING.LENGTH("&clk")-1))
  (
    &wild_tail=1
  )

  if ((&wild_head==1)&&(&wild_tail==1))
  (
    if (STRING.SCAN("gcc_cnoc_bus_timeout4_ahb_clk", STRING.MID("&clk", 1, &clk_input_length-2), 0)!=-1)
    ( 
      &match=1
    )
  )
  else if (&wild_head==1)
  (
    if (STRING.MID("gcc_cnoc_bus_timeout4_ahb_clk", &clk_itr_length-&clk_input_length+1, &clk_input_length-1)==STRING.CUT("&clk", 1))
    ( 
      &match=1
    )
  )
  else if (&wild_tail==1)
  (
    if (STRING.MID("gcc_cnoc_bus_timeout4_ahb_clk", 0, &clk_input_length-1)==STRING.CUT("&clk", -1))
    ( 
      &match=1
    )
  )
  else if ("gcc_cnoc_bus_timeout4_ahb_clk"=="&clk")
  (
    &match=1
  )
  
  if (&match==1)
  (
    &clk_test=&CLK_TEST_GCC_CNOC_BUS_TIMEOUT4_AHB_CLK
    &clk_reg=&HWIO_GCC_CNOC_BUS_TIMEOUT4_AHB_CBCR_ADDR
    &clk_reg_name="GCC_CNOC_BUS_TIMEOUT4_AHB_CBCR"
    &clk_name="gcc_cnoc_bus_timeout4_ahb_clk"
    &clk_reg_cbcr_type="sm_cbc"
    &clk_vote_bit=-1.
    &clk_multiplier=1.

    gosub Print_Clk_Info_Line
  )

  &match=0
  &wild_head=0
  &wild_tail=0
  &clk_input_length=STRING.LENGTH("&clk")
  &clk_itr_length=STRING.LENGTH("gcc_cnoc_bus_timeout6_ahb_clk")

  if (STRING.SCAN("&clk", "*", 0)==0)
  (
    &wild_head=1
  )
  if (STRING.SCAN("&clk", "*", 1)==(STRING.LENGTH("&clk")-1))
  (
    &wild_tail=1
  )

  if ((&wild_head==1)&&(&wild_tail==1))
  (
    if (STRING.SCAN("gcc_cnoc_bus_timeout6_ahb_clk", STRING.MID("&clk", 1, &clk_input_length-2), 0)!=-1)
    ( 
      &match=1
    )
  )
  else if (&wild_head==1)
  (
    if (STRING.MID("gcc_cnoc_bus_timeout6_ahb_clk", &clk_itr_length-&clk_input_length+1, &clk_input_length-1)==STRING.CUT("&clk", 1))
    ( 
      &match=1
    )
  )
  else if (&wild_tail==1)
  (
    if (STRING.MID("gcc_cnoc_bus_timeout6_ahb_clk", 0, &clk_input_length-1)==STRING.CUT("&clk", -1))
    ( 
      &match=1
    )
  )
  else if ("gcc_cnoc_bus_timeout6_ahb_clk"=="&clk")
  (
    &match=1
  )
  
  if (&match==1)
  (
    &clk_test=&CLK_TEST_GCC_CNOC_BUS_TIMEOUT6_AHB_CLK
    &clk_reg=&HWIO_GCC_CNOC_BUS_TIMEOUT6_AHB_CBCR_ADDR
    &clk_reg_name="GCC_CNOC_BUS_TIMEOUT6_AHB_CBCR"
    &clk_name="gcc_cnoc_bus_timeout6_ahb_clk"
    &clk_reg_cbcr_type="sm_cbc"
    &clk_vote_bit=-1.
    &clk_multiplier=1.

    gosub Print_Clk_Info_Line
  )

  &match=0
  &wild_head=0
  &wild_tail=0
  &clk_input_length=STRING.LENGTH("&clk")
  &clk_itr_length=STRING.LENGTH("gcc_cnoc_bus_timeout7_ahb_clk")

  if (STRING.SCAN("&clk", "*", 0)==0)
  (
    &wild_head=1
  )
  if (STRING.SCAN("&clk", "*", 1)==(STRING.LENGTH("&clk")-1))
  (
    &wild_tail=1
  )

  if ((&wild_head==1)&&(&wild_tail==1))
  (
    if (STRING.SCAN("gcc_cnoc_bus_timeout7_ahb_clk", STRING.MID("&clk", 1, &clk_input_length-2), 0)!=-1)
    ( 
      &match=1
    )
  )
  else if (&wild_head==1)
  (
    if (STRING.MID("gcc_cnoc_bus_timeout7_ahb_clk", &clk_itr_length-&clk_input_length+1, &clk_input_length-1)==STRING.CUT("&clk", 1))
    ( 
      &match=1
    )
  )
  else if (&wild_tail==1)
  (
    if (STRING.MID("gcc_cnoc_bus_timeout7_ahb_clk", 0, &clk_input_length-1)==STRING.CUT("&clk", -1))
    ( 
      &match=1
    )
  )
  else if ("gcc_cnoc_bus_timeout7_ahb_clk"=="&clk")
  (
    &match=1
  )
  
  if (&match==1)
  (
    &clk_test=&CLK_TEST_GCC_CNOC_BUS_TIMEOUT7_AHB_CLK
    &clk_reg=&HWIO_GCC_CNOC_BUS_TIMEOUT7_AHB_CBCR_ADDR
    &clk_reg_name="GCC_CNOC_BUS_TIMEOUT7_AHB_CBCR"
    &clk_name="gcc_cnoc_bus_timeout7_ahb_clk"
    &clk_reg_cbcr_type="sm_cbc"
    &clk_vote_bit=-1.
    &clk_multiplier=1.

    gosub Print_Clk_Info_Line
  )

  &match=0
  &wild_head=0
  &wild_tail=0
  &clk_input_length=STRING.LENGTH("&clk")
  &clk_itr_length=STRING.LENGTH("gcc_cnoc_bus_timeout8_ahb_clk")

  if (STRING.SCAN("&clk", "*", 0)==0)
  (
    &wild_head=1
  )
  if (STRING.SCAN("&clk", "*", 1)==(STRING.LENGTH("&clk")-1))
  (
    &wild_tail=1
  )

  if ((&wild_head==1)&&(&wild_tail==1))
  (
    if (STRING.SCAN("gcc_cnoc_bus_timeout8_ahb_clk", STRING.MID("&clk", 1, &clk_input_length-2), 0)!=-1)
    ( 
      &match=1
    )
  )
  else if (&wild_head==1)
  (
    if (STRING.MID("gcc_cnoc_bus_timeout8_ahb_clk", &clk_itr_length-&clk_input_length+1, &clk_input_length-1)==STRING.CUT("&clk", 1))
    ( 
      &match=1
    )
  )
  else if (&wild_tail==1)
  (
    if (STRING.MID("gcc_cnoc_bus_timeout8_ahb_clk", 0, &clk_input_length-1)==STRING.CUT("&clk", -1))
    ( 
      &match=1
    )
  )
  else if ("gcc_cnoc_bus_timeout8_ahb_clk"=="&clk")
  (
    &match=1
  )
  
  if (&match==1)
  (
    &clk_test=&CLK_TEST_GCC_CNOC_BUS_TIMEOUT8_AHB_CLK
    &clk_reg=&HWIO_GCC_CNOC_BUS_TIMEOUT8_AHB_CBCR_ADDR
    &clk_reg_name="GCC_CNOC_BUS_TIMEOUT8_AHB_CBCR"
    &clk_name="gcc_cnoc_bus_timeout8_ahb_clk"
    &clk_reg_cbcr_type="sm_cbc"
    &clk_vote_bit=-1.
    &clk_multiplier=1.

    gosub Print_Clk_Info_Line
  )

  &match=0
  &wild_head=0
  &wild_tail=0
  &clk_input_length=STRING.LENGTH("&clk")
  &clk_itr_length=STRING.LENGTH("gcc_cnoc_bus_timeout9_ahb_clk")

  if (STRING.SCAN("&clk", "*", 0)==0)
  (
    &wild_head=1
  )
  if (STRING.SCAN("&clk", "*", 1)==(STRING.LENGTH("&clk")-1))
  (
    &wild_tail=1
  )

  if ((&wild_head==1)&&(&wild_tail==1))
  (
    if (STRING.SCAN("gcc_cnoc_bus_timeout9_ahb_clk", STRING.MID("&clk", 1, &clk_input_length-2), 0)!=-1)
    ( 
      &match=1
    )
  )
  else if (&wild_head==1)
  (
    if (STRING.MID("gcc_cnoc_bus_timeout9_ahb_clk", &clk_itr_length-&clk_input_length+1, &clk_input_length-1)==STRING.CUT("&clk", 1))
    ( 
      &match=1
    )
  )
  else if (&wild_tail==1)
  (
    if (STRING.MID("gcc_cnoc_bus_timeout9_ahb_clk", 0, &clk_input_length-1)==STRING.CUT("&clk", -1))
    ( 
      &match=1
    )
  )
  else if ("gcc_cnoc_bus_timeout9_ahb_clk"=="&clk")
  (
    &match=1
  )
  
  if (&match==1)
  (
    &clk_test=&CLK_TEST_GCC_CNOC_BUS_TIMEOUT9_AHB_CLK
    &clk_reg=&HWIO_GCC_CNOC_BUS_TIMEOUT9_AHB_CBCR_ADDR
    &clk_reg_name="GCC_CNOC_BUS_TIMEOUT9_AHB_CBCR"
    &clk_name="gcc_cnoc_bus_timeout9_ahb_clk"
    &clk_reg_cbcr_type="sm_cbc"
    &clk_vote_bit=-1.
    &clk_multiplier=1.

    gosub Print_Clk_Info_Line
  )

  &match=0
  &wild_head=0
  &wild_tail=0
  &clk_input_length=STRING.LENGTH("&clk")
  &clk_itr_length=STRING.LENGTH("gcc_cnoc_mst_rpm_ahb_clk")

  if (STRING.SCAN("&clk", "*", 0)==0)
  (
    &wild_head=1
  )
  if (STRING.SCAN("&clk", "*", 1)==(STRING.LENGTH("&clk")-1))
  (
    &wild_tail=1
  )

  if ((&wild_head==1)&&(&wild_tail==1))
  (
    if (STRING.SCAN("gcc_cnoc_mst_rpm_ahb_clk", STRING.MID("&clk", 1, &clk_input_length-2), 0)!=-1)
    ( 
      &match=1
    )
  )
  else if (&wild_head==1)
  (
    if (STRING.MID("gcc_cnoc_mst_rpm_ahb_clk", &clk_itr_length-&clk_input_length+1, &clk_input_length-1)==STRING.CUT("&clk", 1))
    ( 
      &match=1
    )
  )
  else if (&wild_tail==1)
  (
    if (STRING.MID("gcc_cnoc_mst_rpm_ahb_clk", 0, &clk_input_length-1)==STRING.CUT("&clk", -1))
    ( 
      &match=1
    )
  )
  else if ("gcc_cnoc_mst_rpm_ahb_clk"=="&clk")
  (
    &match=1
  )
  
  if (&match==1)
  (
    &clk_test=&CLK_TEST_GCC_CNOC_MST_RPM_AHB_CLK
    &clk_reg=&HWIO_GCC_CNOC_MST_RPM_AHB_CBCR_ADDR
    &clk_reg_name="GCC_CNOC_MST_RPM_AHB_CBCR"
    &clk_name="gcc_cnoc_mst_rpm_ahb_clk"
    &clk_reg_cbcr_type="sm_cbc"
    &clk_vote_bit=-1.
    &clk_multiplier=1.

    gosub Print_Clk_Info_Line
  )

  &match=0
  &wild_head=0
  &wild_tail=0
  &clk_input_length=STRING.LENGTH("&clk")
  &clk_itr_length=STRING.LENGTH("gcc_dcc_ahb_clk")

  if (STRING.SCAN("&clk", "*", 0)==0)
  (
    &wild_head=1
  )
  if (STRING.SCAN("&clk", "*", 1)==(STRING.LENGTH("&clk")-1))
  (
    &wild_tail=1
  )

  if ((&wild_head==1)&&(&wild_tail==1))
  (
    if (STRING.SCAN("gcc_dcc_ahb_clk", STRING.MID("&clk", 1, &clk_input_length-2), 0)!=-1)
    ( 
      &match=1
    )
  )
  else if (&wild_head==1)
  (
    if (STRING.MID("gcc_dcc_ahb_clk", &clk_itr_length-&clk_input_length+1, &clk_input_length-1)==STRING.CUT("&clk", 1))
    ( 
      &match=1
    )
  )
  else if (&wild_tail==1)
  (
    if (STRING.MID("gcc_dcc_ahb_clk", 0, &clk_input_length-1)==STRING.CUT("&clk", -1))
    ( 
      &match=1
    )
  )
  else if ("gcc_dcc_ahb_clk"=="&clk")
  (
    &match=1
  )
  
  if (&match==1)
  (
    &clk_test=&CLK_TEST_GCC_DCC_AHB_CLK
    &clk_reg=&HWIO_GCC_DCC_AHB_CBCR_ADDR
    &clk_reg_name="GCC_DCC_AHB_CBCR"
    &clk_name="gcc_dcc_ahb_clk"
    &clk_reg_cbcr_type="sm_pscbc"
    &clk_vote_bit=-1.
    &clk_multiplier=1.

    gosub Print_Clk_Info_Line
  )

  &match=0
  &wild_head=0
  &wild_tail=0
  &clk_input_length=STRING.LENGTH("&clk")
  &clk_itr_length=STRING.LENGTH("gcc_imem_cfg_ahb_clk")

  if (STRING.SCAN("&clk", "*", 0)==0)
  (
    &wild_head=1
  )
  if (STRING.SCAN("&clk", "*", 1)==(STRING.LENGTH("&clk")-1))
  (
    &wild_tail=1
  )

  if ((&wild_head==1)&&(&wild_tail==1))
  (
    if (STRING.SCAN("gcc_imem_cfg_ahb_clk", STRING.MID("&clk", 1, &clk_input_length-2), 0)!=-1)
    ( 
      &match=1
    )
  )
  else if (&wild_head==1)
  (
    if (STRING.MID("gcc_imem_cfg_ahb_clk", &clk_itr_length-&clk_input_length+1, &clk_input_length-1)==STRING.CUT("&clk", 1))
    ( 
      &match=1
    )
  )
  else if (&wild_tail==1)
  (
    if (STRING.MID("gcc_imem_cfg_ahb_clk", 0, &clk_input_length-1)==STRING.CUT("&clk", -1))
    ( 
      &match=1
    )
  )
  else if ("gcc_imem_cfg_ahb_clk"=="&clk")
  (
    &match=1
  )
  
  if (&match==1)
  (
    &clk_test=&CLK_TEST_GCC_IMEM_CFG_AHB_CLK
    &clk_reg=&HWIO_GCC_IMEM_CFG_AHB_CBCR_ADDR
    &clk_reg_name="GCC_IMEM_CFG_AHB_CBCR"
    &clk_name="gcc_imem_cfg_ahb_clk"
    &clk_reg_cbcr_type="sm_cbc"
    &clk_vote_bit=-1.
    &clk_multiplier=1.

    gosub Print_Clk_Info_Line
  )

  &match=0
  &wild_head=0
  &wild_tail=0
  &clk_input_length=STRING.LENGTH("&clk")
  &clk_itr_length=STRING.LENGTH("gcc_lpass_core_smmu_ahb_clk")

  if (STRING.SCAN("&clk", "*", 0)==0)
  (
    &wild_head=1
  )
  if (STRING.SCAN("&clk", "*", 1)==(STRING.LENGTH("&clk")-1))
  (
    &wild_tail=1
  )

  if ((&wild_head==1)&&(&wild_tail==1))
  (
    if (STRING.SCAN("gcc_lpass_core_smmu_ahb_clk", STRING.MID("&clk", 1, &clk_input_length-2), 0)!=-1)
    ( 
      &match=1
    )
  )
  else if (&wild_head==1)
  (
    if (STRING.MID("gcc_lpass_core_smmu_ahb_clk", &clk_itr_length-&clk_input_length+1, &clk_input_length-1)==STRING.CUT("&clk", 1))
    ( 
      &match=1
    )
  )
  else if (&wild_tail==1)
  (
    if (STRING.MID("gcc_lpass_core_smmu_ahb_clk", 0, &clk_input_length-1)==STRING.CUT("&clk", -1))
    ( 
      &match=1
    )
  )
  else if ("gcc_lpass_core_smmu_ahb_clk"=="&clk")
  (
    &match=1
  )
  
  if (&match==1)
  (
    &clk_test=&CLK_TEST_GCC_LPASS_CORE_SMMU_AHB_CLK
    &clk_reg=&HWIO_GCC_LPASS_CORE_SMMU_AHB_CBCR_ADDR
    &clk_reg_name="GCC_LPASS_CORE_SMMU_AHB_CBCR"
    &clk_name="gcc_lpass_core_smmu_ahb_clk"
    &clk_reg_cbcr_type="sm_cbc"
    &clk_vote_bit=-1.
    &clk_multiplier=1.

    gosub Print_Clk_Info_Line
  )

  &match=0
  &wild_head=0
  &wild_tail=0
  &clk_input_length=STRING.LENGTH("&clk")
  &clk_itr_length=STRING.LENGTH("gcc_lpass_q6_smmu_ahb_clk")

  if (STRING.SCAN("&clk", "*", 0)==0)
  (
    &wild_head=1
  )
  if (STRING.SCAN("&clk", "*", 1)==(STRING.LENGTH("&clk")-1))
  (
    &wild_tail=1
  )

  if ((&wild_head==1)&&(&wild_tail==1))
  (
    if (STRING.SCAN("gcc_lpass_q6_smmu_ahb_clk", STRING.MID("&clk", 1, &clk_input_length-2), 0)!=-1)
    ( 
      &match=1
    )
  )
  else if (&wild_head==1)
  (
    if (STRING.MID("gcc_lpass_q6_smmu_ahb_clk", &clk_itr_length-&clk_input_length+1, &clk_input_length-1)==STRING.CUT("&clk", 1))
    ( 
      &match=1
    )
  )
  else if (&wild_tail==1)
  (
    if (STRING.MID("gcc_lpass_q6_smmu_ahb_clk", 0, &clk_input_length-1)==STRING.CUT("&clk", -1))
    ( 
      &match=1
    )
  )
  else if ("gcc_lpass_q6_smmu_ahb_clk"=="&clk")
  (
    &match=1
  )
  
  if (&match==1)
  (
    &clk_test=&CLK_TEST_GCC_LPASS_Q6_SMMU_AHB_CLK
    &clk_reg=&HWIO_GCC_LPASS_Q6_SMMU_AHB_CBCR_ADDR
    &clk_reg_name="GCC_LPASS_Q6_SMMU_AHB_CBCR"
    &clk_name="gcc_lpass_q6_smmu_ahb_clk"
    &clk_reg_cbcr_type="sm_cbc"
    &clk_vote_bit=-1.
    &clk_multiplier=1.

    gosub Print_Clk_Info_Line
  )

  &match=0
  &wild_head=0
  &wild_tail=0
  &clk_input_length=STRING.LENGTH("&clk")
  &clk_itr_length=STRING.LENGTH("gcc_lpass_smmu_aon_ahb_clk")

  if (STRING.SCAN("&clk", "*", 0)==0)
  (
    &wild_head=1
  )
  if (STRING.SCAN("&clk", "*", 1)==(STRING.LENGTH("&clk")-1))
  (
    &wild_tail=1
  )

  if ((&wild_head==1)&&(&wild_tail==1))
  (
    if (STRING.SCAN("gcc_lpass_smmu_aon_ahb_clk", STRING.MID("&clk", 1, &clk_input_length-2), 0)!=-1)
    ( 
      &match=1
    )
  )
  else if (&wild_head==1)
  (
    if (STRING.MID("gcc_lpass_smmu_aon_ahb_clk", &clk_itr_length-&clk_input_length+1, &clk_input_length-1)==STRING.CUT("&clk", 1))
    ( 
      &match=1
    )
  )
  else if (&wild_tail==1)
  (
    if (STRING.MID("gcc_lpass_smmu_aon_ahb_clk", 0, &clk_input_length-1)==STRING.CUT("&clk", -1))
    ( 
      &match=1
    )
  )
  else if ("gcc_lpass_smmu_aon_ahb_clk"=="&clk")
  (
    &match=1
  )
  
  if (&match==1)
  (
    &clk_test=&CLK_TEST_GCC_LPASS_SMMU_AON_AHB_CLK
    &clk_reg=&HWIO_GCC_LPASS_SMMU_AON_AHB_CBCR_ADDR
    &clk_reg_name="GCC_LPASS_SMMU_AON_AHB_CBCR"
    &clk_name="gcc_lpass_smmu_aon_ahb_clk"
    &clk_reg_cbcr_type="sm_cbc"
    &clk_vote_bit=-1.
    &clk_multiplier=1.

    gosub Print_Clk_Info_Line
  )

  &match=0
  &wild_head=0
  &wild_tail=0
  &clk_input_length=STRING.LENGTH("&clk")
  &clk_itr_length=STRING.LENGTH("gcc_mmss_noc_cfg_ahb_clk")

  if (STRING.SCAN("&clk", "*", 0)==0)
  (
    &wild_head=1
  )
  if (STRING.SCAN("&clk", "*", 1)==(STRING.LENGTH("&clk")-1))
  (
    &wild_tail=1
  )

  if ((&wild_head==1)&&(&wild_tail==1))
  (
    if (STRING.SCAN("gcc_mmss_noc_cfg_ahb_clk", STRING.MID("&clk", 1, &clk_input_length-2), 0)!=-1)
    ( 
      &match=1
    )
  )
  else if (&wild_head==1)
  (
    if (STRING.MID("gcc_mmss_noc_cfg_ahb_clk", &clk_itr_length-&clk_input_length+1, &clk_input_length-1)==STRING.CUT("&clk", 1))
    ( 
      &match=1
    )
  )
  else if (&wild_tail==1)
  (
    if (STRING.MID("gcc_mmss_noc_cfg_ahb_clk", 0, &clk_input_length-1)==STRING.CUT("&clk", -1))
    ( 
      &match=1
    )
  )
  else if ("gcc_mmss_noc_cfg_ahb_clk"=="&clk")
  (
    &match=1
  )
  
  if (&match==1)
  (
    &clk_test=&CLK_TEST_GCC_MMSS_NOC_CFG_AHB_CLK
    &clk_reg=&HWIO_GCC_MMSS_NOC_CFG_AHB_CBCR_ADDR
    &clk_reg_name="GCC_MMSS_NOC_CFG_AHB_CBCR"
    &clk_name="gcc_mmss_noc_cfg_ahb_clk"
    &clk_reg_cbcr_type="sm_cbc"
    &clk_vote_bit=-1.
    &clk_multiplier=1.

    gosub Print_Clk_Info_Line
  )

  &match=0
  &wild_head=0
  &wild_tail=0
  &clk_input_length=STRING.LENGTH("&clk")
  &clk_itr_length=STRING.LENGTH("gcc_mpm_ahb_clk")

  if (STRING.SCAN("&clk", "*", 0)==0)
  (
    &wild_head=1
  )
  if (STRING.SCAN("&clk", "*", 1)==(STRING.LENGTH("&clk")-1))
  (
    &wild_tail=1
  )

  if ((&wild_head==1)&&(&wild_tail==1))
  (
    if (STRING.SCAN("gcc_mpm_ahb_clk", STRING.MID("&clk", 1, &clk_input_length-2), 0)!=-1)
    ( 
      &match=1
    )
  )
  else if (&wild_head==1)
  (
    if (STRING.MID("gcc_mpm_ahb_clk", &clk_itr_length-&clk_input_length+1, &clk_input_length-1)==STRING.CUT("&clk", 1))
    ( 
      &match=1
    )
  )
  else if (&wild_tail==1)
  (
    if (STRING.MID("gcc_mpm_ahb_clk", 0, &clk_input_length-1)==STRING.CUT("&clk", -1))
    ( 
      &match=1
    )
  )
  else if ("gcc_mpm_ahb_clk"=="&clk")
  (
    &match=1
  )
  
  if (&match==1)
  (
    &clk_test=&CLK_TEST_GCC_MPM_AHB_CLK
    &clk_reg=&HWIO_GCC_MPM_AHB_CBCR_ADDR
    &clk_reg_name="GCC_MPM_AHB_CBCR"
    &clk_name="gcc_mpm_ahb_clk"
    &clk_reg_cbcr_type="sm_cbc"
    &clk_vote_bit=19.
    &clk_multiplier=1.

    gosub Print_Clk_Info_Line
  )

  &match=0
  &wild_head=0
  &wild_tail=0
  &clk_input_length=STRING.LENGTH("&clk")
  &clk_itr_length=STRING.LENGTH("gcc_msg_ram_ahb_clk")

  if (STRING.SCAN("&clk", "*", 0)==0)
  (
    &wild_head=1
  )
  if (STRING.SCAN("&clk", "*", 1)==(STRING.LENGTH("&clk")-1))
  (
    &wild_tail=1
  )

  if ((&wild_head==1)&&(&wild_tail==1))
  (
    if (STRING.SCAN("gcc_msg_ram_ahb_clk", STRING.MID("&clk", 1, &clk_input_length-2), 0)!=-1)
    ( 
      &match=1
    )
  )
  else if (&wild_head==1)
  (
    if (STRING.MID("gcc_msg_ram_ahb_clk", &clk_itr_length-&clk_input_length+1, &clk_input_length-1)==STRING.CUT("&clk", 1))
    ( 
      &match=1
    )
  )
  else if (&wild_tail==1)
  (
    if (STRING.MID("gcc_msg_ram_ahb_clk", 0, &clk_input_length-1)==STRING.CUT("&clk", -1))
    ( 
      &match=1
    )
  )
  else if ("gcc_msg_ram_ahb_clk"=="&clk")
  (
    &match=1
  )
  
  if (&match==1)
  (
    &clk_test=&CLK_TEST_GCC_MSG_RAM_AHB_CLK
    &clk_reg=&HWIO_GCC_MSG_RAM_AHB_CBCR_ADDR
    &clk_reg_name="GCC_MSG_RAM_AHB_CBCR"
    &clk_name="gcc_msg_ram_ahb_clk"
    &clk_reg_cbcr_type="sm_pscbc"
    &clk_vote_bit=9.
    &clk_multiplier=1.

    gosub Print_Clk_Info_Line
  )

  &match=0
  &wild_head=0
  &wild_tail=0
  &clk_input_length=STRING.LENGTH("&clk")
  &clk_itr_length=STRING.LENGTH("gcc_noc_conf_xpu_ahb_clk")

  if (STRING.SCAN("&clk", "*", 0)==0)
  (
    &wild_head=1
  )
  if (STRING.SCAN("&clk", "*", 1)==(STRING.LENGTH("&clk")-1))
  (
    &wild_tail=1
  )

  if ((&wild_head==1)&&(&wild_tail==1))
  (
    if (STRING.SCAN("gcc_noc_conf_xpu_ahb_clk", STRING.MID("&clk", 1, &clk_input_length-2), 0)!=-1)
    ( 
      &match=1
    )
  )
  else if (&wild_head==1)
  (
    if (STRING.MID("gcc_noc_conf_xpu_ahb_clk", &clk_itr_length-&clk_input_length+1, &clk_input_length-1)==STRING.CUT("&clk", 1))
    ( 
      &match=1
    )
  )
  else if (&wild_tail==1)
  (
    if (STRING.MID("gcc_noc_conf_xpu_ahb_clk", 0, &clk_input_length-1)==STRING.CUT("&clk", -1))
    ( 
      &match=1
    )
  )
  else if ("gcc_noc_conf_xpu_ahb_clk"=="&clk")
  (
    &match=1
  )
  
  if (&match==1)
  (
    &clk_test=&CLK_TEST_GCC_NOC_CONF_XPU_AHB_CLK
    &clk_reg=&HWIO_GCC_NOC_CONF_XPU_AHB_CBCR_ADDR
    &clk_reg_name="GCC_NOC_CONF_XPU_AHB_CBCR"
    &clk_name="gcc_noc_conf_xpu_ahb_clk"
    &clk_reg_cbcr_type="sm_cbc"
    &clk_vote_bit=-1.
    &clk_multiplier=1.

    gosub Print_Clk_Info_Line
  )

  &match=0
  &wild_head=0
  &wild_tail=0
  &clk_input_length=STRING.LENGTH("&clk")
  &clk_itr_length=STRING.LENGTH("gcc_pcie_0_cfg_ahb_clk")

  if (STRING.SCAN("&clk", "*", 0)==0)
  (
    &wild_head=1
  )
  if (STRING.SCAN("&clk", "*", 1)==(STRING.LENGTH("&clk")-1))
  (
    &wild_tail=1
  )

  if ((&wild_head==1)&&(&wild_tail==1))
  (
    if (STRING.SCAN("gcc_pcie_0_cfg_ahb_clk", STRING.MID("&clk", 1, &clk_input_length-2), 0)!=-1)
    ( 
      &match=1
    )
  )
  else if (&wild_head==1)
  (
    if (STRING.MID("gcc_pcie_0_cfg_ahb_clk", &clk_itr_length-&clk_input_length+1, &clk_input_length-1)==STRING.CUT("&clk", 1))
    ( 
      &match=1
    )
  )
  else if (&wild_tail==1)
  (
    if (STRING.MID("gcc_pcie_0_cfg_ahb_clk", 0, &clk_input_length-1)==STRING.CUT("&clk", -1))
    ( 
      &match=1
    )
  )
  else if ("gcc_pcie_0_cfg_ahb_clk"=="&clk")
  (
    &match=1
  )
  
  if (&match==1)
  (
    &clk_test=&CLK_TEST_GCC_PCIE_0_CFG_AHB_CLK
    &clk_reg=&HWIO_GCC_PCIE_0_CFG_AHB_CBCR_ADDR
    &clk_reg_name="GCC_PCIE_0_CFG_AHB_CBCR"
    &clk_name="gcc_pcie_0_cfg_ahb_clk"
    &clk_reg_cbcr_type="sm_cbc"
    &clk_vote_bit=-1.
    &clk_multiplier=1.

    gosub Print_Clk_Info_Line
  )

  &match=0
  &wild_head=0
  &wild_tail=0
  &clk_input_length=STRING.LENGTH("&clk")
  &clk_itr_length=STRING.LENGTH("gcc_pcie_1_cfg_ahb_clk")

  if (STRING.SCAN("&clk", "*", 0)==0)
  (
    &wild_head=1
  )
  if (STRING.SCAN("&clk", "*", 1)==(STRING.LENGTH("&clk")-1))
  (
    &wild_tail=1
  )

  if ((&wild_head==1)&&(&wild_tail==1))
  (
    if (STRING.SCAN("gcc_pcie_1_cfg_ahb_clk", STRING.MID("&clk", 1, &clk_input_length-2), 0)!=-1)
    ( 
      &match=1
    )
  )
  else if (&wild_head==1)
  (
    if (STRING.MID("gcc_pcie_1_cfg_ahb_clk", &clk_itr_length-&clk_input_length+1, &clk_input_length-1)==STRING.CUT("&clk", 1))
    ( 
      &match=1
    )
  )
  else if (&wild_tail==1)
  (
    if (STRING.MID("gcc_pcie_1_cfg_ahb_clk", 0, &clk_input_length-1)==STRING.CUT("&clk", -1))
    ( 
      &match=1
    )
  )
  else if ("gcc_pcie_1_cfg_ahb_clk"=="&clk")
  (
    &match=1
  )
  
  if (&match==1)
  (
    &clk_test=&CLK_TEST_GCC_PCIE_1_CFG_AHB_CLK
    &clk_reg=&HWIO_GCC_PCIE_1_CFG_AHB_CBCR_ADDR
    &clk_reg_name="GCC_PCIE_1_CFG_AHB_CBCR"
    &clk_name="gcc_pcie_1_cfg_ahb_clk"
    &clk_reg_cbcr_type="sm_cbc"
    &clk_vote_bit=-1.
    &clk_multiplier=1.

    gosub Print_Clk_Info_Line
  )

  &match=0
  &wild_head=0
  &wild_tail=0
  &clk_input_length=STRING.LENGTH("&clk")
  &clk_itr_length=STRING.LENGTH("gcc_pcie_2_cfg_ahb_clk")

  if (STRING.SCAN("&clk", "*", 0)==0)
  (
    &wild_head=1
  )
  if (STRING.SCAN("&clk", "*", 1)==(STRING.LENGTH("&clk")-1))
  (
    &wild_tail=1
  )

  if ((&wild_head==1)&&(&wild_tail==1))
  (
    if (STRING.SCAN("gcc_pcie_2_cfg_ahb_clk", STRING.MID("&clk", 1, &clk_input_length-2), 0)!=-1)
    ( 
      &match=1
    )
  )
  else if (&wild_head==1)
  (
    if (STRING.MID("gcc_pcie_2_cfg_ahb_clk", &clk_itr_length-&clk_input_length+1, &clk_input_length-1)==STRING.CUT("&clk", 1))
    ( 
      &match=1
    )
  )
  else if (&wild_tail==1)
  (
    if (STRING.MID("gcc_pcie_2_cfg_ahb_clk", 0, &clk_input_length-1)==STRING.CUT("&clk", -1))
    ( 
      &match=1
    )
  )
  else if ("gcc_pcie_2_cfg_ahb_clk"=="&clk")
  (
    &match=1
  )
  
  if (&match==1)
  (
    &clk_test=&CLK_TEST_GCC_PCIE_2_CFG_AHB_CLK
    &clk_reg=&HWIO_GCC_PCIE_2_CFG_AHB_CBCR_ADDR
    &clk_reg_name="GCC_PCIE_2_CFG_AHB_CBCR"
    &clk_name="gcc_pcie_2_cfg_ahb_clk"
    &clk_reg_cbcr_type="sm_cbc"
    &clk_vote_bit=-1.
    &clk_multiplier=1.

    gosub Print_Clk_Info_Line
  )

  &match=0
  &wild_head=0
  &wild_tail=0
  &clk_input_length=STRING.LENGTH("&clk")
  &clk_itr_length=STRING.LENGTH("gcc_pcie_phy_cfg_ahb_clk")

  if (STRING.SCAN("&clk", "*", 0)==0)
  (
    &wild_head=1
  )
  if (STRING.SCAN("&clk", "*", 1)==(STRING.LENGTH("&clk")-1))
  (
    &wild_tail=1
  )

  if ((&wild_head==1)&&(&wild_tail==1))
  (
    if (STRING.SCAN("gcc_pcie_phy_cfg_ahb_clk", STRING.MID("&clk", 1, &clk_input_length-2), 0)!=-1)
    ( 
      &match=1
    )
  )
  else if (&wild_head==1)
  (
    if (STRING.MID("gcc_pcie_phy_cfg_ahb_clk", &clk_itr_length-&clk_input_length+1, &clk_input_length-1)==STRING.CUT("&clk", 1))
    ( 
      &match=1
    )
  )
  else if (&wild_tail==1)
  (
    if (STRING.MID("gcc_pcie_phy_cfg_ahb_clk", 0, &clk_input_length-1)==STRING.CUT("&clk", -1))
    ( 
      &match=1
    )
  )
  else if ("gcc_pcie_phy_cfg_ahb_clk"=="&clk")
  (
    &match=1
  )
  
  if (&match==1)
  (
    &clk_test=&CLK_TEST_GCC_PCIE_PHY_CFG_AHB_CLK
    &clk_reg=&HWIO_GCC_PCIE_PHY_CFG_AHB_CBCR_ADDR
    &clk_reg_name="GCC_PCIE_PHY_CFG_AHB_CBCR"
    &clk_name="gcc_pcie_phy_cfg_ahb_clk"
    &clk_reg_cbcr_type="sm_cbc"
    &clk_vote_bit=-1.
    &clk_multiplier=1.

    gosub Print_Clk_Info_Line
  )

  &match=0
  &wild_head=0
  &wild_tail=0
  &clk_input_length=STRING.LENGTH("&clk")
  &clk_itr_length=STRING.LENGTH("gcc_periph_noc_cfg_ahb_clk")

  if (STRING.SCAN("&clk", "*", 0)==0)
  (
    &wild_head=1
  )
  if (STRING.SCAN("&clk", "*", 1)==(STRING.LENGTH("&clk")-1))
  (
    &wild_tail=1
  )

  if ((&wild_head==1)&&(&wild_tail==1))
  (
    if (STRING.SCAN("gcc_periph_noc_cfg_ahb_clk", STRING.MID("&clk", 1, &clk_input_length-2), 0)!=-1)
    ( 
      &match=1
    )
  )
  else if (&wild_head==1)
  (
    if (STRING.MID("gcc_periph_noc_cfg_ahb_clk", &clk_itr_length-&clk_input_length+1, &clk_input_length-1)==STRING.CUT("&clk", 1))
    ( 
      &match=1
    )
  )
  else if (&wild_tail==1)
  (
    if (STRING.MID("gcc_periph_noc_cfg_ahb_clk", 0, &clk_input_length-1)==STRING.CUT("&clk", -1))
    ( 
      &match=1
    )
  )
  else if ("gcc_periph_noc_cfg_ahb_clk"=="&clk")
  (
    &match=1
  )
  
  if (&match==1)
  (
    &clk_test=&CLK_TEST_GCC_PERIPH_NOC_CFG_AHB_CLK
    &clk_reg=&HWIO_GCC_PERIPH_NOC_CFG_AHB_CBCR_ADDR
    &clk_reg_name="GCC_PERIPH_NOC_CFG_AHB_CBCR"
    &clk_name="gcc_periph_noc_cfg_ahb_clk"
    &clk_reg_cbcr_type="sm_cbc"
    &clk_vote_bit=-1.
    &clk_multiplier=1.

    gosub Print_Clk_Info_Line
  )

  &match=0
  &wild_head=0
  &wild_tail=0
  &clk_input_length=STRING.LENGTH("&clk")
  &clk_itr_length=STRING.LENGTH("gcc_pimem_ahb_clk")

  if (STRING.SCAN("&clk", "*", 0)==0)
  (
    &wild_head=1
  )
  if (STRING.SCAN("&clk", "*", 1)==(STRING.LENGTH("&clk")-1))
  (
    &wild_tail=1
  )

  if ((&wild_head==1)&&(&wild_tail==1))
  (
    if (STRING.SCAN("gcc_pimem_ahb_clk", STRING.MID("&clk", 1, &clk_input_length-2), 0)!=-1)
    ( 
      &match=1
    )
  )
  else if (&wild_head==1)
  (
    if (STRING.MID("gcc_pimem_ahb_clk", &clk_itr_length-&clk_input_length+1, &clk_input_length-1)==STRING.CUT("&clk", 1))
    ( 
      &match=1
    )
  )
  else if (&wild_tail==1)
  (
    if (STRING.MID("gcc_pimem_ahb_clk", 0, &clk_input_length-1)==STRING.CUT("&clk", -1))
    ( 
      &match=1
    )
  )
  else if ("gcc_pimem_ahb_clk"=="&clk")
  (
    &match=1
  )
  
  if (&match==1)
  (
    &clk_test=&CLK_TEST_GCC_PIMEM_AHB_CLK
    &clk_reg=&HWIO_GCC_PIMEM_AHB_CBCR_ADDR
    &clk_reg_name="GCC_PIMEM_AHB_CBCR"
    &clk_name="gcc_pimem_ahb_clk"
    &clk_reg_cbcr_type="sm_cbc"
    &clk_vote_bit=-1.
    &clk_multiplier=1.

    gosub Print_Clk_Info_Line
  )

  &match=0
  &wild_head=0
  &wild_tail=0
  &clk_input_length=STRING.LENGTH("&clk")
  &clk_itr_length=STRING.LENGTH("gcc_prng_ahb_clk")

  if (STRING.SCAN("&clk", "*", 0)==0)
  (
    &wild_head=1
  )
  if (STRING.SCAN("&clk", "*", 1)==(STRING.LENGTH("&clk")-1))
  (
    &wild_tail=1
  )

  if ((&wild_head==1)&&(&wild_tail==1))
  (
    if (STRING.SCAN("gcc_prng_ahb_clk", STRING.MID("&clk", 1, &clk_input_length-2), 0)!=-1)
    ( 
      &match=1
    )
  )
  else if (&wild_head==1)
  (
    if (STRING.MID("gcc_prng_ahb_clk", &clk_itr_length-&clk_input_length+1, &clk_input_length-1)==STRING.CUT("&clk", 1))
    ( 
      &match=1
    )
  )
  else if (&wild_tail==1)
  (
    if (STRING.MID("gcc_prng_ahb_clk", 0, &clk_input_length-1)==STRING.CUT("&clk", -1))
    ( 
      &match=1
    )
  )
  else if ("gcc_prng_ahb_clk"=="&clk")
  (
    &match=1
  )
  
  if (&match==1)
  (
    &clk_test=&CLK_TEST_GCC_PRNG_AHB_CLK
    &clk_reg=&HWIO_GCC_PRNG_AHB_CBCR_ADDR
    &clk_reg_name="GCC_PRNG_AHB_CBCR"
    &clk_name="gcc_prng_ahb_clk"
    &clk_reg_cbcr_type="sm_cbc"
    &clk_vote_bit=13.
    &clk_multiplier=1.

    gosub Print_Clk_Info_Line
  )

  &match=0
  &wild_head=0
  &wild_tail=0
  &clk_input_length=STRING.LENGTH("&clk")
  &clk_itr_length=STRING.LENGTH("gcc_qdss_cfg_ahb_clk")

  if (STRING.SCAN("&clk", "*", 0)==0)
  (
    &wild_head=1
  )
  if (STRING.SCAN("&clk", "*", 1)==(STRING.LENGTH("&clk")-1))
  (
    &wild_tail=1
  )

  if ((&wild_head==1)&&(&wild_tail==1))
  (
    if (STRING.SCAN("gcc_qdss_cfg_ahb_clk", STRING.MID("&clk", 1, &clk_input_length-2), 0)!=-1)
    ( 
      &match=1
    )
  )
  else if (&wild_head==1)
  (
    if (STRING.MID("gcc_qdss_cfg_ahb_clk", &clk_itr_length-&clk_input_length+1, &clk_input_length-1)==STRING.CUT("&clk", 1))
    ( 
      &match=1
    )
  )
  else if (&wild_tail==1)
  (
    if (STRING.MID("gcc_qdss_cfg_ahb_clk", 0, &clk_input_length-1)==STRING.CUT("&clk", -1))
    ( 
      &match=1
    )
  )
  else if ("gcc_qdss_cfg_ahb_clk"=="&clk")
  (
    &match=1
  )
  
  if (&match==1)
  (
    &clk_test=&CLK_TEST_GCC_QDSS_CFG_AHB_CLK
    &clk_reg=&HWIO_GCC_QDSS_CFG_AHB_CBCR_ADDR
    &clk_reg_name="GCC_QDSS_CFG_AHB_CBCR"
    &clk_name="gcc_qdss_cfg_ahb_clk"
    &clk_reg_cbcr_type="sm_cbc"
    &clk_vote_bit=-1.
    &clk_multiplier=1.

    gosub Print_Clk_Info_Line
  )

  &match=0
  &wild_head=0
  &wild_tail=0
  &clk_input_length=STRING.LENGTH("&clk")
  &clk_itr_length=STRING.LENGTH("gcc_qdss_dap_ahb_clk")

  if (STRING.SCAN("&clk", "*", 0)==0)
  (
    &wild_head=1
  )
  if (STRING.SCAN("&clk", "*", 1)==(STRING.LENGTH("&clk")-1))
  (
    &wild_tail=1
  )

  if ((&wild_head==1)&&(&wild_tail==1))
  (
    if (STRING.SCAN("gcc_qdss_dap_ahb_clk", STRING.MID("&clk", 1, &clk_input_length-2), 0)!=-1)
    ( 
      &match=1
    )
  )
  else if (&wild_head==1)
  (
    if (STRING.MID("gcc_qdss_dap_ahb_clk", &clk_itr_length-&clk_input_length+1, &clk_input_length-1)==STRING.CUT("&clk", 1))
    ( 
      &match=1
    )
  )
  else if (&wild_tail==1)
  (
    if (STRING.MID("gcc_qdss_dap_ahb_clk", 0, &clk_input_length-1)==STRING.CUT("&clk", -1))
    ( 
      &match=1
    )
  )
  else if ("gcc_qdss_dap_ahb_clk"=="&clk")
  (
    &match=1
  )
  
  if (&match==1)
  (
    &clk_test=&CLK_TEST_GCC_QDSS_DAP_AHB_CLK
    &clk_reg=&HWIO_GCC_QDSS_DAP_AHB_CBCR_ADDR
    &clk_reg_name="GCC_QDSS_DAP_AHB_CBCR"
    &clk_name="gcc_qdss_dap_ahb_clk"
    &clk_reg_cbcr_type="sm_cbc"
    &clk_vote_bit=-1.
    &clk_multiplier=1.

    gosub Print_Clk_Info_Line
  )

  &match=0
  &wild_head=0
  &wild_tail=0
  &clk_input_length=STRING.LENGTH("&clk")
  &clk_itr_length=STRING.LENGTH("gcc_qdss_mpu_ahb_clk")

  if (STRING.SCAN("&clk", "*", 0)==0)
  (
    &wild_head=1
  )
  if (STRING.SCAN("&clk", "*", 1)==(STRING.LENGTH("&clk")-1))
  (
    &wild_tail=1
  )

  if ((&wild_head==1)&&(&wild_tail==1))
  (
    if (STRING.SCAN("gcc_qdss_mpu_ahb_clk", STRING.MID("&clk", 1, &clk_input_length-2), 0)!=-1)
    ( 
      &match=1
    )
  )
  else if (&wild_head==1)
  (
    if (STRING.MID("gcc_qdss_mpu_ahb_clk", &clk_itr_length-&clk_input_length+1, &clk_input_length-1)==STRING.CUT("&clk", 1))
    ( 
      &match=1
    )
  )
  else if (&wild_tail==1)
  (
    if (STRING.MID("gcc_qdss_mpu_ahb_clk", 0, &clk_input_length-1)==STRING.CUT("&clk", -1))
    ( 
      &match=1
    )
  )
  else if ("gcc_qdss_mpu_ahb_clk"=="&clk")
  (
    &match=1
  )
  
  if (&match==1)
  (
    &clk_test=&CLK_TEST_GCC_QDSS_MPU_AHB_CLK
    &clk_reg=&HWIO_GCC_QDSS_MPU_AHB_CBCR_ADDR
    &clk_reg_name="GCC_QDSS_MPU_AHB_CBCR"
    &clk_name="gcc_qdss_mpu_ahb_clk"
    &clk_reg_cbcr_type="sm_cbc"
    &clk_vote_bit=-1.
    &clk_multiplier=1.

    gosub Print_Clk_Info_Line
  )

  &match=0
  &wild_head=0
  &wild_tail=0
  &clk_input_length=STRING.LENGTH("&clk")
  &clk_itr_length=STRING.LENGTH("gcc_rbcpr_cx_ahb_clk")

  if (STRING.SCAN("&clk", "*", 0)==0)
  (
    &wild_head=1
  )
  if (STRING.SCAN("&clk", "*", 1)==(STRING.LENGTH("&clk")-1))
  (
    &wild_tail=1
  )

  if ((&wild_head==1)&&(&wild_tail==1))
  (
    if (STRING.SCAN("gcc_rbcpr_cx_ahb_clk", STRING.MID("&clk", 1, &clk_input_length-2), 0)!=-1)
    ( 
      &match=1
    )
  )
  else if (&wild_head==1)
  (
    if (STRING.MID("gcc_rbcpr_cx_ahb_clk", &clk_itr_length-&clk_input_length+1, &clk_input_length-1)==STRING.CUT("&clk", 1))
    ( 
      &match=1
    )
  )
  else if (&wild_tail==1)
  (
    if (STRING.MID("gcc_rbcpr_cx_ahb_clk", 0, &clk_input_length-1)==STRING.CUT("&clk", -1))
    ( 
      &match=1
    )
  )
  else if ("gcc_rbcpr_cx_ahb_clk"=="&clk")
  (
    &match=1
  )
  
  if (&match==1)
  (
    &clk_test=&CLK_TEST_GCC_RBCPR_CX_AHB_CLK
    &clk_reg=&HWIO_GCC_RBCPR_CX_AHB_CBCR_ADDR
    &clk_reg_name="GCC_RBCPR_CX_AHB_CBCR"
    &clk_name="gcc_rbcpr_cx_ahb_clk"
    &clk_reg_cbcr_type="sm_cbc"
    &clk_vote_bit=-1.
    &clk_multiplier=1.

    gosub Print_Clk_Info_Line
  )

  &match=0
  &wild_head=0
  &wild_tail=0
  &clk_input_length=STRING.LENGTH("&clk")
  &clk_itr_length=STRING.LENGTH("gcc_rbcpr_mx_ahb_clk")

  if (STRING.SCAN("&clk", "*", 0)==0)
  (
    &wild_head=1
  )
  if (STRING.SCAN("&clk", "*", 1)==(STRING.LENGTH("&clk")-1))
  (
    &wild_tail=1
  )

  if ((&wild_head==1)&&(&wild_tail==1))
  (
    if (STRING.SCAN("gcc_rbcpr_mx_ahb_clk", STRING.MID("&clk", 1, &clk_input_length-2), 0)!=-1)
    ( 
      &match=1
    )
  )
  else if (&wild_head==1)
  (
    if (STRING.MID("gcc_rbcpr_mx_ahb_clk", &clk_itr_length-&clk_input_length+1, &clk_input_length-1)==STRING.CUT("&clk", 1))
    ( 
      &match=1
    )
  )
  else if (&wild_tail==1)
  (
    if (STRING.MID("gcc_rbcpr_mx_ahb_clk", 0, &clk_input_length-1)==STRING.CUT("&clk", -1))
    ( 
      &match=1
    )
  )
  else if ("gcc_rbcpr_mx_ahb_clk"=="&clk")
  (
    &match=1
  )
  
  if (&match==1)
  (
    &clk_test=&CLK_TEST_GCC_RBCPR_MX_AHB_CLK
    &clk_reg=&HWIO_GCC_RBCPR_MX_AHB_CBCR_ADDR
    &clk_reg_name="GCC_RBCPR_MX_AHB_CBCR"
    &clk_name="gcc_rbcpr_mx_ahb_clk"
    &clk_reg_cbcr_type="sm_cbc"
    &clk_vote_bit=-1.
    &clk_multiplier=1.

    gosub Print_Clk_Info_Line
  )

  &match=0
  &wild_head=0
  &wild_tail=0
  &clk_input_length=STRING.LENGTH("&clk")
  &clk_itr_length=STRING.LENGTH("gcc_rbcpr_xpu_ahb_clk")

  if (STRING.SCAN("&clk", "*", 0)==0)
  (
    &wild_head=1
  )
  if (STRING.SCAN("&clk", "*", 1)==(STRING.LENGTH("&clk")-1))
  (
    &wild_tail=1
  )

  if ((&wild_head==1)&&(&wild_tail==1))
  (
    if (STRING.SCAN("gcc_rbcpr_xpu_ahb_clk", STRING.MID("&clk", 1, &clk_input_length-2), 0)!=-1)
    ( 
      &match=1
    )
  )
  else if (&wild_head==1)
  (
    if (STRING.MID("gcc_rbcpr_xpu_ahb_clk", &clk_itr_length-&clk_input_length+1, &clk_input_length-1)==STRING.CUT("&clk", 1))
    ( 
      &match=1
    )
  )
  else if (&wild_tail==1)
  (
    if (STRING.MID("gcc_rbcpr_xpu_ahb_clk", 0, &clk_input_length-1)==STRING.CUT("&clk", -1))
    ( 
      &match=1
    )
  )
  else if ("gcc_rbcpr_xpu_ahb_clk"=="&clk")
  (
    &match=1
  )
  
  if (&match==1)
  (
    &clk_test=&CLK_TEST_GCC_RBCPR_XPU_AHB_CLK
    &clk_reg=&HWIO_GCC_RBCPR_XPU_AHB_CBCR_ADDR
    &clk_reg_name="GCC_RBCPR_XPU_AHB_CBCR"
    &clk_name="gcc_rbcpr_xpu_ahb_clk"
    &clk_reg_cbcr_type="sm_cbc"
    &clk_vote_bit=-1.
    &clk_multiplier=1.

    gosub Print_Clk_Info_Line
  )

  &match=0
  &wild_head=0
  &wild_tail=0
  &clk_input_length=STRING.LENGTH("&clk")
  &clk_itr_length=STRING.LENGTH("gcc_rpm_mst_m2_cnoc_ahb_clk")

  if (STRING.SCAN("&clk", "*", 0)==0)
  (
    &wild_head=1
  )
  if (STRING.SCAN("&clk", "*", 1)==(STRING.LENGTH("&clk")-1))
  (
    &wild_tail=1
  )

  if ((&wild_head==1)&&(&wild_tail==1))
  (
    if (STRING.SCAN("gcc_rpm_mst_m2_cnoc_ahb_clk", STRING.MID("&clk", 1, &clk_input_length-2), 0)!=-1)
    ( 
      &match=1
    )
  )
  else if (&wild_head==1)
  (
    if (STRING.MID("gcc_rpm_mst_m2_cnoc_ahb_clk", &clk_itr_length-&clk_input_length+1, &clk_input_length-1)==STRING.CUT("&clk", 1))
    ( 
      &match=1
    )
  )
  else if (&wild_tail==1)
  (
    if (STRING.MID("gcc_rpm_mst_m2_cnoc_ahb_clk", 0, &clk_input_length-1)==STRING.CUT("&clk", -1))
    ( 
      &match=1
    )
  )
  else if ("gcc_rpm_mst_m2_cnoc_ahb_clk"=="&clk")
  (
    &match=1
  )
  
  if (&match==1)
  (
    &clk_test=&CLK_TEST_GCC_RPM_MST_M2_CNOC_AHB_CLK
    &clk_reg=&HWIO_GCC_RPM_MST_M2_CNOC_AHB_CBCR_ADDR
    &clk_reg_name="GCC_RPM_MST_M2_CNOC_AHB_CBCR"
    &clk_name="gcc_rpm_mst_m2_cnoc_ahb_clk"
    &clk_reg_cbcr_type="sm_cbc"
    &clk_vote_bit=-1.
    &clk_multiplier=1.

    gosub Print_Clk_Info_Line
  )

  &match=0
  &wild_head=0
  &wild_tail=0
  &clk_input_length=STRING.LENGTH("&clk")
  &clk_itr_length=STRING.LENGTH("gcc_sec_ctrl_ahb_clk")

  if (STRING.SCAN("&clk", "*", 0)==0)
  (
    &wild_head=1
  )
  if (STRING.SCAN("&clk", "*", 1)==(STRING.LENGTH("&clk")-1))
  (
    &wild_tail=1
  )

  if ((&wild_head==1)&&(&wild_tail==1))
  (
    if (STRING.SCAN("gcc_sec_ctrl_ahb_clk", STRING.MID("&clk", 1, &clk_input_length-2), 0)!=-1)
    ( 
      &match=1
    )
  )
  else if (&wild_head==1)
  (
    if (STRING.MID("gcc_sec_ctrl_ahb_clk", &clk_itr_length-&clk_input_length+1, &clk_input_length-1)==STRING.CUT("&clk", 1))
    ( 
      &match=1
    )
  )
  else if (&wild_tail==1)
  (
    if (STRING.MID("gcc_sec_ctrl_ahb_clk", 0, &clk_input_length-1)==STRING.CUT("&clk", -1))
    ( 
      &match=1
    )
  )
  else if ("gcc_sec_ctrl_ahb_clk"=="&clk")
  (
    &match=1
  )
  
  if (&match==1)
  (
    &clk_test=&CLK_TEST_GCC_SEC_CTRL_AHB_CLK
    &clk_reg=&HWIO_GCC_SEC_CTRL_AHB_CBCR_ADDR
    &clk_reg_name="GCC_SEC_CTRL_AHB_CBCR"
    &clk_name="gcc_sec_ctrl_ahb_clk"
    &clk_reg_cbcr_type="sm_cbc"
    &clk_vote_bit=-1.
    &clk_multiplier=1.

    gosub Print_Clk_Info_Line
  )

  &match=0
  &wild_head=0
  &wild_tail=0
  &clk_input_length=STRING.LENGTH("&clk")
  &clk_itr_length=STRING.LENGTH("gcc_sec_ctrl_boot_rom_patch_clk")

  if (STRING.SCAN("&clk", "*", 0)==0)
  (
    &wild_head=1
  )
  if (STRING.SCAN("&clk", "*", 1)==(STRING.LENGTH("&clk")-1))
  (
    &wild_tail=1
  )

  if ((&wild_head==1)&&(&wild_tail==1))
  (
    if (STRING.SCAN("gcc_sec_ctrl_boot_rom_patch_clk", STRING.MID("&clk", 1, &clk_input_length-2), 0)!=-1)
    ( 
      &match=1
    )
  )
  else if (&wild_head==1)
  (
    if (STRING.MID("gcc_sec_ctrl_boot_rom_patch_clk", &clk_itr_length-&clk_input_length+1, &clk_input_length-1)==STRING.CUT("&clk", 1))
    ( 
      &match=1
    )
  )
  else if (&wild_tail==1)
  (
    if (STRING.MID("gcc_sec_ctrl_boot_rom_patch_clk", 0, &clk_input_length-1)==STRING.CUT("&clk", -1))
    ( 
      &match=1
    )
  )
  else if ("gcc_sec_ctrl_boot_rom_patch_clk"=="&clk")
  (
    &match=1
  )
  
  if (&match==1)
  (
    &clk_test=&CLK_TEST_GCC_SEC_CTRL_BOOT_ROM_PATCH_CLK
    &clk_reg=&HWIO_GCC_SEC_CTRL_BOOT_ROM_PATCH_CBCR_ADDR
    &clk_reg_name="GCC_SEC_CTRL_BOOT_ROM_PATCH_CBCR"
    &clk_name="gcc_sec_ctrl_boot_rom_patch_clk"
    &clk_reg_cbcr_type="sm_cbc"
    &clk_vote_bit=-1.
    &clk_multiplier=1.

    gosub Print_Clk_Info_Line
  )

  &match=0
  &wild_head=0
  &wild_tail=0
  &clk_input_length=STRING.LENGTH("&clk")
  &clk_itr_length=STRING.LENGTH("gcc_smmu_aggre0_ahb_clk")

  if (STRING.SCAN("&clk", "*", 0)==0)
  (
    &wild_head=1
  )
  if (STRING.SCAN("&clk", "*", 1)==(STRING.LENGTH("&clk")-1))
  (
    &wild_tail=1
  )

  if ((&wild_head==1)&&(&wild_tail==1))
  (
    if (STRING.SCAN("gcc_smmu_aggre0_ahb_clk", STRING.MID("&clk", 1, &clk_input_length-2), 0)!=-1)
    ( 
      &match=1
    )
  )
  else if (&wild_head==1)
  (
    if (STRING.MID("gcc_smmu_aggre0_ahb_clk", &clk_itr_length-&clk_input_length+1, &clk_input_length-1)==STRING.CUT("&clk", 1))
    ( 
      &match=1
    )
  )
  else if (&wild_tail==1)
  (
    if (STRING.MID("gcc_smmu_aggre0_ahb_clk", 0, &clk_input_length-1)==STRING.CUT("&clk", -1))
    ( 
      &match=1
    )
  )
  else if ("gcc_smmu_aggre0_ahb_clk"=="&clk")
  (
    &match=1
  )
  
  if (&match==1)
  (
    &clk_test=&CLK_TEST_GCC_SMMU_AGGRE0_AHB_CLK
    &clk_reg=&HWIO_GCC_SMMU_AGGRE0_AHB_CBCR_ADDR
    &clk_reg_name="GCC_SMMU_AGGRE0_AHB_CBCR"
    &clk_name="gcc_smmu_aggre0_ahb_clk"
    &clk_reg_cbcr_type="sm_cbc"
    &clk_vote_bit=-1.
    &clk_multiplier=1.

    gosub Print_Clk_Info_Line
  )

  &match=0
  &wild_head=0
  &wild_tail=0
  &clk_input_length=STRING.LENGTH("&clk")
  &clk_itr_length=STRING.LENGTH("gcc_smmu_aggre1_ahb_clk")

  if (STRING.SCAN("&clk", "*", 0)==0)
  (
    &wild_head=1
  )
  if (STRING.SCAN("&clk", "*", 1)==(STRING.LENGTH("&clk")-1))
  (
    &wild_tail=1
  )

  if ((&wild_head==1)&&(&wild_tail==1))
  (
    if (STRING.SCAN("gcc_smmu_aggre1_ahb_clk", STRING.MID("&clk", 1, &clk_input_length-2), 0)!=-1)
    ( 
      &match=1
    )
  )
  else if (&wild_head==1)
  (
    if (STRING.MID("gcc_smmu_aggre1_ahb_clk", &clk_itr_length-&clk_input_length+1, &clk_input_length-1)==STRING.CUT("&clk", 1))
    ( 
      &match=1
    )
  )
  else if (&wild_tail==1)
  (
    if (STRING.MID("gcc_smmu_aggre1_ahb_clk", 0, &clk_input_length-1)==STRING.CUT("&clk", -1))
    ( 
      &match=1
    )
  )
  else if ("gcc_smmu_aggre1_ahb_clk"=="&clk")
  (
    &match=1
  )
  
  if (&match==1)
  (
    &clk_test=&CLK_TEST_GCC_SMMU_AGGRE1_AHB_CLK
    &clk_reg=&HWIO_GCC_SMMU_AGGRE1_AHB_CBCR_ADDR
    &clk_reg_name="GCC_SMMU_AGGRE1_AHB_CBCR"
    &clk_name="gcc_smmu_aggre1_ahb_clk"
    &clk_reg_cbcr_type="sm_cbc"
    &clk_vote_bit=-1.
    &clk_multiplier=1.

    gosub Print_Clk_Info_Line
  )

  &match=0
  &wild_head=0
  &wild_tail=0
  &clk_input_length=STRING.LENGTH("&clk")
  &clk_itr_length=STRING.LENGTH("gcc_smmu_aggre2_ahb_clk")

  if (STRING.SCAN("&clk", "*", 0)==0)
  (
    &wild_head=1
  )
  if (STRING.SCAN("&clk", "*", 1)==(STRING.LENGTH("&clk")-1))
  (
    &wild_tail=1
  )

  if ((&wild_head==1)&&(&wild_tail==1))
  (
    if (STRING.SCAN("gcc_smmu_aggre2_ahb_clk", STRING.MID("&clk", 1, &clk_input_length-2), 0)!=-1)
    ( 
      &match=1
    )
  )
  else if (&wild_head==1)
  (
    if (STRING.MID("gcc_smmu_aggre2_ahb_clk", &clk_itr_length-&clk_input_length+1, &clk_input_length-1)==STRING.CUT("&clk", 1))
    ( 
      &match=1
    )
  )
  else if (&wild_tail==1)
  (
    if (STRING.MID("gcc_smmu_aggre2_ahb_clk", 0, &clk_input_length-1)==STRING.CUT("&clk", -1))
    ( 
      &match=1
    )
  )
  else if ("gcc_smmu_aggre2_ahb_clk"=="&clk")
  (
    &match=1
  )
  
  if (&match==1)
  (
    &clk_test=&CLK_TEST_GCC_SMMU_AGGRE2_AHB_CLK
    &clk_reg=&HWIO_GCC_SMMU_AGGRE2_AHB_CBCR_ADDR
    &clk_reg_name="GCC_SMMU_AGGRE2_AHB_CBCR"
    &clk_name="gcc_smmu_aggre2_ahb_clk"
    &clk_reg_cbcr_type="sm_cbc"
    &clk_vote_bit=-1.
    &clk_multiplier=1.

    gosub Print_Clk_Info_Line
  )

  &match=0
  &wild_head=0
  &wild_tail=0
  &clk_input_length=STRING.LENGTH("&clk")
  &clk_itr_length=STRING.LENGTH("gcc_snoc_cnoc_ahb_clk")

  if (STRING.SCAN("&clk", "*", 0)==0)
  (
    &wild_head=1
  )
  if (STRING.SCAN("&clk", "*", 1)==(STRING.LENGTH("&clk")-1))
  (
    &wild_tail=1
  )

  if ((&wild_head==1)&&(&wild_tail==1))
  (
    if (STRING.SCAN("gcc_snoc_cnoc_ahb_clk", STRING.MID("&clk", 1, &clk_input_length-2), 0)!=-1)
    ( 
      &match=1
    )
  )
  else if (&wild_head==1)
  (
    if (STRING.MID("gcc_snoc_cnoc_ahb_clk", &clk_itr_length-&clk_input_length+1, &clk_input_length-1)==STRING.CUT("&clk", 1))
    ( 
      &match=1
    )
  )
  else if (&wild_tail==1)
  (
    if (STRING.MID("gcc_snoc_cnoc_ahb_clk", 0, &clk_input_length-1)==STRING.CUT("&clk", -1))
    ( 
      &match=1
    )
  )
  else if ("gcc_snoc_cnoc_ahb_clk"=="&clk")
  (
    &match=1
  )
  
  if (&match==1)
  (
    &clk_test=&CLK_TEST_GCC_SNOC_CNOC_AHB_CLK
    &clk_reg=&HWIO_GCC_SNOC_CNOC_AHB_CBCR_ADDR
    &clk_reg_name="GCC_SNOC_CNOC_AHB_CBCR"
    &clk_name="gcc_snoc_cnoc_ahb_clk"
    &clk_reg_cbcr_type="sm_cbc"
    &clk_vote_bit=-1.
    &clk_multiplier=1.

    gosub Print_Clk_Info_Line
  )

  &match=0
  &wild_head=0
  &wild_tail=0
  &clk_input_length=STRING.LENGTH("&clk")
  &clk_itr_length=STRING.LENGTH("gcc_spdm_cfg_ahb_clk")

  if (STRING.SCAN("&clk", "*", 0)==0)
  (
    &wild_head=1
  )
  if (STRING.SCAN("&clk", "*", 1)==(STRING.LENGTH("&clk")-1))
  (
    &wild_tail=1
  )

  if ((&wild_head==1)&&(&wild_tail==1))
  (
    if (STRING.SCAN("gcc_spdm_cfg_ahb_clk", STRING.MID("&clk", 1, &clk_input_length-2), 0)!=-1)
    ( 
      &match=1
    )
  )
  else if (&wild_head==1)
  (
    if (STRING.MID("gcc_spdm_cfg_ahb_clk", &clk_itr_length-&clk_input_length+1, &clk_input_length-1)==STRING.CUT("&clk", 1))
    ( 
      &match=1
    )
  )
  else if (&wild_tail==1)
  (
    if (STRING.MID("gcc_spdm_cfg_ahb_clk", 0, &clk_input_length-1)==STRING.CUT("&clk", -1))
    ( 
      &match=1
    )
  )
  else if ("gcc_spdm_cfg_ahb_clk"=="&clk")
  (
    &match=1
  )
  
  if (&match==1)
  (
    &clk_test=&CLK_TEST_GCC_SPDM_CFG_AHB_CLK
    &clk_reg=&HWIO_GCC_SPDM_CFG_AHB_CBCR_ADDR
    &clk_reg_name="GCC_SPDM_CFG_AHB_CBCR"
    &clk_name="gcc_spdm_cfg_ahb_clk"
    &clk_reg_cbcr_type="sm_cbc"
    &clk_vote_bit=-1.
    &clk_multiplier=1.

    gosub Print_Clk_Info_Line
  )

  &match=0
  &wild_head=0
  &wild_tail=0
  &clk_input_length=STRING.LENGTH("&clk")
  &clk_itr_length=STRING.LENGTH("gcc_spdm_mstr_ahb_clk")

  if (STRING.SCAN("&clk", "*", 0)==0)
  (
    &wild_head=1
  )
  if (STRING.SCAN("&clk", "*", 1)==(STRING.LENGTH("&clk")-1))
  (
    &wild_tail=1
  )

  if ((&wild_head==1)&&(&wild_tail==1))
  (
    if (STRING.SCAN("gcc_spdm_mstr_ahb_clk", STRING.MID("&clk", 1, &clk_input_length-2), 0)!=-1)
    ( 
      &match=1
    )
  )
  else if (&wild_head==1)
  (
    if (STRING.MID("gcc_spdm_mstr_ahb_clk", &clk_itr_length-&clk_input_length+1, &clk_input_length-1)==STRING.CUT("&clk", 1))
    ( 
      &match=1
    )
  )
  else if (&wild_tail==1)
  (
    if (STRING.MID("gcc_spdm_mstr_ahb_clk", 0, &clk_input_length-1)==STRING.CUT("&clk", -1))
    ( 
      &match=1
    )
  )
  else if ("gcc_spdm_mstr_ahb_clk"=="&clk")
  (
    &match=1
  )
  
  if (&match==1)
  (
    &clk_test=&CLK_TEST_GCC_SPDM_MSTR_AHB_CLK
    &clk_reg=&HWIO_GCC_SPDM_MSTR_AHB_CBCR_ADDR
    &clk_reg_name="GCC_SPDM_MSTR_AHB_CBCR"
    &clk_name="gcc_spdm_mstr_ahb_clk"
    &clk_reg_cbcr_type="sm_cbc"
    &clk_vote_bit=-1.
    &clk_multiplier=1.

    gosub Print_Clk_Info_Line
  )

  &match=0
  &wild_head=0
  &wild_tail=0
  &clk_input_length=STRING.LENGTH("&clk")
  &clk_itr_length=STRING.LENGTH("gcc_spmi_cnoc_ahb_clk")

  if (STRING.SCAN("&clk", "*", 0)==0)
  (
    &wild_head=1
  )
  if (STRING.SCAN("&clk", "*", 1)==(STRING.LENGTH("&clk")-1))
  (
    &wild_tail=1
  )

  if ((&wild_head==1)&&(&wild_tail==1))
  (
    if (STRING.SCAN("gcc_spmi_cnoc_ahb_clk", STRING.MID("&clk", 1, &clk_input_length-2), 0)!=-1)
    ( 
      &match=1
    )
  )
  else if (&wild_head==1)
  (
    if (STRING.MID("gcc_spmi_cnoc_ahb_clk", &clk_itr_length-&clk_input_length+1, &clk_input_length-1)==STRING.CUT("&clk", 1))
    ( 
      &match=1
    )
  )
  else if (&wild_tail==1)
  (
    if (STRING.MID("gcc_spmi_cnoc_ahb_clk", 0, &clk_input_length-1)==STRING.CUT("&clk", -1))
    ( 
      &match=1
    )
  )
  else if ("gcc_spmi_cnoc_ahb_clk"=="&clk")
  (
    &match=1
  )
  
  if (&match==1)
  (
    &clk_test=&CLK_TEST_GCC_SPMI_CNOC_AHB_CLK
    &clk_reg=&HWIO_GCC_SPMI_CNOC_AHB_CBCR_ADDR
    &clk_reg_name="GCC_SPMI_CNOC_AHB_CBCR"
    &clk_name="gcc_spmi_cnoc_ahb_clk"
    &clk_reg_cbcr_type="sm_cbc"
    &clk_vote_bit=6.
    &clk_multiplier=1.

    gosub Print_Clk_Info_Line
  )

  &match=0
  &wild_head=0
  &wild_tail=0
  &clk_input_length=STRING.LENGTH("&clk")
  &clk_itr_length=STRING.LENGTH("gcc_ssc_cnoc_ahbs_clk")

  if (STRING.SCAN("&clk", "*", 0)==0)
  (
    &wild_head=1
  )
  if (STRING.SCAN("&clk", "*", 1)==(STRING.LENGTH("&clk")-1))
  (
    &wild_tail=1
  )

  if ((&wild_head==1)&&(&wild_tail==1))
  (
    if (STRING.SCAN("gcc_ssc_cnoc_ahbs_clk", STRING.MID("&clk", 1, &clk_input_length-2), 0)!=-1)
    ( 
      &match=1
    )
  )
  else if (&wild_head==1)
  (
    if (STRING.MID("gcc_ssc_cnoc_ahbs_clk", &clk_itr_length-&clk_input_length+1, &clk_input_length-1)==STRING.CUT("&clk", 1))
    ( 
      &match=1
    )
  )
  else if (&wild_tail==1)
  (
    if (STRING.MID("gcc_ssc_cnoc_ahbs_clk", 0, &clk_input_length-1)==STRING.CUT("&clk", -1))
    ( 
      &match=1
    )
  )
  else if ("gcc_ssc_cnoc_ahbs_clk"=="&clk")
  (
    &match=1
  )
  
  if (&match==1)
  (
    &clk_test=&CLK_TEST_GCC_SSC_CNOC_AHBS_CLK
    &clk_reg=&HWIO_GCC_SSC_CNOC_AHBS_CBCR_ADDR
    &clk_reg_name="GCC_SSC_CNOC_AHBS_CBCR"
    &clk_name="gcc_ssc_cnoc_ahbs_clk"
    &clk_reg_cbcr_type="sm_cbc"
    &clk_vote_bit=-1.
    &clk_multiplier=1.

    gosub Print_Clk_Info_Line
  )

  &match=0
  &wild_head=0
  &wild_tail=0
  &clk_input_length=STRING.LENGTH("&clk")
  &clk_itr_length=STRING.LENGTH("gcc_ssc_cnoc_mpu_clk")

  if (STRING.SCAN("&clk", "*", 0)==0)
  (
    &wild_head=1
  )
  if (STRING.SCAN("&clk", "*", 1)==(STRING.LENGTH("&clk")-1))
  (
    &wild_tail=1
  )

  if ((&wild_head==1)&&(&wild_tail==1))
  (
    if (STRING.SCAN("gcc_ssc_cnoc_mpu_clk", STRING.MID("&clk", 1, &clk_input_length-2), 0)!=-1)
    ( 
      &match=1
    )
  )
  else if (&wild_head==1)
  (
    if (STRING.MID("gcc_ssc_cnoc_mpu_clk", &clk_itr_length-&clk_input_length+1, &clk_input_length-1)==STRING.CUT("&clk", 1))
    ( 
      &match=1
    )
  )
  else if (&wild_tail==1)
  (
    if (STRING.MID("gcc_ssc_cnoc_mpu_clk", 0, &clk_input_length-1)==STRING.CUT("&clk", -1))
    ( 
      &match=1
    )
  )
  else if ("gcc_ssc_cnoc_mpu_clk"=="&clk")
  (
    &match=1
  )
  
  if (&match==1)
  (
    &clk_test=&CLK_TEST_GCC_SSC_CNOC_MPU_CLK
    &clk_reg=&HWIO_GCC_SSC_CNOC_MPU_CBCR_ADDR
    &clk_reg_name="GCC_SSC_CNOC_MPU_CBCR"
    &clk_name="gcc_ssc_cnoc_mpu_clk"
    &clk_reg_cbcr_type="sm_cbc"
    &clk_vote_bit=-1.
    &clk_multiplier=1.

    gosub Print_Clk_Info_Line
  )

  &match=0
  &wild_head=0
  &wild_tail=0
  &clk_input_length=STRING.LENGTH("&clk")
  &clk_itr_length=STRING.LENGTH("gcc_tcsr_ahb_clk")

  if (STRING.SCAN("&clk", "*", 0)==0)
  (
    &wild_head=1
  )
  if (STRING.SCAN("&clk", "*", 1)==(STRING.LENGTH("&clk")-1))
  (
    &wild_tail=1
  )

  if ((&wild_head==1)&&(&wild_tail==1))
  (
    if (STRING.SCAN("gcc_tcsr_ahb_clk", STRING.MID("&clk", 1, &clk_input_length-2), 0)!=-1)
    ( 
      &match=1
    )
  )
  else if (&wild_head==1)
  (
    if (STRING.MID("gcc_tcsr_ahb_clk", &clk_itr_length-&clk_input_length+1, &clk_input_length-1)==STRING.CUT("&clk", 1))
    ( 
      &match=1
    )
  )
  else if (&wild_tail==1)
  (
    if (STRING.MID("gcc_tcsr_ahb_clk", 0, &clk_input_length-1)==STRING.CUT("&clk", -1))
    ( 
      &match=1
    )
  )
  else if ("gcc_tcsr_ahb_clk"=="&clk")
  (
    &match=1
  )
  
  if (&match==1)
  (
    &clk_test=&CLK_TEST_GCC_TCSR_AHB_CLK
    &clk_reg=&HWIO_GCC_TCSR_AHB_CBCR_ADDR
    &clk_reg_name="GCC_TCSR_AHB_CBCR"
    &clk_name="gcc_tcsr_ahb_clk"
    &clk_reg_cbcr_type="sm_cbc"
    &clk_vote_bit=31.
    &clk_multiplier=1.

    gosub Print_Clk_Info_Line
  )

  &match=0
  &wild_head=0
  &wild_tail=0
  &clk_input_length=STRING.LENGTH("&clk")
  &clk_itr_length=STRING.LENGTH("gcc_tlmm_ahb_clk")

  if (STRING.SCAN("&clk", "*", 0)==0)
  (
    &wild_head=1
  )
  if (STRING.SCAN("&clk", "*", 1)==(STRING.LENGTH("&clk")-1))
  (
    &wild_tail=1
  )

  if ((&wild_head==1)&&(&wild_tail==1))
  (
    if (STRING.SCAN("gcc_tlmm_ahb_clk", STRING.MID("&clk", 1, &clk_input_length-2), 0)!=-1)
    ( 
      &match=1
    )
  )
  else if (&wild_head==1)
  (
    if (STRING.MID("gcc_tlmm_ahb_clk", &clk_itr_length-&clk_input_length+1, &clk_input_length-1)==STRING.CUT("&clk", 1))
    ( 
      &match=1
    )
  )
  else if (&wild_tail==1)
  (
    if (STRING.MID("gcc_tlmm_ahb_clk", 0, &clk_input_length-1)==STRING.CUT("&clk", -1))
    ( 
      &match=1
    )
  )
  else if ("gcc_tlmm_ahb_clk"=="&clk")
  (
    &match=1
  )
  
  if (&match==1)
  (
    &clk_test=&CLK_TEST_GCC_TLMM_AHB_CLK
    &clk_reg=&HWIO_GCC_TLMM_AHB_CBCR_ADDR
    &clk_reg_name="GCC_TLMM_AHB_CBCR"
    &clk_name="gcc_tlmm_ahb_clk"
    &clk_reg_cbcr_type="sm_cbc"
    &clk_vote_bit=8.
    &clk_multiplier=1.

    gosub Print_Clk_Info_Line
  )

  &match=0
  &wild_head=0
  &wild_tail=0
  &clk_input_length=STRING.LENGTH("&clk")
  &clk_itr_length=STRING.LENGTH("gcc_tlmm_clk")

  if (STRING.SCAN("&clk", "*", 0)==0)
  (
    &wild_head=1
  )
  if (STRING.SCAN("&clk", "*", 1)==(STRING.LENGTH("&clk")-1))
  (
    &wild_tail=1
  )

  if ((&wild_head==1)&&(&wild_tail==1))
  (
    if (STRING.SCAN("gcc_tlmm_clk", STRING.MID("&clk", 1, &clk_input_length-2), 0)!=-1)
    ( 
      &match=1
    )
  )
  else if (&wild_head==1)
  (
    if (STRING.MID("gcc_tlmm_clk", &clk_itr_length-&clk_input_length+1, &clk_input_length-1)==STRING.CUT("&clk", 1))
    ( 
      &match=1
    )
  )
  else if (&wild_tail==1)
  (
    if (STRING.MID("gcc_tlmm_clk", 0, &clk_input_length-1)==STRING.CUT("&clk", -1))
    ( 
      &match=1
    )
  )
  else if ("gcc_tlmm_clk"=="&clk")
  (
    &match=1
  )
  
  if (&match==1)
  (
    &clk_test=&CLK_TEST_GCC_TLMM_CLK
    &clk_reg=&HWIO_GCC_TLMM_CBCR_ADDR
    &clk_reg_name="GCC_TLMM_CBCR"
    &clk_name="gcc_tlmm_clk"
    &clk_reg_cbcr_type="sm_cbc"
    &clk_vote_bit=7.
    &clk_multiplier=1.

    gosub Print_Clk_Info_Line
  )

  &match=0
  &wild_head=0
  &wild_tail=0
  &clk_input_length=STRING.LENGTH("&clk")
  &clk_itr_length=STRING.LENGTH("gcc_ufs_ahb_clk")

  if (STRING.SCAN("&clk", "*", 0)==0)
  (
    &wild_head=1
  )
  if (STRING.SCAN("&clk", "*", 1)==(STRING.LENGTH("&clk")-1))
  (
    &wild_tail=1
  )

  if ((&wild_head==1)&&(&wild_tail==1))
  (
    if (STRING.SCAN("gcc_ufs_ahb_clk", STRING.MID("&clk", 1, &clk_input_length-2), 0)!=-1)
    ( 
      &match=1
    )
  )
  else if (&wild_head==1)
  (
    if (STRING.MID("gcc_ufs_ahb_clk", &clk_itr_length-&clk_input_length+1, &clk_input_length-1)==STRING.CUT("&clk", 1))
    ( 
      &match=1
    )
  )
  else if (&wild_tail==1)
  (
    if (STRING.MID("gcc_ufs_ahb_clk", 0, &clk_input_length-1)==STRING.CUT("&clk", -1))
    ( 
      &match=1
    )
  )
  else if ("gcc_ufs_ahb_clk"=="&clk")
  (
    &match=1
  )
  
  if (&match==1)
  (
    &clk_test=&CLK_TEST_GCC_UFS_AHB_CLK
    &clk_reg=&HWIO_GCC_UFS_AHB_CBCR_ADDR
    &clk_reg_name="GCC_UFS_AHB_CBCR"
    &clk_name="gcc_ufs_ahb_clk"
    &clk_reg_cbcr_type="sm_cbc"
    &clk_vote_bit=-1.
    &clk_multiplier=1.

    gosub Print_Clk_Info_Line
  )

  &match=0
  &wild_head=0
  &wild_tail=0
  &clk_input_length=STRING.LENGTH("&clk")
  &clk_itr_length=STRING.LENGTH("gcc_aggre1_noc_msmpu_cfg_ahb_clk")

  if (STRING.SCAN("&clk", "*", 0)==0)
  (
    &wild_head=1
  )
  if (STRING.SCAN("&clk", "*", 1)==(STRING.LENGTH("&clk")-1))
  (
    &wild_tail=1
  )

  if ((&wild_head==1)&&(&wild_tail==1))
  (
    if (STRING.SCAN("gcc_aggre1_noc_msmpu_cfg_ahb_clk", STRING.MID("&clk", 1, &clk_input_length-2), 0)!=-1)
    ( 
      &match=1
    )
  )
  else if (&wild_head==1)
  (
    if (STRING.MID("gcc_aggre1_noc_msmpu_cfg_ahb_clk", &clk_itr_length-&clk_input_length+1, &clk_input_length-1)==STRING.CUT("&clk", 1))
    ( 
      &match=1
    )
  )
  else if (&wild_tail==1)
  (
    if (STRING.MID("gcc_aggre1_noc_msmpu_cfg_ahb_clk", 0, &clk_input_length-1)==STRING.CUT("&clk", -1))
    ( 
      &match=1
    )
  )
  else if ("gcc_aggre1_noc_msmpu_cfg_ahb_clk"=="&clk")
  (
    &match=1
  )
  
  if (&match==1)
  (
    &clk_test=&CLK_TEST_GCC_AGGRE1_NOC_MSMPU_CFG_AHB_CLK
    &clk_reg=&HWIO_GCC_AGGRE1_NOC_MSMPU_CFG_AHB_CBCR_ADDR
    &clk_reg_name="GCC_AGGRE1_NOC_MSMPU_CFG_AHB_CBCR"
    &clk_name="gcc_aggre1_noc_msmpu_cfg_ahb_clk"
    &clk_reg_cbcr_type="sm_cbc"
    &clk_vote_bit=-1.
    &clk_multiplier=1.

    gosub Print_Clk_Info_Line
  )

  &match=0
  &wild_head=0
  &wild_tail=0
  &clk_input_length=STRING.LENGTH("&clk")
  &clk_itr_length=STRING.LENGTH("gcc_aggre2_noc_msmpu_cfg_ahb_clk")

  if (STRING.SCAN("&clk", "*", 0)==0)
  (
    &wild_head=1
  )
  if (STRING.SCAN("&clk", "*", 1)==(STRING.LENGTH("&clk")-1))
  (
    &wild_tail=1
  )

  if ((&wild_head==1)&&(&wild_tail==1))
  (
    if (STRING.SCAN("gcc_aggre2_noc_msmpu_cfg_ahb_clk", STRING.MID("&clk", 1, &clk_input_length-2), 0)!=-1)
    ( 
      &match=1
    )
  )
  else if (&wild_head==1)
  (
    if (STRING.MID("gcc_aggre2_noc_msmpu_cfg_ahb_clk", &clk_itr_length-&clk_input_length+1, &clk_input_length-1)==STRING.CUT("&clk", 1))
    ( 
      &match=1
    )
  )
  else if (&wild_tail==1)
  (
    if (STRING.MID("gcc_aggre2_noc_msmpu_cfg_ahb_clk", 0, &clk_input_length-1)==STRING.CUT("&clk", -1))
    ( 
      &match=1
    )
  )
  else if ("gcc_aggre2_noc_msmpu_cfg_ahb_clk"=="&clk")
  (
    &match=1
  )
  
  if (&match==1)
  (
    &clk_test=&CLK_TEST_GCC_AGGRE2_NOC_MSMPU_CFG_AHB_CLK
    &clk_reg=&HWIO_GCC_AGGRE2_NOC_MSMPU_CFG_AHB_CBCR_ADDR
    &clk_reg_name="GCC_AGGRE2_NOC_MSMPU_CFG_AHB_CBCR"
    &clk_name="gcc_aggre2_noc_msmpu_cfg_ahb_clk"
    &clk_reg_cbcr_type="sm_cbc"
    &clk_vote_bit=-1.
    &clk_multiplier=1.

    gosub Print_Clk_Info_Line
  )

  &match=0
  &wild_head=0
  &wild_tail=0
  &clk_input_length=STRING.LENGTH("&clk")
  &clk_itr_length=STRING.LENGTH("gcc_ipa_ahb_clk")

  if (STRING.SCAN("&clk", "*", 0)==0)
  (
    &wild_head=1
  )
  if (STRING.SCAN("&clk", "*", 1)==(STRING.LENGTH("&clk")-1))
  (
    &wild_tail=1
  )

  if ((&wild_head==1)&&(&wild_tail==1))
  (
    if (STRING.SCAN("gcc_ipa_ahb_clk", STRING.MID("&clk", 1, &clk_input_length-2), 0)!=-1)
    ( 
      &match=1
    )
  )
  else if (&wild_head==1)
  (
    if (STRING.MID("gcc_ipa_ahb_clk", &clk_itr_length-&clk_input_length+1, &clk_input_length-1)==STRING.CUT("&clk", 1))
    ( 
      &match=1
    )
  )
  else if (&wild_tail==1)
  (
    if (STRING.MID("gcc_ipa_ahb_clk", 0, &clk_input_length-1)==STRING.CUT("&clk", -1))
    ( 
      &match=1
    )
  )
  else if ("gcc_ipa_ahb_clk"=="&clk")
  (
    &match=1
  )
  
  if (&match==1)
  (
    &clk_test=&CLK_TEST_GCC_IPA_AHB_CLK
    &clk_reg=&HWIO_GCC_IPA_AHB_CBCR_ADDR
    &clk_reg_name="GCC_IPA_AHB_CBCR"
    &clk_name="gcc_ipa_ahb_clk"
    &clk_reg_cbcr_type="sm_cbc"
    &clk_vote_bit=-1.
    &clk_multiplier=1.

    gosub Print_Clk_Info_Line
  )

  &match=0
  &wild_head=0
  &wild_tail=0
  &clk_input_length=STRING.LENGTH("&clk")
  &clk_itr_length=STRING.LENGTH("gcc_mss_cfg_ahb_clk")

  if (STRING.SCAN("&clk", "*", 0)==0)
  (
    &wild_head=1
  )
  if (STRING.SCAN("&clk", "*", 1)==(STRING.LENGTH("&clk")-1))
  (
    &wild_tail=1
  )

  if ((&wild_head==1)&&(&wild_tail==1))
  (
    if (STRING.SCAN("gcc_mss_cfg_ahb_clk", STRING.MID("&clk", 1, &clk_input_length-2), 0)!=-1)
    ( 
      &match=1
    )
  )
  else if (&wild_head==1)
  (
    if (STRING.MID("gcc_mss_cfg_ahb_clk", &clk_itr_length-&clk_input_length+1, &clk_input_length-1)==STRING.CUT("&clk", 1))
    ( 
      &match=1
    )
  )
  else if (&wild_tail==1)
  (
    if (STRING.MID("gcc_mss_cfg_ahb_clk", 0, &clk_input_length-1)==STRING.CUT("&clk", -1))
    ( 
      &match=1
    )
  )
  else if ("gcc_mss_cfg_ahb_clk"=="&clk")
  (
    &match=1
  )
  
  if (&match==1)
  (
    &clk_test=&CLK_TEST_GCC_MSS_CFG_AHB_CLK
    &clk_reg=&HWIO_GCC_MSS_CFG_AHB_CBCR_ADDR
    &clk_reg_name="GCC_MSS_CFG_AHB_CBCR"
    &clk_name="gcc_mss_cfg_ahb_clk"
    &clk_reg_cbcr_type="sm_cbc"
    &clk_vote_bit=-1.
    &clk_multiplier=1.

    gosub Print_Clk_Info_Line
  )

  &match=0
  &wild_head=0
  &wild_tail=0
  &clk_input_length=STRING.LENGTH("&clk")
  &clk_itr_length=STRING.LENGTH("gcc_mss_msmpu_cfg_ahb_clk")

  if (STRING.SCAN("&clk", "*", 0)==0)
  (
    &wild_head=1
  )
  if (STRING.SCAN("&clk", "*", 1)==(STRING.LENGTH("&clk")-1))
  (
    &wild_tail=1
  )

  if ((&wild_head==1)&&(&wild_tail==1))
  (
    if (STRING.SCAN("gcc_mss_msmpu_cfg_ahb_clk", STRING.MID("&clk", 1, &clk_input_length-2), 0)!=-1)
    ( 
      &match=1
    )
  )
  else if (&wild_head==1)
  (
    if (STRING.MID("gcc_mss_msmpu_cfg_ahb_clk", &clk_itr_length-&clk_input_length+1, &clk_input_length-1)==STRING.CUT("&clk", 1))
    ( 
      &match=1
    )
  )
  else if (&wild_tail==1)
  (
    if (STRING.MID("gcc_mss_msmpu_cfg_ahb_clk", 0, &clk_input_length-1)==STRING.CUT("&clk", -1))
    ( 
      &match=1
    )
  )
  else if ("gcc_mss_msmpu_cfg_ahb_clk"=="&clk")
  (
    &match=1
  )
  
  if (&match==1)
  (
    &clk_test=&CLK_TEST_GCC_MSS_MSMPU_CFG_AHB_CLK
    &clk_reg=&HWIO_GCC_MSS_MSMPU_CFG_AHB_CBCR_ADDR
    &clk_reg_name="GCC_MSS_MSMPU_CFG_AHB_CBCR"
    &clk_name="gcc_mss_msmpu_cfg_ahb_clk"
    &clk_reg_cbcr_type="sm_cbc"
    &clk_vote_bit=-1.
    &clk_multiplier=1.

    gosub Print_Clk_Info_Line
  )

  &match=0
  &wild_head=0
  &wild_tail=0
  &clk_input_length=STRING.LENGTH("&clk")
  &clk_itr_length=STRING.LENGTH("gcc_mss_q6_cfg_ahb_clk")

  if (STRING.SCAN("&clk", "*", 0)==0)
  (
    &wild_head=1
  )
  if (STRING.SCAN("&clk", "*", 1)==(STRING.LENGTH("&clk")-1))
  (
    &wild_tail=1
  )

  if ((&wild_head==1)&&(&wild_tail==1))
  (
    if (STRING.SCAN("gcc_mss_q6_cfg_ahb_clk", STRING.MID("&clk", 1, &clk_input_length-2), 0)!=-1)
    ( 
      &match=1
    )
  )
  else if (&wild_head==1)
  (
    if (STRING.MID("gcc_mss_q6_cfg_ahb_clk", &clk_itr_length-&clk_input_length+1, &clk_input_length-1)==STRING.CUT("&clk", 1))
    ( 
      &match=1
    )
  )
  else if (&wild_tail==1)
  (
    if (STRING.MID("gcc_mss_q6_cfg_ahb_clk", 0, &clk_input_length-1)==STRING.CUT("&clk", -1))
    ( 
      &match=1
    )
  )
  else if ("gcc_mss_q6_cfg_ahb_clk"=="&clk")
  (
    &match=1
  )
  
  if (&match==1)
  (
    &clk_test=&CLK_TEST_GCC_MSS_Q6_CFG_AHB_CLK
    &clk_reg=&HWIO_GCC_MSS_Q6_CFG_AHB_CBCR_ADDR
    &clk_reg_name="GCC_MSS_Q6_CFG_AHB_CBCR"
    &clk_name="gcc_mss_q6_cfg_ahb_clk"
    &clk_reg_cbcr_type="sm_cbc"
    &clk_vote_bit=-1.
    &clk_multiplier=1.

    gosub Print_Clk_Info_Line
  )

  &match=0
  &wild_head=0
  &wild_tail=0
  &clk_input_length=STRING.LENGTH("&clk")
  &clk_itr_length=STRING.LENGTH("gcc_mss_q6_msmpu_cfg_ahb_clk")

  if (STRING.SCAN("&clk", "*", 0)==0)
  (
    &wild_head=1
  )
  if (STRING.SCAN("&clk", "*", 1)==(STRING.LENGTH("&clk")-1))
  (
    &wild_tail=1
  )

  if ((&wild_head==1)&&(&wild_tail==1))
  (
    if (STRING.SCAN("gcc_mss_q6_msmpu_cfg_ahb_clk", STRING.MID("&clk", 1, &clk_input_length-2), 0)!=-1)
    ( 
      &match=1
    )
  )
  else if (&wild_head==1)
  (
    if (STRING.MID("gcc_mss_q6_msmpu_cfg_ahb_clk", &clk_itr_length-&clk_input_length+1, &clk_input_length-1)==STRING.CUT("&clk", 1))
    ( 
      &match=1
    )
  )
  else if (&wild_tail==1)
  (
    if (STRING.MID("gcc_mss_q6_msmpu_cfg_ahb_clk", 0, &clk_input_length-1)==STRING.CUT("&clk", -1))
    ( 
      &match=1
    )
  )
  else if ("gcc_mss_q6_msmpu_cfg_ahb_clk"=="&clk")
  (
    &match=1
  )
  
  if (&match==1)
  (
    &clk_test=&CLK_TEST_GCC_MSS_Q6_MSMPU_CFG_AHB_CLK
    &clk_reg=&HWIO_GCC_MSS_Q6_MSMPU_CFG_AHB_CBCR_ADDR
    &clk_reg_name="GCC_MSS_Q6_MSMPU_CFG_AHB_CBCR"
    &clk_name="gcc_mss_q6_msmpu_cfg_ahb_clk"
    &clk_reg_cbcr_type="sm_cbc"
    &clk_vote_bit=-1.
    &clk_multiplier=1.

    gosub Print_Clk_Info_Line
  )

  &match=0
  &wild_head=0
  &wild_tail=0
  &clk_input_length=STRING.LENGTH("&clk")
  &clk_itr_length=STRING.LENGTH("gcc_skl_ahb_clk")

  if (STRING.SCAN("&clk", "*", 0)==0)
  (
    &wild_head=1
  )
  if (STRING.SCAN("&clk", "*", 1)==(STRING.LENGTH("&clk")-1))
  (
    &wild_tail=1
  )

  if ((&wild_head==1)&&(&wild_tail==1))
  (
    if (STRING.SCAN("gcc_skl_ahb_clk", STRING.MID("&clk", 1, &clk_input_length-2), 0)!=-1)
    ( 
      &match=1
    )
  )
  else if (&wild_head==1)
  (
    if (STRING.MID("gcc_skl_ahb_clk", &clk_itr_length-&clk_input_length+1, &clk_input_length-1)==STRING.CUT("&clk", 1))
    ( 
      &match=1
    )
  )
  else if (&wild_tail==1)
  (
    if (STRING.MID("gcc_skl_ahb_clk", 0, &clk_input_length-1)==STRING.CUT("&clk", -1))
    ( 
      &match=1
    )
  )
  else if ("gcc_skl_ahb_clk"=="&clk")
  (
    &match=1
  )
  
  if (&match==1)
  (
    &clk_test=&CLK_TEST_GCC_SKL_AHB_CLK
    &clk_reg=&HWIO_GCC_SKL_AHB_CBCR_ADDR
    &clk_reg_name="GCC_SKL_AHB_CBCR"
    &clk_name="gcc_skl_ahb_clk"
    &clk_reg_cbcr_type="sm_cbc"
    &clk_vote_bit=-1.
    &clk_multiplier=1.

    gosub Print_Clk_Info_Line
  )

  &match=0
  &wild_head=0
  &wild_tail=0
  &clk_input_length=STRING.LENGTH("&clk")
  &clk_itr_length=STRING.LENGTH("gcc_spdm_debug_cy_clk")

  if (STRING.SCAN("&clk", "*", 0)==0)
  (
    &wild_head=1
  )
  if (STRING.SCAN("&clk", "*", 1)==(STRING.LENGTH("&clk")-1))
  (
    &wild_tail=1
  )

  if ((&wild_head==1)&&(&wild_tail==1))
  (
    if (STRING.SCAN("gcc_spdm_debug_cy_clk", STRING.MID("&clk", 1, &clk_input_length-2), 0)!=-1)
    ( 
      &match=1
    )
  )
  else if (&wild_head==1)
  (
    if (STRING.MID("gcc_spdm_debug_cy_clk", &clk_itr_length-&clk_input_length+1, &clk_input_length-1)==STRING.CUT("&clk", 1))
    ( 
      &match=1
    )
  )
  else if (&wild_tail==1)
  (
    if (STRING.MID("gcc_spdm_debug_cy_clk", 0, &clk_input_length-1)==STRING.CUT("&clk", -1))
    ( 
      &match=1
    )
  )
  else if ("gcc_spdm_debug_cy_clk"=="&clk")
  (
    &match=1
  )
  
  if (&match==1)
  (
    &clk_test=0
    &clk_reg=&HWIO_GCC_SPDM_DEBUG_CY_CBCR_ADDR
    &clk_reg_name="GCC_SPDM_DEBUG_CY_CBCR"
    &clk_name="gcc_spdm_debug_cy_clk"
    &clk_reg_cbcr_type="sm_cbc"
    &clk_vote_bit=-1.
    &clk_multiplier=1.

    gosub Print_Clk_Info_Line
  )

  &match=0
  &wild_head=0
  &wild_tail=0
  &clk_input_length=STRING.LENGTH("&clk")
  &clk_itr_length=STRING.LENGTH("gcc_bimc_sleep_clk")

  if (STRING.SCAN("&clk", "*", 0)==0)
  (
    &wild_head=1
  )
  if (STRING.SCAN("&clk", "*", 1)==(STRING.LENGTH("&clk")-1))
  (
    &wild_tail=1
  )

  if ((&wild_head==1)&&(&wild_tail==1))
  (
    if (STRING.SCAN("gcc_bimc_sleep_clk", STRING.MID("&clk", 1, &clk_input_length-2), 0)!=-1)
    ( 
      &match=1
    )
  )
  else if (&wild_head==1)
  (
    if (STRING.MID("gcc_bimc_sleep_clk", &clk_itr_length-&clk_input_length+1, &clk_input_length-1)==STRING.CUT("&clk", 1))
    ( 
      &match=1
    )
  )
  else if (&wild_tail==1)
  (
    if (STRING.MID("gcc_bimc_sleep_clk", 0, &clk_input_length-1)==STRING.CUT("&clk", -1))
    ( 
      &match=1
    )
  )
  else if ("gcc_bimc_sleep_clk"=="&clk")
  (
    &match=1
  )
  
  if (&match==1)
  (
    &clk_test=&CLK_TEST_GCC_BIMC_SLEEP_CLK
    &clk_reg=&HWIO_GCC_BIMC_SLEEP_CBCR_ADDR
    &clk_reg_name="GCC_BIMC_SLEEP_CBCR"
    &clk_name="gcc_bimc_sleep_clk"
    &clk_reg_cbcr_type="sm_cbc"
    &clk_vote_bit=-1.
    &clk_multiplier=1.

    gosub Print_Clk_Info_Line
  )

  &match=0
  &wild_head=0
  &wild_tail=0
  &clk_input_length=STRING.LENGTH("&clk")
  &clk_itr_length=STRING.LENGTH("gcc_blsp1_sleep_clk")

  if (STRING.SCAN("&clk", "*", 0)==0)
  (
    &wild_head=1
  )
  if (STRING.SCAN("&clk", "*", 1)==(STRING.LENGTH("&clk")-1))
  (
    &wild_tail=1
  )

  if ((&wild_head==1)&&(&wild_tail==1))
  (
    if (STRING.SCAN("gcc_blsp1_sleep_clk", STRING.MID("&clk", 1, &clk_input_length-2), 0)!=-1)
    ( 
      &match=1
    )
  )
  else if (&wild_head==1)
  (
    if (STRING.MID("gcc_blsp1_sleep_clk", &clk_itr_length-&clk_input_length+1, &clk_input_length-1)==STRING.CUT("&clk", 1))
    ( 
      &match=1
    )
  )
  else if (&wild_tail==1)
  (
    if (STRING.MID("gcc_blsp1_sleep_clk", 0, &clk_input_length-1)==STRING.CUT("&clk", -1))
    ( 
      &match=1
    )
  )
  else if ("gcc_blsp1_sleep_clk"=="&clk")
  (
    &match=1
  )
  
  if (&match==1)
  (
    &clk_test=&CLK_TEST_GCC_BLSP1_SLEEP_CLK
    &clk_reg=&HWIO_GCC_BLSP1_SLEEP_CBCR_ADDR
    &clk_reg_name="GCC_BLSP1_SLEEP_CBCR"
    &clk_name="gcc_blsp1_sleep_clk"
    &clk_reg_cbcr_type="sm_cbc"
    &clk_vote_bit=16.
    &clk_multiplier=1.

    gosub Print_Clk_Info_Line
  )

  &match=0
  &wild_head=0
  &wild_tail=0
  &clk_input_length=STRING.LENGTH("&clk")
  &clk_itr_length=STRING.LENGTH("gcc_blsp2_sleep_clk")

  if (STRING.SCAN("&clk", "*", 0)==0)
  (
    &wild_head=1
  )
  if (STRING.SCAN("&clk", "*", 1)==(STRING.LENGTH("&clk")-1))
  (
    &wild_tail=1
  )

  if ((&wild_head==1)&&(&wild_tail==1))
  (
    if (STRING.SCAN("gcc_blsp2_sleep_clk", STRING.MID("&clk", 1, &clk_input_length-2), 0)!=-1)
    ( 
      &match=1
    )
  )
  else if (&wild_head==1)
  (
    if (STRING.MID("gcc_blsp2_sleep_clk", &clk_itr_length-&clk_input_length+1, &clk_input_length-1)==STRING.CUT("&clk", 1))
    ( 
      &match=1
    )
  )
  else if (&wild_tail==1)
  (
    if (STRING.MID("gcc_blsp2_sleep_clk", 0, &clk_input_length-1)==STRING.CUT("&clk", -1))
    ( 
      &match=1
    )
  )
  else if ("gcc_blsp2_sleep_clk"=="&clk")
  (
    &match=1
  )
  
  if (&match==1)
  (
    &clk_test=&CLK_TEST_GCC_BLSP2_SLEEP_CLK
    &clk_reg=&HWIO_GCC_BLSP2_SLEEP_CBCR_ADDR
    &clk_reg_name="GCC_BLSP2_SLEEP_CBCR"
    &clk_name="gcc_blsp2_sleep_clk"
    &clk_reg_cbcr_type="sm_cbc"
    &clk_vote_bit=14.
    &clk_multiplier=1.

    gosub Print_Clk_Info_Line
  )

  &match=0
  &wild_head=0
  &wild_tail=0
  &clk_input_length=STRING.LENGTH("&clk")
  &clk_itr_length=STRING.LENGTH("gcc_ddr_dim_sleep_clk")

  if (STRING.SCAN("&clk", "*", 0)==0)
  (
    &wild_head=1
  )
  if (STRING.SCAN("&clk", "*", 1)==(STRING.LENGTH("&clk")-1))
  (
    &wild_tail=1
  )

  if ((&wild_head==1)&&(&wild_tail==1))
  (
    if (STRING.SCAN("gcc_ddr_dim_sleep_clk", STRING.MID("&clk", 1, &clk_input_length-2), 0)!=-1)
    ( 
      &match=1
    )
  )
  else if (&wild_head==1)
  (
    if (STRING.MID("gcc_ddr_dim_sleep_clk", &clk_itr_length-&clk_input_length+1, &clk_input_length-1)==STRING.CUT("&clk", 1))
    ( 
      &match=1
    )
  )
  else if (&wild_tail==1)
  (
    if (STRING.MID("gcc_ddr_dim_sleep_clk", 0, &clk_input_length-1)==STRING.CUT("&clk", -1))
    ( 
      &match=1
    )
  )
  else if ("gcc_ddr_dim_sleep_clk"=="&clk")
  (
    &match=1
  )
  
  if (&match==1)
  (
    &clk_test=&CLK_TEST_GCC_DDR_DIM_SLEEP_CLK
    &clk_reg=&HWIO_GCC_DDR_DIM_SLEEP_CBCR_ADDR
    &clk_reg_name="GCC_DDR_DIM_SLEEP_CBCR"
    &clk_name="gcc_ddr_dim_sleep_clk"
    &clk_reg_cbcr_type="sm_cbc"
    &clk_vote_bit=-1.
    &clk_multiplier=1.

    gosub Print_Clk_Info_Line
  )

  &match=0
  &wild_head=0
  &wild_tail=0
  &clk_input_length=STRING.LENGTH("&clk")
  &clk_itr_length=STRING.LENGTH("gcc_im_sleep_clk")

  if (STRING.SCAN("&clk", "*", 0)==0)
  (
    &wild_head=1
  )
  if (STRING.SCAN("&clk", "*", 1)==(STRING.LENGTH("&clk")-1))
  (
    &wild_tail=1
  )

  if ((&wild_head==1)&&(&wild_tail==1))
  (
    if (STRING.SCAN("gcc_im_sleep_clk", STRING.MID("&clk", 1, &clk_input_length-2), 0)!=-1)
    ( 
      &match=1
    )
  )
  else if (&wild_head==1)
  (
    if (STRING.MID("gcc_im_sleep_clk", &clk_itr_length-&clk_input_length+1, &clk_input_length-1)==STRING.CUT("&clk", 1))
    ( 
      &match=1
    )
  )
  else if (&wild_tail==1)
  (
    if (STRING.MID("gcc_im_sleep_clk", 0, &clk_input_length-1)==STRING.CUT("&clk", -1))
    ( 
      &match=1
    )
  )
  else if ("gcc_im_sleep_clk"=="&clk")
  (
    &match=1
  )
  
  if (&match==1)
  (
    &clk_test=&CLK_TEST_GCC_IM_SLEEP_CLK
    &clk_reg=&HWIO_GCC_GCC_IM_SLEEP_CBCR_ADDR
    &clk_reg_name="GCC_GCC_IM_SLEEP_CBCR"
    &clk_name="gcc_im_sleep_clk"
    &clk_reg_cbcr_type="sm_cbc"
    &clk_vote_bit=-1.
    &clk_multiplier=1.

    gosub Print_Clk_Info_Line
  )

  &match=0
  &wild_head=0
  &wild_tail=0
  &clk_input_length=STRING.LENGTH("&clk")
  &clk_itr_length=STRING.LENGTH("gcc_rpm_sleep_clk")

  if (STRING.SCAN("&clk", "*", 0)==0)
  (
    &wild_head=1
  )
  if (STRING.SCAN("&clk", "*", 1)==(STRING.LENGTH("&clk")-1))
  (
    &wild_tail=1
  )

  if ((&wild_head==1)&&(&wild_tail==1))
  (
    if (STRING.SCAN("gcc_rpm_sleep_clk", STRING.MID("&clk", 1, &clk_input_length-2), 0)!=-1)
    ( 
      &match=1
    )
  )
  else if (&wild_head==1)
  (
    if (STRING.MID("gcc_rpm_sleep_clk", &clk_itr_length-&clk_input_length+1, &clk_input_length-1)==STRING.CUT("&clk", 1))
    ( 
      &match=1
    )
  )
  else if (&wild_tail==1)
  (
    if (STRING.MID("gcc_rpm_sleep_clk", 0, &clk_input_length-1)==STRING.CUT("&clk", -1))
    ( 
      &match=1
    )
  )
  else if ("gcc_rpm_sleep_clk"=="&clk")
  (
    &match=1
  )
  
  if (&match==1)
  (
    &clk_test=&CLK_TEST_GCC_RPM_SLEEP_CLK
    &clk_reg=&HWIO_GCC_RPM_SLEEP_CBCR_ADDR
    &clk_reg_name="GCC_RPM_SLEEP_CBCR"
    &clk_name="gcc_rpm_sleep_clk"
    &clk_reg_cbcr_type="sm_cbc"
    &clk_vote_bit=-1.
    &clk_multiplier=1.

    gosub Print_Clk_Info_Line
  )

  &match=0
  &wild_head=0
  &wild_tail=0
  &clk_input_length=STRING.LENGTH("&clk")
  &clk_itr_length=STRING.LENGTH("gcc_tsif_inactivity_timers_clk")

  if (STRING.SCAN("&clk", "*", 0)==0)
  (
    &wild_head=1
  )
  if (STRING.SCAN("&clk", "*", 1)==(STRING.LENGTH("&clk")-1))
  (
    &wild_tail=1
  )

  if ((&wild_head==1)&&(&wild_tail==1))
  (
    if (STRING.SCAN("gcc_tsif_inactivity_timers_clk", STRING.MID("&clk", 1, &clk_input_length-2), 0)!=-1)
    ( 
      &match=1
    )
  )
  else if (&wild_head==1)
  (
    if (STRING.MID("gcc_tsif_inactivity_timers_clk", &clk_itr_length-&clk_input_length+1, &clk_input_length-1)==STRING.CUT("&clk", 1))
    ( 
      &match=1
    )
  )
  else if (&wild_tail==1)
  (
    if (STRING.MID("gcc_tsif_inactivity_timers_clk", 0, &clk_input_length-1)==STRING.CUT("&clk", -1))
    ( 
      &match=1
    )
  )
  else if ("gcc_tsif_inactivity_timers_clk"=="&clk")
  (
    &match=1
  )
  
  if (&match==1)
  (
    &clk_test=&CLK_TEST_GCC_TSIF_INACTIVITY_TIMERS_CLK
    &clk_reg=&HWIO_GCC_TSIF_INACTIVITY_TIMERS_CBCR_ADDR
    &clk_reg_name="GCC_TSIF_INACTIVITY_TIMERS_CBCR"
    &clk_name="gcc_tsif_inactivity_timers_clk"
    &clk_reg_cbcr_type="sm_cbc"
    &clk_vote_bit=-1.
    &clk_multiplier=1.

    gosub Print_Clk_Info_Line
  )

  &match=0
  &wild_head=0
  &wild_tail=0
  &clk_input_length=STRING.LENGTH("&clk")
  &clk_itr_length=STRING.LENGTH("gcc_usb20_sleep_clk")

  if (STRING.SCAN("&clk", "*", 0)==0)
  (
    &wild_head=1
  )
  if (STRING.SCAN("&clk", "*", 1)==(STRING.LENGTH("&clk")-1))
  (
    &wild_tail=1
  )

  if ((&wild_head==1)&&(&wild_tail==1))
  (
    if (STRING.SCAN("gcc_usb20_sleep_clk", STRING.MID("&clk", 1, &clk_input_length-2), 0)!=-1)
    ( 
      &match=1
    )
  )
  else if (&wild_head==1)
  (
    if (STRING.MID("gcc_usb20_sleep_clk", &clk_itr_length-&clk_input_length+1, &clk_input_length-1)==STRING.CUT("&clk", 1))
    ( 
      &match=1
    )
  )
  else if (&wild_tail==1)
  (
    if (STRING.MID("gcc_usb20_sleep_clk", 0, &clk_input_length-1)==STRING.CUT("&clk", -1))
    ( 
      &match=1
    )
  )
  else if ("gcc_usb20_sleep_clk"=="&clk")
  (
    &match=1
  )
  
  if (&match==1)
  (
    &clk_test=&CLK_TEST_GCC_USB20_SLEEP_CLK
    &clk_reg=&HWIO_GCC_USB20_SLEEP_CBCR_ADDR
    &clk_reg_name="GCC_USB20_SLEEP_CBCR"
    &clk_name="gcc_usb20_sleep_clk"
    &clk_reg_cbcr_type="sm_cbc"
    &clk_vote_bit=-1.
    &clk_multiplier=1.

    gosub Print_Clk_Info_Line
  )

  &match=0
  &wild_head=0
  &wild_tail=0
  &clk_input_length=STRING.LENGTH("&clk")
  &clk_itr_length=STRING.LENGTH("gcc_usb30_sleep_clk")

  if (STRING.SCAN("&clk", "*", 0)==0)
  (
    &wild_head=1
  )
  if (STRING.SCAN("&clk", "*", 1)==(STRING.LENGTH("&clk")-1))
  (
    &wild_tail=1
  )

  if ((&wild_head==1)&&(&wild_tail==1))
  (
    if (STRING.SCAN("gcc_usb30_sleep_clk", STRING.MID("&clk", 1, &clk_input_length-2), 0)!=-1)
    ( 
      &match=1
    )
  )
  else if (&wild_head==1)
  (
    if (STRING.MID("gcc_usb30_sleep_clk", &clk_itr_length-&clk_input_length+1, &clk_input_length-1)==STRING.CUT("&clk", 1))
    ( 
      &match=1
    )
  )
  else if (&wild_tail==1)
  (
    if (STRING.MID("gcc_usb30_sleep_clk", 0, &clk_input_length-1)==STRING.CUT("&clk", -1))
    ( 
      &match=1
    )
  )
  else if ("gcc_usb30_sleep_clk"=="&clk")
  (
    &match=1
  )
  
  if (&match==1)
  (
    &clk_test=&CLK_TEST_GCC_USB30_SLEEP_CLK
    &clk_reg=&HWIO_GCC_USB30_SLEEP_CBCR_ADDR
    &clk_reg_name="GCC_USB30_SLEEP_CBCR"
    &clk_name="gcc_usb30_sleep_clk"
    &clk_reg_cbcr_type="sm_cbc"
    &clk_vote_bit=-1.
    &clk_multiplier=1.

    gosub Print_Clk_Info_Line
  )

  &match=0
  &wild_head=0
  &wild_tail=0
  &clk_input_length=STRING.LENGTH("&clk")
  &clk_itr_length=STRING.LENGTH("gcc_ipa_sleep_clk")

  if (STRING.SCAN("&clk", "*", 0)==0)
  (
    &wild_head=1
  )
  if (STRING.SCAN("&clk", "*", 1)==(STRING.LENGTH("&clk")-1))
  (
    &wild_tail=1
  )

  if ((&wild_head==1)&&(&wild_tail==1))
  (
    if (STRING.SCAN("gcc_ipa_sleep_clk", STRING.MID("&clk", 1, &clk_input_length-2), 0)!=-1)
    ( 
      &match=1
    )
  )
  else if (&wild_head==1)
  (
    if (STRING.MID("gcc_ipa_sleep_clk", &clk_itr_length-&clk_input_length+1, &clk_input_length-1)==STRING.CUT("&clk", 1))
    ( 
      &match=1
    )
  )
  else if (&wild_tail==1)
  (
    if (STRING.MID("gcc_ipa_sleep_clk", 0, &clk_input_length-1)==STRING.CUT("&clk", -1))
    ( 
      &match=1
    )
  )
  else if ("gcc_ipa_sleep_clk"=="&clk")
  (
    &match=1
  )
  
  if (&match==1)
  (
    &clk_test=&CLK_TEST_GCC_IPA_SLEEP_CLK
    &clk_reg=&HWIO_GCC_IPA_SLEEP_CBCR_ADDR
    &clk_reg_name="GCC_IPA_SLEEP_CBCR"
    &clk_name="gcc_ipa_sleep_clk"
    &clk_reg_cbcr_type="sm_cbc"
    &clk_vote_bit=-1.
    &clk_multiplier=1.

    gosub Print_Clk_Info_Line
  )

  &match=0
  &wild_head=0
  &wild_tail=0
  &clk_input_length=STRING.LENGTH("&clk")
  &clk_itr_length=STRING.LENGTH("gcc_dcd_xo_clk")

  if (STRING.SCAN("&clk", "*", 0)==0)
  (
    &wild_head=1
  )
  if (STRING.SCAN("&clk", "*", 1)==(STRING.LENGTH("&clk")-1))
  (
    &wild_tail=1
  )

  if ((&wild_head==1)&&(&wild_tail==1))
  (
    if (STRING.SCAN("gcc_dcd_xo_clk", STRING.MID("&clk", 1, &clk_input_length-2), 0)!=-1)
    ( 
      &match=1
    )
  )
  else if (&wild_head==1)
  (
    if (STRING.MID("gcc_dcd_xo_clk", &clk_itr_length-&clk_input_length+1, &clk_input_length-1)==STRING.CUT("&clk", 1))
    ( 
      &match=1
    )
  )
  else if (&wild_tail==1)
  (
    if (STRING.MID("gcc_dcd_xo_clk", 0, &clk_input_length-1)==STRING.CUT("&clk", -1))
    ( 
      &match=1
    )
  )
  else if ("gcc_dcd_xo_clk"=="&clk")
  (
    &match=1
  )
  
  if (&match==1)
  (
    &clk_test=&CLK_TEST_GCC_DCD_XO_CLK
    &clk_reg=&HWIO_GCC_DCD_XO_CBCR_ADDR
    &clk_reg_name="GCC_DCD_XO_CBCR"
    &clk_name="gcc_dcd_xo_clk"
    &clk_reg_cbcr_type="sm_cbc"
    &clk_vote_bit=-1.
    &clk_multiplier=1.

    gosub Print_Clk_Info_Line
  )

  &match=0
  &wild_head=0
  &wild_tail=0
  &clk_input_length=STRING.LENGTH("&clk")
  &clk_itr_length=STRING.LENGTH("gcc_pdm_xo4_clk")

  if (STRING.SCAN("&clk", "*", 0)==0)
  (
    &wild_head=1
  )
  if (STRING.SCAN("&clk", "*", 1)==(STRING.LENGTH("&clk")-1))
  (
    &wild_tail=1
  )

  if ((&wild_head==1)&&(&wild_tail==1))
  (
    if (STRING.SCAN("gcc_pdm_xo4_clk", STRING.MID("&clk", 1, &clk_input_length-2), 0)!=-1)
    ( 
      &match=1
    )
  )
  else if (&wild_head==1)
  (
    if (STRING.MID("gcc_pdm_xo4_clk", &clk_itr_length-&clk_input_length+1, &clk_input_length-1)==STRING.CUT("&clk", 1))
    ( 
      &match=1
    )
  )
  else if (&wild_tail==1)
  (
    if (STRING.MID("gcc_pdm_xo4_clk", 0, &clk_input_length-1)==STRING.CUT("&clk", -1))
    ( 
      &match=1
    )
  )
  else if ("gcc_pdm_xo4_clk"=="&clk")
  (
    &match=1
  )
  
  if (&match==1)
  (
    &clk_test=&CLK_TEST_GCC_PDM_XO4_CLK
    &clk_reg=&HWIO_GCC_PDM_XO4_CBCR_ADDR
    &clk_reg_name="GCC_PDM_XO4_CBCR"
    &clk_name="gcc_pdm_xo4_clk"
    &clk_reg_cbcr_type="sm_cbc"
    &clk_vote_bit=-1.
    &clk_multiplier=1.

    gosub Print_Clk_Info_Line
  )

  &match=0
  &wild_head=0
  &wild_tail=0
  &clk_input_length=STRING.LENGTH("&clk")
  &clk_itr_length=STRING.LENGTH("gcc_rpm_timer_clk")

  if (STRING.SCAN("&clk", "*", 0)==0)
  (
    &wild_head=1
  )
  if (STRING.SCAN("&clk", "*", 1)==(STRING.LENGTH("&clk")-1))
  (
    &wild_tail=1
  )

  if ((&wild_head==1)&&(&wild_tail==1))
  (
    if (STRING.SCAN("gcc_rpm_timer_clk", STRING.MID("&clk", 1, &clk_input_length-2), 0)!=-1)
    ( 
      &match=1
    )
  )
  else if (&wild_head==1)
  (
    if (STRING.MID("gcc_rpm_timer_clk", &clk_itr_length-&clk_input_length+1, &clk_input_length-1)==STRING.CUT("&clk", 1))
    ( 
      &match=1
    )
  )
  else if (&wild_tail==1)
  (
    if (STRING.MID("gcc_rpm_timer_clk", 0, &clk_input_length-1)==STRING.CUT("&clk", -1))
    ( 
      &match=1
    )
  )
  else if ("gcc_rpm_timer_clk"=="&clk")
  (
    &match=1
  )
  
  if (&match==1)
  (
    &clk_test=&CLK_TEST_GCC_RPM_TIMER_CLK
    &clk_reg=&HWIO_GCC_RPM_TIMER_CBCR_ADDR
    &clk_reg_name="GCC_RPM_TIMER_CBCR"
    &clk_name="gcc_rpm_timer_clk"
    &clk_reg_cbcr_type="sm_cbc"
    &clk_vote_bit=-1.
    &clk_multiplier=1.

    gosub Print_Clk_Info_Line
  )

  &match=0
  &wild_head=0
  &wild_tail=0
  &clk_input_length=STRING.LENGTH("&clk")
  &clk_itr_length=STRING.LENGTH("gcc_spdm_ff_clk")

  if (STRING.SCAN("&clk", "*", 0)==0)
  (
    &wild_head=1
  )
  if (STRING.SCAN("&clk", "*", 1)==(STRING.LENGTH("&clk")-1))
  (
    &wild_tail=1
  )

  if ((&wild_head==1)&&(&wild_tail==1))
  (
    if (STRING.SCAN("gcc_spdm_ff_clk", STRING.MID("&clk", 1, &clk_input_length-2), 0)!=-1)
    ( 
      &match=1
    )
  )
  else if (&wild_head==1)
  (
    if (STRING.MID("gcc_spdm_ff_clk", &clk_itr_length-&clk_input_length+1, &clk_input_length-1)==STRING.CUT("&clk", 1))
    ( 
      &match=1
    )
  )
  else if (&wild_tail==1)
  (
    if (STRING.MID("gcc_spdm_ff_clk", 0, &clk_input_length-1)==STRING.CUT("&clk", -1))
    ( 
      &match=1
    )
  )
  else if ("gcc_spdm_ff_clk"=="&clk")
  (
    &match=1
  )
  
  if (&match==1)
  (
    &clk_test=&CLK_TEST_GCC_SPDM_FF_CLK
    &clk_reg=&HWIO_GCC_SPDM_FF_CBCR_ADDR
    &clk_reg_name="GCC_SPDM_FF_CBCR"
    &clk_name="gcc_spdm_ff_clk"
    &clk_reg_cbcr_type="sm_cbc"
    &clk_vote_bit=-1.
    &clk_multiplier=1.

    gosub Print_Clk_Info_Line
  )

  &match=0
  &wild_head=0
  &wild_tail=0
  &clk_input_length=STRING.LENGTH("&clk")
  &clk_itr_length=STRING.LENGTH("gcc_ssc_xo_clk")

  if (STRING.SCAN("&clk", "*", 0)==0)
  (
    &wild_head=1
  )
  if (STRING.SCAN("&clk", "*", 1)==(STRING.LENGTH("&clk")-1))
  (
    &wild_tail=1
  )

  if ((&wild_head==1)&&(&wild_tail==1))
  (
    if (STRING.SCAN("gcc_ssc_xo_clk", STRING.MID("&clk", 1, &clk_input_length-2), 0)!=-1)
    ( 
      &match=1
    )
  )
  else if (&wild_head==1)
  (
    if (STRING.MID("gcc_ssc_xo_clk", &clk_itr_length-&clk_input_length+1, &clk_input_length-1)==STRING.CUT("&clk", 1))
    ( 
      &match=1
    )
  )
  else if (&wild_tail==1)
  (
    if (STRING.MID("gcc_ssc_xo_clk", 0, &clk_input_length-1)==STRING.CUT("&clk", -1))
    ( 
      &match=1
    )
  )
  else if ("gcc_ssc_xo_clk"=="&clk")
  (
    &match=1
  )
  
  if (&match==1)
  (
    &clk_test=&CLK_TEST_GCC_SSC_XO_CLK
    &clk_reg=&HWIO_GCC_SSC_XO_CBCR_ADDR
    &clk_reg_name="GCC_SSC_XO_CBCR"
    &clk_name="gcc_ssc_xo_clk"
    &clk_reg_cbcr_type="sm_cbc"
    &clk_vote_bit=-1.
    &clk_multiplier=1.

    gosub Print_Clk_Info_Line
  )

  &match=0
  &wild_head=0
  &wild_tail=0
  &clk_input_length=STRING.LENGTH("&clk")
  &clk_itr_length=STRING.LENGTH("gcc_xo_clk")

  if (STRING.SCAN("&clk", "*", 0)==0)
  (
    &wild_head=1
  )
  if (STRING.SCAN("&clk", "*", 1)==(STRING.LENGTH("&clk")-1))
  (
    &wild_tail=1
  )

  if ((&wild_head==1)&&(&wild_tail==1))
  (
    if (STRING.SCAN("gcc_xo_clk", STRING.MID("&clk", 1, &clk_input_length-2), 0)!=-1)
    ( 
      &match=1
    )
  )
  else if (&wild_head==1)
  (
    if (STRING.MID("gcc_xo_clk", &clk_itr_length-&clk_input_length+1, &clk_input_length-1)==STRING.CUT("&clk", 1))
    ( 
      &match=1
    )
  )
  else if (&wild_tail==1)
  (
    if (STRING.MID("gcc_xo_clk", 0, &clk_input_length-1)==STRING.CUT("&clk", -1))
    ( 
      &match=1
    )
  )
  else if ("gcc_xo_clk"=="&clk")
  (
    &match=1
  )
  
  if (&match==1)
  (
    &clk_test=&CLK_TEST_GCC_XO_CLK
    &clk_reg=&HWIO_GCC_GCC_XO_CBCR_ADDR
    &clk_reg_name="GCC_GCC_XO_CBCR"
    &clk_name="gcc_xo_clk"
    &clk_reg_cbcr_type="sm_cbc"
    &clk_vote_bit=-1.
    &clk_multiplier=1.

    gosub Print_Clk_Info_Line
  )

  &match=0
  &wild_head=0
  &wild_tail=0
  &clk_input_length=STRING.LENGTH("&clk")
  &clk_itr_length=STRING.LENGTH("gcc_xo_div4_clk")

  if (STRING.SCAN("&clk", "*", 0)==0)
  (
    &wild_head=1
  )
  if (STRING.SCAN("&clk", "*", 1)==(STRING.LENGTH("&clk")-1))
  (
    &wild_tail=1
  )

  if ((&wild_head==1)&&(&wild_tail==1))
  (
    if (STRING.SCAN("gcc_xo_div4_clk", STRING.MID("&clk", 1, &clk_input_length-2), 0)!=-1)
    ( 
      &match=1
    )
  )
  else if (&wild_head==1)
  (
    if (STRING.MID("gcc_xo_div4_clk", &clk_itr_length-&clk_input_length+1, &clk_input_length-1)==STRING.CUT("&clk", 1))
    ( 
      &match=1
    )
  )
  else if (&wild_tail==1)
  (
    if (STRING.MID("gcc_xo_div4_clk", 0, &clk_input_length-1)==STRING.CUT("&clk", -1))
    ( 
      &match=1
    )
  )
  else if ("gcc_xo_div4_clk"=="&clk")
  (
    &match=1
  )
  
  if (&match==1)
  (
    &clk_test=&CLK_TEST_GCC_XO_DIV4_CLK
    &clk_reg=&HWIO_GCC_GCC_XO_DIV4_CBCR_ADDR
    &clk_reg_name="GCC_GCC_XO_DIV4_CBCR"
    &clk_name="gcc_xo_div4_clk"
    &clk_reg_cbcr_type="sm_cbc"
    &clk_vote_bit=-1.
    &clk_multiplier=1.

    gosub Print_Clk_Info_Line
  )

  &match=0
  &wild_head=0
  &wild_tail=0
  &clk_input_length=STRING.LENGTH("&clk")
  &clk_itr_length=STRING.LENGTH("gcc_qrefs_vbg_cal_clk")

  if (STRING.SCAN("&clk", "*", 0)==0)
  (
    &wild_head=1
  )
  if (STRING.SCAN("&clk", "*", 1)==(STRING.LENGTH("&clk")-1))
  (
    &wild_tail=1
  )

  if ((&wild_head==1)&&(&wild_tail==1))
  (
    if (STRING.SCAN("gcc_qrefs_vbg_cal_clk", STRING.MID("&clk", 1, &clk_input_length-2), 0)!=-1)
    ( 
      &match=1
    )
  )
  else if (&wild_head==1)
  (
    if (STRING.MID("gcc_qrefs_vbg_cal_clk", &clk_itr_length-&clk_input_length+1, &clk_input_length-1)==STRING.CUT("&clk", 1))
    ( 
      &match=1
    )
  )
  else if (&wild_tail==1)
  (
    if (STRING.MID("gcc_qrefs_vbg_cal_clk", 0, &clk_input_length-1)==STRING.CUT("&clk", -1))
    ( 
      &match=1
    )
  )
  else if ("gcc_qrefs_vbg_cal_clk"=="&clk")
  (
    &match=1
  )
  
  if (&match==1)
  (
    &clk_test=&CLK_TEST_GCC_QREFS_VBG_CAL_CLK
    &clk_reg=&HWIO_GCC_QREFS_VBG_CAL_CBCR_ADDR
    &clk_reg_name="GCC_QREFS_VBG_CAL_CBCR"
    &clk_name="gcc_qrefs_vbg_cal_clk"
    &clk_reg_cbcr_type="sm_cbc"
    &clk_vote_bit=-1.
    &clk_multiplier=1.

    gosub Print_Clk_Info_Line
  )

  &match=0
  &wild_head=0
  &wild_tail=0
  &clk_input_length=STRING.LENGTH("&clk")
  &clk_itr_length=STRING.LENGTH("gcc_gp1_clk")

  if (STRING.SCAN("&clk", "*", 0)==0)
  (
    &wild_head=1
  )
  if (STRING.SCAN("&clk", "*", 1)==(STRING.LENGTH("&clk")-1))
  (
    &wild_tail=1
  )

  if ((&wild_head==1)&&(&wild_tail==1))
  (
    if (STRING.SCAN("gcc_gp1_clk", STRING.MID("&clk", 1, &clk_input_length-2), 0)!=-1)
    ( 
      &match=1
    )
  )
  else if (&wild_head==1)
  (
    if (STRING.MID("gcc_gp1_clk", &clk_itr_length-&clk_input_length+1, &clk_input_length-1)==STRING.CUT("&clk", 1))
    ( 
      &match=1
    )
  )
  else if (&wild_tail==1)
  (
    if (STRING.MID("gcc_gp1_clk", 0, &clk_input_length-1)==STRING.CUT("&clk", -1))
    ( 
      &match=1
    )
  )
  else if ("gcc_gp1_clk"=="&clk")
  (
    &match=1
  )
  
  if (&match==1)
  (
    &clk_test=&CLK_TEST_GCC_GP1_CLK
    &clk_reg=&HWIO_GCC_GP1_CBCR_ADDR
    &clk_reg_name="GCC_GP1_CBCR"
    &clk_name="gcc_gp1_clk"
    &clk_reg_cbcr_type="sm_cbc"
    &clk_vote_bit=-1.
    &clk_multiplier=1.

    gosub Print_Clk_Info_Line
  )

  &match=0
  &wild_head=0
  &wild_tail=0
  &clk_input_length=STRING.LENGTH("&clk")
  &clk_itr_length=STRING.LENGTH("gcc_gp2_clk")

  if (STRING.SCAN("&clk", "*", 0)==0)
  (
    &wild_head=1
  )
  if (STRING.SCAN("&clk", "*", 1)==(STRING.LENGTH("&clk")-1))
  (
    &wild_tail=1
  )

  if ((&wild_head==1)&&(&wild_tail==1))
  (
    if (STRING.SCAN("gcc_gp2_clk", STRING.MID("&clk", 1, &clk_input_length-2), 0)!=-1)
    ( 
      &match=1
    )
  )
  else if (&wild_head==1)
  (
    if (STRING.MID("gcc_gp2_clk", &clk_itr_length-&clk_input_length+1, &clk_input_length-1)==STRING.CUT("&clk", 1))
    ( 
      &match=1
    )
  )
  else if (&wild_tail==1)
  (
    if (STRING.MID("gcc_gp2_clk", 0, &clk_input_length-1)==STRING.CUT("&clk", -1))
    ( 
      &match=1
    )
  )
  else if ("gcc_gp2_clk"=="&clk")
  (
    &match=1
  )
  
  if (&match==1)
  (
    &clk_test=&CLK_TEST_GCC_GP2_CLK
    &clk_reg=&HWIO_GCC_GP2_CBCR_ADDR
    &clk_reg_name="GCC_GP2_CBCR"
    &clk_name="gcc_gp2_clk"
    &clk_reg_cbcr_type="sm_cbc"
    &clk_vote_bit=-1.
    &clk_multiplier=1.

    gosub Print_Clk_Info_Line
  )

  &match=0
  &wild_head=0
  &wild_tail=0
  &clk_input_length=STRING.LENGTH("&clk")
  &clk_itr_length=STRING.LENGTH("gcc_gp3_clk")

  if (STRING.SCAN("&clk", "*", 0)==0)
  (
    &wild_head=1
  )
  if (STRING.SCAN("&clk", "*", 1)==(STRING.LENGTH("&clk")-1))
  (
    &wild_tail=1
  )

  if ((&wild_head==1)&&(&wild_tail==1))
  (
    if (STRING.SCAN("gcc_gp3_clk", STRING.MID("&clk", 1, &clk_input_length-2), 0)!=-1)
    ( 
      &match=1
    )
  )
  else if (&wild_head==1)
  (
    if (STRING.MID("gcc_gp3_clk", &clk_itr_length-&clk_input_length+1, &clk_input_length-1)==STRING.CUT("&clk", 1))
    ( 
      &match=1
    )
  )
  else if (&wild_tail==1)
  (
    if (STRING.MID("gcc_gp3_clk", 0, &clk_input_length-1)==STRING.CUT("&clk", -1))
    ( 
      &match=1
    )
  )
  else if ("gcc_gp3_clk"=="&clk")
  (
    &match=1
  )
  
  if (&match==1)
  (
    &clk_test=&CLK_TEST_GCC_GP3_CLK
    &clk_reg=&HWIO_GCC_GP3_CBCR_ADDR
    &clk_reg_name="GCC_GP3_CBCR"
    &clk_name="gcc_gp3_clk"
    &clk_reg_cbcr_type="sm_cbc"
    &clk_vote_bit=-1.
    &clk_multiplier=1.

    gosub Print_Clk_Info_Line
  )

  &match=0
  &wild_head=0
  &wild_tail=0
  &clk_input_length=STRING.LENGTH("&clk")
  &clk_itr_length=STRING.LENGTH("gcc_hmss_ahb_clk")

  if (STRING.SCAN("&clk", "*", 0)==0)
  (
    &wild_head=1
  )
  if (STRING.SCAN("&clk", "*", 1)==(STRING.LENGTH("&clk")-1))
  (
    &wild_tail=1
  )

  if ((&wild_head==1)&&(&wild_tail==1))
  (
    if (STRING.SCAN("gcc_hmss_ahb_clk", STRING.MID("&clk", 1, &clk_input_length-2), 0)!=-1)
    ( 
      &match=1
    )
  )
  else if (&wild_head==1)
  (
    if (STRING.MID("gcc_hmss_ahb_clk", &clk_itr_length-&clk_input_length+1, &clk_input_length-1)==STRING.CUT("&clk", 1))
    ( 
      &match=1
    )
  )
  else if (&wild_tail==1)
  (
    if (STRING.MID("gcc_hmss_ahb_clk", 0, &clk_input_length-1)==STRING.CUT("&clk", -1))
    ( 
      &match=1
    )
  )
  else if ("gcc_hmss_ahb_clk"=="&clk")
  (
    &match=1
  )
  
  if (&match==1)
  (
    &clk_test=&CLK_TEST_GCC_HMSS_AHB_CLK
    &clk_reg=&HWIO_GCC_HMSS_AHB_CBCR_ADDR
    &clk_reg_name="GCC_HMSS_AHB_CBCR"
    &clk_name="gcc_hmss_ahb_clk"
    &clk_reg_cbcr_type="sm_cbc"
    &clk_vote_bit=21.
    &clk_multiplier=1.

    gosub Print_Clk_Info_Line
  )

  &match=0
  &wild_head=0
  &wild_tail=0
  &clk_input_length=STRING.LENGTH("&clk")
  &clk_itr_length=STRING.LENGTH("gcc_snoc_bus_timeout0_ahb_clk")

  if (STRING.SCAN("&clk", "*", 0)==0)
  (
    &wild_head=1
  )
  if (STRING.SCAN("&clk", "*", 1)==(STRING.LENGTH("&clk")-1))
  (
    &wild_tail=1
  )

  if ((&wild_head==1)&&(&wild_tail==1))
  (
    if (STRING.SCAN("gcc_snoc_bus_timeout0_ahb_clk", STRING.MID("&clk", 1, &clk_input_length-2), 0)!=-1)
    ( 
      &match=1
    )
  )
  else if (&wild_head==1)
  (
    if (STRING.MID("gcc_snoc_bus_timeout0_ahb_clk", &clk_itr_length-&clk_input_length+1, &clk_input_length-1)==STRING.CUT("&clk", 1))
    ( 
      &match=1
    )
  )
  else if (&wild_tail==1)
  (
    if (STRING.MID("gcc_snoc_bus_timeout0_ahb_clk", 0, &clk_input_length-1)==STRING.CUT("&clk", -1))
    ( 
      &match=1
    )
  )
  else if ("gcc_snoc_bus_timeout0_ahb_clk"=="&clk")
  (
    &match=1
  )
  
  if (&match==1)
  (
    &clk_test=&CLK_TEST_GCC_SNOC_BUS_TIMEOUT0_AHB_CLK
    &clk_reg=&HWIO_GCC_SNOC_BUS_TIMEOUT0_AHB_CBCR_ADDR
    &clk_reg_name="GCC_SNOC_BUS_TIMEOUT0_AHB_CBCR"
    &clk_name="gcc_snoc_bus_timeout0_ahb_clk"
    &clk_reg_cbcr_type="sm_cbc"
    &clk_vote_bit=-1.
    &clk_multiplier=1.

    gosub Print_Clk_Info_Line
  )

  &match=0
  &wild_head=0
  &wild_tail=0
  &clk_input_length=STRING.LENGTH("&clk")
  &clk_itr_length=STRING.LENGTH("gcc_sys_noc_hmss_ahb_clk")

  if (STRING.SCAN("&clk", "*", 0)==0)
  (
    &wild_head=1
  )
  if (STRING.SCAN("&clk", "*", 1)==(STRING.LENGTH("&clk")-1))
  (
    &wild_tail=1
  )

  if ((&wild_head==1)&&(&wild_tail==1))
  (
    if (STRING.SCAN("gcc_sys_noc_hmss_ahb_clk", STRING.MID("&clk", 1, &clk_input_length-2), 0)!=-1)
    ( 
      &match=1
    )
  )
  else if (&wild_head==1)
  (
    if (STRING.MID("gcc_sys_noc_hmss_ahb_clk", &clk_itr_length-&clk_input_length+1, &clk_input_length-1)==STRING.CUT("&clk", 1))
    ( 
      &match=1
    )
  )
  else if (&wild_tail==1)
  (
    if (STRING.MID("gcc_sys_noc_hmss_ahb_clk", 0, &clk_input_length-1)==STRING.CUT("&clk", -1))
    ( 
      &match=1
    )
  )
  else if ("gcc_sys_noc_hmss_ahb_clk"=="&clk")
  (
    &match=1
  )
  
  if (&match==1)
  (
    &clk_test=&CLK_TEST_GCC_SYS_NOC_HMSS_AHB_CLK
    &clk_reg=&HWIO_GCC_SYS_NOC_HMSS_AHB_CBCR_ADDR
    &clk_reg_name="GCC_SYS_NOC_HMSS_AHB_CBCR"
    &clk_name="gcc_sys_noc_hmss_ahb_clk"
    &clk_reg_cbcr_type="sm_cbc"
    &clk_vote_bit=23.
    &clk_multiplier=1.

    gosub Print_Clk_Info_Line
  )

  &match=0
  &wild_head=0
  &wild_tail=0
  &clk_input_length=STRING.LENGTH("&clk")
  &clk_itr_length=STRING.LENGTH("gcc_hmss_rbcpr_clk")

  if (STRING.SCAN("&clk", "*", 0)==0)
  (
    &wild_head=1
  )
  if (STRING.SCAN("&clk", "*", 1)==(STRING.LENGTH("&clk")-1))
  (
    &wild_tail=1
  )

  if ((&wild_head==1)&&(&wild_tail==1))
  (
    if (STRING.SCAN("gcc_hmss_rbcpr_clk", STRING.MID("&clk", 1, &clk_input_length-2), 0)!=-1)
    ( 
      &match=1
    )
  )
  else if (&wild_head==1)
  (
    if (STRING.MID("gcc_hmss_rbcpr_clk", &clk_itr_length-&clk_input_length+1, &clk_input_length-1)==STRING.CUT("&clk", 1))
    ( 
      &match=1
    )
  )
  else if (&wild_tail==1)
  (
    if (STRING.MID("gcc_hmss_rbcpr_clk", 0, &clk_input_length-1)==STRING.CUT("&clk", -1))
    ( 
      &match=1
    )
  )
  else if ("gcc_hmss_rbcpr_clk"=="&clk")
  (
    &match=1
  )
  
  if (&match==1)
  (
    &clk_test=&CLK_TEST_GCC_HMSS_RBCPR_CLK
    &clk_reg=&HWIO_GCC_HMSS_RBCPR_CBCR_ADDR
    &clk_reg_name="GCC_HMSS_RBCPR_CBCR"
    &clk_name="gcc_hmss_rbcpr_clk"
    &clk_reg_cbcr_type="sm_cbc"
    &clk_vote_bit=-1.
    &clk_multiplier=1.

    gosub Print_Clk_Info_Line
  )

  &match=0
  &wild_head=0
  &wild_tail=0
  &clk_input_length=STRING.LENGTH("&clk")
  &clk_itr_length=STRING.LENGTH("gcc_aggre2_noc_ipa_clk")

  if (STRING.SCAN("&clk", "*", 0)==0)
  (
    &wild_head=1
  )
  if (STRING.SCAN("&clk", "*", 1)==(STRING.LENGTH("&clk")-1))
  (
    &wild_tail=1
  )

  if ((&wild_head==1)&&(&wild_tail==1))
  (
    if (STRING.SCAN("gcc_aggre2_noc_ipa_clk", STRING.MID("&clk", 1, &clk_input_length-2), 0)!=-1)
    ( 
      &match=1
    )
  )
  else if (&wild_head==1)
  (
    if (STRING.MID("gcc_aggre2_noc_ipa_clk", &clk_itr_length-&clk_input_length+1, &clk_input_length-1)==STRING.CUT("&clk", 1))
    ( 
      &match=1
    )
  )
  else if (&wild_tail==1)
  (
    if (STRING.MID("gcc_aggre2_noc_ipa_clk", 0, &clk_input_length-1)==STRING.CUT("&clk", -1))
    ( 
      &match=1
    )
  )
  else if ("gcc_aggre2_noc_ipa_clk"=="&clk")
  (
    &match=1
  )
  
  if (&match==1)
  (
    &clk_test=&CLK_TEST_GCC_AGGRE2_NOC_IPA_CLK
    &clk_reg=&HWIO_GCC_AGGRE2_NOC_IPA_CBCR_ADDR
    &clk_reg_name="GCC_AGGRE2_NOC_IPA_CBCR"
    &clk_name="gcc_aggre2_noc_ipa_clk"
    &clk_reg_cbcr_type="sm_cbc"
    &clk_vote_bit=-1.
    &clk_multiplier=1.

    gosub Print_Clk_Info_Line
  )

  &match=0
  &wild_head=0
  &wild_tail=0
  &clk_input_length=STRING.LENGTH("&clk")
  &clk_itr_length=STRING.LENGTH("gcc_ipa_clk")

  if (STRING.SCAN("&clk", "*", 0)==0)
  (
    &wild_head=1
  )
  if (STRING.SCAN("&clk", "*", 1)==(STRING.LENGTH("&clk")-1))
  (
    &wild_tail=1
  )

  if ((&wild_head==1)&&(&wild_tail==1))
  (
    if (STRING.SCAN("gcc_ipa_clk", STRING.MID("&clk", 1, &clk_input_length-2), 0)!=-1)
    ( 
      &match=1
    )
  )
  else if (&wild_head==1)
  (
    if (STRING.MID("gcc_ipa_clk", &clk_itr_length-&clk_input_length+1, &clk_input_length-1)==STRING.CUT("&clk", 1))
    ( 
      &match=1
    )
  )
  else if (&wild_tail==1)
  (
    if (STRING.MID("gcc_ipa_clk", 0, &clk_input_length-1)==STRING.CUT("&clk", -1))
    ( 
      &match=1
    )
  )
  else if ("gcc_ipa_clk"=="&clk")
  (
    &match=1
  )
  
  if (&match==1)
  (
    &clk_test=&CLK_TEST_GCC_IPA_CLK
    &clk_reg=&HWIO_GCC_IPA_CBCR_ADDR
    &clk_reg_name="GCC_IPA_CBCR"
    &clk_name="gcc_ipa_clk"
    &clk_reg_cbcr_type="sm_pscbc"
    &clk_vote_bit=-1.
    &clk_multiplier=1.

    gosub Print_Clk_Info_Line
  )

  &match=0
  &wild_head=0
  &wild_tail=0
  &clk_input_length=STRING.LENGTH("&clk")
  &clk_itr_length=STRING.LENGTH("gcc_bimc_gfx_clk")

  if (STRING.SCAN("&clk", "*", 0)==0)
  (
    &wild_head=1
  )
  if (STRING.SCAN("&clk", "*", 1)==(STRING.LENGTH("&clk")-1))
  (
    &wild_tail=1
  )

  if ((&wild_head==1)&&(&wild_tail==1))
  (
    if (STRING.SCAN("gcc_bimc_gfx_clk", STRING.MID("&clk", 1, &clk_input_length-2), 0)!=-1)
    ( 
      &match=1
    )
  )
  else if (&wild_head==1)
  (
    if (STRING.MID("gcc_bimc_gfx_clk", &clk_itr_length-&clk_input_length+1, &clk_input_length-1)==STRING.CUT("&clk", 1))
    ( 
      &match=1
    )
  )
  else if (&wild_tail==1)
  (
    if (STRING.MID("gcc_bimc_gfx_clk", 0, &clk_input_length-1)==STRING.CUT("&clk", -1))
    ( 
      &match=1
    )
  )
  else if ("gcc_bimc_gfx_clk"=="&clk")
  (
    &match=1
  )
  
  if (&match==1)
  (
    &clk_test=&CLK_TEST_GCC_BIMC_GFX_CLK
    &clk_reg=&HWIO_GCC_BIMC_GFX_CBCR_ADDR
    &clk_reg_name="GCC_BIMC_GFX_CBCR"
    &clk_name="gcc_bimc_gfx_clk"
    &clk_reg_cbcr_type="sm_cbc"
    &clk_vote_bit=-1.
    &clk_multiplier=1.

    gosub Print_Clk_Info_Line
  )

  &match=0
  &wild_head=0
  &wild_tail=0
  &clk_input_length=STRING.LENGTH("&clk")
  &clk_itr_length=STRING.LENGTH("gcc_mmss_bimc_gfx_clk")

  if (STRING.SCAN("&clk", "*", 0)==0)
  (
    &wild_head=1
  )
  if (STRING.SCAN("&clk", "*", 1)==(STRING.LENGTH("&clk")-1))
  (
    &wild_tail=1
  )

  if ((&wild_head==1)&&(&wild_tail==1))
  (
    if (STRING.SCAN("gcc_mmss_bimc_gfx_clk", STRING.MID("&clk", 1, &clk_input_length-2), 0)!=-1)
    ( 
      &match=1
    )
  )
  else if (&wild_head==1)
  (
    if (STRING.MID("gcc_mmss_bimc_gfx_clk", &clk_itr_length-&clk_input_length+1, &clk_input_length-1)==STRING.CUT("&clk", 1))
    ( 
      &match=1
    )
  )
  else if (&wild_tail==1)
  (
    if (STRING.MID("gcc_mmss_bimc_gfx_clk", 0, &clk_input_length-1)==STRING.CUT("&clk", -1))
    ( 
      &match=1
    )
  )
  else if ("gcc_mmss_bimc_gfx_clk"=="&clk")
  (
    &match=1
  )
  
  if (&match==1)
  (
    &clk_test=&CLK_TEST_GCC_MMSS_BIMC_GFX_CLK
    &clk_reg=&HWIO_GCC_MMSS_BIMC_GFX_CBCR_ADDR
    &clk_reg_name="GCC_MMSS_BIMC_GFX_CBCR"
    &clk_name="gcc_mmss_bimc_gfx_clk"
    &clk_reg_cbcr_type="sm_pscbc"
    &clk_vote_bit=-1.
    &clk_multiplier=1.

    gosub Print_Clk_Info_Line
  )

  &match=0
  &wild_head=0
  &wild_tail=0
  &clk_input_length=STRING.LENGTH("&clk")
  &clk_itr_length=STRING.LENGTH("gcc_mss_q6_bimc_axi_clk")

  if (STRING.SCAN("&clk", "*", 0)==0)
  (
    &wild_head=1
  )
  if (STRING.SCAN("&clk", "*", 1)==(STRING.LENGTH("&clk")-1))
  (
    &wild_tail=1
  )

  if ((&wild_head==1)&&(&wild_tail==1))
  (
    if (STRING.SCAN("gcc_mss_q6_bimc_axi_clk", STRING.MID("&clk", 1, &clk_input_length-2), 0)!=-1)
    ( 
      &match=1
    )
  )
  else if (&wild_head==1)
  (
    if (STRING.MID("gcc_mss_q6_bimc_axi_clk", &clk_itr_length-&clk_input_length+1, &clk_input_length-1)==STRING.CUT("&clk", 1))
    ( 
      &match=1
    )
  )
  else if (&wild_tail==1)
  (
    if (STRING.MID("gcc_mss_q6_bimc_axi_clk", 0, &clk_input_length-1)==STRING.CUT("&clk", -1))
    ( 
      &match=1
    )
  )
  else if ("gcc_mss_q6_bimc_axi_clk"=="&clk")
  (
    &match=1
  )
  
  if (&match==1)
  (
    &clk_test=&CLK_TEST_GCC_MSS_Q6_BIMC_AXI_CLK
    &clk_reg=&HWIO_GCC_MSS_Q6_BIMC_AXI_CBCR_ADDR
    &clk_reg_name="GCC_MSS_Q6_BIMC_AXI_CBCR"
    &clk_name="gcc_mss_q6_bimc_axi_clk"
    &clk_reg_cbcr_type="sm_cbc"
    &clk_vote_bit=-1.
    &clk_multiplier=1.

    gosub Print_Clk_Info_Line
  )

  &match=0
  &wild_head=0
  &wild_tail=0
  &clk_input_length=STRING.LENGTH("&clk")
  &clk_itr_length=STRING.LENGTH("gcc_mss_q6_msmpu_client_axi_clk")

  if (STRING.SCAN("&clk", "*", 0)==0)
  (
    &wild_head=1
  )
  if (STRING.SCAN("&clk", "*", 1)==(STRING.LENGTH("&clk")-1))
  (
    &wild_tail=1
  )

  if ((&wild_head==1)&&(&wild_tail==1))
  (
    if (STRING.SCAN("gcc_mss_q6_msmpu_client_axi_clk", STRING.MID("&clk", 1, &clk_input_length-2), 0)!=-1)
    ( 
      &match=1
    )
  )
  else if (&wild_head==1)
  (
    if (STRING.MID("gcc_mss_q6_msmpu_client_axi_clk", &clk_itr_length-&clk_input_length+1, &clk_input_length-1)==STRING.CUT("&clk", 1))
    ( 
      &match=1
    )
  )
  else if (&wild_tail==1)
  (
    if (STRING.MID("gcc_mss_q6_msmpu_client_axi_clk", 0, &clk_input_length-1)==STRING.CUT("&clk", -1))
    ( 
      &match=1
    )
  )
  else if ("gcc_mss_q6_msmpu_client_axi_clk"=="&clk")
  (
    &match=1
  )
  
  if (&match==1)
  (
    &clk_test=&CLK_TEST_GCC_MSS_Q6_MSMPU_CLIENT_AXI_CLK
    &clk_reg=&HWIO_GCC_MSS_Q6_MSMPU_CLIENT_AXI_CBCR_ADDR
    &clk_reg_name="GCC_MSS_Q6_MSMPU_CLIENT_AXI_CBCR"
    &clk_name="gcc_mss_q6_msmpu_client_axi_clk"
    &clk_reg_cbcr_type="sm_cbc"
    &clk_vote_bit=-1.
    &clk_multiplier=1.

    gosub Print_Clk_Info_Line
  )

  &match=0
  &wild_head=0
  &wild_tail=0
  &clk_input_length=STRING.LENGTH("&clk")
  &clk_itr_length=STRING.LENGTH("gcc_mss_q6_smmu_clk")

  if (STRING.SCAN("&clk", "*", 0)==0)
  (
    &wild_head=1
  )
  if (STRING.SCAN("&clk", "*", 1)==(STRING.LENGTH("&clk")-1))
  (
    &wild_tail=1
  )

  if ((&wild_head==1)&&(&wild_tail==1))
  (
    if (STRING.SCAN("gcc_mss_q6_smmu_clk", STRING.MID("&clk", 1, &clk_input_length-2), 0)!=-1)
    ( 
      &match=1
    )
  )
  else if (&wild_head==1)
  (
    if (STRING.MID("gcc_mss_q6_smmu_clk", &clk_itr_length-&clk_input_length+1, &clk_input_length-1)==STRING.CUT("&clk", 1))
    ( 
      &match=1
    )
  )
  else if (&wild_tail==1)
  (
    if (STRING.MID("gcc_mss_q6_smmu_clk", 0, &clk_input_length-1)==STRING.CUT("&clk", -1))
    ( 
      &match=1
    )
  )
  else if ("gcc_mss_q6_smmu_clk"=="&clk")
  (
    &match=1
  )
  
  if (&match==1)
  (
    &clk_test=&CLK_TEST_GCC_MSS_Q6_SMMU_CLK
    &clk_reg=&HWIO_GCC_MSS_Q6_SMMU_CBCR_ADDR
    &clk_reg_name="GCC_MSS_Q6_SMMU_CBCR"
    &clk_name="gcc_mss_q6_smmu_clk"
    &clk_reg_cbcr_type="sm_pscbc"
    &clk_vote_bit=-1.
    &clk_multiplier=1.

    gosub Print_Clk_Info_Line
  )

  &match=0
  &wild_head=0
  &wild_tail=0
  &clk_input_length=STRING.LENGTH("&clk")
  &clk_itr_length=STRING.LENGTH("gcc_mss_vs_clk")

  if (STRING.SCAN("&clk", "*", 0)==0)
  (
    &wild_head=1
  )
  if (STRING.SCAN("&clk", "*", 1)==(STRING.LENGTH("&clk")-1))
  (
    &wild_tail=1
  )

  if ((&wild_head==1)&&(&wild_tail==1))
  (
    if (STRING.SCAN("gcc_mss_vs_clk", STRING.MID("&clk", 1, &clk_input_length-2), 0)!=-1)
    ( 
      &match=1
    )
  )
  else if (&wild_head==1)
  (
    if (STRING.MID("gcc_mss_vs_clk", &clk_itr_length-&clk_input_length+1, &clk_input_length-1)==STRING.CUT("&clk", 1))
    ( 
      &match=1
    )
  )
  else if (&wild_tail==1)
  (
    if (STRING.MID("gcc_mss_vs_clk", 0, &clk_input_length-1)==STRING.CUT("&clk", -1))
    ( 
      &match=1
    )
  )
  else if ("gcc_mss_vs_clk"=="&clk")
  (
    &match=1
  )
  
  if (&match==1)
  (
    &clk_test=&CLK_TEST_GCC_MSS_VS_CLK
    &clk_reg=&HWIO_GCC_MSS_VS_CBCR_ADDR
    &clk_reg_name="GCC_MSS_VS_CBCR"
    &clk_name="gcc_mss_vs_clk"
    &clk_reg_cbcr_type="sm_cbc"
    &clk_vote_bit=-1.
    &clk_multiplier=1.

    gosub Print_Clk_Info_Line
  )

  &match=0
  &wild_head=0
  &wild_tail=0
  &clk_input_length=STRING.LENGTH("&clk")
  &clk_itr_length=STRING.LENGTH("gcc_obt_odt_clk")

  if (STRING.SCAN("&clk", "*", 0)==0)
  (
    &wild_head=1
  )
  if (STRING.SCAN("&clk", "*", 1)==(STRING.LENGTH("&clk")-1))
  (
    &wild_tail=1
  )

  if ((&wild_head==1)&&(&wild_tail==1))
  (
    if (STRING.SCAN("gcc_obt_odt_clk", STRING.MID("&clk", 1, &clk_input_length-2), 0)!=-1)
    ( 
      &match=1
    )
  )
  else if (&wild_head==1)
  (
    if (STRING.MID("gcc_obt_odt_clk", &clk_itr_length-&clk_input_length+1, &clk_input_length-1)==STRING.CUT("&clk", 1))
    ( 
      &match=1
    )
  )
  else if (&wild_tail==1)
  (
    if (STRING.MID("gcc_obt_odt_clk", 0, &clk_input_length-1)==STRING.CUT("&clk", -1))
    ( 
      &match=1
    )
  )
  else if ("gcc_obt_odt_clk"=="&clk")
  (
    &match=1
  )
  
  if (&match==1)
  (
    &clk_test=&CLK_TEST_GCC_OBT_ODT_CLK
    &clk_reg=&HWIO_GCC_OBT_ODT_CBCR_ADDR
    &clk_reg_name="GCC_OBT_ODT_CBCR"
    &clk_name="gcc_obt_odt_clk"
    &clk_reg_cbcr_type="sm_cbc"
    &clk_vote_bit=-1.
    &clk_multiplier=1.

    gosub Print_Clk_Info_Line
  )

  &match=0
  &wild_head=0
  &wild_tail=0
  &clk_input_length=STRING.LENGTH("&clk")
  &clk_itr_length=STRING.LENGTH("gcc_pcie_0_pipe_clk")

  if (STRING.SCAN("&clk", "*", 0)==0)
  (
    &wild_head=1
  )
  if (STRING.SCAN("&clk", "*", 1)==(STRING.LENGTH("&clk")-1))
  (
    &wild_tail=1
  )

  if ((&wild_head==1)&&(&wild_tail==1))
  (
    if (STRING.SCAN("gcc_pcie_0_pipe_clk", STRING.MID("&clk", 1, &clk_input_length-2), 0)!=-1)
    ( 
      &match=1
    )
  )
  else if (&wild_head==1)
  (
    if (STRING.MID("gcc_pcie_0_pipe_clk", &clk_itr_length-&clk_input_length+1, &clk_input_length-1)==STRING.CUT("&clk", 1))
    ( 
      &match=1
    )
  )
  else if (&wild_tail==1)
  (
    if (STRING.MID("gcc_pcie_0_pipe_clk", 0, &clk_input_length-1)==STRING.CUT("&clk", -1))
    ( 
      &match=1
    )
  )
  else if ("gcc_pcie_0_pipe_clk"=="&clk")
  (
    &match=1
  )
  
  if (&match==1)
  (
    &clk_test=&CLK_TEST_GCC_PCIE_0_PIPE_CLK
    &clk_reg=&HWIO_GCC_PCIE_0_PIPE_CBCR_ADDR
    &clk_reg_name="GCC_PCIE_0_PIPE_CBCR"
    &clk_name="gcc_pcie_0_pipe_clk"
    &clk_reg_cbcr_type="sm_pscbc"
    &clk_vote_bit=-1.
    &clk_multiplier=1.

    gosub Print_Clk_Info_Line
  )

  &match=0
  &wild_head=0
  &wild_tail=0
  &clk_input_length=STRING.LENGTH("&clk")
  &clk_itr_length=STRING.LENGTH("gcc_pcie_1_pipe_clk")

  if (STRING.SCAN("&clk", "*", 0)==0)
  (
    &wild_head=1
  )
  if (STRING.SCAN("&clk", "*", 1)==(STRING.LENGTH("&clk")-1))
  (
    &wild_tail=1
  )

  if ((&wild_head==1)&&(&wild_tail==1))
  (
    if (STRING.SCAN("gcc_pcie_1_pipe_clk", STRING.MID("&clk", 1, &clk_input_length-2), 0)!=-1)
    ( 
      &match=1
    )
  )
  else if (&wild_head==1)
  (
    if (STRING.MID("gcc_pcie_1_pipe_clk", &clk_itr_length-&clk_input_length+1, &clk_input_length-1)==STRING.CUT("&clk", 1))
    ( 
      &match=1
    )
  )
  else if (&wild_tail==1)
  (
    if (STRING.MID("gcc_pcie_1_pipe_clk", 0, &clk_input_length-1)==STRING.CUT("&clk", -1))
    ( 
      &match=1
    )
  )
  else if ("gcc_pcie_1_pipe_clk"=="&clk")
  (
    &match=1
  )
  
  if (&match==1)
  (
    &clk_test=&CLK_TEST_GCC_PCIE_1_PIPE_CLK
    &clk_reg=&HWIO_GCC_PCIE_1_PIPE_CBCR_ADDR
    &clk_reg_name="GCC_PCIE_1_PIPE_CBCR"
    &clk_name="gcc_pcie_1_pipe_clk"
    &clk_reg_cbcr_type="sm_pscbc"
    &clk_vote_bit=-1.
    &clk_multiplier=1.

    gosub Print_Clk_Info_Line
  )

  &match=0
  &wild_head=0
  &wild_tail=0
  &clk_input_length=STRING.LENGTH("&clk")
  &clk_itr_length=STRING.LENGTH("gcc_pcie_2_pipe_clk")

  if (STRING.SCAN("&clk", "*", 0)==0)
  (
    &wild_head=1
  )
  if (STRING.SCAN("&clk", "*", 1)==(STRING.LENGTH("&clk")-1))
  (
    &wild_tail=1
  )

  if ((&wild_head==1)&&(&wild_tail==1))
  (
    if (STRING.SCAN("gcc_pcie_2_pipe_clk", STRING.MID("&clk", 1, &clk_input_length-2), 0)!=-1)
    ( 
      &match=1
    )
  )
  else if (&wild_head==1)
  (
    if (STRING.MID("gcc_pcie_2_pipe_clk", &clk_itr_length-&clk_input_length+1, &clk_input_length-1)==STRING.CUT("&clk", 1))
    ( 
      &match=1
    )
  )
  else if (&wild_tail==1)
  (
    if (STRING.MID("gcc_pcie_2_pipe_clk", 0, &clk_input_length-1)==STRING.CUT("&clk", -1))
    ( 
      &match=1
    )
  )
  else if ("gcc_pcie_2_pipe_clk"=="&clk")
  (
    &match=1
  )
  
  if (&match==1)
  (
    &clk_test=&CLK_TEST_GCC_PCIE_2_PIPE_CLK
    &clk_reg=&HWIO_GCC_PCIE_2_PIPE_CBCR_ADDR
    &clk_reg_name="GCC_PCIE_2_PIPE_CBCR"
    &clk_name="gcc_pcie_2_pipe_clk"
    &clk_reg_cbcr_type="sm_pscbc"
    &clk_vote_bit=-1.
    &clk_multiplier=1.

    gosub Print_Clk_Info_Line
  )

  &match=0
  &wild_head=0
  &wild_tail=0
  &clk_input_length=STRING.LENGTH("&clk")
  &clk_itr_length=STRING.LENGTH("gcc_pcie_0_aux_clk")

  if (STRING.SCAN("&clk", "*", 0)==0)
  (
    &wild_head=1
  )
  if (STRING.SCAN("&clk", "*", 1)==(STRING.LENGTH("&clk")-1))
  (
    &wild_tail=1
  )

  if ((&wild_head==1)&&(&wild_tail==1))
  (
    if (STRING.SCAN("gcc_pcie_0_aux_clk", STRING.MID("&clk", 1, &clk_input_length-2), 0)!=-1)
    ( 
      &match=1
    )
  )
  else if (&wild_head==1)
  (
    if (STRING.MID("gcc_pcie_0_aux_clk", &clk_itr_length-&clk_input_length+1, &clk_input_length-1)==STRING.CUT("&clk", 1))
    ( 
      &match=1
    )
  )
  else if (&wild_tail==1)
  (
    if (STRING.MID("gcc_pcie_0_aux_clk", 0, &clk_input_length-1)==STRING.CUT("&clk", -1))
    ( 
      &match=1
    )
  )
  else if ("gcc_pcie_0_aux_clk"=="&clk")
  (
    &match=1
  )
  
  if (&match==1)
  (
    &clk_test=&CLK_TEST_GCC_PCIE_0_AUX_CLK
    &clk_reg=&HWIO_GCC_PCIE_0_AUX_CBCR_ADDR
    &clk_reg_name="GCC_PCIE_0_AUX_CBCR"
    &clk_name="gcc_pcie_0_aux_clk"
    &clk_reg_cbcr_type="sm_cbc"
    &clk_vote_bit=-1.
    &clk_multiplier=1.

    gosub Print_Clk_Info_Line
  )

  &match=0
  &wild_head=0
  &wild_tail=0
  &clk_input_length=STRING.LENGTH("&clk")
  &clk_itr_length=STRING.LENGTH("gcc_pcie_1_aux_clk")

  if (STRING.SCAN("&clk", "*", 0)==0)
  (
    &wild_head=1
  )
  if (STRING.SCAN("&clk", "*", 1)==(STRING.LENGTH("&clk")-1))
  (
    &wild_tail=1
  )

  if ((&wild_head==1)&&(&wild_tail==1))
  (
    if (STRING.SCAN("gcc_pcie_1_aux_clk", STRING.MID("&clk", 1, &clk_input_length-2), 0)!=-1)
    ( 
      &match=1
    )
  )
  else if (&wild_head==1)
  (
    if (STRING.MID("gcc_pcie_1_aux_clk", &clk_itr_length-&clk_input_length+1, &clk_input_length-1)==STRING.CUT("&clk", 1))
    ( 
      &match=1
    )
  )
  else if (&wild_tail==1)
  (
    if (STRING.MID("gcc_pcie_1_aux_clk", 0, &clk_input_length-1)==STRING.CUT("&clk", -1))
    ( 
      &match=1
    )
  )
  else if ("gcc_pcie_1_aux_clk"=="&clk")
  (
    &match=1
  )
  
  if (&match==1)
  (
    &clk_test=&CLK_TEST_GCC_PCIE_1_AUX_CLK
    &clk_reg=&HWIO_GCC_PCIE_1_AUX_CBCR_ADDR
    &clk_reg_name="GCC_PCIE_1_AUX_CBCR"
    &clk_name="gcc_pcie_1_aux_clk"
    &clk_reg_cbcr_type="sm_cbc"
    &clk_vote_bit=-1.
    &clk_multiplier=1.

    gosub Print_Clk_Info_Line
  )

  &match=0
  &wild_head=0
  &wild_tail=0
  &clk_input_length=STRING.LENGTH("&clk")
  &clk_itr_length=STRING.LENGTH("gcc_pcie_2_aux_clk")

  if (STRING.SCAN("&clk", "*", 0)==0)
  (
    &wild_head=1
  )
  if (STRING.SCAN("&clk", "*", 1)==(STRING.LENGTH("&clk")-1))
  (
    &wild_tail=1
  )

  if ((&wild_head==1)&&(&wild_tail==1))
  (
    if (STRING.SCAN("gcc_pcie_2_aux_clk", STRING.MID("&clk", 1, &clk_input_length-2), 0)!=-1)
    ( 
      &match=1
    )
  )
  else if (&wild_head==1)
  (
    if (STRING.MID("gcc_pcie_2_aux_clk", &clk_itr_length-&clk_input_length+1, &clk_input_length-1)==STRING.CUT("&clk", 1))
    ( 
      &match=1
    )
  )
  else if (&wild_tail==1)
  (
    if (STRING.MID("gcc_pcie_2_aux_clk", 0, &clk_input_length-1)==STRING.CUT("&clk", -1))
    ( 
      &match=1
    )
  )
  else if ("gcc_pcie_2_aux_clk"=="&clk")
  (
    &match=1
  )
  
  if (&match==1)
  (
    &clk_test=&CLK_TEST_GCC_PCIE_2_AUX_CLK
    &clk_reg=&HWIO_GCC_PCIE_2_AUX_CBCR_ADDR
    &clk_reg_name="GCC_PCIE_2_AUX_CBCR"
    &clk_name="gcc_pcie_2_aux_clk"
    &clk_reg_cbcr_type="sm_cbc"
    &clk_vote_bit=-1.
    &clk_multiplier=1.

    gosub Print_Clk_Info_Line
  )

  &match=0
  &wild_head=0
  &wild_tail=0
  &clk_input_length=STRING.LENGTH("&clk")
  &clk_itr_length=STRING.LENGTH("gcc_pcie_phy_aux_clk")

  if (STRING.SCAN("&clk", "*", 0)==0)
  (
    &wild_head=1
  )
  if (STRING.SCAN("&clk", "*", 1)==(STRING.LENGTH("&clk")-1))
  (
    &wild_tail=1
  )

  if ((&wild_head==1)&&(&wild_tail==1))
  (
    if (STRING.SCAN("gcc_pcie_phy_aux_clk", STRING.MID("&clk", 1, &clk_input_length-2), 0)!=-1)
    ( 
      &match=1
    )
  )
  else if (&wild_head==1)
  (
    if (STRING.MID("gcc_pcie_phy_aux_clk", &clk_itr_length-&clk_input_length+1, &clk_input_length-1)==STRING.CUT("&clk", 1))
    ( 
      &match=1
    )
  )
  else if (&wild_tail==1)
  (
    if (STRING.MID("gcc_pcie_phy_aux_clk", 0, &clk_input_length-1)==STRING.CUT("&clk", -1))
    ( 
      &match=1
    )
  )
  else if ("gcc_pcie_phy_aux_clk"=="&clk")
  (
    &match=1
  )
  
  if (&match==1)
  (
    &clk_test=&CLK_TEST_GCC_PCIE_PHY_AUX_CLK
    &clk_reg=&HWIO_GCC_PCIE_PHY_AUX_CBCR_ADDR
    &clk_reg_name="GCC_PCIE_PHY_AUX_CBCR"
    &clk_name="gcc_pcie_phy_aux_clk"
    &clk_reg_cbcr_type="sm_cbc"
    &clk_vote_bit=-1.
    &clk_multiplier=1.

    gosub Print_Clk_Info_Line
  )

  &match=0
  &wild_head=0
  &wild_tail=0
  &clk_input_length=STRING.LENGTH("&clk")
  &clk_itr_length=STRING.LENGTH("gcc_pdm2_clk")

  if (STRING.SCAN("&clk", "*", 0)==0)
  (
    &wild_head=1
  )
  if (STRING.SCAN("&clk", "*", 1)==(STRING.LENGTH("&clk")-1))
  (
    &wild_tail=1
  )

  if ((&wild_head==1)&&(&wild_tail==1))
  (
    if (STRING.SCAN("gcc_pdm2_clk", STRING.MID("&clk", 1, &clk_input_length-2), 0)!=-1)
    ( 
      &match=1
    )
  )
  else if (&wild_head==1)
  (
    if (STRING.MID("gcc_pdm2_clk", &clk_itr_length-&clk_input_length+1, &clk_input_length-1)==STRING.CUT("&clk", 1))
    ( 
      &match=1
    )
  )
  else if (&wild_tail==1)
  (
    if (STRING.MID("gcc_pdm2_clk", 0, &clk_input_length-1)==STRING.CUT("&clk", -1))
    ( 
      &match=1
    )
  )
  else if ("gcc_pdm2_clk"=="&clk")
  (
    &match=1
  )
  
  if (&match==1)
  (
    &clk_test=&CLK_TEST_GCC_PDM2_CLK
    &clk_reg=&HWIO_GCC_PDM2_CBCR_ADDR
    &clk_reg_name="GCC_PDM2_CBCR"
    &clk_name="gcc_pdm2_clk"
    &clk_reg_cbcr_type="sm_cbc"
    &clk_vote_bit=-1.
    &clk_multiplier=1.

    gosub Print_Clk_Info_Line
  )

  &match=0
  &wild_head=0
  &wild_tail=0
  &clk_input_length=STRING.LENGTH("&clk")
  &clk_itr_length=STRING.LENGTH("gcc_aggre1_pnoc_ahb_clk")

  if (STRING.SCAN("&clk", "*", 0)==0)
  (
    &wild_head=1
  )
  if (STRING.SCAN("&clk", "*", 1)==(STRING.LENGTH("&clk")-1))
  (
    &wild_tail=1
  )

  if ((&wild_head==1)&&(&wild_tail==1))
  (
    if (STRING.SCAN("gcc_aggre1_pnoc_ahb_clk", STRING.MID("&clk", 1, &clk_input_length-2), 0)!=-1)
    ( 
      &match=1
    )
  )
  else if (&wild_head==1)
  (
    if (STRING.MID("gcc_aggre1_pnoc_ahb_clk", &clk_itr_length-&clk_input_length+1, &clk_input_length-1)==STRING.CUT("&clk", 1))
    ( 
      &match=1
    )
  )
  else if (&wild_tail==1)
  (
    if (STRING.MID("gcc_aggre1_pnoc_ahb_clk", 0, &clk_input_length-1)==STRING.CUT("&clk", -1))
    ( 
      &match=1
    )
  )
  else if ("gcc_aggre1_pnoc_ahb_clk"=="&clk")
  (
    &match=1
  )
  
  if (&match==1)
  (
    &clk_test=&CLK_TEST_GCC_AGGRE1_PNOC_AHB_CLK
    &clk_reg=&HWIO_GCC_AGGRE1_PNOC_AHB_CBCR_ADDR
    &clk_reg_name="GCC_AGGRE1_PNOC_AHB_CBCR"
    &clk_name="gcc_aggre1_pnoc_ahb_clk"
    &clk_reg_cbcr_type="sm_cbc"
    &clk_vote_bit=-1.
    &clk_multiplier=1.

    gosub Print_Clk_Info_Line
  )

  &match=0
  &wild_head=0
  &wild_tail=0
  &clk_input_length=STRING.LENGTH("&clk")
  &clk_itr_length=STRING.LENGTH("gcc_blsp1_ahb_clk")

  if (STRING.SCAN("&clk", "*", 0)==0)
  (
    &wild_head=1
  )
  if (STRING.SCAN("&clk", "*", 1)==(STRING.LENGTH("&clk")-1))
  (
    &wild_tail=1
  )

  if ((&wild_head==1)&&(&wild_tail==1))
  (
    if (STRING.SCAN("gcc_blsp1_ahb_clk", STRING.MID("&clk", 1, &clk_input_length-2), 0)!=-1)
    ( 
      &match=1
    )
  )
  else if (&wild_head==1)
  (
    if (STRING.MID("gcc_blsp1_ahb_clk", &clk_itr_length-&clk_input_length+1, &clk_input_length-1)==STRING.CUT("&clk", 1))
    ( 
      &match=1
    )
  )
  else if (&wild_tail==1)
  (
    if (STRING.MID("gcc_blsp1_ahb_clk", 0, &clk_input_length-1)==STRING.CUT("&clk", -1))
    ( 
      &match=1
    )
  )
  else if ("gcc_blsp1_ahb_clk"=="&clk")
  (
    &match=1
  )
  
  if (&match==1)
  (
    &clk_test=&CLK_TEST_GCC_BLSP1_AHB_CLK
    &clk_reg=&HWIO_GCC_BLSP1_AHB_CBCR_ADDR
    &clk_reg_name="GCC_BLSP1_AHB_CBCR"
    &clk_name="gcc_blsp1_ahb_clk"
    &clk_reg_cbcr_type="sm_pscbc"
    &clk_vote_bit=17.
    &clk_multiplier=1.

    gosub Print_Clk_Info_Line
  )

  &match=0
  &wild_head=0
  &wild_tail=0
  &clk_input_length=STRING.LENGTH("&clk")
  &clk_itr_length=STRING.LENGTH("gcc_blsp2_ahb_clk")

  if (STRING.SCAN("&clk", "*", 0)==0)
  (
    &wild_head=1
  )
  if (STRING.SCAN("&clk", "*", 1)==(STRING.LENGTH("&clk")-1))
  (
    &wild_tail=1
  )

  if ((&wild_head==1)&&(&wild_tail==1))
  (
    if (STRING.SCAN("gcc_blsp2_ahb_clk", STRING.MID("&clk", 1, &clk_input_length-2), 0)!=-1)
    ( 
      &match=1
    )
  )
  else if (&wild_head==1)
  (
    if (STRING.MID("gcc_blsp2_ahb_clk", &clk_itr_length-&clk_input_length+1, &clk_input_length-1)==STRING.CUT("&clk", 1))
    ( 
      &match=1
    )
  )
  else if (&wild_tail==1)
  (
    if (STRING.MID("gcc_blsp2_ahb_clk", 0, &clk_input_length-1)==STRING.CUT("&clk", -1))
    ( 
      &match=1
    )
  )
  else if ("gcc_blsp2_ahb_clk"=="&clk")
  (
    &match=1
  )
  
  if (&match==1)
  (
    &clk_test=&CLK_TEST_GCC_BLSP2_AHB_CLK
    &clk_reg=&HWIO_GCC_BLSP2_AHB_CBCR_ADDR
    &clk_reg_name="GCC_BLSP2_AHB_CBCR"
    &clk_name="gcc_blsp2_ahb_clk"
    &clk_reg_cbcr_type="sm_pscbc"
    &clk_vote_bit=15.
    &clk_multiplier=1.

    gosub Print_Clk_Info_Line
  )

  &match=0
  &wild_head=0
  &wild_tail=0
  &clk_input_length=STRING.LENGTH("&clk")
  &clk_itr_length=STRING.LENGTH("gcc_pdm_ahb_clk")

  if (STRING.SCAN("&clk", "*", 0)==0)
  (
    &wild_head=1
  )
  if (STRING.SCAN("&clk", "*", 1)==(STRING.LENGTH("&clk")-1))
  (
    &wild_tail=1
  )

  if ((&wild_head==1)&&(&wild_tail==1))
  (
    if (STRING.SCAN("gcc_pdm_ahb_clk", STRING.MID("&clk", 1, &clk_input_length-2), 0)!=-1)
    ( 
      &match=1
    )
  )
  else if (&wild_head==1)
  (
    if (STRING.MID("gcc_pdm_ahb_clk", &clk_itr_length-&clk_input_length+1, &clk_input_length-1)==STRING.CUT("&clk", 1))
    ( 
      &match=1
    )
  )
  else if (&wild_tail==1)
  (
    if (STRING.MID("gcc_pdm_ahb_clk", 0, &clk_input_length-1)==STRING.CUT("&clk", -1))
    ( 
      &match=1
    )
  )
  else if ("gcc_pdm_ahb_clk"=="&clk")
  (
    &match=1
  )
  
  if (&match==1)
  (
    &clk_test=&CLK_TEST_GCC_PDM_AHB_CLK
    &clk_reg=&HWIO_GCC_PDM_AHB_CBCR_ADDR
    &clk_reg_name="GCC_PDM_AHB_CBCR"
    &clk_name="gcc_pdm_ahb_clk"
    &clk_reg_cbcr_type="sm_cbc"
    &clk_vote_bit=-1.
    &clk_multiplier=1.

    gosub Print_Clk_Info_Line
  )

  &match=0
  &wild_head=0
  &wild_tail=0
  &clk_input_length=STRING.LENGTH("&clk")
  &clk_itr_length=STRING.LENGTH("gcc_periph_noc_ahb_clk")

  if (STRING.SCAN("&clk", "*", 0)==0)
  (
    &wild_head=1
  )
  if (STRING.SCAN("&clk", "*", 1)==(STRING.LENGTH("&clk")-1))
  (
    &wild_tail=1
  )

  if ((&wild_head==1)&&(&wild_tail==1))
  (
    if (STRING.SCAN("gcc_periph_noc_ahb_clk", STRING.MID("&clk", 1, &clk_input_length-2), 0)!=-1)
    ( 
      &match=1
    )
  )
  else if (&wild_head==1)
  (
    if (STRING.MID("gcc_periph_noc_ahb_clk", &clk_itr_length-&clk_input_length+1, &clk_input_length-1)==STRING.CUT("&clk", 1))
    ( 
      &match=1
    )
  )
  else if (&wild_tail==1)
  (
    if (STRING.MID("gcc_periph_noc_ahb_clk", 0, &clk_input_length-1)==STRING.CUT("&clk", -1))
    ( 
      &match=1
    )
  )
  else if ("gcc_periph_noc_ahb_clk"=="&clk")||("buses"=="&clk")
  (
    &match=1
  )
  
  if (&match==1)
  (
    &clk_test=&CLK_TEST_GCC_PERIPH_NOC_AHB_CLK
    &clk_reg=&HWIO_GCC_PERIPH_NOC_AHB_CBCR_ADDR
    &clk_reg_name="GCC_PERIPH_NOC_AHB_CBCR"
    &clk_name="gcc_periph_noc_ahb_clk"
    &clk_reg_cbcr_type="sm_cbc"
    &clk_vote_bit=-1.
    &clk_multiplier=1.

    gosub Print_Clk_Info_Line
  )

  &match=0
  &wild_head=0
  &wild_tail=0
  &clk_input_length=STRING.LENGTH("&clk")
  &clk_itr_length=STRING.LENGTH("gcc_periph_noc_mpu_cfg_ahb_clk")

  if (STRING.SCAN("&clk", "*", 0)==0)
  (
    &wild_head=1
  )
  if (STRING.SCAN("&clk", "*", 1)==(STRING.LENGTH("&clk")-1))
  (
    &wild_tail=1
  )

  if ((&wild_head==1)&&(&wild_tail==1))
  (
    if (STRING.SCAN("gcc_periph_noc_mpu_cfg_ahb_clk", STRING.MID("&clk", 1, &clk_input_length-2), 0)!=-1)
    ( 
      &match=1
    )
  )
  else if (&wild_head==1)
  (
    if (STRING.MID("gcc_periph_noc_mpu_cfg_ahb_clk", &clk_itr_length-&clk_input_length+1, &clk_input_length-1)==STRING.CUT("&clk", 1))
    ( 
      &match=1
    )
  )
  else if (&wild_tail==1)
  (
    if (STRING.MID("gcc_periph_noc_mpu_cfg_ahb_clk", 0, &clk_input_length-1)==STRING.CUT("&clk", -1))
    ( 
      &match=1
    )
  )
  else if ("gcc_periph_noc_mpu_cfg_ahb_clk"=="&clk")
  (
    &match=1
  )
  
  if (&match==1)
  (
    &clk_test=&CLK_TEST_GCC_PERIPH_NOC_MPU_CFG_AHB_CLK
    &clk_reg=&HWIO_GCC_PERIPH_NOC_MPU_CFG_AHB_CBCR_ADDR
    &clk_reg_name="GCC_PERIPH_NOC_MPU_CFG_AHB_CBCR"
    &clk_name="gcc_periph_noc_mpu_cfg_ahb_clk"
    &clk_reg_cbcr_type="sm_cbc"
    &clk_vote_bit=-1.
    &clk_multiplier=1.

    gosub Print_Clk_Info_Line
  )

  &match=0
  &wild_head=0
  &wild_tail=0
  &clk_input_length=STRING.LENGTH("&clk")
  &clk_itr_length=STRING.LENGTH("gcc_pnoc_bus_timeout1_ahb_clk")

  if (STRING.SCAN("&clk", "*", 0)==0)
  (
    &wild_head=1
  )
  if (STRING.SCAN("&clk", "*", 1)==(STRING.LENGTH("&clk")-1))
  (
    &wild_tail=1
  )

  if ((&wild_head==1)&&(&wild_tail==1))
  (
    if (STRING.SCAN("gcc_pnoc_bus_timeout1_ahb_clk", STRING.MID("&clk", 1, &clk_input_length-2), 0)!=-1)
    ( 
      &match=1
    )
  )
  else if (&wild_head==1)
  (
    if (STRING.MID("gcc_pnoc_bus_timeout1_ahb_clk", &clk_itr_length-&clk_input_length+1, &clk_input_length-1)==STRING.CUT("&clk", 1))
    ( 
      &match=1
    )
  )
  else if (&wild_tail==1)
  (
    if (STRING.MID("gcc_pnoc_bus_timeout1_ahb_clk", 0, &clk_input_length-1)==STRING.CUT("&clk", -1))
    ( 
      &match=1
    )
  )
  else if ("gcc_pnoc_bus_timeout1_ahb_clk"=="&clk")
  (
    &match=1
  )
  
  if (&match==1)
  (
    &clk_test=&CLK_TEST_GCC_PNOC_BUS_TIMEOUT1_AHB_CLK
    &clk_reg=&HWIO_GCC_PNOC_BUS_TIMEOUT1_AHB_CBCR_ADDR
    &clk_reg_name="GCC_PNOC_BUS_TIMEOUT1_AHB_CBCR"
    &clk_name="gcc_pnoc_bus_timeout1_ahb_clk"
    &clk_reg_cbcr_type="sm_cbc"
    &clk_vote_bit=-1.
    &clk_multiplier=1.

    gosub Print_Clk_Info_Line
  )

  &match=0
  &wild_head=0
  &wild_tail=0
  &clk_input_length=STRING.LENGTH("&clk")
  &clk_itr_length=STRING.LENGTH("gcc_pnoc_bus_timeout2_ahb_clk")

  if (STRING.SCAN("&clk", "*", 0)==0)
  (
    &wild_head=1
  )
  if (STRING.SCAN("&clk", "*", 1)==(STRING.LENGTH("&clk")-1))
  (
    &wild_tail=1
  )

  if ((&wild_head==1)&&(&wild_tail==1))
  (
    if (STRING.SCAN("gcc_pnoc_bus_timeout2_ahb_clk", STRING.MID("&clk", 1, &clk_input_length-2), 0)!=-1)
    ( 
      &match=1
    )
  )
  else if (&wild_head==1)
  (
    if (STRING.MID("gcc_pnoc_bus_timeout2_ahb_clk", &clk_itr_length-&clk_input_length+1, &clk_input_length-1)==STRING.CUT("&clk", 1))
    ( 
      &match=1
    )
  )
  else if (&wild_tail==1)
  (
    if (STRING.MID("gcc_pnoc_bus_timeout2_ahb_clk", 0, &clk_input_length-1)==STRING.CUT("&clk", -1))
    ( 
      &match=1
    )
  )
  else if ("gcc_pnoc_bus_timeout2_ahb_clk"=="&clk")
  (
    &match=1
  )
  
  if (&match==1)
  (
    &clk_test=&CLK_TEST_GCC_PNOC_BUS_TIMEOUT2_AHB_CLK
    &clk_reg=&HWIO_GCC_PNOC_BUS_TIMEOUT2_AHB_CBCR_ADDR
    &clk_reg_name="GCC_PNOC_BUS_TIMEOUT2_AHB_CBCR"
    &clk_name="gcc_pnoc_bus_timeout2_ahb_clk"
    &clk_reg_cbcr_type="sm_cbc"
    &clk_vote_bit=-1.
    &clk_multiplier=1.

    gosub Print_Clk_Info_Line
  )

  &match=0
  &wild_head=0
  &wild_tail=0
  &clk_input_length=STRING.LENGTH("&clk")
  &clk_itr_length=STRING.LENGTH("gcc_pnoc_bus_timeout3_ahb_clk")

  if (STRING.SCAN("&clk", "*", 0)==0)
  (
    &wild_head=1
  )
  if (STRING.SCAN("&clk", "*", 1)==(STRING.LENGTH("&clk")-1))
  (
    &wild_tail=1
  )

  if ((&wild_head==1)&&(&wild_tail==1))
  (
    if (STRING.SCAN("gcc_pnoc_bus_timeout3_ahb_clk", STRING.MID("&clk", 1, &clk_input_length-2), 0)!=-1)
    ( 
      &match=1
    )
  )
  else if (&wild_head==1)
  (
    if (STRING.MID("gcc_pnoc_bus_timeout3_ahb_clk", &clk_itr_length-&clk_input_length+1, &clk_input_length-1)==STRING.CUT("&clk", 1))
    ( 
      &match=1
    )
  )
  else if (&wild_tail==1)
  (
    if (STRING.MID("gcc_pnoc_bus_timeout3_ahb_clk", 0, &clk_input_length-1)==STRING.CUT("&clk", -1))
    ( 
      &match=1
    )
  )
  else if ("gcc_pnoc_bus_timeout3_ahb_clk"=="&clk")
  (
    &match=1
  )
  
  if (&match==1)
  (
    &clk_test=&CLK_TEST_GCC_PNOC_BUS_TIMEOUT3_AHB_CLK
    &clk_reg=&HWIO_GCC_PNOC_BUS_TIMEOUT3_AHB_CBCR_ADDR
    &clk_reg_name="GCC_PNOC_BUS_TIMEOUT3_AHB_CBCR"
    &clk_name="gcc_pnoc_bus_timeout3_ahb_clk"
    &clk_reg_cbcr_type="sm_cbc"
    &clk_vote_bit=-1.
    &clk_multiplier=1.

    gosub Print_Clk_Info_Line
  )

  &match=0
  &wild_head=0
  &wild_tail=0
  &clk_input_length=STRING.LENGTH("&clk")
  &clk_itr_length=STRING.LENGTH("gcc_pnoc_bus_timeout4_ahb_clk")

  if (STRING.SCAN("&clk", "*", 0)==0)
  (
    &wild_head=1
  )
  if (STRING.SCAN("&clk", "*", 1)==(STRING.LENGTH("&clk")-1))
  (
    &wild_tail=1
  )

  if ((&wild_head==1)&&(&wild_tail==1))
  (
    if (STRING.SCAN("gcc_pnoc_bus_timeout4_ahb_clk", STRING.MID("&clk", 1, &clk_input_length-2), 0)!=-1)
    ( 
      &match=1
    )
  )
  else if (&wild_head==1)
  (
    if (STRING.MID("gcc_pnoc_bus_timeout4_ahb_clk", &clk_itr_length-&clk_input_length+1, &clk_input_length-1)==STRING.CUT("&clk", 1))
    ( 
      &match=1
    )
  )
  else if (&wild_tail==1)
  (
    if (STRING.MID("gcc_pnoc_bus_timeout4_ahb_clk", 0, &clk_input_length-1)==STRING.CUT("&clk", -1))
    ( 
      &match=1
    )
  )
  else if ("gcc_pnoc_bus_timeout4_ahb_clk"=="&clk")
  (
    &match=1
  )
  
  if (&match==1)
  (
    &clk_test=&CLK_TEST_GCC_PNOC_BUS_TIMEOUT4_AHB_CLK
    &clk_reg=&HWIO_GCC_PNOC_BUS_TIMEOUT4_AHB_CBCR_ADDR
    &clk_reg_name="GCC_PNOC_BUS_TIMEOUT4_AHB_CBCR"
    &clk_name="gcc_pnoc_bus_timeout4_ahb_clk"
    &clk_reg_cbcr_type="sm_cbc"
    &clk_vote_bit=-1.
    &clk_multiplier=1.

    gosub Print_Clk_Info_Line
  )

  &match=0
  &wild_head=0
  &wild_tail=0
  &clk_input_length=STRING.LENGTH("&clk")
  &clk_itr_length=STRING.LENGTH("gcc_sdcc1_ahb_clk")

  if (STRING.SCAN("&clk", "*", 0)==0)
  (
    &wild_head=1
  )
  if (STRING.SCAN("&clk", "*", 1)==(STRING.LENGTH("&clk")-1))
  (
    &wild_tail=1
  )

  if ((&wild_head==1)&&(&wild_tail==1))
  (
    if (STRING.SCAN("gcc_sdcc1_ahb_clk", STRING.MID("&clk", 1, &clk_input_length-2), 0)!=-1)
    ( 
      &match=1
    )
  )
  else if (&wild_head==1)
  (
    if (STRING.MID("gcc_sdcc1_ahb_clk", &clk_itr_length-&clk_input_length+1, &clk_input_length-1)==STRING.CUT("&clk", 1))
    ( 
      &match=1
    )
  )
  else if (&wild_tail==1)
  (
    if (STRING.MID("gcc_sdcc1_ahb_clk", 0, &clk_input_length-1)==STRING.CUT("&clk", -1))
    ( 
      &match=1
    )
  )
  else if ("gcc_sdcc1_ahb_clk"=="&clk")
  (
    &match=1
  )
  
  if (&match==1)
  (
    &clk_test=&CLK_TEST_GCC_SDCC1_AHB_CLK
    &clk_reg=&HWIO_GCC_SDCC1_AHB_CBCR_ADDR
    &clk_reg_name="GCC_SDCC1_AHB_CBCR"
    &clk_name="gcc_sdcc1_ahb_clk"
    &clk_reg_cbcr_type="sm_cbc"
    &clk_vote_bit=-1.
    &clk_multiplier=1.

    gosub Print_Clk_Info_Line
  )

  &match=0
  &wild_head=0
  &wild_tail=0
  &clk_input_length=STRING.LENGTH("&clk")
  &clk_itr_length=STRING.LENGTH("gcc_sdcc2_ahb_clk")

  if (STRING.SCAN("&clk", "*", 0)==0)
  (
    &wild_head=1
  )
  if (STRING.SCAN("&clk", "*", 1)==(STRING.LENGTH("&clk")-1))
  (
    &wild_tail=1
  )

  if ((&wild_head==1)&&(&wild_tail==1))
  (
    if (STRING.SCAN("gcc_sdcc2_ahb_clk", STRING.MID("&clk", 1, &clk_input_length-2), 0)!=-1)
    ( 
      &match=1
    )
  )
  else if (&wild_head==1)
  (
    if (STRING.MID("gcc_sdcc2_ahb_clk", &clk_itr_length-&clk_input_length+1, &clk_input_length-1)==STRING.CUT("&clk", 1))
    ( 
      &match=1
    )
  )
  else if (&wild_tail==1)
  (
    if (STRING.MID("gcc_sdcc2_ahb_clk", 0, &clk_input_length-1)==STRING.CUT("&clk", -1))
    ( 
      &match=1
    )
  )
  else if ("gcc_sdcc2_ahb_clk"=="&clk")
  (
    &match=1
  )
  
  if (&match==1)
  (
    &clk_test=&CLK_TEST_GCC_SDCC2_AHB_CLK
    &clk_reg=&HWIO_GCC_SDCC2_AHB_CBCR_ADDR
    &clk_reg_name="GCC_SDCC2_AHB_CBCR"
    &clk_name="gcc_sdcc2_ahb_clk"
    &clk_reg_cbcr_type="sm_cbc"
    &clk_vote_bit=-1.
    &clk_multiplier=1.

    gosub Print_Clk_Info_Line
  )

  &match=0
  &wild_head=0
  &wild_tail=0
  &clk_input_length=STRING.LENGTH("&clk")
  &clk_itr_length=STRING.LENGTH("gcc_sdcc3_ahb_clk")

  if (STRING.SCAN("&clk", "*", 0)==0)
  (
    &wild_head=1
  )
  if (STRING.SCAN("&clk", "*", 1)==(STRING.LENGTH("&clk")-1))
  (
    &wild_tail=1
  )

  if ((&wild_head==1)&&(&wild_tail==1))
  (
    if (STRING.SCAN("gcc_sdcc3_ahb_clk", STRING.MID("&clk", 1, &clk_input_length-2), 0)!=-1)
    ( 
      &match=1
    )
  )
  else if (&wild_head==1)
  (
    if (STRING.MID("gcc_sdcc3_ahb_clk", &clk_itr_length-&clk_input_length+1, &clk_input_length-1)==STRING.CUT("&clk", 1))
    ( 
      &match=1
    )
  )
  else if (&wild_tail==1)
  (
    if (STRING.MID("gcc_sdcc3_ahb_clk", 0, &clk_input_length-1)==STRING.CUT("&clk", -1))
    ( 
      &match=1
    )
  )
  else if ("gcc_sdcc3_ahb_clk"=="&clk")
  (
    &match=1
  )
  
  if (&match==1)
  (
    &clk_test=&CLK_TEST_GCC_SDCC3_AHB_CLK
    &clk_reg=&HWIO_GCC_SDCC3_AHB_CBCR_ADDR
    &clk_reg_name="GCC_SDCC3_AHB_CBCR"
    &clk_name="gcc_sdcc3_ahb_clk"
    &clk_reg_cbcr_type="sm_cbc"
    &clk_vote_bit=-1.
    &clk_multiplier=1.

    gosub Print_Clk_Info_Line
  )

  &match=0
  &wild_head=0
  &wild_tail=0
  &clk_input_length=STRING.LENGTH("&clk")
  &clk_itr_length=STRING.LENGTH("gcc_sdcc4_ahb_clk")

  if (STRING.SCAN("&clk", "*", 0)==0)
  (
    &wild_head=1
  )
  if (STRING.SCAN("&clk", "*", 1)==(STRING.LENGTH("&clk")-1))
  (
    &wild_tail=1
  )

  if ((&wild_head==1)&&(&wild_tail==1))
  (
    if (STRING.SCAN("gcc_sdcc4_ahb_clk", STRING.MID("&clk", 1, &clk_input_length-2), 0)!=-1)
    ( 
      &match=1
    )
  )
  else if (&wild_head==1)
  (
    if (STRING.MID("gcc_sdcc4_ahb_clk", &clk_itr_length-&clk_input_length+1, &clk_input_length-1)==STRING.CUT("&clk", 1))
    ( 
      &match=1
    )
  )
  else if (&wild_tail==1)
  (
    if (STRING.MID("gcc_sdcc4_ahb_clk", 0, &clk_input_length-1)==STRING.CUT("&clk", -1))
    ( 
      &match=1
    )
  )
  else if ("gcc_sdcc4_ahb_clk"=="&clk")
  (
    &match=1
  )
  
  if (&match==1)
  (
    &clk_test=&CLK_TEST_GCC_SDCC4_AHB_CLK
    &clk_reg=&HWIO_GCC_SDCC4_AHB_CBCR_ADDR
    &clk_reg_name="GCC_SDCC4_AHB_CBCR"
    &clk_name="gcc_sdcc4_ahb_clk"
    &clk_reg_cbcr_type="sm_cbc"
    &clk_vote_bit=-1.
    &clk_multiplier=1.

    gosub Print_Clk_Info_Line
  )

  &match=0
  &wild_head=0
  &wild_tail=0
  &clk_input_length=STRING.LENGTH("&clk")
  &clk_itr_length=STRING.LENGTH("gcc_snoc_pnoc_ahb_clk")

  if (STRING.SCAN("&clk", "*", 0)==0)
  (
    &wild_head=1
  )
  if (STRING.SCAN("&clk", "*", 1)==(STRING.LENGTH("&clk")-1))
  (
    &wild_tail=1
  )

  if ((&wild_head==1)&&(&wild_tail==1))
  (
    if (STRING.SCAN("gcc_snoc_pnoc_ahb_clk", STRING.MID("&clk", 1, &clk_input_length-2), 0)!=-1)
    ( 
      &match=1
    )
  )
  else if (&wild_head==1)
  (
    if (STRING.MID("gcc_snoc_pnoc_ahb_clk", &clk_itr_length-&clk_input_length+1, &clk_input_length-1)==STRING.CUT("&clk", 1))
    ( 
      &match=1
    )
  )
  else if (&wild_tail==1)
  (
    if (STRING.MID("gcc_snoc_pnoc_ahb_clk", 0, &clk_input_length-1)==STRING.CUT("&clk", -1))
    ( 
      &match=1
    )
  )
  else if ("gcc_snoc_pnoc_ahb_clk"=="&clk")
  (
    &match=1
  )
  
  if (&match==1)
  (
    &clk_test=&CLK_TEST_GCC_SNOC_PNOC_AHB_CLK
    &clk_reg=&HWIO_GCC_SNOC_PNOC_AHB_CBCR_ADDR
    &clk_reg_name="GCC_SNOC_PNOC_AHB_CBCR"
    &clk_name="gcc_snoc_pnoc_ahb_clk"
    &clk_reg_cbcr_type="sm_cbc"
    &clk_vote_bit=-1.
    &clk_multiplier=1.

    gosub Print_Clk_Info_Line
  )

  &match=0
  &wild_head=0
  &wild_tail=0
  &clk_input_length=STRING.LENGTH("&clk")
  &clk_itr_length=STRING.LENGTH("gcc_spdm_pnoc_cy_clk")

  if (STRING.SCAN("&clk", "*", 0)==0)
  (
    &wild_head=1
  )
  if (STRING.SCAN("&clk", "*", 1)==(STRING.LENGTH("&clk")-1))
  (
    &wild_tail=1
  )

  if ((&wild_head==1)&&(&wild_tail==1))
  (
    if (STRING.SCAN("gcc_spdm_pnoc_cy_clk", STRING.MID("&clk", 1, &clk_input_length-2), 0)!=-1)
    ( 
      &match=1
    )
  )
  else if (&wild_head==1)
  (
    if (STRING.MID("gcc_spdm_pnoc_cy_clk", &clk_itr_length-&clk_input_length+1, &clk_input_length-1)==STRING.CUT("&clk", 1))
    ( 
      &match=1
    )
  )
  else if (&wild_tail==1)
  (
    if (STRING.MID("gcc_spdm_pnoc_cy_clk", 0, &clk_input_length-1)==STRING.CUT("&clk", -1))
    ( 
      &match=1
    )
  )
  else if ("gcc_spdm_pnoc_cy_clk"=="&clk")
  (
    &match=1
  )
  
  if (&match==1)
  (
    &clk_test=&CLK_TEST_GCC_SPDM_PNOC_CY_CLK
    &clk_reg=&HWIO_GCC_SPDM_PNOC_CY_CBCR_ADDR
    &clk_reg_name="GCC_SPDM_PNOC_CY_CBCR"
    &clk_name="gcc_spdm_pnoc_cy_clk"
    &clk_reg_cbcr_type="sm_cbc"
    &clk_vote_bit=-1.
    &clk_multiplier=1.

    gosub Print_Clk_Info_Line
  )

  &match=0
  &wild_head=0
  &wild_tail=0
  &clk_input_length=STRING.LENGTH("&clk")
  &clk_itr_length=STRING.LENGTH("gcc_tsif_ahb_clk")

  if (STRING.SCAN("&clk", "*", 0)==0)
  (
    &wild_head=1
  )
  if (STRING.SCAN("&clk", "*", 1)==(STRING.LENGTH("&clk")-1))
  (
    &wild_tail=1
  )

  if ((&wild_head==1)&&(&wild_tail==1))
  (
    if (STRING.SCAN("gcc_tsif_ahb_clk", STRING.MID("&clk", 1, &clk_input_length-2), 0)!=-1)
    ( 
      &match=1
    )
  )
  else if (&wild_head==1)
  (
    if (STRING.MID("gcc_tsif_ahb_clk", &clk_itr_length-&clk_input_length+1, &clk_input_length-1)==STRING.CUT("&clk", 1))
    ( 
      &match=1
    )
  )
  else if (&wild_tail==1)
  (
    if (STRING.MID("gcc_tsif_ahb_clk", 0, &clk_input_length-1)==STRING.CUT("&clk", -1))
    ( 
      &match=1
    )
  )
  else if ("gcc_tsif_ahb_clk"=="&clk")
  (
    &match=1
  )
  
  if (&match==1)
  (
    &clk_test=&CLK_TEST_GCC_TSIF_AHB_CLK
    &clk_reg=&HWIO_GCC_TSIF_AHB_CBCR_ADDR
    &clk_reg_name="GCC_TSIF_AHB_CBCR"
    &clk_name="gcc_tsif_ahb_clk"
    &clk_reg_cbcr_type="sm_pscbc"
    &clk_vote_bit=-1.
    &clk_multiplier=1.

    gosub Print_Clk_Info_Line
  )

  &match=0
  &wild_head=0
  &wild_tail=0
  &clk_input_length=STRING.LENGTH("&clk")
  &clk_itr_length=STRING.LENGTH("gcc_usb_phy_cfg_ahb2phy_clk")

  if (STRING.SCAN("&clk", "*", 0)==0)
  (
    &wild_head=1
  )
  if (STRING.SCAN("&clk", "*", 1)==(STRING.LENGTH("&clk")-1))
  (
    &wild_tail=1
  )

  if ((&wild_head==1)&&(&wild_tail==1))
  (
    if (STRING.SCAN("gcc_usb_phy_cfg_ahb2phy_clk", STRING.MID("&clk", 1, &clk_input_length-2), 0)!=-1)
    ( 
      &match=1
    )
  )
  else if (&wild_head==1)
  (
    if (STRING.MID("gcc_usb_phy_cfg_ahb2phy_clk", &clk_itr_length-&clk_input_length+1, &clk_input_length-1)==STRING.CUT("&clk", 1))
    ( 
      &match=1
    )
  )
  else if (&wild_tail==1)
  (
    if (STRING.MID("gcc_usb_phy_cfg_ahb2phy_clk", 0, &clk_input_length-1)==STRING.CUT("&clk", -1))
    ( 
      &match=1
    )
  )
  else if ("gcc_usb_phy_cfg_ahb2phy_clk"=="&clk")
  (
    &match=1
  )
  
  if (&match==1)
  (
    &clk_test=&CLK_TEST_GCC_USB_PHY_CFG_AHB2PHY_CLK
    &clk_reg=&HWIO_GCC_USB_PHY_CFG_AHB2PHY_CBCR_ADDR
    &clk_reg_name="GCC_USB_PHY_CFG_AHB2PHY_CBCR"
    &clk_name="gcc_usb_phy_cfg_ahb2phy_clk"
    &clk_reg_cbcr_type="sm_cbc"
    &clk_vote_bit=-1.
    &clk_multiplier=1.

    gosub Print_Clk_Info_Line
  )

  &match=0
  &wild_head=0
  &wild_tail=0
  &clk_input_length=STRING.LENGTH("&clk")
  &clk_itr_length=STRING.LENGTH("gcc_qspi_ahb_clk")

  if (STRING.SCAN("&clk", "*", 0)==0)
  (
    &wild_head=1
  )
  if (STRING.SCAN("&clk", "*", 1)==(STRING.LENGTH("&clk")-1))
  (
    &wild_tail=1
  )

  if ((&wild_head==1)&&(&wild_tail==1))
  (
    if (STRING.SCAN("gcc_qspi_ahb_clk", STRING.MID("&clk", 1, &clk_input_length-2), 0)!=-1)
    ( 
      &match=1
    )
  )
  else if (&wild_head==1)
  (
    if (STRING.MID("gcc_qspi_ahb_clk", &clk_itr_length-&clk_input_length+1, &clk_input_length-1)==STRING.CUT("&clk", 1))
    ( 
      &match=1
    )
  )
  else if (&wild_tail==1)
  (
    if (STRING.MID("gcc_qspi_ahb_clk", 0, &clk_input_length-1)==STRING.CUT("&clk", -1))
    ( 
      &match=1
    )
  )
  else if ("gcc_qspi_ahb_clk"=="&clk")
  (
    &match=1
  )
  
  if (&match==1)
  (
    &clk_test=&CLK_TEST_GCC_QSPI_AHB_CLK
    &clk_reg=&HWIO_GCC_QSPI_AHB_CBCR_ADDR
    &clk_reg_name="GCC_QSPI_AHB_CBCR"
    &clk_name="gcc_qspi_ahb_clk"
    &clk_reg_cbcr_type="sm_cbc"
    &clk_vote_bit=-1.
    &clk_multiplier=1.

    gosub Print_Clk_Info_Line
  )

  &match=0
  &wild_head=0
  &wild_tail=0
  &clk_input_length=STRING.LENGTH("&clk")
  &clk_itr_length=STRING.LENGTH("gcc_bimc_pimem_axi_clk")

  if (STRING.SCAN("&clk", "*", 0)==0)
  (
    &wild_head=1
  )
  if (STRING.SCAN("&clk", "*", 1)==(STRING.LENGTH("&clk")-1))
  (
    &wild_tail=1
  )

  if ((&wild_head==1)&&(&wild_tail==1))
  (
    if (STRING.SCAN("gcc_bimc_pimem_axi_clk", STRING.MID("&clk", 1, &clk_input_length-2), 0)!=-1)
    ( 
      &match=1
    )
  )
  else if (&wild_head==1)
  (
    if (STRING.MID("gcc_bimc_pimem_axi_clk", &clk_itr_length-&clk_input_length+1, &clk_input_length-1)==STRING.CUT("&clk", 1))
    ( 
      &match=1
    )
  )
  else if (&wild_tail==1)
  (
    if (STRING.MID("gcc_bimc_pimem_axi_clk", 0, &clk_input_length-1)==STRING.CUT("&clk", -1))
    ( 
      &match=1
    )
  )
  else if ("gcc_bimc_pimem_axi_clk"=="&clk")
  (
    &match=1
  )
  
  if (&match==1)
  (
    &clk_test=&CLK_TEST_GCC_BIMC_PIMEM_AXI_CLK
    &clk_reg=&HWIO_GCC_BIMC_PIMEM_AXI_CBCR_ADDR
    &clk_reg_name="GCC_BIMC_PIMEM_AXI_CBCR"
    &clk_name="gcc_bimc_pimem_axi_clk"
    &clk_reg_cbcr_type="sm_cbc"
    &clk_vote_bit=-1.
    &clk_multiplier=1.

    gosub Print_Clk_Info_Line
  )

  &match=0
  &wild_head=0
  &wild_tail=0
  &clk_input_length=STRING.LENGTH("&clk")
  &clk_itr_length=STRING.LENGTH("gcc_pimem_axi_clk")

  if (STRING.SCAN("&clk", "*", 0)==0)
  (
    &wild_head=1
  )
  if (STRING.SCAN("&clk", "*", 1)==(STRING.LENGTH("&clk")-1))
  (
    &wild_tail=1
  )

  if ((&wild_head==1)&&(&wild_tail==1))
  (
    if (STRING.SCAN("gcc_pimem_axi_clk", STRING.MID("&clk", 1, &clk_input_length-2), 0)!=-1)
    ( 
      &match=1
    )
  )
  else if (&wild_head==1)
  (
    if (STRING.MID("gcc_pimem_axi_clk", &clk_itr_length-&clk_input_length+1, &clk_input_length-1)==STRING.CUT("&clk", 1))
    ( 
      &match=1
    )
  )
  else if (&wild_tail==1)
  (
    if (STRING.MID("gcc_pimem_axi_clk", 0, &clk_input_length-1)==STRING.CUT("&clk", -1))
    ( 
      &match=1
    )
  )
  else if ("gcc_pimem_axi_clk"=="&clk")
  (
    &match=1
  )
  
  if (&match==1)
  (
    &clk_test=&CLK_TEST_GCC_PIMEM_AXI_CLK
    &clk_reg=&HWIO_GCC_PIMEM_AXI_CBCR_ADDR
    &clk_reg_name="GCC_PIMEM_AXI_CBCR"
    &clk_name="gcc_pimem_axi_clk"
    &clk_reg_cbcr_type="sm_pscbc"
    &clk_vote_bit=-1.
    &clk_multiplier=1.

    gosub Print_Clk_Info_Line
  )

  &match=0
  &wild_head=0
  &wild_tail=0
  &clk_input_length=STRING.LENGTH("&clk")
  &clk_itr_length=STRING.LENGTH("gcc_sys_noc_pimem_axi_clk")

  if (STRING.SCAN("&clk", "*", 0)==0)
  (
    &wild_head=1
  )
  if (STRING.SCAN("&clk", "*", 1)==(STRING.LENGTH("&clk")-1))
  (
    &wild_tail=1
  )

  if ((&wild_head==1)&&(&wild_tail==1))
  (
    if (STRING.SCAN("gcc_sys_noc_pimem_axi_clk", STRING.MID("&clk", 1, &clk_input_length-2), 0)!=-1)
    ( 
      &match=1
    )
  )
  else if (&wild_head==1)
  (
    if (STRING.MID("gcc_sys_noc_pimem_axi_clk", &clk_itr_length-&clk_input_length+1, &clk_input_length-1)==STRING.CUT("&clk", 1))
    ( 
      &match=1
    )
  )
  else if (&wild_tail==1)
  (
    if (STRING.MID("gcc_sys_noc_pimem_axi_clk", 0, &clk_input_length-1)==STRING.CUT("&clk", -1))
    ( 
      &match=1
    )
  )
  else if ("gcc_sys_noc_pimem_axi_clk"=="&clk")
  (
    &match=1
  )
  
  if (&match==1)
  (
    &clk_test=&CLK_TEST_GCC_SYS_NOC_PIMEM_AXI_CLK
    &clk_reg=&HWIO_GCC_SYS_NOC_PIMEM_AXI_CBCR_ADDR
    &clk_reg_name="GCC_SYS_NOC_PIMEM_AXI_CBCR"
    &clk_name="gcc_sys_noc_pimem_axi_clk"
    &clk_reg_cbcr_type="sm_cbc"
    &clk_vote_bit=-1.
    &clk_multiplier=1.

    gosub Print_Clk_Info_Line
  )

  &match=0
  &wild_head=0
  &wild_tail=0
  &clk_input_length=STRING.LENGTH("&clk")
  &clk_itr_length=STRING.LENGTH("gcc_aggre0_noc_at_clk")

  if (STRING.SCAN("&clk", "*", 0)==0)
  (
    &wild_head=1
  )
  if (STRING.SCAN("&clk", "*", 1)==(STRING.LENGTH("&clk")-1))
  (
    &wild_tail=1
  )

  if ((&wild_head==1)&&(&wild_tail==1))
  (
    if (STRING.SCAN("gcc_aggre0_noc_at_clk", STRING.MID("&clk", 1, &clk_input_length-2), 0)!=-1)
    ( 
      &match=1
    )
  )
  else if (&wild_head==1)
  (
    if (STRING.MID("gcc_aggre0_noc_at_clk", &clk_itr_length-&clk_input_length+1, &clk_input_length-1)==STRING.CUT("&clk", 1))
    ( 
      &match=1
    )
  )
  else if (&wild_tail==1)
  (
    if (STRING.MID("gcc_aggre0_noc_at_clk", 0, &clk_input_length-1)==STRING.CUT("&clk", -1))
    ( 
      &match=1
    )
  )
  else if ("gcc_aggre0_noc_at_clk"=="&clk")
  (
    &match=1
  )
  
  if (&match==1)
  (
    &clk_test=&CLK_TEST_GCC_AGGRE0_NOC_AT_CLK
    &clk_reg=&HWIO_GCC_AGGRE0_NOC_AT_CBCR_ADDR
    &clk_reg_name="GCC_AGGRE0_NOC_AT_CBCR"
    &clk_name="gcc_aggre0_noc_at_clk"
    &clk_reg_cbcr_type="sm_cbc"
    &clk_vote_bit=-1.
    &clk_multiplier=1.

    gosub Print_Clk_Info_Line
  )

  &match=0
  &wild_head=0
  &wild_tail=0
  &clk_input_length=STRING.LENGTH("&clk")
  &clk_itr_length=STRING.LENGTH("gcc_aggre1_noc_at_clk")

  if (STRING.SCAN("&clk", "*", 0)==0)
  (
    &wild_head=1
  )
  if (STRING.SCAN("&clk", "*", 1)==(STRING.LENGTH("&clk")-1))
  (
    &wild_tail=1
  )

  if ((&wild_head==1)&&(&wild_tail==1))
  (
    if (STRING.SCAN("gcc_aggre1_noc_at_clk", STRING.MID("&clk", 1, &clk_input_length-2), 0)!=-1)
    ( 
      &match=1
    )
  )
  else if (&wild_head==1)
  (
    if (STRING.MID("gcc_aggre1_noc_at_clk", &clk_itr_length-&clk_input_length+1, &clk_input_length-1)==STRING.CUT("&clk", 1))
    ( 
      &match=1
    )
  )
  else if (&wild_tail==1)
  (
    if (STRING.MID("gcc_aggre1_noc_at_clk", 0, &clk_input_length-1)==STRING.CUT("&clk", -1))
    ( 
      &match=1
    )
  )
  else if ("gcc_aggre1_noc_at_clk"=="&clk")
  (
    &match=1
  )
  
  if (&match==1)
  (
    &clk_test=&CLK_TEST_GCC_AGGRE1_NOC_AT_CLK
    &clk_reg=&HWIO_GCC_AGGRE1_NOC_AT_CBCR_ADDR
    &clk_reg_name="GCC_AGGRE1_NOC_AT_CBCR"
    &clk_name="gcc_aggre1_noc_at_clk"
    &clk_reg_cbcr_type="sm_cbc"
    &clk_vote_bit=-1.
    &clk_multiplier=1.

    gosub Print_Clk_Info_Line
  )

  &match=0
  &wild_head=0
  &wild_tail=0
  &clk_input_length=STRING.LENGTH("&clk")
  &clk_itr_length=STRING.LENGTH("gcc_aggre2_noc_at_clk")

  if (STRING.SCAN("&clk", "*", 0)==0)
  (
    &wild_head=1
  )
  if (STRING.SCAN("&clk", "*", 1)==(STRING.LENGTH("&clk")-1))
  (
    &wild_tail=1
  )

  if ((&wild_head==1)&&(&wild_tail==1))
  (
    if (STRING.SCAN("gcc_aggre2_noc_at_clk", STRING.MID("&clk", 1, &clk_input_length-2), 0)!=-1)
    ( 
      &match=1
    )
  )
  else if (&wild_head==1)
  (
    if (STRING.MID("gcc_aggre2_noc_at_clk", &clk_itr_length-&clk_input_length+1, &clk_input_length-1)==STRING.CUT("&clk", 1))
    ( 
      &match=1
    )
  )
  else if (&wild_tail==1)
  (
    if (STRING.MID("gcc_aggre2_noc_at_clk", 0, &clk_input_length-1)==STRING.CUT("&clk", -1))
    ( 
      &match=1
    )
  )
  else if ("gcc_aggre2_noc_at_clk"=="&clk")
  (
    &match=1
  )
  
  if (&match==1)
  (
    &clk_test=&CLK_TEST_GCC_AGGRE2_NOC_AT_CLK
    &clk_reg=&HWIO_GCC_AGGRE2_NOC_AT_CBCR_ADDR
    &clk_reg_name="GCC_AGGRE2_NOC_AT_CBCR"
    &clk_name="gcc_aggre2_noc_at_clk"
    &clk_reg_cbcr_type="sm_cbc"
    &clk_vote_bit=-1.
    &clk_multiplier=1.

    gosub Print_Clk_Info_Line
  )

  &match=0
  &wild_head=0
  &wild_tail=0
  &clk_input_length=STRING.LENGTH("&clk")
  &clk_itr_length=STRING.LENGTH("gcc_mmss_noc_at_clk")

  if (STRING.SCAN("&clk", "*", 0)==0)
  (
    &wild_head=1
  )
  if (STRING.SCAN("&clk", "*", 1)==(STRING.LENGTH("&clk")-1))
  (
    &wild_tail=1
  )

  if ((&wild_head==1)&&(&wild_tail==1))
  (
    if (STRING.SCAN("gcc_mmss_noc_at_clk", STRING.MID("&clk", 1, &clk_input_length-2), 0)!=-1)
    ( 
      &match=1
    )
  )
  else if (&wild_head==1)
  (
    if (STRING.MID("gcc_mmss_noc_at_clk", &clk_itr_length-&clk_input_length+1, &clk_input_length-1)==STRING.CUT("&clk", 1))
    ( 
      &match=1
    )
  )
  else if (&wild_tail==1)
  (
    if (STRING.MID("gcc_mmss_noc_at_clk", 0, &clk_input_length-1)==STRING.CUT("&clk", -1))
    ( 
      &match=1
    )
  )
  else if ("gcc_mmss_noc_at_clk"=="&clk")
  (
    &match=1
  )
  
  if (&match==1)
  (
    &clk_test=&CLK_TEST_GCC_MMSS_NOC_AT_CLK
    &clk_reg=&HWIO_GCC_MMSS_NOC_AT_CBCR_ADDR
    &clk_reg_name="GCC_MMSS_NOC_AT_CBCR"
    &clk_name="gcc_mmss_noc_at_clk"
    &clk_reg_cbcr_type="sm_cbc"
    &clk_vote_bit=-1.
    &clk_multiplier=1.

    gosub Print_Clk_Info_Line
  )

  &match=0
  &wild_head=0
  &wild_tail=0
  &clk_input_length=STRING.LENGTH("&clk")
  &clk_itr_length=STRING.LENGTH("gcc_periph_noc_at_clk")

  if (STRING.SCAN("&clk", "*", 0)==0)
  (
    &wild_head=1
  )
  if (STRING.SCAN("&clk", "*", 1)==(STRING.LENGTH("&clk")-1))
  (
    &wild_tail=1
  )

  if ((&wild_head==1)&&(&wild_tail==1))
  (
    if (STRING.SCAN("gcc_periph_noc_at_clk", STRING.MID("&clk", 1, &clk_input_length-2), 0)!=-1)
    ( 
      &match=1
    )
  )
  else if (&wild_head==1)
  (
    if (STRING.MID("gcc_periph_noc_at_clk", &clk_itr_length-&clk_input_length+1, &clk_input_length-1)==STRING.CUT("&clk", 1))
    ( 
      &match=1
    )
  )
  else if (&wild_tail==1)
  (
    if (STRING.MID("gcc_periph_noc_at_clk", 0, &clk_input_length-1)==STRING.CUT("&clk", -1))
    ( 
      &match=1
    )
  )
  else if ("gcc_periph_noc_at_clk"=="&clk")
  (
    &match=1
  )
  
  if (&match==1)
  (
    &clk_test=&CLK_TEST_GCC_PERIPH_NOC_AT_CLK
    &clk_reg=&HWIO_GCC_PERIPH_NOC_AT_CBCR_ADDR
    &clk_reg_name="GCC_PERIPH_NOC_AT_CBCR"
    &clk_name="gcc_periph_noc_at_clk"
    &clk_reg_cbcr_type="sm_cbc"
    &clk_vote_bit=-1.
    &clk_multiplier=1.

    gosub Print_Clk_Info_Line
  )

  &match=0
  &wild_head=0
  &wild_tail=0
  &clk_input_length=STRING.LENGTH("&clk")
  &clk_itr_length=STRING.LENGTH("gcc_qdss_at_clk")

  if (STRING.SCAN("&clk", "*", 0)==0)
  (
    &wild_head=1
  )
  if (STRING.SCAN("&clk", "*", 1)==(STRING.LENGTH("&clk")-1))
  (
    &wild_tail=1
  )

  if ((&wild_head==1)&&(&wild_tail==1))
  (
    if (STRING.SCAN("gcc_qdss_at_clk", STRING.MID("&clk", 1, &clk_input_length-2), 0)!=-1)
    ( 
      &match=1
    )
  )
  else if (&wild_head==1)
  (
    if (STRING.MID("gcc_qdss_at_clk", &clk_itr_length-&clk_input_length+1, &clk_input_length-1)==STRING.CUT("&clk", 1))
    ( 
      &match=1
    )
  )
  else if (&wild_tail==1)
  (
    if (STRING.MID("gcc_qdss_at_clk", 0, &clk_input_length-1)==STRING.CUT("&clk", -1))
    ( 
      &match=1
    )
  )
  else if ("gcc_qdss_at_clk"=="&clk")
  (
    &match=1
  )
  
  if (&match==1)
  (
    &clk_test=&CLK_TEST_GCC_QDSS_AT_CLK
    &clk_reg=&HWIO_GCC_QDSS_AT_CBCR_ADDR
    &clk_reg_name="GCC_QDSS_AT_CBCR"
    &clk_name="gcc_qdss_at_clk"
    &clk_reg_cbcr_type="sm_pscbc"
    &clk_vote_bit=-1.
    &clk_multiplier=1.

    gosub Print_Clk_Info_Line
  )

  &match=0
  &wild_head=0
  &wild_tail=0
  &clk_input_length=STRING.LENGTH("&clk")
  &clk_itr_length=STRING.LENGTH("gcc_ssc_at_clk")

  if (STRING.SCAN("&clk", "*", 0)==0)
  (
    &wild_head=1
  )
  if (STRING.SCAN("&clk", "*", 1)==(STRING.LENGTH("&clk")-1))
  (
    &wild_tail=1
  )

  if ((&wild_head==1)&&(&wild_tail==1))
  (
    if (STRING.SCAN("gcc_ssc_at_clk", STRING.MID("&clk", 1, &clk_input_length-2), 0)!=-1)
    ( 
      &match=1
    )
  )
  else if (&wild_head==1)
  (
    if (STRING.MID("gcc_ssc_at_clk", &clk_itr_length-&clk_input_length+1, &clk_input_length-1)==STRING.CUT("&clk", 1))
    ( 
      &match=1
    )
  )
  else if (&wild_tail==1)
  (
    if (STRING.MID("gcc_ssc_at_clk", 0, &clk_input_length-1)==STRING.CUT("&clk", -1))
    ( 
      &match=1
    )
  )
  else if ("gcc_ssc_at_clk"=="&clk")
  (
    &match=1
  )
  
  if (&match==1)
  (
    &clk_test=&CLK_TEST_GCC_SSC_AT_CLK
    &clk_reg=&HWIO_GCC_SSC_AT_CBCR_ADDR
    &clk_reg_name="GCC_SSC_AT_CBCR"
    &clk_name="gcc_ssc_at_clk"
    &clk_reg_cbcr_type="sm_cbc"
    &clk_vote_bit=-1.
    &clk_multiplier=1.

    gosub Print_Clk_Info_Line
  )

  &match=0
  &wild_head=0
  &wild_tail=0
  &clk_input_length=STRING.LENGTH("&clk")
  &clk_itr_length=STRING.LENGTH("gcc_sys_noc_at_clk")

  if (STRING.SCAN("&clk", "*", 0)==0)
  (
    &wild_head=1
  )
  if (STRING.SCAN("&clk", "*", 1)==(STRING.LENGTH("&clk")-1))
  (
    &wild_tail=1
  )

  if ((&wild_head==1)&&(&wild_tail==1))
  (
    if (STRING.SCAN("gcc_sys_noc_at_clk", STRING.MID("&clk", 1, &clk_input_length-2), 0)!=-1)
    ( 
      &match=1
    )
  )
  else if (&wild_head==1)
  (
    if (STRING.MID("gcc_sys_noc_at_clk", &clk_itr_length-&clk_input_length+1, &clk_input_length-1)==STRING.CUT("&clk", 1))
    ( 
      &match=1
    )
  )
  else if (&wild_tail==1)
  (
    if (STRING.MID("gcc_sys_noc_at_clk", 0, &clk_input_length-1)==STRING.CUT("&clk", -1))
    ( 
      &match=1
    )
  )
  else if ("gcc_sys_noc_at_clk"=="&clk")
  (
    &match=1
  )
  
  if (&match==1)
  (
    &clk_test=&CLK_TEST_GCC_SYS_NOC_AT_CLK
    &clk_reg=&HWIO_GCC_SYS_NOC_AT_CBCR_ADDR
    &clk_reg_name="GCC_SYS_NOC_AT_CBCR"
    &clk_name="gcc_sys_noc_at_clk"
    &clk_reg_cbcr_type="sm_cbc"
    &clk_vote_bit=-1.
    &clk_multiplier=1.

    gosub Print_Clk_Info_Line
  )

  &match=0
  &wild_head=0
  &wild_tail=0
  &clk_input_length=STRING.LENGTH("&clk")
  &clk_itr_length=STRING.LENGTH("gcc_qdss_stm_clk")

  if (STRING.SCAN("&clk", "*", 0)==0)
  (
    &wild_head=1
  )
  if (STRING.SCAN("&clk", "*", 1)==(STRING.LENGTH("&clk")-1))
  (
    &wild_tail=1
  )

  if ((&wild_head==1)&&(&wild_tail==1))
  (
    if (STRING.SCAN("gcc_qdss_stm_clk", STRING.MID("&clk", 1, &clk_input_length-2), 0)!=-1)
    ( 
      &match=1
    )
  )
  else if (&wild_head==1)
  (
    if (STRING.MID("gcc_qdss_stm_clk", &clk_itr_length-&clk_input_length+1, &clk_input_length-1)==STRING.CUT("&clk", 1))
    ( 
      &match=1
    )
  )
  else if (&wild_tail==1)
  (
    if (STRING.MID("gcc_qdss_stm_clk", 0, &clk_input_length-1)==STRING.CUT("&clk", -1))
    ( 
      &match=1
    )
  )
  else if ("gcc_qdss_stm_clk"=="&clk")
  (
    &match=1
  )
  
  if (&match==1)
  (
    &clk_test=&CLK_TEST_GCC_QDSS_STM_CLK
    &clk_reg=&HWIO_GCC_QDSS_STM_CBCR_ADDR
    &clk_reg_name="GCC_QDSS_STM_CBCR"
    &clk_name="gcc_qdss_stm_clk"
    &clk_reg_cbcr_type="sm_cbc"
    &clk_vote_bit=-1.
    &clk_multiplier=1.

    gosub Print_Clk_Info_Line
  )

  &match=0
  &wild_head=0
  &wild_tail=0
  &clk_input_length=STRING.LENGTH("&clk")
  &clk_itr_length=STRING.LENGTH("gcc_sys_noc_qdss_stm_axi_clk")

  if (STRING.SCAN("&clk", "*", 0)==0)
  (
    &wild_head=1
  )
  if (STRING.SCAN("&clk", "*", 1)==(STRING.LENGTH("&clk")-1))
  (
    &wild_tail=1
  )

  if ((&wild_head==1)&&(&wild_tail==1))
  (
    if (STRING.SCAN("gcc_sys_noc_qdss_stm_axi_clk", STRING.MID("&clk", 1, &clk_input_length-2), 0)!=-1)
    ( 
      &match=1
    )
  )
  else if (&wild_head==1)
  (
    if (STRING.MID("gcc_sys_noc_qdss_stm_axi_clk", &clk_itr_length-&clk_input_length+1, &clk_input_length-1)==STRING.CUT("&clk", 1))
    ( 
      &match=1
    )
  )
  else if (&wild_tail==1)
  (
    if (STRING.MID("gcc_sys_noc_qdss_stm_axi_clk", 0, &clk_input_length-1)==STRING.CUT("&clk", -1))
    ( 
      &match=1
    )
  )
  else if ("gcc_sys_noc_qdss_stm_axi_clk"=="&clk")
  (
    &match=1
  )
  
  if (&match==1)
  (
    &clk_test=&CLK_TEST_GCC_SYS_NOC_QDSS_STM_AXI_CLK
    &clk_reg=&HWIO_GCC_SYS_NOC_QDSS_STM_AXI_CBCR_ADDR
    &clk_reg_name="GCC_SYS_NOC_QDSS_STM_AXI_CBCR"
    &clk_name="gcc_sys_noc_qdss_stm_axi_clk"
    &clk_reg_cbcr_type="sm_cbc"
    &clk_vote_bit=-1.
    &clk_multiplier=1.

    gosub Print_Clk_Info_Line
  )

  &match=0
  &wild_head=0
  &wild_tail=0
  &clk_input_length=STRING.LENGTH("&clk")
  &clk_itr_length=STRING.LENGTH("gcc_qdss_traceclkin_clk")

  if (STRING.SCAN("&clk", "*", 0)==0)
  (
    &wild_head=1
  )
  if (STRING.SCAN("&clk", "*", 1)==(STRING.LENGTH("&clk")-1))
  (
    &wild_tail=1
  )

  if ((&wild_head==1)&&(&wild_tail==1))
  (
    if (STRING.SCAN("gcc_qdss_traceclkin_clk", STRING.MID("&clk", 1, &clk_input_length-2), 0)!=-1)
    ( 
      &match=1
    )
  )
  else if (&wild_head==1)
  (
    if (STRING.MID("gcc_qdss_traceclkin_clk", &clk_itr_length-&clk_input_length+1, &clk_input_length-1)==STRING.CUT("&clk", 1))
    ( 
      &match=1
    )
  )
  else if (&wild_tail==1)
  (
    if (STRING.MID("gcc_qdss_traceclkin_clk", 0, &clk_input_length-1)==STRING.CUT("&clk", -1))
    ( 
      &match=1
    )
  )
  else if ("gcc_qdss_traceclkin_clk"=="&clk")
  (
    &match=1
  )
  
  if (&match==1)
  (
    &clk_test=&CLK_TEST_GCC_QDSS_TRACECLKIN_CLK
    &clk_reg=&HWIO_GCC_QDSS_TRACECLKIN_CBCR_ADDR
    &clk_reg_name="GCC_QDSS_TRACECLKIN_CBCR"
    &clk_name="gcc_qdss_traceclkin_clk"
    &clk_reg_cbcr_type="sm_cbc"
    &clk_vote_bit=-1.
    &clk_multiplier=1.

    gosub Print_Clk_Info_Line
  )

  &match=0
  &wild_head=0
  &wild_tail=0
  &clk_input_length=STRING.LENGTH("&clk")
  &clk_itr_length=STRING.LENGTH("gcc_qdss_apb2jtag_clk")

  if (STRING.SCAN("&clk", "*", 0)==0)
  (
    &wild_head=1
  )
  if (STRING.SCAN("&clk", "*", 1)==(STRING.LENGTH("&clk")-1))
  (
    &wild_tail=1
  )

  if ((&wild_head==1)&&(&wild_tail==1))
  (
    if (STRING.SCAN("gcc_qdss_apb2jtag_clk", STRING.MID("&clk", 1, &clk_input_length-2), 0)!=-1)
    ( 
      &match=1
    )
  )
  else if (&wild_head==1)
  (
    if (STRING.MID("gcc_qdss_apb2jtag_clk", &clk_itr_length-&clk_input_length+1, &clk_input_length-1)==STRING.CUT("&clk", 1))
    ( 
      &match=1
    )
  )
  else if (&wild_tail==1)
  (
    if (STRING.MID("gcc_qdss_apb2jtag_clk", 0, &clk_input_length-1)==STRING.CUT("&clk", -1))
    ( 
      &match=1
    )
  )
  else if ("gcc_qdss_apb2jtag_clk"=="&clk")
  (
    &match=1
  )
  
  if (&match==1)
  (
    &clk_test=&CLK_TEST_GCC_QDSS_APB2JTAG_CLK
    &clk_reg=&HWIO_GCC_QDSS_APB2JTAG_CBCR_ADDR
    &clk_reg_name="GCC_QDSS_APB2JTAG_CBCR"
    &clk_name="gcc_qdss_apb2jtag_clk"
    &clk_reg_cbcr_type="sm_cbc"
    &clk_vote_bit=-1.
    &clk_multiplier=1.

    gosub Print_Clk_Info_Line
  )

  &match=0
  &wild_head=0
  &wild_tail=0
  &clk_input_length=STRING.LENGTH("&clk")
  &clk_itr_length=STRING.LENGTH("gcc_qdss_dap_clk")

  if (STRING.SCAN("&clk", "*", 0)==0)
  (
    &wild_head=1
  )
  if (STRING.SCAN("&clk", "*", 1)==(STRING.LENGTH("&clk")-1))
  (
    &wild_tail=1
  )

  if ((&wild_head==1)&&(&wild_tail==1))
  (
    if (STRING.SCAN("gcc_qdss_dap_clk", STRING.MID("&clk", 1, &clk_input_length-2), 0)!=-1)
    ( 
      &match=1
    )
  )
  else if (&wild_head==1)
  (
    if (STRING.MID("gcc_qdss_dap_clk", &clk_itr_length-&clk_input_length+1, &clk_input_length-1)==STRING.CUT("&clk", 1))
    ( 
      &match=1
    )
  )
  else if (&wild_tail==1)
  (
    if (STRING.MID("gcc_qdss_dap_clk", 0, &clk_input_length-1)==STRING.CUT("&clk", -1))
    ( 
      &match=1
    )
  )
  else if ("gcc_qdss_dap_clk"=="&clk")
  (
    &match=1
  )
  
  if (&match==1)
  (
    &clk_test=&CLK_TEST_GCC_QDSS_DAP_CLK
    &clk_reg=&HWIO_GCC_QDSS_DAP_CBCR_ADDR
    &clk_reg_name="GCC_QDSS_DAP_CBCR"
    &clk_name="gcc_qdss_dap_clk"
    &clk_reg_cbcr_type="sm_cbc"
    &clk_vote_bit=-1.
    &clk_multiplier=1.

    gosub Print_Clk_Info_Line
  )

  &match=0
  &wild_head=0
  &wild_tail=0
  &clk_input_length=STRING.LENGTH("&clk")
  &clk_itr_length=STRING.LENGTH("gcc_qdss_tsctr_div16_clk")

  if (STRING.SCAN("&clk", "*", 0)==0)
  (
    &wild_head=1
  )
  if (STRING.SCAN("&clk", "*", 1)==(STRING.LENGTH("&clk")-1))
  (
    &wild_tail=1
  )

  if ((&wild_head==1)&&(&wild_tail==1))
  (
    if (STRING.SCAN("gcc_qdss_tsctr_div16_clk", STRING.MID("&clk", 1, &clk_input_length-2), 0)!=-1)
    ( 
      &match=1
    )
  )
  else if (&wild_head==1)
  (
    if (STRING.MID("gcc_qdss_tsctr_div16_clk", &clk_itr_length-&clk_input_length+1, &clk_input_length-1)==STRING.CUT("&clk", 1))
    ( 
      &match=1
    )
  )
  else if (&wild_tail==1)
  (
    if (STRING.MID("gcc_qdss_tsctr_div16_clk", 0, &clk_input_length-1)==STRING.CUT("&clk", -1))
    ( 
      &match=1
    )
  )
  else if ("gcc_qdss_tsctr_div16_clk"=="&clk")
  (
    &match=1
  )
  
  if (&match==1)
  (
    &clk_test=&CLK_TEST_GCC_QDSS_TSCTR_DIV16_CLK
    &clk_reg=&HWIO_GCC_QDSS_TSCTR_DIV16_CBCR_ADDR
    &clk_reg_name="GCC_QDSS_TSCTR_DIV16_CBCR"
    &clk_name="gcc_qdss_tsctr_div16_clk"
    &clk_reg_cbcr_type="sm_cbc"
    &clk_vote_bit=-1.
    &clk_multiplier=1.

    gosub Print_Clk_Info_Line
  )

  &match=0
  &wild_head=0
  &wild_tail=0
  &clk_input_length=STRING.LENGTH("&clk")
  &clk_itr_length=STRING.LENGTH("gcc_qdss_tsctr_div2_clk")

  if (STRING.SCAN("&clk", "*", 0)==0)
  (
    &wild_head=1
  )
  if (STRING.SCAN("&clk", "*", 1)==(STRING.LENGTH("&clk")-1))
  (
    &wild_tail=1
  )

  if ((&wild_head==1)&&(&wild_tail==1))
  (
    if (STRING.SCAN("gcc_qdss_tsctr_div2_clk", STRING.MID("&clk", 1, &clk_input_length-2), 0)!=-1)
    ( 
      &match=1
    )
  )
  else if (&wild_head==1)
  (
    if (STRING.MID("gcc_qdss_tsctr_div2_clk", &clk_itr_length-&clk_input_length+1, &clk_input_length-1)==STRING.CUT("&clk", 1))
    ( 
      &match=1
    )
  )
  else if (&wild_tail==1)
  (
    if (STRING.MID("gcc_qdss_tsctr_div2_clk", 0, &clk_input_length-1)==STRING.CUT("&clk", -1))
    ( 
      &match=1
    )
  )
  else if ("gcc_qdss_tsctr_div2_clk"=="&clk")
  (
    &match=1
  )
  
  if (&match==1)
  (
    &clk_test=&CLK_TEST_GCC_QDSS_TSCTR_DIV2_CLK
    &clk_reg=&HWIO_GCC_QDSS_TSCTR_DIV2_CBCR_ADDR
    &clk_reg_name="GCC_QDSS_TSCTR_DIV2_CBCR"
    &clk_name="gcc_qdss_tsctr_div2_clk"
    &clk_reg_cbcr_type="sm_cbc"
    &clk_vote_bit=-1.
    &clk_multiplier=1.

    gosub Print_Clk_Info_Line
  )

  &match=0
  &wild_head=0
  &wild_tail=0
  &clk_input_length=STRING.LENGTH("&clk")
  &clk_itr_length=STRING.LENGTH("gcc_qdss_tsctr_div3_clk")

  if (STRING.SCAN("&clk", "*", 0)==0)
  (
    &wild_head=1
  )
  if (STRING.SCAN("&clk", "*", 1)==(STRING.LENGTH("&clk")-1))
  (
    &wild_tail=1
  )

  if ((&wild_head==1)&&(&wild_tail==1))
  (
    if (STRING.SCAN("gcc_qdss_tsctr_div3_clk", STRING.MID("&clk", 1, &clk_input_length-2), 0)!=-1)
    ( 
      &match=1
    )
  )
  else if (&wild_head==1)
  (
    if (STRING.MID("gcc_qdss_tsctr_div3_clk", &clk_itr_length-&clk_input_length+1, &clk_input_length-1)==STRING.CUT("&clk", 1))
    ( 
      &match=1
    )
  )
  else if (&wild_tail==1)
  (
    if (STRING.MID("gcc_qdss_tsctr_div3_clk", 0, &clk_input_length-1)==STRING.CUT("&clk", -1))
    ( 
      &match=1
    )
  )
  else if ("gcc_qdss_tsctr_div3_clk"=="&clk")
  (
    &match=1
  )
  
  if (&match==1)
  (
    &clk_test=&CLK_TEST_GCC_QDSS_TSCTR_DIV3_CLK
    &clk_reg=&HWIO_GCC_QDSS_TSCTR_DIV3_CBCR_ADDR
    &clk_reg_name="GCC_QDSS_TSCTR_DIV3_CBCR"
    &clk_name="gcc_qdss_tsctr_div3_clk"
    &clk_reg_cbcr_type="sm_cbc"
    &clk_vote_bit=-1.
    &clk_multiplier=1.

    gosub Print_Clk_Info_Line
  )

  &match=0
  &wild_head=0
  &wild_tail=0
  &clk_input_length=STRING.LENGTH("&clk")
  &clk_itr_length=STRING.LENGTH("gcc_qdss_tsctr_div4_clk")

  if (STRING.SCAN("&clk", "*", 0)==0)
  (
    &wild_head=1
  )
  if (STRING.SCAN("&clk", "*", 1)==(STRING.LENGTH("&clk")-1))
  (
    &wild_tail=1
  )

  if ((&wild_head==1)&&(&wild_tail==1))
  (
    if (STRING.SCAN("gcc_qdss_tsctr_div4_clk", STRING.MID("&clk", 1, &clk_input_length-2), 0)!=-1)
    ( 
      &match=1
    )
  )
  else if (&wild_head==1)
  (
    if (STRING.MID("gcc_qdss_tsctr_div4_clk", &clk_itr_length-&clk_input_length+1, &clk_input_length-1)==STRING.CUT("&clk", 1))
    ( 
      &match=1
    )
  )
  else if (&wild_tail==1)
  (
    if (STRING.MID("gcc_qdss_tsctr_div4_clk", 0, &clk_input_length-1)==STRING.CUT("&clk", -1))
    ( 
      &match=1
    )
  )
  else if ("gcc_qdss_tsctr_div4_clk"=="&clk")
  (
    &match=1
  )
  
  if (&match==1)
  (
    &clk_test=&CLK_TEST_GCC_QDSS_TSCTR_DIV4_CLK
    &clk_reg=&HWIO_GCC_QDSS_TSCTR_DIV4_CBCR_ADDR
    &clk_reg_name="GCC_QDSS_TSCTR_DIV4_CBCR"
    &clk_name="gcc_qdss_tsctr_div4_clk"
    &clk_reg_cbcr_type="sm_cbc"
    &clk_vote_bit=-1.
    &clk_multiplier=1.

    gosub Print_Clk_Info_Line
  )

  &match=0
  &wild_head=0
  &wild_tail=0
  &clk_input_length=STRING.LENGTH("&clk")
  &clk_itr_length=STRING.LENGTH("gcc_qdss_tsctr_div8_clk")

  if (STRING.SCAN("&clk", "*", 0)==0)
  (
    &wild_head=1
  )
  if (STRING.SCAN("&clk", "*", 1)==(STRING.LENGTH("&clk")-1))
  (
    &wild_tail=1
  )

  if ((&wild_head==1)&&(&wild_tail==1))
  (
    if (STRING.SCAN("gcc_qdss_tsctr_div8_clk", STRING.MID("&clk", 1, &clk_input_length-2), 0)!=-1)
    ( 
      &match=1
    )
  )
  else if (&wild_head==1)
  (
    if (STRING.MID("gcc_qdss_tsctr_div8_clk", &clk_itr_length-&clk_input_length+1, &clk_input_length-1)==STRING.CUT("&clk", 1))
    ( 
      &match=1
    )
  )
  else if (&wild_tail==1)
  (
    if (STRING.MID("gcc_qdss_tsctr_div8_clk", 0, &clk_input_length-1)==STRING.CUT("&clk", -1))
    ( 
      &match=1
    )
  )
  else if ("gcc_qdss_tsctr_div8_clk"=="&clk")
  (
    &match=1
  )
  
  if (&match==1)
  (
    &clk_test=&CLK_TEST_GCC_QDSS_TSCTR_DIV8_CLK
    &clk_reg=&HWIO_GCC_QDSS_TSCTR_DIV8_CBCR_ADDR
    &clk_reg_name="GCC_QDSS_TSCTR_DIV8_CBCR"
    &clk_name="gcc_qdss_tsctr_div8_clk"
    &clk_reg_cbcr_type="sm_cbc"
    &clk_vote_bit=-1.
    &clk_multiplier=1.

    gosub Print_Clk_Info_Line
  )

  &match=0
  &wild_head=0
  &wild_tail=0
  &clk_input_length=STRING.LENGTH("&clk")
  &clk_itr_length=STRING.LENGTH("gcc_ssc_apb_clk")

  if (STRING.SCAN("&clk", "*", 0)==0)
  (
    &wild_head=1
  )
  if (STRING.SCAN("&clk", "*", 1)==(STRING.LENGTH("&clk")-1))
  (
    &wild_tail=1
  )

  if ((&wild_head==1)&&(&wild_tail==1))
  (
    if (STRING.SCAN("gcc_ssc_apb_clk", STRING.MID("&clk", 1, &clk_input_length-2), 0)!=-1)
    ( 
      &match=1
    )
  )
  else if (&wild_head==1)
  (
    if (STRING.MID("gcc_ssc_apb_clk", &clk_itr_length-&clk_input_length+1, &clk_input_length-1)==STRING.CUT("&clk", 1))
    ( 
      &match=1
    )
  )
  else if (&wild_tail==1)
  (
    if (STRING.MID("gcc_ssc_apb_clk", 0, &clk_input_length-1)==STRING.CUT("&clk", -1))
    ( 
      &match=1
    )
  )
  else if ("gcc_ssc_apb_clk"=="&clk")
  (
    &match=1
  )
  
  if (&match==1)
  (
    &clk_test=&CLK_TEST_GCC_SSC_APB_CLK
    &clk_reg=&HWIO_GCC_SSC_APB_CBCR_ADDR
    &clk_reg_name="GCC_SSC_APB_CBCR"
    &clk_name="gcc_ssc_apb_clk"
    &clk_reg_cbcr_type="sm_cbc"
    &clk_vote_bit=-1.
    &clk_multiplier=1.

    gosub Print_Clk_Info_Line
  )

  &match=0
  &wild_head=0
  &wild_tail=0
  &clk_input_length=STRING.LENGTH("&clk")
  &clk_itr_length=STRING.LENGTH("gcc_qspi_ser_clk")

  if (STRING.SCAN("&clk", "*", 0)==0)
  (
    &wild_head=1
  )
  if (STRING.SCAN("&clk", "*", 1)==(STRING.LENGTH("&clk")-1))
  (
    &wild_tail=1
  )

  if ((&wild_head==1)&&(&wild_tail==1))
  (
    if (STRING.SCAN("gcc_qspi_ser_clk", STRING.MID("&clk", 1, &clk_input_length-2), 0)!=-1)
    ( 
      &match=1
    )
  )
  else if (&wild_head==1)
  (
    if (STRING.MID("gcc_qspi_ser_clk", &clk_itr_length-&clk_input_length+1, &clk_input_length-1)==STRING.CUT("&clk", 1))
    ( 
      &match=1
    )
  )
  else if (&wild_tail==1)
  (
    if (STRING.MID("gcc_qspi_ser_clk", 0, &clk_input_length-1)==STRING.CUT("&clk", -1))
    ( 
      &match=1
    )
  )
  else if ("gcc_qspi_ser_clk"=="&clk")
  (
    &match=1
  )
  
  if (&match==1)
  (
    &clk_test=&CLK_TEST_GCC_QSPI_SER_CLK
    &clk_reg=&HWIO_GCC_QSPI_SER_CBCR_ADDR
    &clk_reg_name="GCC_QSPI_SER_CBCR"
    &clk_name="gcc_qspi_ser_clk"
    &clk_reg_cbcr_type="sm_cbc"
    &clk_vote_bit=-1.
    &clk_multiplier=1.

    gosub Print_Clk_Info_Line
  )

  &match=0
  &wild_head=0
  &wild_tail=0
  &clk_input_length=STRING.LENGTH("&clk")
  &clk_itr_length=STRING.LENGTH("gcc_rbcpr_cx_clk")

  if (STRING.SCAN("&clk", "*", 0)==0)
  (
    &wild_head=1
  )
  if (STRING.SCAN("&clk", "*", 1)==(STRING.LENGTH("&clk")-1))
  (
    &wild_tail=1
  )

  if ((&wild_head==1)&&(&wild_tail==1))
  (
    if (STRING.SCAN("gcc_rbcpr_cx_clk", STRING.MID("&clk", 1, &clk_input_length-2), 0)!=-1)
    ( 
      &match=1
    )
  )
  else if (&wild_head==1)
  (
    if (STRING.MID("gcc_rbcpr_cx_clk", &clk_itr_length-&clk_input_length+1, &clk_input_length-1)==STRING.CUT("&clk", 1))
    ( 
      &match=1
    )
  )
  else if (&wild_tail==1)
  (
    if (STRING.MID("gcc_rbcpr_cx_clk", 0, &clk_input_length-1)==STRING.CUT("&clk", -1))
    ( 
      &match=1
    )
  )
  else if ("gcc_rbcpr_cx_clk"=="&clk")
  (
    &match=1
  )
  
  if (&match==1)
  (
    &clk_test=&CLK_TEST_GCC_RBCPR_CX_CLK
    &clk_reg=&HWIO_GCC_RBCPR_CX_CBCR_ADDR
    &clk_reg_name="GCC_RBCPR_CX_CBCR"
    &clk_name="gcc_rbcpr_cx_clk"
    &clk_reg_cbcr_type="sm_cbc"
    &clk_vote_bit=-1.
    &clk_multiplier=1.

    gosub Print_Clk_Info_Line
  )

  &match=0
  &wild_head=0
  &wild_tail=0
  &clk_input_length=STRING.LENGTH("&clk")
  &clk_itr_length=STRING.LENGTH("gcc_rbcpr_mx_clk")

  if (STRING.SCAN("&clk", "*", 0)==0)
  (
    &wild_head=1
  )
  if (STRING.SCAN("&clk", "*", 1)==(STRING.LENGTH("&clk")-1))
  (
    &wild_tail=1
  )

  if ((&wild_head==1)&&(&wild_tail==1))
  (
    if (STRING.SCAN("gcc_rbcpr_mx_clk", STRING.MID("&clk", 1, &clk_input_length-2), 0)!=-1)
    ( 
      &match=1
    )
  )
  else if (&wild_head==1)
  (
    if (STRING.MID("gcc_rbcpr_mx_clk", &clk_itr_length-&clk_input_length+1, &clk_input_length-1)==STRING.CUT("&clk", 1))
    ( 
      &match=1
    )
  )
  else if (&wild_tail==1)
  (
    if (STRING.MID("gcc_rbcpr_mx_clk", 0, &clk_input_length-1)==STRING.CUT("&clk", -1))
    ( 
      &match=1
    )
  )
  else if ("gcc_rbcpr_mx_clk"=="&clk")
  (
    &match=1
  )
  
  if (&match==1)
  (
    &clk_test=&CLK_TEST_GCC_RBCPR_MX_CLK
    &clk_reg=&HWIO_GCC_RBCPR_MX_CBCR_ADDR
    &clk_reg_name="GCC_RBCPR_MX_CBCR"
    &clk_name="gcc_rbcpr_mx_clk"
    &clk_reg_cbcr_type="sm_cbc"
    &clk_vote_bit=-1.
    &clk_multiplier=1.

    gosub Print_Clk_Info_Line
  )

  &match=0
  &wild_head=0
  &wild_tail=0
  &clk_input_length=STRING.LENGTH("&clk")
  &clk_itr_length=STRING.LENGTH("gcc_rpm_bus_ahb_clk")

  if (STRING.SCAN("&clk", "*", 0)==0)
  (
    &wild_head=1
  )
  if (STRING.SCAN("&clk", "*", 1)==(STRING.LENGTH("&clk")-1))
  (
    &wild_tail=1
  )

  if ((&wild_head==1)&&(&wild_tail==1))
  (
    if (STRING.SCAN("gcc_rpm_bus_ahb_clk", STRING.MID("&clk", 1, &clk_input_length-2), 0)!=-1)
    ( 
      &match=1
    )
  )
  else if (&wild_head==1)
  (
    if (STRING.MID("gcc_rpm_bus_ahb_clk", &clk_itr_length-&clk_input_length+1, &clk_input_length-1)==STRING.CUT("&clk", 1))
    ( 
      &match=1
    )
  )
  else if (&wild_tail==1)
  (
    if (STRING.MID("gcc_rpm_bus_ahb_clk", 0, &clk_input_length-1)==STRING.CUT("&clk", -1))
    ( 
      &match=1
    )
  )
  else if ("gcc_rpm_bus_ahb_clk"=="&clk")
  (
    &match=1
  )
  
  if (&match==1)
  (
    &clk_test=&CLK_TEST_GCC_RPM_BUS_AHB_CLK
    &clk_reg=&HWIO_GCC_RPM_BUS_AHB_CBCR_ADDR
    &clk_reg_name="GCC_RPM_BUS_AHB_CBCR"
    &clk_name="gcc_rpm_bus_ahb_clk"
    &clk_reg_cbcr_type="sm_pscbc"
    &clk_vote_bit=-1.
    &clk_multiplier=1.

    gosub Print_Clk_Info_Line
  )

  &match=0
  &wild_head=0
  &wild_tail=0
  &clk_input_length=STRING.LENGTH("&clk")
  &clk_itr_length=STRING.LENGTH("gcc_rpm_proc_fclk")

  if (STRING.SCAN("&clk", "*", 0)==0)
  (
    &wild_head=1
  )
  if (STRING.SCAN("&clk", "*", 1)==(STRING.LENGTH("&clk")-1))
  (
    &wild_tail=1
  )

  if ((&wild_head==1)&&(&wild_tail==1))
  (
    if (STRING.SCAN("gcc_rpm_proc_fclk", STRING.MID("&clk", 1, &clk_input_length-2), 0)!=-1)
    ( 
      &match=1
    )
  )
  else if (&wild_head==1)
  (
    if (STRING.MID("gcc_rpm_proc_fclk", &clk_itr_length-&clk_input_length+1, &clk_input_length-1)==STRING.CUT("&clk", 1))
    ( 
      &match=1
    )
  )
  else if (&wild_tail==1)
  (
    if (STRING.MID("gcc_rpm_proc_fclk", 0, &clk_input_length-1)==STRING.CUT("&clk", -1))
    ( 
      &match=1
    )
  )
  else if ("gcc_rpm_proc_fclk"=="&clk")||("cpus"=="&clk")
  (
    &match=1
  )
  
  if (&match==1)
  (
    &clk_test=&CLK_TEST_GCC_RPM_PROC_FCLK
    &clk_reg=0
    &clk_reg_name="No CBCR"
    &clk_name="gcc_rpm_proc_fclk"
    &clk_reg_cbcr_type=""
    &clk_vote_bit=-1.
    &clk_multiplier=1.

    gosub Print_Clk_Info_Line
  )

  &match=0
  &wild_head=0
  &wild_tail=0
  &clk_input_length=STRING.LENGTH("&clk")
  &clk_itr_length=STRING.LENGTH("gcc_rpm_proc_hclk")

  if (STRING.SCAN("&clk", "*", 0)==0)
  (
    &wild_head=1
  )
  if (STRING.SCAN("&clk", "*", 1)==(STRING.LENGTH("&clk")-1))
  (
    &wild_tail=1
  )

  if ((&wild_head==1)&&(&wild_tail==1))
  (
    if (STRING.SCAN("gcc_rpm_proc_hclk", STRING.MID("&clk", 1, &clk_input_length-2), 0)!=-1)
    ( 
      &match=1
    )
  )
  else if (&wild_head==1)
  (
    if (STRING.MID("gcc_rpm_proc_hclk", &clk_itr_length-&clk_input_length+1, &clk_input_length-1)==STRING.CUT("&clk", 1))
    ( 
      &match=1
    )
  )
  else if (&wild_tail==1)
  (
    if (STRING.MID("gcc_rpm_proc_hclk", 0, &clk_input_length-1)==STRING.CUT("&clk", -1))
    ( 
      &match=1
    )
  )
  else if ("gcc_rpm_proc_hclk"=="&clk")
  (
    &match=1
  )
  
  if (&match==1)
  (
    &clk_test=&CLK_TEST_GCC_RPM_PROC_HCLK
    &clk_reg=&HWIO_GCC_RPM_PROC_HCLK_CBCR_ADDR
    &clk_reg_name="GCC_RPM_PROC_HCLK_CBCR"
    &clk_name="gcc_rpm_proc_hclk"
    &clk_reg_cbcr_type="sm_cbc"
    &clk_vote_bit=-1.
    &clk_multiplier=1.

    gosub Print_Clk_Info_Line
  )

  &match=0
  &wild_head=0
  &wild_tail=0
  &clk_input_length=STRING.LENGTH("&clk")
  &clk_itr_length=STRING.LENGTH("gcc_spdm_rpm_cy_clk")

  if (STRING.SCAN("&clk", "*", 0)==0)
  (
    &wild_head=1
  )
  if (STRING.SCAN("&clk", "*", 1)==(STRING.LENGTH("&clk")-1))
  (
    &wild_tail=1
  )

  if ((&wild_head==1)&&(&wild_tail==1))
  (
    if (STRING.SCAN("gcc_spdm_rpm_cy_clk", STRING.MID("&clk", 1, &clk_input_length-2), 0)!=-1)
    ( 
      &match=1
    )
  )
  else if (&wild_head==1)
  (
    if (STRING.MID("gcc_spdm_rpm_cy_clk", &clk_itr_length-&clk_input_length+1, &clk_input_length-1)==STRING.CUT("&clk", 1))
    ( 
      &match=1
    )
  )
  else if (&wild_tail==1)
  (
    if (STRING.MID("gcc_spdm_rpm_cy_clk", 0, &clk_input_length-1)==STRING.CUT("&clk", -1))
    ( 
      &match=1
    )
  )
  else if ("gcc_spdm_rpm_cy_clk"=="&clk")
  (
    &match=1
  )
  
  if (&match==1)
  (
    &clk_test=&CLK_TEST_GCC_SPDM_RPM_CY_CLK
    &clk_reg=&HWIO_GCC_SPDM_RPM_CY_CBCR_ADDR
    &clk_reg_name="GCC_SPDM_RPM_CY_CBCR"
    &clk_name="gcc_spdm_rpm_cy_clk"
    &clk_reg_cbcr_type="sm_cbc"
    &clk_vote_bit=-1.
    &clk_multiplier=1.

    gosub Print_Clk_Info_Line
  )

  &match=0
  &wild_head=0
  &wild_tail=0
  &clk_input_length=STRING.LENGTH("&clk")
  &clk_itr_length=STRING.LENGTH("gcc_sdcc1_apps_clk")

  if (STRING.SCAN("&clk", "*", 0)==0)
  (
    &wild_head=1
  )
  if (STRING.SCAN("&clk", "*", 1)==(STRING.LENGTH("&clk")-1))
  (
    &wild_tail=1
  )

  if ((&wild_head==1)&&(&wild_tail==1))
  (
    if (STRING.SCAN("gcc_sdcc1_apps_clk", STRING.MID("&clk", 1, &clk_input_length-2), 0)!=-1)
    ( 
      &match=1
    )
  )
  else if (&wild_head==1)
  (
    if (STRING.MID("gcc_sdcc1_apps_clk", &clk_itr_length-&clk_input_length+1, &clk_input_length-1)==STRING.CUT("&clk", 1))
    ( 
      &match=1
    )
  )
  else if (&wild_tail==1)
  (
    if (STRING.MID("gcc_sdcc1_apps_clk", 0, &clk_input_length-1)==STRING.CUT("&clk", -1))
    ( 
      &match=1
    )
  )
  else if ("gcc_sdcc1_apps_clk"=="&clk")
  (
    &match=1
  )
  
  if (&match==1)
  (
    &clk_test=&CLK_TEST_GCC_SDCC1_APPS_CLK
    &clk_reg=&HWIO_GCC_SDCC1_APPS_CBCR_ADDR
    &clk_reg_name="GCC_SDCC1_APPS_CBCR"
    &clk_name="gcc_sdcc1_apps_clk"
    &clk_reg_cbcr_type="sm_pscbc"
    &clk_vote_bit=-1.
    &clk_multiplier=1.

    gosub Print_Clk_Info_Line
  )

  &match=0
  &wild_head=0
  &wild_tail=0
  &clk_input_length=STRING.LENGTH("&clk")
  &clk_itr_length=STRING.LENGTH("gcc_sdcc1_ice_core_clk")

  if (STRING.SCAN("&clk", "*", 0)==0)
  (
    &wild_head=1
  )
  if (STRING.SCAN("&clk", "*", 1)==(STRING.LENGTH("&clk")-1))
  (
    &wild_tail=1
  )

  if ((&wild_head==1)&&(&wild_tail==1))
  (
    if (STRING.SCAN("gcc_sdcc1_ice_core_clk", STRING.MID("&clk", 1, &clk_input_length-2), 0)!=-1)
    ( 
      &match=1
    )
  )
  else if (&wild_head==1)
  (
    if (STRING.MID("gcc_sdcc1_ice_core_clk", &clk_itr_length-&clk_input_length+1, &clk_input_length-1)==STRING.CUT("&clk", 1))
    ( 
      &match=1
    )
  )
  else if (&wild_tail==1)
  (
    if (STRING.MID("gcc_sdcc1_ice_core_clk", 0, &clk_input_length-1)==STRING.CUT("&clk", -1))
    ( 
      &match=1
    )
  )
  else if ("gcc_sdcc1_ice_core_clk"=="&clk")
  (
    &match=1
  )
  
  if (&match==1)
  (
    &clk_test=&CLK_TEST_GCC_SDCC1_ICE_CORE_CLK
    &clk_reg=&HWIO_GCC_SDCC1_ICE_CORE_CBCR_ADDR
    &clk_reg_name="GCC_SDCC1_ICE_CORE_CBCR"
    &clk_name="gcc_sdcc1_ice_core_clk"
    &clk_reg_cbcr_type="sm_pscbc"
    &clk_vote_bit=-1.
    &clk_multiplier=1.

    gosub Print_Clk_Info_Line
  )

  &match=0
  &wild_head=0
  &wild_tail=0
  &clk_input_length=STRING.LENGTH("&clk")
  &clk_itr_length=STRING.LENGTH("gcc_sdcc2_apps_clk")

  if (STRING.SCAN("&clk", "*", 0)==0)
  (
    &wild_head=1
  )
  if (STRING.SCAN("&clk", "*", 1)==(STRING.LENGTH("&clk")-1))
  (
    &wild_tail=1
  )

  if ((&wild_head==1)&&(&wild_tail==1))
  (
    if (STRING.SCAN("gcc_sdcc2_apps_clk", STRING.MID("&clk", 1, &clk_input_length-2), 0)!=-1)
    ( 
      &match=1
    )
  )
  else if (&wild_head==1)
  (
    if (STRING.MID("gcc_sdcc2_apps_clk", &clk_itr_length-&clk_input_length+1, &clk_input_length-1)==STRING.CUT("&clk", 1))
    ( 
      &match=1
    )
  )
  else if (&wild_tail==1)
  (
    if (STRING.MID("gcc_sdcc2_apps_clk", 0, &clk_input_length-1)==STRING.CUT("&clk", -1))
    ( 
      &match=1
    )
  )
  else if ("gcc_sdcc2_apps_clk"=="&clk")
  (
    &match=1
  )
  
  if (&match==1)
  (
    &clk_test=&CLK_TEST_GCC_SDCC2_APPS_CLK
    &clk_reg=&HWIO_GCC_SDCC2_APPS_CBCR_ADDR
    &clk_reg_name="GCC_SDCC2_APPS_CBCR"
    &clk_name="gcc_sdcc2_apps_clk"
    &clk_reg_cbcr_type="sm_pscbc"
    &clk_vote_bit=-1.
    &clk_multiplier=1.

    gosub Print_Clk_Info_Line
  )

  &match=0
  &wild_head=0
  &wild_tail=0
  &clk_input_length=STRING.LENGTH("&clk")
  &clk_itr_length=STRING.LENGTH("gcc_sdcc3_apps_clk")

  if (STRING.SCAN("&clk", "*", 0)==0)
  (
    &wild_head=1
  )
  if (STRING.SCAN("&clk", "*", 1)==(STRING.LENGTH("&clk")-1))
  (
    &wild_tail=1
  )

  if ((&wild_head==1)&&(&wild_tail==1))
  (
    if (STRING.SCAN("gcc_sdcc3_apps_clk", STRING.MID("&clk", 1, &clk_input_length-2), 0)!=-1)
    ( 
      &match=1
    )
  )
  else if (&wild_head==1)
  (
    if (STRING.MID("gcc_sdcc3_apps_clk", &clk_itr_length-&clk_input_length+1, &clk_input_length-1)==STRING.CUT("&clk", 1))
    ( 
      &match=1
    )
  )
  else if (&wild_tail==1)
  (
    if (STRING.MID("gcc_sdcc3_apps_clk", 0, &clk_input_length-1)==STRING.CUT("&clk", -1))
    ( 
      &match=1
    )
  )
  else if ("gcc_sdcc3_apps_clk"=="&clk")
  (
    &match=1
  )
  
  if (&match==1)
  (
    &clk_test=&CLK_TEST_GCC_SDCC3_APPS_CLK
    &clk_reg=&HWIO_GCC_SDCC3_APPS_CBCR_ADDR
    &clk_reg_name="GCC_SDCC3_APPS_CBCR"
    &clk_name="gcc_sdcc3_apps_clk"
    &clk_reg_cbcr_type="sm_pscbc"
    &clk_vote_bit=-1.
    &clk_multiplier=1.

    gosub Print_Clk_Info_Line
  )

  &match=0
  &wild_head=0
  &wild_tail=0
  &clk_input_length=STRING.LENGTH("&clk")
  &clk_itr_length=STRING.LENGTH("gcc_sdcc4_apps_clk")

  if (STRING.SCAN("&clk", "*", 0)==0)
  (
    &wild_head=1
  )
  if (STRING.SCAN("&clk", "*", 1)==(STRING.LENGTH("&clk")-1))
  (
    &wild_tail=1
  )

  if ((&wild_head==1)&&(&wild_tail==1))
  (
    if (STRING.SCAN("gcc_sdcc4_apps_clk", STRING.MID("&clk", 1, &clk_input_length-2), 0)!=-1)
    ( 
      &match=1
    )
  )
  else if (&wild_head==1)
  (
    if (STRING.MID("gcc_sdcc4_apps_clk", &clk_itr_length-&clk_input_length+1, &clk_input_length-1)==STRING.CUT("&clk", 1))
    ( 
      &match=1
    )
  )
  else if (&wild_tail==1)
  (
    if (STRING.MID("gcc_sdcc4_apps_clk", 0, &clk_input_length-1)==STRING.CUT("&clk", -1))
    ( 
      &match=1
    )
  )
  else if ("gcc_sdcc4_apps_clk"=="&clk")
  (
    &match=1
  )
  
  if (&match==1)
  (
    &clk_test=&CLK_TEST_GCC_SDCC4_APPS_CLK
    &clk_reg=&HWIO_GCC_SDCC4_APPS_CBCR_ADDR
    &clk_reg_name="GCC_SDCC4_APPS_CBCR"
    &clk_name="gcc_sdcc4_apps_clk"
    &clk_reg_cbcr_type="sm_pscbc"
    &clk_vote_bit=-1.
    &clk_multiplier=1.

    gosub Print_Clk_Info_Line
  )

  &match=0
  &wild_head=0
  &wild_tail=0
  &clk_input_length=STRING.LENGTH("&clk")
  &clk_itr_length=STRING.LENGTH("gcc_sec_ctrl_clk")

  if (STRING.SCAN("&clk", "*", 0)==0)
  (
    &wild_head=1
  )
  if (STRING.SCAN("&clk", "*", 1)==(STRING.LENGTH("&clk")-1))
  (
    &wild_tail=1
  )

  if ((&wild_head==1)&&(&wild_tail==1))
  (
    if (STRING.SCAN("gcc_sec_ctrl_clk", STRING.MID("&clk", 1, &clk_input_length-2), 0)!=-1)
    ( 
      &match=1
    )
  )
  else if (&wild_head==1)
  (
    if (STRING.MID("gcc_sec_ctrl_clk", &clk_itr_length-&clk_input_length+1, &clk_input_length-1)==STRING.CUT("&clk", 1))
    ( 
      &match=1
    )
  )
  else if (&wild_tail==1)
  (
    if (STRING.MID("gcc_sec_ctrl_clk", 0, &clk_input_length-1)==STRING.CUT("&clk", -1))
    ( 
      &match=1
    )
  )
  else if ("gcc_sec_ctrl_clk"=="&clk")
  (
    &match=1
  )
  
  if (&match==1)
  (
    &clk_test=&CLK_TEST_GCC_SEC_CTRL_CLK
    &clk_reg=&HWIO_GCC_SEC_CTRL_CBCR_ADDR
    &clk_reg_name="GCC_SEC_CTRL_CBCR"
    &clk_name="gcc_sec_ctrl_clk"
    &clk_reg_cbcr_type="sm_pscbc"
    &clk_vote_bit=-1.
    &clk_multiplier=1.

    gosub Print_Clk_Info_Line
  )

  &match=0
  &wild_head=0
  &wild_tail=0
  &clk_input_length=STRING.LENGTH("&clk")
  &clk_itr_length=STRING.LENGTH("gcc_sec_ctrl_sense_clk")

  if (STRING.SCAN("&clk", "*", 0)==0)
  (
    &wild_head=1
  )
  if (STRING.SCAN("&clk", "*", 1)==(STRING.LENGTH("&clk")-1))
  (
    &wild_tail=1
  )

  if ((&wild_head==1)&&(&wild_tail==1))
  (
    if (STRING.SCAN("gcc_sec_ctrl_sense_clk", STRING.MID("&clk", 1, &clk_input_length-2), 0)!=-1)
    ( 
      &match=1
    )
  )
  else if (&wild_head==1)
  (
    if (STRING.MID("gcc_sec_ctrl_sense_clk", &clk_itr_length-&clk_input_length+1, &clk_input_length-1)==STRING.CUT("&clk", 1))
    ( 
      &match=1
    )
  )
  else if (&wild_tail==1)
  (
    if (STRING.MID("gcc_sec_ctrl_sense_clk", 0, &clk_input_length-1)==STRING.CUT("&clk", -1))
    ( 
      &match=1
    )
  )
  else if ("gcc_sec_ctrl_sense_clk"=="&clk")
  (
    &match=1
  )
  
  if (&match==1)
  (
    &clk_test=&CLK_TEST_GCC_SEC_CTRL_SENSE_CLK
    &clk_reg=&HWIO_GCC_SEC_CTRL_SENSE_CBCR_ADDR
    &clk_reg_name="GCC_SEC_CTRL_SENSE_CBCR"
    &clk_name="gcc_sec_ctrl_sense_clk"
    &clk_reg_cbcr_type="sm_cbc"
    &clk_vote_bit=-1.
    &clk_multiplier=1.

    gosub Print_Clk_Info_Line
  )

  &match=0
  &wild_head=0
  &wild_tail=0
  &clk_input_length=STRING.LENGTH("&clk")
  &clk_itr_length=STRING.LENGTH("gcc_spmi_ahb_clk")

  if (STRING.SCAN("&clk", "*", 0)==0)
  (
    &wild_head=1
  )
  if (STRING.SCAN("&clk", "*", 1)==(STRING.LENGTH("&clk")-1))
  (
    &wild_tail=1
  )

  if ((&wild_head==1)&&(&wild_tail==1))
  (
    if (STRING.SCAN("gcc_spmi_ahb_clk", STRING.MID("&clk", 1, &clk_input_length-2), 0)!=-1)
    ( 
      &match=1
    )
  )
  else if (&wild_head==1)
  (
    if (STRING.MID("gcc_spmi_ahb_clk", &clk_itr_length-&clk_input_length+1, &clk_input_length-1)==STRING.CUT("&clk", 1))
    ( 
      &match=1
    )
  )
  else if (&wild_tail==1)
  (
    if (STRING.MID("gcc_spmi_ahb_clk", 0, &clk_input_length-1)==STRING.CUT("&clk", -1))
    ( 
      &match=1
    )
  )
  else if ("gcc_spmi_ahb_clk"=="&clk")
  (
    &match=1
  )
  
  if (&match==1)
  (
    &clk_test=&CLK_TEST_GCC_SPMI_AHB_CLK
    &clk_reg=&HWIO_GCC_SPMI_AHB_CBCR_ADDR
    &clk_reg_name="GCC_SPMI_AHB_CBCR"
    &clk_name="gcc_spmi_ahb_clk"
    &clk_reg_cbcr_type="sm_pscbc"
    &clk_vote_bit=-1.
    &clk_multiplier=1.

    gosub Print_Clk_Info_Line
  )

  &match=0
  &wild_head=0
  &wild_tail=0
  &clk_input_length=STRING.LENGTH("&clk")
  &clk_itr_length=STRING.LENGTH("gcc_spmi_ser_clk")

  if (STRING.SCAN("&clk", "*", 0)==0)
  (
    &wild_head=1
  )
  if (STRING.SCAN("&clk", "*", 1)==(STRING.LENGTH("&clk")-1))
  (
    &wild_tail=1
  )

  if ((&wild_head==1)&&(&wild_tail==1))
  (
    if (STRING.SCAN("gcc_spmi_ser_clk", STRING.MID("&clk", 1, &clk_input_length-2), 0)!=-1)
    ( 
      &match=1
    )
  )
  else if (&wild_head==1)
  (
    if (STRING.MID("gcc_spmi_ser_clk", &clk_itr_length-&clk_input_length+1, &clk_input_length-1)==STRING.CUT("&clk", 1))
    ( 
      &match=1
    )
  )
  else if (&wild_tail==1)
  (
    if (STRING.MID("gcc_spmi_ser_clk", 0, &clk_input_length-1)==STRING.CUT("&clk", -1))
    ( 
      &match=1
    )
  )
  else if ("gcc_spmi_ser_clk"=="&clk")
  (
    &match=1
  )
  
  if (&match==1)
  (
    &clk_test=&CLK_TEST_GCC_SPMI_SER_CLK
    &clk_reg=&HWIO_GCC_SPMI_SER_CBCR_ADDR
    &clk_reg_name="GCC_SPMI_SER_CBCR"
    &clk_name="gcc_spmi_ser_clk"
    &clk_reg_cbcr_type="sm_pscbc"
    &clk_vote_bit=-1.
    &clk_multiplier=1.

    gosub Print_Clk_Info_Line
  )

  &match=0
  &wild_head=0
  &wild_tail=0
  &clk_input_length=STRING.LENGTH("&clk")
  &clk_itr_length=STRING.LENGTH("gcc_bimc_nius_hs_axi_clk")

  if (STRING.SCAN("&clk", "*", 0)==0)
  (
    &wild_head=1
  )
  if (STRING.SCAN("&clk", "*", 1)==(STRING.LENGTH("&clk")-1))
  (
    &wild_tail=1
  )

  if ((&wild_head==1)&&(&wild_tail==1))
  (
    if (STRING.SCAN("gcc_bimc_nius_hs_axi_clk", STRING.MID("&clk", 1, &clk_input_length-2), 0)!=-1)
    ( 
      &match=1
    )
  )
  else if (&wild_head==1)
  (
    if (STRING.MID("gcc_bimc_nius_hs_axi_clk", &clk_itr_length-&clk_input_length+1, &clk_input_length-1)==STRING.CUT("&clk", 1))
    ( 
      &match=1
    )
  )
  else if (&wild_tail==1)
  (
    if (STRING.MID("gcc_bimc_nius_hs_axi_clk", 0, &clk_input_length-1)==STRING.CUT("&clk", -1))
    ( 
      &match=1
    )
  )
  else if ("gcc_bimc_nius_hs_axi_clk"=="&clk")
  (
    &match=1
  )
  
  if (&match==1)
  (
    &clk_test=&CLK_TEST_GCC_BIMC_NIUS_HS_AXI_CLK
    &clk_reg=&HWIO_GCC_BIMC_NIUS_HS_AXI_CBCR_ADDR
    &clk_reg_name="GCC_BIMC_NIUS_HS_AXI_CBCR"
    &clk_name="gcc_bimc_nius_hs_axi_clk"
    &clk_reg_cbcr_type="sm_cbc"
    &clk_vote_bit=-1.
    &clk_multiplier=1.

    gosub Print_Clk_Info_Line
  )

  &match=0
  &wild_head=0
  &wild_tail=0
  &clk_input_length=STRING.LENGTH("&clk")
  &clk_itr_length=STRING.LENGTH("gcc_bimc_sysnoc_hs_axi_clk")

  if (STRING.SCAN("&clk", "*", 0)==0)
  (
    &wild_head=1
  )
  if (STRING.SCAN("&clk", "*", 1)==(STRING.LENGTH("&clk")-1))
  (
    &wild_tail=1
  )

  if ((&wild_head==1)&&(&wild_tail==1))
  (
    if (STRING.SCAN("gcc_bimc_sysnoc_hs_axi_clk", STRING.MID("&clk", 1, &clk_input_length-2), 0)!=-1)
    ( 
      &match=1
    )
  )
  else if (&wild_head==1)
  (
    if (STRING.MID("gcc_bimc_sysnoc_hs_axi_clk", &clk_itr_length-&clk_input_length+1, &clk_input_length-1)==STRING.CUT("&clk", 1))
    ( 
      &match=1
    )
  )
  else if (&wild_tail==1)
  (
    if (STRING.MID("gcc_bimc_sysnoc_hs_axi_clk", 0, &clk_input_length-1)==STRING.CUT("&clk", -1))
    ( 
      &match=1
    )
  )
  else if ("gcc_bimc_sysnoc_hs_axi_clk"=="&clk")
  (
    &match=1
  )
  
  if (&match==1)
  (
    &clk_test=&CLK_TEST_GCC_BIMC_SYSNOC_HS_AXI_CLK
    &clk_reg=&HWIO_GCC_BIMC_SYSNOC_HS_AXI_CBCR_ADDR
    &clk_reg_name="GCC_BIMC_SYSNOC_HS_AXI_CBCR"
    &clk_name="gcc_bimc_sysnoc_hs_axi_clk"
    &clk_reg_cbcr_type="sm_cbc"
    &clk_vote_bit=-1.
    &clk_multiplier=1.

    gosub Print_Clk_Info_Line
  )

  &match=0
  &wild_head=0
  &wild_tail=0
  &clk_input_length=STRING.LENGTH("&clk")
  &clk_itr_length=STRING.LENGTH("gcc_lpass_q6_axi_clk")

  if (STRING.SCAN("&clk", "*", 0)==0)
  (
    &wild_head=1
  )
  if (STRING.SCAN("&clk", "*", 1)==(STRING.LENGTH("&clk")-1))
  (
    &wild_tail=1
  )

  if ((&wild_head==1)&&(&wild_tail==1))
  (
    if (STRING.SCAN("gcc_lpass_q6_axi_clk", STRING.MID("&clk", 1, &clk_input_length-2), 0)!=-1)
    ( 
      &match=1
    )
  )
  else if (&wild_head==1)
  (
    if (STRING.MID("gcc_lpass_q6_axi_clk", &clk_itr_length-&clk_input_length+1, &clk_input_length-1)==STRING.CUT("&clk", 1))
    ( 
      &match=1
    )
  )
  else if (&wild_tail==1)
  (
    if (STRING.MID("gcc_lpass_q6_axi_clk", 0, &clk_input_length-1)==STRING.CUT("&clk", -1))
    ( 
      &match=1
    )
  )
  else if ("gcc_lpass_q6_axi_clk"=="&clk")
  (
    &match=1
  )
  
  if (&match==1)
  (
    &clk_test=&CLK_TEST_GCC_LPASS_Q6_AXI_CLK
    &clk_reg=&HWIO_GCC_LPASS_Q6_AXI_CBCR_ADDR
    &clk_reg_name="GCC_LPASS_Q6_AXI_CBCR"
    &clk_name="gcc_lpass_q6_axi_clk"
    &clk_reg_cbcr_type="sm_cbc"
    &clk_vote_bit=-1.
    &clk_multiplier=1.

    gosub Print_Clk_Info_Line
  )

  &match=0
  &wild_head=0
  &wild_tail=0
  &clk_input_length=STRING.LENGTH("&clk")
  &clk_itr_length=STRING.LENGTH("gcc_lpass_q6_smmu_axi_clk")

  if (STRING.SCAN("&clk", "*", 0)==0)
  (
    &wild_head=1
  )
  if (STRING.SCAN("&clk", "*", 1)==(STRING.LENGTH("&clk")-1))
  (
    &wild_tail=1
  )

  if ((&wild_head==1)&&(&wild_tail==1))
  (
    if (STRING.SCAN("gcc_lpass_q6_smmu_axi_clk", STRING.MID("&clk", 1, &clk_input_length-2), 0)!=-1)
    ( 
      &match=1
    )
  )
  else if (&wild_head==1)
  (
    if (STRING.MID("gcc_lpass_q6_smmu_axi_clk", &clk_itr_length-&clk_input_length+1, &clk_input_length-1)==STRING.CUT("&clk", 1))
    ( 
      &match=1
    )
  )
  else if (&wild_tail==1)
  (
    if (STRING.MID("gcc_lpass_q6_smmu_axi_clk", 0, &clk_input_length-1)==STRING.CUT("&clk", -1))
    ( 
      &match=1
    )
  )
  else if ("gcc_lpass_q6_smmu_axi_clk"=="&clk")
  (
    &match=1
  )
  
  if (&match==1)
  (
    &clk_test=&CLK_TEST_GCC_LPASS_Q6_SMMU_AXI_CLK
    &clk_reg=&HWIO_GCC_LPASS_Q6_SMMU_AXI_CBCR_ADDR
    &clk_reg_name="GCC_LPASS_Q6_SMMU_AXI_CBCR"
    &clk_name="gcc_lpass_q6_smmu_axi_clk"
    &clk_reg_cbcr_type="sm_pscbc"
    &clk_vote_bit=-1.
    &clk_multiplier=1.

    gosub Print_Clk_Info_Line
  )

  &match=0
  &wild_head=0
  &wild_tail=0
  &clk_input_length=STRING.LENGTH("&clk")
  &clk_itr_length=STRING.LENGTH("gcc_sys_noc_hs_axi_clk")

  if (STRING.SCAN("&clk", "*", 0)==0)
  (
    &wild_head=1
  )
  if (STRING.SCAN("&clk", "*", 1)==(STRING.LENGTH("&clk")-1))
  (
    &wild_tail=1
  )

  if ((&wild_head==1)&&(&wild_tail==1))
  (
    if (STRING.SCAN("gcc_sys_noc_hs_axi_clk", STRING.MID("&clk", 1, &clk_input_length-2), 0)!=-1)
    ( 
      &match=1
    )
  )
  else if (&wild_head==1)
  (
    if (STRING.MID("gcc_sys_noc_hs_axi_clk", &clk_itr_length-&clk_input_length+1, &clk_input_length-1)==STRING.CUT("&clk", 1))
    ( 
      &match=1
    )
  )
  else if (&wild_tail==1)
  (
    if (STRING.MID("gcc_sys_noc_hs_axi_clk", 0, &clk_input_length-1)==STRING.CUT("&clk", -1))
    ( 
      &match=1
    )
  )
  else if ("gcc_sys_noc_hs_axi_clk"=="&clk")
  (
    &match=1
  )
  
  if (&match==1)
  (
    &clk_test=&CLK_TEST_GCC_SYS_NOC_HS_AXI_CLK
    &clk_reg=&HWIO_GCC_SYS_NOC_HS_AXI_CBCR_ADDR
    &clk_reg_name="GCC_SYS_NOC_HS_AXI_CBCR"
    &clk_name="gcc_sys_noc_hs_axi_clk"
    &clk_reg_cbcr_type="sm_cbc"
    &clk_vote_bit=-1.
    &clk_multiplier=1.

    gosub Print_Clk_Info_Line
  )

  &match=0
  &wild_head=0
  &wild_tail=0
  &clk_input_length=STRING.LENGTH("&clk")
  &clk_itr_length=STRING.LENGTH("gcc_mss_mnoc_bimc_axi_clk")

  if (STRING.SCAN("&clk", "*", 0)==0)
  (
    &wild_head=1
  )
  if (STRING.SCAN("&clk", "*", 1)==(STRING.LENGTH("&clk")-1))
  (
    &wild_tail=1
  )

  if ((&wild_head==1)&&(&wild_tail==1))
  (
    if (STRING.SCAN("gcc_mss_mnoc_bimc_axi_clk", STRING.MID("&clk", 1, &clk_input_length-2), 0)!=-1)
    ( 
      &match=1
    )
  )
  else if (&wild_head==1)
  (
    if (STRING.MID("gcc_mss_mnoc_bimc_axi_clk", &clk_itr_length-&clk_input_length+1, &clk_input_length-1)==STRING.CUT("&clk", 1))
    ( 
      &match=1
    )
  )
  else if (&wild_tail==1)
  (
    if (STRING.MID("gcc_mss_mnoc_bimc_axi_clk", 0, &clk_input_length-1)==STRING.CUT("&clk", -1))
    ( 
      &match=1
    )
  )
  else if ("gcc_mss_mnoc_bimc_axi_clk"=="&clk")
  (
    &match=1
  )
  
  if (&match==1)
  (
    &clk_test=&CLK_TEST_GCC_MSS_MNOC_BIMC_AXI_CLK
    &clk_reg=&HWIO_GCC_MSS_MNOC_BIMC_AXI_CBCR_ADDR
    &clk_reg_name="GCC_MSS_MNOC_BIMC_AXI_CBCR"
    &clk_name="gcc_mss_mnoc_bimc_axi_clk"
    &clk_reg_cbcr_type="sm_cbc"
    &clk_vote_bit=-1.
    &clk_multiplier=1.

    gosub Print_Clk_Info_Line
  )

  &match=0
  &wild_head=0
  &wild_tail=0
  &clk_input_length=STRING.LENGTH("&clk")
  &clk_itr_length=STRING.LENGTH("gcc_mss_msmpu_client_axi_clk")

  if (STRING.SCAN("&clk", "*", 0)==0)
  (
    &wild_head=1
  )
  if (STRING.SCAN("&clk", "*", 1)==(STRING.LENGTH("&clk")-1))
  (
    &wild_tail=1
  )

  if ((&wild_head==1)&&(&wild_tail==1))
  (
    if (STRING.SCAN("gcc_mss_msmpu_client_axi_clk", STRING.MID("&clk", 1, &clk_input_length-2), 0)!=-1)
    ( 
      &match=1
    )
  )
  else if (&wild_head==1)
  (
    if (STRING.MID("gcc_mss_msmpu_client_axi_clk", &clk_itr_length-&clk_input_length+1, &clk_input_length-1)==STRING.CUT("&clk", 1))
    ( 
      &match=1
    )
  )
  else if (&wild_tail==1)
  (
    if (STRING.MID("gcc_mss_msmpu_client_axi_clk", 0, &clk_input_length-1)==STRING.CUT("&clk", -1))
    ( 
      &match=1
    )
  )
  else if ("gcc_mss_msmpu_client_axi_clk"=="&clk")
  (
    &match=1
  )
  
  if (&match==1)
  (
    &clk_test=&CLK_TEST_GCC_MSS_MSMPU_CLIENT_AXI_CLK
    &clk_reg=&HWIO_GCC_MSS_MSMPU_CLIENT_AXI_CBCR_ADDR
    &clk_reg_name="GCC_MSS_MSMPU_CLIENT_AXI_CBCR"
    &clk_name="gcc_mss_msmpu_client_axi_clk"
    &clk_reg_cbcr_type="sm_cbc"
    &clk_vote_bit=-1.
    &clk_multiplier=1.

    gosub Print_Clk_Info_Line
  )

  &match=0
  &wild_head=0
  &wild_tail=0
  &clk_input_length=STRING.LENGTH("&clk")
  &clk_itr_length=STRING.LENGTH("gcc_aggre0_snoc_axi_clk")

  if (STRING.SCAN("&clk", "*", 0)==0)
  (
    &wild_head=1
  )
  if (STRING.SCAN("&clk", "*", 1)==(STRING.LENGTH("&clk")-1))
  (
    &wild_tail=1
  )

  if ((&wild_head==1)&&(&wild_tail==1))
  (
    if (STRING.SCAN("gcc_aggre0_snoc_axi_clk", STRING.MID("&clk", 1, &clk_input_length-2), 0)!=-1)
    ( 
      &match=1
    )
  )
  else if (&wild_head==1)
  (
    if (STRING.MID("gcc_aggre0_snoc_axi_clk", &clk_itr_length-&clk_input_length+1, &clk_input_length-1)==STRING.CUT("&clk", 1))
    ( 
      &match=1
    )
  )
  else if (&wild_tail==1)
  (
    if (STRING.MID("gcc_aggre0_snoc_axi_clk", 0, &clk_input_length-1)==STRING.CUT("&clk", -1))
    ( 
      &match=1
    )
  )
  else if ("gcc_aggre0_snoc_axi_clk"=="&clk")||("buses"=="&clk")
  (
    &match=1
  )
  
  if (&match==1)
  (
    &clk_test=&CLK_TEST_GCC_AGGRE0_SNOC_AXI_CLK
    &clk_reg=&HWIO_GCC_AGGRE0_SNOC_AXI_CBCR_ADDR
    &clk_reg_name="GCC_AGGRE0_SNOC_AXI_CBCR"
    &clk_name="gcc_aggre0_snoc_axi_clk"
    &clk_reg_cbcr_type="sm_cbc"
    &clk_vote_bit=-1.
    &clk_multiplier=1.

    gosub Print_Clk_Info_Line
  )

  &match=0
  &wild_head=0
  &wild_tail=0
  &clk_input_length=STRING.LENGTH("&clk")
  &clk_itr_length=STRING.LENGTH("gcc_aggre1_snoc_axi_clk")

  if (STRING.SCAN("&clk", "*", 0)==0)
  (
    &wild_head=1
  )
  if (STRING.SCAN("&clk", "*", 1)==(STRING.LENGTH("&clk")-1))
  (
    &wild_tail=1
  )

  if ((&wild_head==1)&&(&wild_tail==1))
  (
    if (STRING.SCAN("gcc_aggre1_snoc_axi_clk", STRING.MID("&clk", 1, &clk_input_length-2), 0)!=-1)
    ( 
      &match=1
    )
  )
  else if (&wild_head==1)
  (
    if (STRING.MID("gcc_aggre1_snoc_axi_clk", &clk_itr_length-&clk_input_length+1, &clk_input_length-1)==STRING.CUT("&clk", 1))
    ( 
      &match=1
    )
  )
  else if (&wild_tail==1)
  (
    if (STRING.MID("gcc_aggre1_snoc_axi_clk", 0, &clk_input_length-1)==STRING.CUT("&clk", -1))
    ( 
      &match=1
    )
  )
  else if ("gcc_aggre1_snoc_axi_clk"=="&clk")||("buses"=="&clk")
  (
    &match=1
  )
  
  if (&match==1)
  (
    &clk_test=&CLK_TEST_GCC_AGGRE1_SNOC_AXI_CLK
    &clk_reg=&HWIO_GCC_AGGRE1_SNOC_AXI_CBCR_ADDR
    &clk_reg_name="GCC_AGGRE1_SNOC_AXI_CBCR"
    &clk_name="gcc_aggre1_snoc_axi_clk"
    &clk_reg_cbcr_type="sm_cbc"
    &clk_vote_bit=-1.
    &clk_multiplier=1.

    gosub Print_Clk_Info_Line
  )

  &match=0
  &wild_head=0
  &wild_tail=0
  &clk_input_length=STRING.LENGTH("&clk")
  &clk_itr_length=STRING.LENGTH("gcc_aggre2_snoc_axi_clk")

  if (STRING.SCAN("&clk", "*", 0)==0)
  (
    &wild_head=1
  )
  if (STRING.SCAN("&clk", "*", 1)==(STRING.LENGTH("&clk")-1))
  (
    &wild_tail=1
  )

  if ((&wild_head==1)&&(&wild_tail==1))
  (
    if (STRING.SCAN("gcc_aggre2_snoc_axi_clk", STRING.MID("&clk", 1, &clk_input_length-2), 0)!=-1)
    ( 
      &match=1
    )
  )
  else if (&wild_head==1)
  (
    if (STRING.MID("gcc_aggre2_snoc_axi_clk", &clk_itr_length-&clk_input_length+1, &clk_input_length-1)==STRING.CUT("&clk", 1))
    ( 
      &match=1
    )
  )
  else if (&wild_tail==1)
  (
    if (STRING.MID("gcc_aggre2_snoc_axi_clk", 0, &clk_input_length-1)==STRING.CUT("&clk", -1))
    ( 
      &match=1
    )
  )
  else if ("gcc_aggre2_snoc_axi_clk"=="&clk")||("buses"=="&clk")
  (
    &match=1
  )
  
  if (&match==1)
  (
    &clk_test=&CLK_TEST_GCC_AGGRE2_SNOC_AXI_CLK
    &clk_reg=&HWIO_GCC_AGGRE2_SNOC_AXI_CBCR_ADDR
    &clk_reg_name="GCC_AGGRE2_SNOC_AXI_CBCR"
    &clk_name="gcc_aggre2_snoc_axi_clk"
    &clk_reg_cbcr_type="sm_cbc"
    &clk_vote_bit=-1.
    &clk_multiplier=1.

    gosub Print_Clk_Info_Line
  )

  &match=0
  &wild_head=0
  &wild_tail=0
  &clk_input_length=STRING.LENGTH("&clk")
  &clk_itr_length=STRING.LENGTH("gcc_bimc_nius_axi_clk")

  if (STRING.SCAN("&clk", "*", 0)==0)
  (
    &wild_head=1
  )
  if (STRING.SCAN("&clk", "*", 1)==(STRING.LENGTH("&clk")-1))
  (
    &wild_tail=1
  )

  if ((&wild_head==1)&&(&wild_tail==1))
  (
    if (STRING.SCAN("gcc_bimc_nius_axi_clk", STRING.MID("&clk", 1, &clk_input_length-2), 0)!=-1)
    ( 
      &match=1
    )
  )
  else if (&wild_head==1)
  (
    if (STRING.MID("gcc_bimc_nius_axi_clk", &clk_itr_length-&clk_input_length+1, &clk_input_length-1)==STRING.CUT("&clk", 1))
    ( 
      &match=1
    )
  )
  else if (&wild_tail==1)
  (
    if (STRING.MID("gcc_bimc_nius_axi_clk", 0, &clk_input_length-1)==STRING.CUT("&clk", -1))
    ( 
      &match=1
    )
  )
  else if ("gcc_bimc_nius_axi_clk"=="&clk")
  (
    &match=1
  )
  
  if (&match==1)
  (
    &clk_test=&CLK_TEST_GCC_BIMC_NIUS_AXI_CLK
    &clk_reg=&HWIO_GCC_BIMC_NIUS_AXI_CBCR_ADDR
    &clk_reg_name="GCC_BIMC_NIUS_AXI_CBCR"
    &clk_name="gcc_bimc_nius_axi_clk"
    &clk_reg_cbcr_type="sm_cbc"
    &clk_vote_bit=-1.
    &clk_multiplier=1.

    gosub Print_Clk_Info_Line
  )

  &match=0
  &wild_head=0
  &wild_tail=0
  &clk_input_length=STRING.LENGTH("&clk")
  &clk_itr_length=STRING.LENGTH("gcc_bimc_sysnoc_axi_clk")

  if (STRING.SCAN("&clk", "*", 0)==0)
  (
    &wild_head=1
  )
  if (STRING.SCAN("&clk", "*", 1)==(STRING.LENGTH("&clk")-1))
  (
    &wild_tail=1
  )

  if ((&wild_head==1)&&(&wild_tail==1))
  (
    if (STRING.SCAN("gcc_bimc_sysnoc_axi_clk", STRING.MID("&clk", 1, &clk_input_length-2), 0)!=-1)
    ( 
      &match=1
    )
  )
  else if (&wild_head==1)
  (
    if (STRING.MID("gcc_bimc_sysnoc_axi_clk", &clk_itr_length-&clk_input_length+1, &clk_input_length-1)==STRING.CUT("&clk", 1))
    ( 
      &match=1
    )
  )
  else if (&wild_tail==1)
  (
    if (STRING.MID("gcc_bimc_sysnoc_axi_clk", 0, &clk_input_length-1)==STRING.CUT("&clk", -1))
    ( 
      &match=1
    )
  )
  else if ("gcc_bimc_sysnoc_axi_clk"=="&clk")
  (
    &match=1
  )
  
  if (&match==1)
  (
    &clk_test=&CLK_TEST_GCC_BIMC_SYSNOC_AXI_CLK
    &clk_reg=&HWIO_GCC_BIMC_SYSNOC_AXI_CBCR_ADDR
    &clk_reg_name="GCC_BIMC_SYSNOC_AXI_CBCR"
    &clk_name="gcc_bimc_sysnoc_axi_clk"
    &clk_reg_cbcr_type="sm_cbc"
    &clk_vote_bit=-1.
    &clk_multiplier=1.

    gosub Print_Clk_Info_Line
  )

  &match=0
  &wild_head=0
  &wild_tail=0
  &clk_input_length=STRING.LENGTH("&clk")
  &clk_itr_length=STRING.LENGTH("gcc_ce1_axi_clk")

  if (STRING.SCAN("&clk", "*", 0)==0)
  (
    &wild_head=1
  )
  if (STRING.SCAN("&clk", "*", 1)==(STRING.LENGTH("&clk")-1))
  (
    &wild_tail=1
  )

  if ((&wild_head==1)&&(&wild_tail==1))
  (
    if (STRING.SCAN("gcc_ce1_axi_clk", STRING.MID("&clk", 1, &clk_input_length-2), 0)!=-1)
    ( 
      &match=1
    )
  )
  else if (&wild_head==1)
  (
    if (STRING.MID("gcc_ce1_axi_clk", &clk_itr_length-&clk_input_length+1, &clk_input_length-1)==STRING.CUT("&clk", 1))
    ( 
      &match=1
    )
  )
  else if (&wild_tail==1)
  (
    if (STRING.MID("gcc_ce1_axi_clk", 0, &clk_input_length-1)==STRING.CUT("&clk", -1))
    ( 
      &match=1
    )
  )
  else if ("gcc_ce1_axi_clk"=="&clk")
  (
    &match=1
  )
  
  if (&match==1)
  (
    &clk_test=&CLK_TEST_GCC_CE1_AXI_CLK
    &clk_reg=&HWIO_GCC_CE1_AXI_CBCR_ADDR
    &clk_reg_name="GCC_CE1_AXI_CBCR"
    &clk_name="gcc_ce1_axi_clk"
    &clk_reg_cbcr_type="sm_cbc"
    &clk_vote_bit=4.
    &clk_multiplier=1.

    gosub Print_Clk_Info_Line
  )

  &match=0
  &wild_head=0
  &wild_tail=0
  &clk_input_length=STRING.LENGTH("&clk")
  &clk_itr_length=STRING.LENGTH("gcc_imem_axi_clk")

  if (STRING.SCAN("&clk", "*", 0)==0)
  (
    &wild_head=1
  )
  if (STRING.SCAN("&clk", "*", 1)==(STRING.LENGTH("&clk")-1))
  (
    &wild_tail=1
  )

  if ((&wild_head==1)&&(&wild_tail==1))
  (
    if (STRING.SCAN("gcc_imem_axi_clk", STRING.MID("&clk", 1, &clk_input_length-2), 0)!=-1)
    ( 
      &match=1
    )
  )
  else if (&wild_head==1)
  (
    if (STRING.MID("gcc_imem_axi_clk", &clk_itr_length-&clk_input_length+1, &clk_input_length-1)==STRING.CUT("&clk", 1))
    ( 
      &match=1
    )
  )
  else if (&wild_tail==1)
  (
    if (STRING.MID("gcc_imem_axi_clk", 0, &clk_input_length-1)==STRING.CUT("&clk", -1))
    ( 
      &match=1
    )
  )
  else if ("gcc_imem_axi_clk"=="&clk")
  (
    &match=1
  )
  
  if (&match==1)
  (
    &clk_test=&CLK_TEST_GCC_IMEM_AXI_CLK
    &clk_reg=&HWIO_GCC_IMEM_AXI_CBCR_ADDR
    &clk_reg_name="GCC_IMEM_AXI_CBCR"
    &clk_name="gcc_imem_axi_clk"
    &clk_reg_cbcr_type="sm_pscbc"
    &clk_vote_bit=24.
    &clk_multiplier=1.

    gosub Print_Clk_Info_Line
  )

  &match=0
  &wild_head=0
  &wild_tail=0
  &clk_input_length=STRING.LENGTH("&clk")
  &clk_itr_length=STRING.LENGTH("gcc_lpass_sway_clk")

  if (STRING.SCAN("&clk", "*", 0)==0)
  (
    &wild_head=1
  )
  if (STRING.SCAN("&clk", "*", 1)==(STRING.LENGTH("&clk")-1))
  (
    &wild_tail=1
  )

  if ((&wild_head==1)&&(&wild_tail==1))
  (
    if (STRING.SCAN("gcc_lpass_sway_clk", STRING.MID("&clk", 1, &clk_input_length-2), 0)!=-1)
    ( 
      &match=1
    )
  )
  else if (&wild_head==1)
  (
    if (STRING.MID("gcc_lpass_sway_clk", &clk_itr_length-&clk_input_length+1, &clk_input_length-1)==STRING.CUT("&clk", 1))
    ( 
      &match=1
    )
  )
  else if (&wild_tail==1)
  (
    if (STRING.MID("gcc_lpass_sway_clk", 0, &clk_input_length-1)==STRING.CUT("&clk", -1))
    ( 
      &match=1
    )
  )
  else if ("gcc_lpass_sway_clk"=="&clk")
  (
    &match=1
  )
  
  if (&match==1)
  (
    &clk_test=&CLK_TEST_GCC_LPASS_SWAY_CLK
    &clk_reg=&HWIO_GCC_LPASS_SWAY_CBCR_ADDR
    &clk_reg_name="GCC_LPASS_SWAY_CBCR"
    &clk_name="gcc_lpass_sway_clk"
    &clk_reg_cbcr_type="sm_cbc"
    &clk_vote_bit=-1.
    &clk_multiplier=1.

    gosub Print_Clk_Info_Line
  )

  &match=0
  &wild_head=0
  &wild_tail=0
  &clk_input_length=STRING.LENGTH("&clk")
  &clk_itr_length=STRING.LENGTH("gcc_mmss_sys_noc_axi_clk")

  if (STRING.SCAN("&clk", "*", 0)==0)
  (
    &wild_head=1
  )
  if (STRING.SCAN("&clk", "*", 1)==(STRING.LENGTH("&clk")-1))
  (
    &wild_tail=1
  )

  if ((&wild_head==1)&&(&wild_tail==1))
  (
    if (STRING.SCAN("gcc_mmss_sys_noc_axi_clk", STRING.MID("&clk", 1, &clk_input_length-2), 0)!=-1)
    ( 
      &match=1
    )
  )
  else if (&wild_head==1)
  (
    if (STRING.MID("gcc_mmss_sys_noc_axi_clk", &clk_itr_length-&clk_input_length+1, &clk_input_length-1)==STRING.CUT("&clk", 1))
    ( 
      &match=1
    )
  )
  else if (&wild_tail==1)
  (
    if (STRING.MID("gcc_mmss_sys_noc_axi_clk", 0, &clk_input_length-1)==STRING.CUT("&clk", -1))
    ( 
      &match=1
    )
  )
  else if ("gcc_mmss_sys_noc_axi_clk"=="&clk")
  (
    &match=1
  )
  
  if (&match==1)
  (
    &clk_test=&CLK_TEST_GCC_MMSS_SYS_NOC_AXI_CLK
    &clk_reg=&HWIO_GCC_MMSS_SYS_NOC_AXI_CBCR_ADDR
    &clk_reg_name="GCC_MMSS_SYS_NOC_AXI_CBCR"
    &clk_name="gcc_mmss_sys_noc_axi_clk"
    &clk_reg_cbcr_type="sm_cbc"
    &clk_vote_bit=-1.
    &clk_multiplier=1.

    gosub Print_Clk_Info_Line
  )

  &match=0
  &wild_head=0
  &wild_tail=0
  &clk_input_length=STRING.LENGTH("&clk")
  &clk_itr_length=STRING.LENGTH("gcc_pcie_0_mstr_axi_clk")

  if (STRING.SCAN("&clk", "*", 0)==0)
  (
    &wild_head=1
  )
  if (STRING.SCAN("&clk", "*", 1)==(STRING.LENGTH("&clk")-1))
  (
    &wild_tail=1
  )

  if ((&wild_head==1)&&(&wild_tail==1))
  (
    if (STRING.SCAN("gcc_pcie_0_mstr_axi_clk", STRING.MID("&clk", 1, &clk_input_length-2), 0)!=-1)
    ( 
      &match=1
    )
  )
  else if (&wild_head==1)
  (
    if (STRING.MID("gcc_pcie_0_mstr_axi_clk", &clk_itr_length-&clk_input_length+1, &clk_input_length-1)==STRING.CUT("&clk", 1))
    ( 
      &match=1
    )
  )
  else if (&wild_tail==1)
  (
    if (STRING.MID("gcc_pcie_0_mstr_axi_clk", 0, &clk_input_length-1)==STRING.CUT("&clk", -1))
    ( 
      &match=1
    )
  )
  else if ("gcc_pcie_0_mstr_axi_clk"=="&clk")
  (
    &match=1
  )
  
  if (&match==1)
  (
    &clk_test=&CLK_TEST_GCC_PCIE_0_MSTR_AXI_CLK
    &clk_reg=&HWIO_GCC_PCIE_0_MSTR_AXI_CBCR_ADDR
    &clk_reg_name="GCC_PCIE_0_MSTR_AXI_CBCR"
    &clk_name="gcc_pcie_0_mstr_axi_clk"
    &clk_reg_cbcr_type="sm_pscbc"
    &clk_vote_bit=-1.
    &clk_multiplier=1.

    gosub Print_Clk_Info_Line
  )

  &match=0
  &wild_head=0
  &wild_tail=0
  &clk_input_length=STRING.LENGTH("&clk")
  &clk_itr_length=STRING.LENGTH("gcc_pcie_0_slv_axi_clk")

  if (STRING.SCAN("&clk", "*", 0)==0)
  (
    &wild_head=1
  )
  if (STRING.SCAN("&clk", "*", 1)==(STRING.LENGTH("&clk")-1))
  (
    &wild_tail=1
  )

  if ((&wild_head==1)&&(&wild_tail==1))
  (
    if (STRING.SCAN("gcc_pcie_0_slv_axi_clk", STRING.MID("&clk", 1, &clk_input_length-2), 0)!=-1)
    ( 
      &match=1
    )
  )
  else if (&wild_head==1)
  (
    if (STRING.MID("gcc_pcie_0_slv_axi_clk", &clk_itr_length-&clk_input_length+1, &clk_input_length-1)==STRING.CUT("&clk", 1))
    ( 
      &match=1
    )
  )
  else if (&wild_tail==1)
  (
    if (STRING.MID("gcc_pcie_0_slv_axi_clk", 0, &clk_input_length-1)==STRING.CUT("&clk", -1))
    ( 
      &match=1
    )
  )
  else if ("gcc_pcie_0_slv_axi_clk"=="&clk")
  (
    &match=1
  )
  
  if (&match==1)
  (
    &clk_test=&CLK_TEST_GCC_PCIE_0_SLV_AXI_CLK
    &clk_reg=&HWIO_GCC_PCIE_0_SLV_AXI_CBCR_ADDR
    &clk_reg_name="GCC_PCIE_0_SLV_AXI_CBCR"
    &clk_name="gcc_pcie_0_slv_axi_clk"
    &clk_reg_cbcr_type="sm_pscbc"
    &clk_vote_bit=-1.
    &clk_multiplier=1.

    gosub Print_Clk_Info_Line
  )

  &match=0
  &wild_head=0
  &wild_tail=0
  &clk_input_length=STRING.LENGTH("&clk")
  &clk_itr_length=STRING.LENGTH("gcc_pcie_1_mstr_axi_clk")

  if (STRING.SCAN("&clk", "*", 0)==0)
  (
    &wild_head=1
  )
  if (STRING.SCAN("&clk", "*", 1)==(STRING.LENGTH("&clk")-1))
  (
    &wild_tail=1
  )

  if ((&wild_head==1)&&(&wild_tail==1))
  (
    if (STRING.SCAN("gcc_pcie_1_mstr_axi_clk", STRING.MID("&clk", 1, &clk_input_length-2), 0)!=-1)
    ( 
      &match=1
    )
  )
  else if (&wild_head==1)
  (
    if (STRING.MID("gcc_pcie_1_mstr_axi_clk", &clk_itr_length-&clk_input_length+1, &clk_input_length-1)==STRING.CUT("&clk", 1))
    ( 
      &match=1
    )
  )
  else if (&wild_tail==1)
  (
    if (STRING.MID("gcc_pcie_1_mstr_axi_clk", 0, &clk_input_length-1)==STRING.CUT("&clk", -1))
    ( 
      &match=1
    )
  )
  else if ("gcc_pcie_1_mstr_axi_clk"=="&clk")
  (
    &match=1
  )
  
  if (&match==1)
  (
    &clk_test=&CLK_TEST_GCC_PCIE_1_MSTR_AXI_CLK
    &clk_reg=&HWIO_GCC_PCIE_1_MSTR_AXI_CBCR_ADDR
    &clk_reg_name="GCC_PCIE_1_MSTR_AXI_CBCR"
    &clk_name="gcc_pcie_1_mstr_axi_clk"
    &clk_reg_cbcr_type="sm_pscbc"
    &clk_vote_bit=-1.
    &clk_multiplier=1.

    gosub Print_Clk_Info_Line
  )

  &match=0
  &wild_head=0
  &wild_tail=0
  &clk_input_length=STRING.LENGTH("&clk")
  &clk_itr_length=STRING.LENGTH("gcc_pcie_1_slv_axi_clk")

  if (STRING.SCAN("&clk", "*", 0)==0)
  (
    &wild_head=1
  )
  if (STRING.SCAN("&clk", "*", 1)==(STRING.LENGTH("&clk")-1))
  (
    &wild_tail=1
  )

  if ((&wild_head==1)&&(&wild_tail==1))
  (
    if (STRING.SCAN("gcc_pcie_1_slv_axi_clk", STRING.MID("&clk", 1, &clk_input_length-2), 0)!=-1)
    ( 
      &match=1
    )
  )
  else if (&wild_head==1)
  (
    if (STRING.MID("gcc_pcie_1_slv_axi_clk", &clk_itr_length-&clk_input_length+1, &clk_input_length-1)==STRING.CUT("&clk", 1))
    ( 
      &match=1
    )
  )
  else if (&wild_tail==1)
  (
    if (STRING.MID("gcc_pcie_1_slv_axi_clk", 0, &clk_input_length-1)==STRING.CUT("&clk", -1))
    ( 
      &match=1
    )
  )
  else if ("gcc_pcie_1_slv_axi_clk"=="&clk")
  (
    &match=1
  )
  
  if (&match==1)
  (
    &clk_test=&CLK_TEST_GCC_PCIE_1_SLV_AXI_CLK
    &clk_reg=&HWIO_GCC_PCIE_1_SLV_AXI_CBCR_ADDR
    &clk_reg_name="GCC_PCIE_1_SLV_AXI_CBCR"
    &clk_name="gcc_pcie_1_slv_axi_clk"
    &clk_reg_cbcr_type="sm_pscbc"
    &clk_vote_bit=-1.
    &clk_multiplier=1.

    gosub Print_Clk_Info_Line
  )

  &match=0
  &wild_head=0
  &wild_tail=0
  &clk_input_length=STRING.LENGTH("&clk")
  &clk_itr_length=STRING.LENGTH("gcc_pcie_2_mstr_axi_clk")

  if (STRING.SCAN("&clk", "*", 0)==0)
  (
    &wild_head=1
  )
  if (STRING.SCAN("&clk", "*", 1)==(STRING.LENGTH("&clk")-1))
  (
    &wild_tail=1
  )

  if ((&wild_head==1)&&(&wild_tail==1))
  (
    if (STRING.SCAN("gcc_pcie_2_mstr_axi_clk", STRING.MID("&clk", 1, &clk_input_length-2), 0)!=-1)
    ( 
      &match=1
    )
  )
  else if (&wild_head==1)
  (
    if (STRING.MID("gcc_pcie_2_mstr_axi_clk", &clk_itr_length-&clk_input_length+1, &clk_input_length-1)==STRING.CUT("&clk", 1))
    ( 
      &match=1
    )
  )
  else if (&wild_tail==1)
  (
    if (STRING.MID("gcc_pcie_2_mstr_axi_clk", 0, &clk_input_length-1)==STRING.CUT("&clk", -1))
    ( 
      &match=1
    )
  )
  else if ("gcc_pcie_2_mstr_axi_clk"=="&clk")
  (
    &match=1
  )
  
  if (&match==1)
  (
    &clk_test=&CLK_TEST_GCC_PCIE_2_MSTR_AXI_CLK
    &clk_reg=&HWIO_GCC_PCIE_2_MSTR_AXI_CBCR_ADDR
    &clk_reg_name="GCC_PCIE_2_MSTR_AXI_CBCR"
    &clk_name="gcc_pcie_2_mstr_axi_clk"
    &clk_reg_cbcr_type="sm_pscbc"
    &clk_vote_bit=-1.
    &clk_multiplier=1.

    gosub Print_Clk_Info_Line
  )

  &match=0
  &wild_head=0
  &wild_tail=0
  &clk_input_length=STRING.LENGTH("&clk")
  &clk_itr_length=STRING.LENGTH("gcc_pcie_2_slv_axi_clk")

  if (STRING.SCAN("&clk", "*", 0)==0)
  (
    &wild_head=1
  )
  if (STRING.SCAN("&clk", "*", 1)==(STRING.LENGTH("&clk")-1))
  (
    &wild_tail=1
  )

  if ((&wild_head==1)&&(&wild_tail==1))
  (
    if (STRING.SCAN("gcc_pcie_2_slv_axi_clk", STRING.MID("&clk", 1, &clk_input_length-2), 0)!=-1)
    ( 
      &match=1
    )
  )
  else if (&wild_head==1)
  (
    if (STRING.MID("gcc_pcie_2_slv_axi_clk", &clk_itr_length-&clk_input_length+1, &clk_input_length-1)==STRING.CUT("&clk", 1))
    ( 
      &match=1
    )
  )
  else if (&wild_tail==1)
  (
    if (STRING.MID("gcc_pcie_2_slv_axi_clk", 0, &clk_input_length-1)==STRING.CUT("&clk", -1))
    ( 
      &match=1
    )
  )
  else if ("gcc_pcie_2_slv_axi_clk"=="&clk")
  (
    &match=1
  )
  
  if (&match==1)
  (
    &clk_test=&CLK_TEST_GCC_PCIE_2_SLV_AXI_CLK
    &clk_reg=&HWIO_GCC_PCIE_2_SLV_AXI_CBCR_ADDR
    &clk_reg_name="GCC_PCIE_2_SLV_AXI_CBCR"
    &clk_name="gcc_pcie_2_slv_axi_clk"
    &clk_reg_cbcr_type="sm_pscbc"
    &clk_vote_bit=-1.
    &clk_multiplier=1.

    gosub Print_Clk_Info_Line
  )

  &match=0
  &wild_head=0
  &wild_tail=0
  &clk_input_length=STRING.LENGTH("&clk")
  &clk_itr_length=STRING.LENGTH("gcc_qdss_etr_usb_clk")

  if (STRING.SCAN("&clk", "*", 0)==0)
  (
    &wild_head=1
  )
  if (STRING.SCAN("&clk", "*", 1)==(STRING.LENGTH("&clk")-1))
  (
    &wild_tail=1
  )

  if ((&wild_head==1)&&(&wild_tail==1))
  (
    if (STRING.SCAN("gcc_qdss_etr_usb_clk", STRING.MID("&clk", 1, &clk_input_length-2), 0)!=-1)
    ( 
      &match=1
    )
  )
  else if (&wild_head==1)
  (
    if (STRING.MID("gcc_qdss_etr_usb_clk", &clk_itr_length-&clk_input_length+1, &clk_input_length-1)==STRING.CUT("&clk", 1))
    ( 
      &match=1
    )
  )
  else if (&wild_tail==1)
  (
    if (STRING.MID("gcc_qdss_etr_usb_clk", 0, &clk_input_length-1)==STRING.CUT("&clk", -1))
    ( 
      &match=1
    )
  )
  else if ("gcc_qdss_etr_usb_clk"=="&clk")
  (
    &match=1
  )
  
  if (&match==1)
  (
    &clk_test=&CLK_TEST_GCC_QDSS_ETR_USB_CLK
    &clk_reg=&HWIO_GCC_QDSS_ETR_USB_CBCR_ADDR
    &clk_reg_name="GCC_QDSS_ETR_USB_CBCR"
    &clk_name="gcc_qdss_etr_usb_clk"
    &clk_reg_cbcr_type="sm_cbc"
    &clk_vote_bit=-1.
    &clk_multiplier=1.

    gosub Print_Clk_Info_Line
  )

  &match=0
  &wild_head=0
  &wild_tail=0
  &clk_input_length=STRING.LENGTH("&clk")
  &clk_itr_length=STRING.LENGTH("gcc_smmu_aggre0_axi_clk")

  if (STRING.SCAN("&clk", "*", 0)==0)
  (
    &wild_head=1
  )
  if (STRING.SCAN("&clk", "*", 1)==(STRING.LENGTH("&clk")-1))
  (
    &wild_tail=1
  )

  if ((&wild_head==1)&&(&wild_tail==1))
  (
    if (STRING.SCAN("gcc_smmu_aggre0_axi_clk", STRING.MID("&clk", 1, &clk_input_length-2), 0)!=-1)
    ( 
      &match=1
    )
  )
  else if (&wild_head==1)
  (
    if (STRING.MID("gcc_smmu_aggre0_axi_clk", &clk_itr_length-&clk_input_length+1, &clk_input_length-1)==STRING.CUT("&clk", 1))
    ( 
      &match=1
    )
  )
  else if (&wild_tail==1)
  (
    if (STRING.MID("gcc_smmu_aggre0_axi_clk", 0, &clk_input_length-1)==STRING.CUT("&clk", -1))
    ( 
      &match=1
    )
  )
  else if ("gcc_smmu_aggre0_axi_clk"=="&clk")
  (
    &match=1
  )
  
  if (&match==1)
  (
    &clk_test=&CLK_TEST_GCC_SMMU_AGGRE0_AXI_CLK
    &clk_reg=&HWIO_GCC_SMMU_AGGRE0_AXI_CBCR_ADDR
    &clk_reg_name="GCC_SMMU_AGGRE0_AXI_CBCR"
    &clk_name="gcc_smmu_aggre0_axi_clk"
    &clk_reg_cbcr_type="sm_pscbc"
    &clk_vote_bit=-1.
    &clk_multiplier=1.

    gosub Print_Clk_Info_Line
  )

  &match=0
  &wild_head=0
  &wild_tail=0
  &clk_input_length=STRING.LENGTH("&clk")
  &clk_itr_length=STRING.LENGTH("gcc_smmu_aggre1_axi_clk")

  if (STRING.SCAN("&clk", "*", 0)==0)
  (
    &wild_head=1
  )
  if (STRING.SCAN("&clk", "*", 1)==(STRING.LENGTH("&clk")-1))
  (
    &wild_tail=1
  )

  if ((&wild_head==1)&&(&wild_tail==1))
  (
    if (STRING.SCAN("gcc_smmu_aggre1_axi_clk", STRING.MID("&clk", 1, &clk_input_length-2), 0)!=-1)
    ( 
      &match=1
    )
  )
  else if (&wild_head==1)
  (
    if (STRING.MID("gcc_smmu_aggre1_axi_clk", &clk_itr_length-&clk_input_length+1, &clk_input_length-1)==STRING.CUT("&clk", 1))
    ( 
      &match=1
    )
  )
  else if (&wild_tail==1)
  (
    if (STRING.MID("gcc_smmu_aggre1_axi_clk", 0, &clk_input_length-1)==STRING.CUT("&clk", -1))
    ( 
      &match=1
    )
  )
  else if ("gcc_smmu_aggre1_axi_clk"=="&clk")
  (
    &match=1
  )
  
  if (&match==1)
  (
    &clk_test=&CLK_TEST_GCC_SMMU_AGGRE1_AXI_CLK
    &clk_reg=&HWIO_GCC_SMMU_AGGRE1_AXI_CBCR_ADDR
    &clk_reg_name="GCC_SMMU_AGGRE1_AXI_CBCR"
    &clk_name="gcc_smmu_aggre1_axi_clk"
    &clk_reg_cbcr_type="sm_pscbc"
    &clk_vote_bit=-1.
    &clk_multiplier=1.

    gosub Print_Clk_Info_Line
  )

  &match=0
  &wild_head=0
  &wild_tail=0
  &clk_input_length=STRING.LENGTH("&clk")
  &clk_itr_length=STRING.LENGTH("gcc_smmu_aggre2_axi_clk")

  if (STRING.SCAN("&clk", "*", 0)==0)
  (
    &wild_head=1
  )
  if (STRING.SCAN("&clk", "*", 1)==(STRING.LENGTH("&clk")-1))
  (
    &wild_tail=1
  )

  if ((&wild_head==1)&&(&wild_tail==1))
  (
    if (STRING.SCAN("gcc_smmu_aggre2_axi_clk", STRING.MID("&clk", 1, &clk_input_length-2), 0)!=-1)
    ( 
      &match=1
    )
  )
  else if (&wild_head==1)
  (
    if (STRING.MID("gcc_smmu_aggre2_axi_clk", &clk_itr_length-&clk_input_length+1, &clk_input_length-1)==STRING.CUT("&clk", 1))
    ( 
      &match=1
    )
  )
  else if (&wild_tail==1)
  (
    if (STRING.MID("gcc_smmu_aggre2_axi_clk", 0, &clk_input_length-1)==STRING.CUT("&clk", -1))
    ( 
      &match=1
    )
  )
  else if ("gcc_smmu_aggre2_axi_clk"=="&clk")
  (
    &match=1
  )
  
  if (&match==1)
  (
    &clk_test=&CLK_TEST_GCC_SMMU_AGGRE2_AXI_CLK
    &clk_reg=&HWIO_GCC_SMMU_AGGRE2_AXI_CBCR_ADDR
    &clk_reg_name="GCC_SMMU_AGGRE2_AXI_CBCR"
    &clk_name="gcc_smmu_aggre2_axi_clk"
    &clk_reg_cbcr_type="sm_pscbc"
    &clk_vote_bit=-1.
    &clk_multiplier=1.

    gosub Print_Clk_Info_Line
  )

  &match=0
  &wild_head=0
  &wild_tail=0
  &clk_input_length=STRING.LENGTH("&clk")
  &clk_itr_length=STRING.LENGTH("gcc_snoc_bus_timeout1_ahb_clk")

  if (STRING.SCAN("&clk", "*", 0)==0)
  (
    &wild_head=1
  )
  if (STRING.SCAN("&clk", "*", 1)==(STRING.LENGTH("&clk")-1))
  (
    &wild_tail=1
  )

  if ((&wild_head==1)&&(&wild_tail==1))
  (
    if (STRING.SCAN("gcc_snoc_bus_timeout1_ahb_clk", STRING.MID("&clk", 1, &clk_input_length-2), 0)!=-1)
    ( 
      &match=1
    )
  )
  else if (&wild_head==1)
  (
    if (STRING.MID("gcc_snoc_bus_timeout1_ahb_clk", &clk_itr_length-&clk_input_length+1, &clk_input_length-1)==STRING.CUT("&clk", 1))
    ( 
      &match=1
    )
  )
  else if (&wild_tail==1)
  (
    if (STRING.MID("gcc_snoc_bus_timeout1_ahb_clk", 0, &clk_input_length-1)==STRING.CUT("&clk", -1))
    ( 
      &match=1
    )
  )
  else if ("gcc_snoc_bus_timeout1_ahb_clk"=="&clk")
  (
    &match=1
  )
  
  if (&match==1)
  (
    &clk_test=&CLK_TEST_GCC_SNOC_BUS_TIMEOUT1_AHB_CLK
    &clk_reg=&HWIO_GCC_SNOC_BUS_TIMEOUT1_AHB_CBCR_ADDR
    &clk_reg_name="GCC_SNOC_BUS_TIMEOUT1_AHB_CBCR"
    &clk_name="gcc_snoc_bus_timeout1_ahb_clk"
    &clk_reg_cbcr_type="sm_cbc"
    &clk_vote_bit=-1.
    &clk_multiplier=1.

    gosub Print_Clk_Info_Line
  )

  &match=0
  &wild_head=0
  &wild_tail=0
  &clk_input_length=STRING.LENGTH("&clk")
  &clk_itr_length=STRING.LENGTH("gcc_snoc_bus_timeout3_ahb_clk")

  if (STRING.SCAN("&clk", "*", 0)==0)
  (
    &wild_head=1
  )
  if (STRING.SCAN("&clk", "*", 1)==(STRING.LENGTH("&clk")-1))
  (
    &wild_tail=1
  )

  if ((&wild_head==1)&&(&wild_tail==1))
  (
    if (STRING.SCAN("gcc_snoc_bus_timeout3_ahb_clk", STRING.MID("&clk", 1, &clk_input_length-2), 0)!=-1)
    ( 
      &match=1
    )
  )
  else if (&wild_head==1)
  (
    if (STRING.MID("gcc_snoc_bus_timeout3_ahb_clk", &clk_itr_length-&clk_input_length+1, &clk_input_length-1)==STRING.CUT("&clk", 1))
    ( 
      &match=1
    )
  )
  else if (&wild_tail==1)
  (
    if (STRING.MID("gcc_snoc_bus_timeout3_ahb_clk", 0, &clk_input_length-1)==STRING.CUT("&clk", -1))
    ( 
      &match=1
    )
  )
  else if ("gcc_snoc_bus_timeout3_ahb_clk"=="&clk")
  (
    &match=1
  )
  
  if (&match==1)
  (
    &clk_test=&CLK_TEST_GCC_SNOC_BUS_TIMEOUT3_AHB_CLK
    &clk_reg=&HWIO_GCC_SNOC_BUS_TIMEOUT3_AHB_CBCR_ADDR
    &clk_reg_name="GCC_SNOC_BUS_TIMEOUT3_AHB_CBCR"
    &clk_name="gcc_snoc_bus_timeout3_ahb_clk"
    &clk_reg_cbcr_type="sm_cbc"
    &clk_vote_bit=-1.
    &clk_multiplier=1.

    gosub Print_Clk_Info_Line
  )

  &match=0
  &wild_head=0
  &wild_tail=0
  &clk_input_length=STRING.LENGTH("&clk")
  &clk_itr_length=STRING.LENGTH("gcc_spdm_snoc_cy_clk")

  if (STRING.SCAN("&clk", "*", 0)==0)
  (
    &wild_head=1
  )
  if (STRING.SCAN("&clk", "*", 1)==(STRING.LENGTH("&clk")-1))
  (
    &wild_tail=1
  )

  if ((&wild_head==1)&&(&wild_tail==1))
  (
    if (STRING.SCAN("gcc_spdm_snoc_cy_clk", STRING.MID("&clk", 1, &clk_input_length-2), 0)!=-1)
    ( 
      &match=1
    )
  )
  else if (&wild_head==1)
  (
    if (STRING.MID("gcc_spdm_snoc_cy_clk", &clk_itr_length-&clk_input_length+1, &clk_input_length-1)==STRING.CUT("&clk", 1))
    ( 
      &match=1
    )
  )
  else if (&wild_tail==1)
  (
    if (STRING.MID("gcc_spdm_snoc_cy_clk", 0, &clk_input_length-1)==STRING.CUT("&clk", -1))
    ( 
      &match=1
    )
  )
  else if ("gcc_spdm_snoc_cy_clk"=="&clk")
  (
    &match=1
  )
  
  if (&match==1)
  (
    &clk_test=&CLK_TEST_GCC_SPDM_SNOC_CY_CLK
    &clk_reg=&HWIO_GCC_SPDM_SNOC_CY_CBCR_ADDR
    &clk_reg_name="GCC_SPDM_SNOC_CY_CBCR"
    &clk_name="gcc_spdm_snoc_cy_clk"
    &clk_reg_cbcr_type="sm_cbc"
    &clk_vote_bit=-1.
    &clk_multiplier=1.

    gosub Print_Clk_Info_Line
  )

  &match=0
  &wild_head=0
  &wild_tail=0
  &clk_input_length=STRING.LENGTH("&clk")
  &clk_itr_length=STRING.LENGTH("gcc_ssc_snoc_ahbm_clk")

  if (STRING.SCAN("&clk", "*", 0)==0)
  (
    &wild_head=1
  )
  if (STRING.SCAN("&clk", "*", 1)==(STRING.LENGTH("&clk")-1))
  (
    &wild_tail=1
  )

  if ((&wild_head==1)&&(&wild_tail==1))
  (
    if (STRING.SCAN("gcc_ssc_snoc_ahbm_clk", STRING.MID("&clk", 1, &clk_input_length-2), 0)!=-1)
    ( 
      &match=1
    )
  )
  else if (&wild_head==1)
  (
    if (STRING.MID("gcc_ssc_snoc_ahbm_clk", &clk_itr_length-&clk_input_length+1, &clk_input_length-1)==STRING.CUT("&clk", 1))
    ( 
      &match=1
    )
  )
  else if (&wild_tail==1)
  (
    if (STRING.MID("gcc_ssc_snoc_ahbm_clk", 0, &clk_input_length-1)==STRING.CUT("&clk", -1))
    ( 
      &match=1
    )
  )
  else if ("gcc_ssc_snoc_ahbm_clk"=="&clk")
  (
    &match=1
  )
  
  if (&match==1)
  (
    &clk_test=&CLK_TEST_GCC_SSC_SNOC_AHBM_CLK
    &clk_reg=&HWIO_GCC_SSC_SNOC_AHBM_CBCR_ADDR
    &clk_reg_name="GCC_SSC_SNOC_AHBM_CBCR"
    &clk_name="gcc_ssc_snoc_ahbm_clk"
    &clk_reg_cbcr_type="sm_cbc"
    &clk_vote_bit=-1.
    &clk_multiplier=1.

    gosub Print_Clk_Info_Line
  )

  &match=0
  &wild_head=0
  &wild_tail=0
  &clk_input_length=STRING.LENGTH("&clk")
  &clk_itr_length=STRING.LENGTH("gcc_sys_noc_axi_clk")

  if (STRING.SCAN("&clk", "*", 0)==0)
  (
    &wild_head=1
  )
  if (STRING.SCAN("&clk", "*", 1)==(STRING.LENGTH("&clk")-1))
  (
    &wild_tail=1
  )

  if ((&wild_head==1)&&(&wild_tail==1))
  (
    if (STRING.SCAN("gcc_sys_noc_axi_clk", STRING.MID("&clk", 1, &clk_input_length-2), 0)!=-1)
    ( 
      &match=1
    )
  )
  else if (&wild_head==1)
  (
    if (STRING.MID("gcc_sys_noc_axi_clk", &clk_itr_length-&clk_input_length+1, &clk_input_length-1)==STRING.CUT("&clk", 1))
    ( 
      &match=1
    )
  )
  else if (&wild_tail==1)
  (
    if (STRING.MID("gcc_sys_noc_axi_clk", 0, &clk_input_length-1)==STRING.CUT("&clk", -1))
    ( 
      &match=1
    )
  )
  else if ("gcc_sys_noc_axi_clk"=="&clk")||("buses"=="&clk")
  (
    &match=1
  )
  
  if (&match==1)
  (
    &clk_test=&CLK_TEST_GCC_SYS_NOC_AXI_CLK
    &clk_reg=&HWIO_GCC_SYS_NOC_AXI_CBCR_ADDR
    &clk_reg_name="GCC_SYS_NOC_AXI_CBCR"
    &clk_name="gcc_sys_noc_axi_clk"
    &clk_reg_cbcr_type="sm_cbc"
    &clk_vote_bit=-1.
    &clk_multiplier=1.

    gosub Print_Clk_Info_Line
  )

  &match=0
  &wild_head=0
  &wild_tail=0
  &clk_input_length=STRING.LENGTH("&clk")
  &clk_itr_length=STRING.LENGTH("gcc_sys_noc_ssc_q6_axi_clk")

  if (STRING.SCAN("&clk", "*", 0)==0)
  (
    &wild_head=1
  )
  if (STRING.SCAN("&clk", "*", 1)==(STRING.LENGTH("&clk")-1))
  (
    &wild_tail=1
  )

  if ((&wild_head==1)&&(&wild_tail==1))
  (
    if (STRING.SCAN("gcc_sys_noc_ssc_q6_axi_clk", STRING.MID("&clk", 1, &clk_input_length-2), 0)!=-1)
    ( 
      &match=1
    )
  )
  else if (&wild_head==1)
  (
    if (STRING.MID("gcc_sys_noc_ssc_q6_axi_clk", &clk_itr_length-&clk_input_length+1, &clk_input_length-1)==STRING.CUT("&clk", 1))
    ( 
      &match=1
    )
  )
  else if (&wild_tail==1)
  (
    if (STRING.MID("gcc_sys_noc_ssc_q6_axi_clk", 0, &clk_input_length-1)==STRING.CUT("&clk", -1))
    ( 
      &match=1
    )
  )
  else if ("gcc_sys_noc_ssc_q6_axi_clk"=="&clk")
  (
    &match=1
  )
  
  if (&match==1)
  (
    &clk_test=&CLK_TEST_GCC_SYS_NOC_SSC_Q6_AXI_CLK
    &clk_reg=&HWIO_GCC_SYS_NOC_SSC_Q6_AXI_CBCR_ADDR
    &clk_reg_name="GCC_SYS_NOC_SSC_Q6_AXI_CBCR"
    &clk_name="gcc_sys_noc_ssc_q6_axi_clk"
    &clk_reg_cbcr_type="sm_pscbc"
    &clk_vote_bit=-1.
    &clk_multiplier=1.

    gosub Print_Clk_Info_Line
  )

  &match=0
  &wild_head=0
  &wild_tail=0
  &clk_input_length=STRING.LENGTH("&clk")
  &clk_itr_length=STRING.LENGTH("gcc_aggre1_snoc_msmpu_client_axi_clk")

  if (STRING.SCAN("&clk", "*", 0)==0)
  (
    &wild_head=1
  )
  if (STRING.SCAN("&clk", "*", 1)==(STRING.LENGTH("&clk")-1))
  (
    &wild_tail=1
  )

  if ((&wild_head==1)&&(&wild_tail==1))
  (
    if (STRING.SCAN("gcc_aggre1_snoc_msmpu_client_axi_clk", STRING.MID("&clk", 1, &clk_input_length-2), 0)!=-1)
    ( 
      &match=1
    )
  )
  else if (&wild_head==1)
  (
    if (STRING.MID("gcc_aggre1_snoc_msmpu_client_axi_clk", &clk_itr_length-&clk_input_length+1, &clk_input_length-1)==STRING.CUT("&clk", 1))
    ( 
      &match=1
    )
  )
  else if (&wild_tail==1)
  (
    if (STRING.MID("gcc_aggre1_snoc_msmpu_client_axi_clk", 0, &clk_input_length-1)==STRING.CUT("&clk", -1))
    ( 
      &match=1
    )
  )
  else if ("gcc_aggre1_snoc_msmpu_client_axi_clk"=="&clk")
  (
    &match=1
  )
  
  if (&match==1)
  (
    &clk_test=&CLK_TEST_GCC_AGGRE1_SNOC_MSMPU_CLIENT_AXI_CLK
    &clk_reg=&HWIO_GCC_AGGRE1_SNOC_MSMPU_CLIENT_AXI_CBCR_ADDR
    &clk_reg_name="GCC_AGGRE1_SNOC_MSMPU_CLIENT_AXI_CBCR"
    &clk_name="gcc_aggre1_snoc_msmpu_client_axi_clk"
    &clk_reg_cbcr_type="sm_cbc"
    &clk_vote_bit=-1.
    &clk_multiplier=1.

    gosub Print_Clk_Info_Line
  )

  &match=0
  &wild_head=0
  &wild_tail=0
  &clk_input_length=STRING.LENGTH("&clk")
  &clk_itr_length=STRING.LENGTH("gcc_aggre2_snoc_msmpu_client_axi_clk")

  if (STRING.SCAN("&clk", "*", 0)==0)
  (
    &wild_head=1
  )
  if (STRING.SCAN("&clk", "*", 1)==(STRING.LENGTH("&clk")-1))
  (
    &wild_tail=1
  )

  if ((&wild_head==1)&&(&wild_tail==1))
  (
    if (STRING.SCAN("gcc_aggre2_snoc_msmpu_client_axi_clk", STRING.MID("&clk", 1, &clk_input_length-2), 0)!=-1)
    ( 
      &match=1
    )
  )
  else if (&wild_head==1)
  (
    if (STRING.MID("gcc_aggre2_snoc_msmpu_client_axi_clk", &clk_itr_length-&clk_input_length+1, &clk_input_length-1)==STRING.CUT("&clk", 1))
    ( 
      &match=1
    )
  )
  else if (&wild_tail==1)
  (
    if (STRING.MID("gcc_aggre2_snoc_msmpu_client_axi_clk", 0, &clk_input_length-1)==STRING.CUT("&clk", -1))
    ( 
      &match=1
    )
  )
  else if ("gcc_aggre2_snoc_msmpu_client_axi_clk"=="&clk")
  (
    &match=1
  )
  
  if (&match==1)
  (
    &clk_test=&CLK_TEST_GCC_AGGRE2_SNOC_MSMPU_CLIENT_AXI_CLK
    &clk_reg=&HWIO_GCC_AGGRE2_SNOC_MSMPU_CLIENT_AXI_CBCR_ADDR
    &clk_reg_name="GCC_AGGRE2_SNOC_MSMPU_CLIENT_AXI_CBCR"
    &clk_name="gcc_aggre2_snoc_msmpu_client_axi_clk"
    &clk_reg_cbcr_type="sm_cbc"
    &clk_vote_bit=-1.
    &clk_multiplier=1.

    gosub Print_Clk_Info_Line
  )

  &match=0
  &wild_head=0
  &wild_tail=0
  &clk_input_length=STRING.LENGTH("&clk")
  &clk_itr_length=STRING.LENGTH("gcc_mss_snoc_axi_clk")

  if (STRING.SCAN("&clk", "*", 0)==0)
  (
    &wild_head=1
  )
  if (STRING.SCAN("&clk", "*", 1)==(STRING.LENGTH("&clk")-1))
  (
    &wild_tail=1
  )

  if ((&wild_head==1)&&(&wild_tail==1))
  (
    if (STRING.SCAN("gcc_mss_snoc_axi_clk", STRING.MID("&clk", 1, &clk_input_length-2), 0)!=-1)
    ( 
      &match=1
    )
  )
  else if (&wild_head==1)
  (
    if (STRING.MID("gcc_mss_snoc_axi_clk", &clk_itr_length-&clk_input_length+1, &clk_input_length-1)==STRING.CUT("&clk", 1))
    ( 
      &match=1
    )
  )
  else if (&wild_tail==1)
  (
    if (STRING.MID("gcc_mss_snoc_axi_clk", 0, &clk_input_length-1)==STRING.CUT("&clk", -1))
    ( 
      &match=1
    )
  )
  else if ("gcc_mss_snoc_axi_clk"=="&clk")
  (
    &match=1
  )
  
  if (&match==1)
  (
    &clk_test=&CLK_TEST_GCC_MSS_SNOC_AXI_CLK
    &clk_reg=&HWIO_GCC_MSS_SNOC_AXI_CBCR_ADDR
    &clk_reg_name="GCC_MSS_SNOC_AXI_CBCR"
    &clk_name="gcc_mss_snoc_axi_clk"
    &clk_reg_cbcr_type="sm_cbc"
    &clk_vote_bit=-1.
    &clk_multiplier=1.

    gosub Print_Clk_Info_Line
  )

  &match=0
  &wild_head=0
  &wild_tail=0
  &clk_input_length=STRING.LENGTH("&clk")
  &clk_itr_length=STRING.LENGTH("gcc_cfg_noc_tic_clk")

  if (STRING.SCAN("&clk", "*", 0)==0)
  (
    &wild_head=1
  )
  if (STRING.SCAN("&clk", "*", 1)==(STRING.LENGTH("&clk")-1))
  (
    &wild_tail=1
  )

  if ((&wild_head==1)&&(&wild_tail==1))
  (
    if (STRING.SCAN("gcc_cfg_noc_tic_clk", STRING.MID("&clk", 1, &clk_input_length-2), 0)!=-1)
    ( 
      &match=1
    )
  )
  else if (&wild_head==1)
  (
    if (STRING.MID("gcc_cfg_noc_tic_clk", &clk_itr_length-&clk_input_length+1, &clk_input_length-1)==STRING.CUT("&clk", 1))
    ( 
      &match=1
    )
  )
  else if (&wild_tail==1)
  (
    if (STRING.MID("gcc_cfg_noc_tic_clk", 0, &clk_input_length-1)==STRING.CUT("&clk", -1))
    ( 
      &match=1
    )
  )
  else if ("gcc_cfg_noc_tic_clk"=="&clk")
  (
    &match=1
  )
  
  if (&match==1)
  (
    &clk_test=&CLK_TEST_GCC_CFG_NOC_TIC_CLK
    &clk_reg=0
    &clk_reg_name="No CBCR"
    &clk_name="gcc_cfg_noc_tic_clk"
    &clk_reg_cbcr_type=""
    &clk_vote_bit=-1.
    &clk_multiplier=1.

    gosub Print_Clk_Info_Line
  )

  &match=0
  &wild_head=0
  &wild_tail=0
  &clk_input_length=STRING.LENGTH("&clk")
  &clk_itr_length=STRING.LENGTH("gcc_tic_clk")

  if (STRING.SCAN("&clk", "*", 0)==0)
  (
    &wild_head=1
  )
  if (STRING.SCAN("&clk", "*", 1)==(STRING.LENGTH("&clk")-1))
  (
    &wild_tail=1
  )

  if ((&wild_head==1)&&(&wild_tail==1))
  (
    if (STRING.SCAN("gcc_tic_clk", STRING.MID("&clk", 1, &clk_input_length-2), 0)!=-1)
    ( 
      &match=1
    )
  )
  else if (&wild_head==1)
  (
    if (STRING.MID("gcc_tic_clk", &clk_itr_length-&clk_input_length+1, &clk_input_length-1)==STRING.CUT("&clk", 1))
    ( 
      &match=1
    )
  )
  else if (&wild_tail==1)
  (
    if (STRING.MID("gcc_tic_clk", 0, &clk_input_length-1)==STRING.CUT("&clk", -1))
    ( 
      &match=1
    )
  )
  else if ("gcc_tic_clk"=="&clk")
  (
    &match=1
  )
  
  if (&match==1)
  (
    &clk_test=0
    &clk_reg=0
    &clk_reg_name="No CBCR"
    &clk_name="gcc_tic_clk"
    &clk_reg_cbcr_type=""
    &clk_vote_bit=-1.
    &clk_multiplier=1.

    gosub Print_Clk_Info_Line
  )

  &match=0
  &wild_head=0
  &wild_tail=0
  &clk_input_length=STRING.LENGTH("&clk")
  &clk_itr_length=STRING.LENGTH("gcc_tsif_ref_clk")

  if (STRING.SCAN("&clk", "*", 0)==0)
  (
    &wild_head=1
  )
  if (STRING.SCAN("&clk", "*", 1)==(STRING.LENGTH("&clk")-1))
  (
    &wild_tail=1
  )

  if ((&wild_head==1)&&(&wild_tail==1))
  (
    if (STRING.SCAN("gcc_tsif_ref_clk", STRING.MID("&clk", 1, &clk_input_length-2), 0)!=-1)
    ( 
      &match=1
    )
  )
  else if (&wild_head==1)
  (
    if (STRING.MID("gcc_tsif_ref_clk", &clk_itr_length-&clk_input_length+1, &clk_input_length-1)==STRING.CUT("&clk", 1))
    ( 
      &match=1
    )
  )
  else if (&wild_tail==1)
  (
    if (STRING.MID("gcc_tsif_ref_clk", 0, &clk_input_length-1)==STRING.CUT("&clk", -1))
    ( 
      &match=1
    )
  )
  else if ("gcc_tsif_ref_clk"=="&clk")
  (
    &match=1
  )
  
  if (&match==1)
  (
    &clk_test=&CLK_TEST_GCC_TSIF_REF_CLK
    &clk_reg=&HWIO_GCC_TSIF_REF_CBCR_ADDR
    &clk_reg_name="GCC_TSIF_REF_CBCR"
    &clk_name="gcc_tsif_ref_clk"
    &clk_reg_cbcr_type="sm_cbc"
    &clk_vote_bit=-1.
    &clk_multiplier=1.

    gosub Print_Clk_Info_Line
  )

  &match=0
  &wild_head=0
  &wild_tail=0
  &clk_input_length=STRING.LENGTH("&clk")
  &clk_itr_length=STRING.LENGTH("gcc_aggre2_ufs_axi_clk")

  if (STRING.SCAN("&clk", "*", 0)==0)
  (
    &wild_head=1
  )
  if (STRING.SCAN("&clk", "*", 1)==(STRING.LENGTH("&clk")-1))
  (
    &wild_tail=1
  )

  if ((&wild_head==1)&&(&wild_tail==1))
  (
    if (STRING.SCAN("gcc_aggre2_ufs_axi_clk", STRING.MID("&clk", 1, &clk_input_length-2), 0)!=-1)
    ( 
      &match=1
    )
  )
  else if (&wild_head==1)
  (
    if (STRING.MID("gcc_aggre2_ufs_axi_clk", &clk_itr_length-&clk_input_length+1, &clk_input_length-1)==STRING.CUT("&clk", 1))
    ( 
      &match=1
    )
  )
  else if (&wild_tail==1)
  (
    if (STRING.MID("gcc_aggre2_ufs_axi_clk", 0, &clk_input_length-1)==STRING.CUT("&clk", -1))
    ( 
      &match=1
    )
  )
  else if ("gcc_aggre2_ufs_axi_clk"=="&clk")
  (
    &match=1
  )
  
  if (&match==1)
  (
    &clk_test=&CLK_TEST_GCC_AGGRE2_UFS_AXI_CLK
    &clk_reg=&HWIO_GCC_AGGRE2_UFS_AXI_CBCR_ADDR
    &clk_reg_name="GCC_AGGRE2_UFS_AXI_CBCR"
    &clk_name="gcc_aggre2_ufs_axi_clk"
    &clk_reg_cbcr_type="sm_cbc"
    &clk_vote_bit=-1.
    &clk_multiplier=1.

    gosub Print_Clk_Info_Line
  )

  &match=0
  &wild_head=0
  &wild_tail=0
  &clk_input_length=STRING.LENGTH("&clk")
  &clk_itr_length=STRING.LENGTH("gcc_sys_noc_ufs_axi_clk")

  if (STRING.SCAN("&clk", "*", 0)==0)
  (
    &wild_head=1
  )
  if (STRING.SCAN("&clk", "*", 1)==(STRING.LENGTH("&clk")-1))
  (
    &wild_tail=1
  )

  if ((&wild_head==1)&&(&wild_tail==1))
  (
    if (STRING.SCAN("gcc_sys_noc_ufs_axi_clk", STRING.MID("&clk", 1, &clk_input_length-2), 0)!=-1)
    ( 
      &match=1
    )
  )
  else if (&wild_head==1)
  (
    if (STRING.MID("gcc_sys_noc_ufs_axi_clk", &clk_itr_length-&clk_input_length+1, &clk_input_length-1)==STRING.CUT("&clk", 1))
    ( 
      &match=1
    )
  )
  else if (&wild_tail==1)
  (
    if (STRING.MID("gcc_sys_noc_ufs_axi_clk", 0, &clk_input_length-1)==STRING.CUT("&clk", -1))
    ( 
      &match=1
    )
  )
  else if ("gcc_sys_noc_ufs_axi_clk"=="&clk")
  (
    &match=1
  )
  
  if (&match==1)
  (
    &clk_test=&CLK_TEST_GCC_SYS_NOC_UFS_AXI_CLK
    &clk_reg=&HWIO_GCC_SYS_NOC_UFS_AXI_CBCR_ADDR
    &clk_reg_name="GCC_SYS_NOC_UFS_AXI_CBCR"
    &clk_name="gcc_sys_noc_ufs_axi_clk"
    &clk_reg_cbcr_type="sm_cbc"
    &clk_vote_bit=-1.
    &clk_multiplier=1.

    gosub Print_Clk_Info_Line
  )

  &match=0
  &wild_head=0
  &wild_tail=0
  &clk_input_length=STRING.LENGTH("&clk")
  &clk_itr_length=STRING.LENGTH("gcc_ufs_axi_clk")

  if (STRING.SCAN("&clk", "*", 0)==0)
  (
    &wild_head=1
  )
  if (STRING.SCAN("&clk", "*", 1)==(STRING.LENGTH("&clk")-1))
  (
    &wild_tail=1
  )

  if ((&wild_head==1)&&(&wild_tail==1))
  (
    if (STRING.SCAN("gcc_ufs_axi_clk", STRING.MID("&clk", 1, &clk_input_length-2), 0)!=-1)
    ( 
      &match=1
    )
  )
  else if (&wild_head==1)
  (
    if (STRING.MID("gcc_ufs_axi_clk", &clk_itr_length-&clk_input_length+1, &clk_input_length-1)==STRING.CUT("&clk", 1))
    ( 
      &match=1
    )
  )
  else if (&wild_tail==1)
  (
    if (STRING.MID("gcc_ufs_axi_clk", 0, &clk_input_length-1)==STRING.CUT("&clk", -1))
    ( 
      &match=1
    )
  )
  else if ("gcc_ufs_axi_clk"=="&clk")
  (
    &match=1
  )
  
  if (&match==1)
  (
    &clk_test=&CLK_TEST_GCC_UFS_AXI_CLK
    &clk_reg=&HWIO_GCC_UFS_AXI_CBCR_ADDR
    &clk_reg_name="GCC_UFS_AXI_CBCR"
    &clk_name="gcc_ufs_axi_clk"
    &clk_reg_cbcr_type="sm_pscbc"
    &clk_vote_bit=-1.
    &clk_multiplier=1.

    gosub Print_Clk_Info_Line
  )

  &match=0
  &wild_head=0
  &wild_tail=0
  &clk_input_length=STRING.LENGTH("&clk")
  &clk_itr_length=STRING.LENGTH("gcc_ufs_rx_cfg_clk")

  if (STRING.SCAN("&clk", "*", 0)==0)
  (
    &wild_head=1
  )
  if (STRING.SCAN("&clk", "*", 1)==(STRING.LENGTH("&clk")-1))
  (
    &wild_tail=1
  )

  if ((&wild_head==1)&&(&wild_tail==1))
  (
    if (STRING.SCAN("gcc_ufs_rx_cfg_clk", STRING.MID("&clk", 1, &clk_input_length-2), 0)!=-1)
    ( 
      &match=1
    )
  )
  else if (&wild_head==1)
  (
    if (STRING.MID("gcc_ufs_rx_cfg_clk", &clk_itr_length-&clk_input_length+1, &clk_input_length-1)==STRING.CUT("&clk", 1))
    ( 
      &match=1
    )
  )
  else if (&wild_tail==1)
  (
    if (STRING.MID("gcc_ufs_rx_cfg_clk", 0, &clk_input_length-1)==STRING.CUT("&clk", -1))
    ( 
      &match=1
    )
  )
  else if ("gcc_ufs_rx_cfg_clk"=="&clk")
  (
    &match=1
  )
  
  if (&match==1)
  (
    &clk_test=&CLK_TEST_GCC_UFS_RX_CFG_CLK
    &clk_reg=&HWIO_GCC_UFS_RX_CFG_CBCR_ADDR
    &clk_reg_name="GCC_UFS_RX_CFG_CBCR"
    &clk_name="gcc_ufs_rx_cfg_clk"
    &clk_reg_cbcr_type="sm_cbc"
    &clk_vote_bit=-1.
    &clk_multiplier=1.

    gosub Print_Clk_Info_Line
  )

  &match=0
  &wild_head=0
  &wild_tail=0
  &clk_input_length=STRING.LENGTH("&clk")
  &clk_itr_length=STRING.LENGTH("gcc_ufs_tx_cfg_clk")

  if (STRING.SCAN("&clk", "*", 0)==0)
  (
    &wild_head=1
  )
  if (STRING.SCAN("&clk", "*", 1)==(STRING.LENGTH("&clk")-1))
  (
    &wild_tail=1
  )

  if ((&wild_head==1)&&(&wild_tail==1))
  (
    if (STRING.SCAN("gcc_ufs_tx_cfg_clk", STRING.MID("&clk", 1, &clk_input_length-2), 0)!=-1)
    ( 
      &match=1
    )
  )
  else if (&wild_head==1)
  (
    if (STRING.MID("gcc_ufs_tx_cfg_clk", &clk_itr_length-&clk_input_length+1, &clk_input_length-1)==STRING.CUT("&clk", 1))
    ( 
      &match=1
    )
  )
  else if (&wild_tail==1)
  (
    if (STRING.MID("gcc_ufs_tx_cfg_clk", 0, &clk_input_length-1)==STRING.CUT("&clk", -1))
    ( 
      &match=1
    )
  )
  else if ("gcc_ufs_tx_cfg_clk"=="&clk")
  (
    &match=1
  )
  
  if (&match==1)
  (
    &clk_test=&CLK_TEST_GCC_UFS_TX_CFG_CLK
    &clk_reg=&HWIO_GCC_UFS_TX_CFG_CBCR_ADDR
    &clk_reg_name="GCC_UFS_TX_CFG_CBCR"
    &clk_name="gcc_ufs_tx_cfg_clk"
    &clk_reg_cbcr_type="sm_cbc"
    &clk_vote_bit=-1.
    &clk_multiplier=1.

    gosub Print_Clk_Info_Line
  )

  &match=0
  &wild_head=0
  &wild_tail=0
  &clk_input_length=STRING.LENGTH("&clk")
  &clk_itr_length=STRING.LENGTH("gcc_ufs_ice_core_clk")

  if (STRING.SCAN("&clk", "*", 0)==0)
  (
    &wild_head=1
  )
  if (STRING.SCAN("&clk", "*", 1)==(STRING.LENGTH("&clk")-1))
  (
    &wild_tail=1
  )

  if ((&wild_head==1)&&(&wild_tail==1))
  (
    if (STRING.SCAN("gcc_ufs_ice_core_clk", STRING.MID("&clk", 1, &clk_input_length-2), 0)!=-1)
    ( 
      &match=1
    )
  )
  else if (&wild_head==1)
  (
    if (STRING.MID("gcc_ufs_ice_core_clk", &clk_itr_length-&clk_input_length+1, &clk_input_length-1)==STRING.CUT("&clk", 1))
    ( 
      &match=1
    )
  )
  else if (&wild_tail==1)
  (
    if (STRING.MID("gcc_ufs_ice_core_clk", 0, &clk_input_length-1)==STRING.CUT("&clk", -1))
    ( 
      &match=1
    )
  )
  else if ("gcc_ufs_ice_core_clk"=="&clk")
  (
    &match=1
  )
  
  if (&match==1)
  (
    &clk_test=&CLK_TEST_GCC_UFS_ICE_CORE_CLK
    &clk_reg=&HWIO_GCC_UFS_ICE_CORE_CBCR_ADDR
    &clk_reg_name="GCC_UFS_ICE_CORE_CBCR"
    &clk_name="gcc_ufs_ice_core_clk"
    &clk_reg_cbcr_type="sm_pscbc"
    &clk_vote_bit=-1.
    &clk_multiplier=1.

    gosub Print_Clk_Info_Line
  )

  &match=0
  &wild_head=0
  &wild_tail=0
  &clk_input_length=STRING.LENGTH("&clk")
  &clk_itr_length=STRING.LENGTH("gcc_ufs_unipro_core_clk")

  if (STRING.SCAN("&clk", "*", 0)==0)
  (
    &wild_head=1
  )
  if (STRING.SCAN("&clk", "*", 1)==(STRING.LENGTH("&clk")-1))
  (
    &wild_tail=1
  )

  if ((&wild_head==1)&&(&wild_tail==1))
  (
    if (STRING.SCAN("gcc_ufs_unipro_core_clk", STRING.MID("&clk", 1, &clk_input_length-2), 0)!=-1)
    ( 
      &match=1
    )
  )
  else if (&wild_head==1)
  (
    if (STRING.MID("gcc_ufs_unipro_core_clk", &clk_itr_length-&clk_input_length+1, &clk_input_length-1)==STRING.CUT("&clk", 1))
    ( 
      &match=1
    )
  )
  else if (&wild_tail==1)
  (
    if (STRING.MID("gcc_ufs_unipro_core_clk", 0, &clk_input_length-1)==STRING.CUT("&clk", -1))
    ( 
      &match=1
    )
  )
  else if ("gcc_ufs_unipro_core_clk"=="&clk")
  (
    &match=1
  )
  
  if (&match==1)
  (
    &clk_test=&CLK_TEST_GCC_UFS_UNIPRO_CORE_CLK
    &clk_reg=&HWIO_GCC_UFS_UNIPRO_CORE_CBCR_ADDR
    &clk_reg_name="GCC_UFS_UNIPRO_CORE_CBCR"
    &clk_name="gcc_ufs_unipro_core_clk"
    &clk_reg_cbcr_type="sm_pscbc"
    &clk_vote_bit=-1.
    &clk_multiplier=1.

    gosub Print_Clk_Info_Line
  )

  &match=0
  &wild_head=0
  &wild_tail=0
  &clk_input_length=STRING.LENGTH("&clk")
  &clk_itr_length=STRING.LENGTH("gcc_ufs_rx_symbol_0_clk")

  if (STRING.SCAN("&clk", "*", 0)==0)
  (
    &wild_head=1
  )
  if (STRING.SCAN("&clk", "*", 1)==(STRING.LENGTH("&clk")-1))
  (
    &wild_tail=1
  )

  if ((&wild_head==1)&&(&wild_tail==1))
  (
    if (STRING.SCAN("gcc_ufs_rx_symbol_0_clk", STRING.MID("&clk", 1, &clk_input_length-2), 0)!=-1)
    ( 
      &match=1
    )
  )
  else if (&wild_head==1)
  (
    if (STRING.MID("gcc_ufs_rx_symbol_0_clk", &clk_itr_length-&clk_input_length+1, &clk_input_length-1)==STRING.CUT("&clk", 1))
    ( 
      &match=1
    )
  )
  else if (&wild_tail==1)
  (
    if (STRING.MID("gcc_ufs_rx_symbol_0_clk", 0, &clk_input_length-1)==STRING.CUT("&clk", -1))
    ( 
      &match=1
    )
  )
  else if ("gcc_ufs_rx_symbol_0_clk"=="&clk")
  (
    &match=1
  )
  
  if (&match==1)
  (
    &clk_test=&CLK_TEST_GCC_UFS_RX_SYMBOL_0_CLK
    &clk_reg=&HWIO_GCC_UFS_RX_SYMBOL_0_CBCR_ADDR
    &clk_reg_name="GCC_UFS_RX_SYMBOL_0_CBCR"
    &clk_name="gcc_ufs_rx_symbol_0_clk"
    &clk_reg_cbcr_type="sm_pscbc"
    &clk_vote_bit=-1.
    &clk_multiplier=1.

    gosub Print_Clk_Info_Line
  )

  &match=0
  &wild_head=0
  &wild_tail=0
  &clk_input_length=STRING.LENGTH("&clk")
  &clk_itr_length=STRING.LENGTH("gcc_ufs_rx_symbol_1_clk")

  if (STRING.SCAN("&clk", "*", 0)==0)
  (
    &wild_head=1
  )
  if (STRING.SCAN("&clk", "*", 1)==(STRING.LENGTH("&clk")-1))
  (
    &wild_tail=1
  )

  if ((&wild_head==1)&&(&wild_tail==1))
  (
    if (STRING.SCAN("gcc_ufs_rx_symbol_1_clk", STRING.MID("&clk", 1, &clk_input_length-2), 0)!=-1)
    ( 
      &match=1
    )
  )
  else if (&wild_head==1)
  (
    if (STRING.MID("gcc_ufs_rx_symbol_1_clk", &clk_itr_length-&clk_input_length+1, &clk_input_length-1)==STRING.CUT("&clk", 1))
    ( 
      &match=1
    )
  )
  else if (&wild_tail==1)
  (
    if (STRING.MID("gcc_ufs_rx_symbol_1_clk", 0, &clk_input_length-1)==STRING.CUT("&clk", -1))
    ( 
      &match=1
    )
  )
  else if ("gcc_ufs_rx_symbol_1_clk"=="&clk")
  (
    &match=1
  )
  
  if (&match==1)
  (
    &clk_test=&CLK_TEST_GCC_UFS_RX_SYMBOL_1_CLK
    &clk_reg=&HWIO_GCC_UFS_RX_SYMBOL_1_CBCR_ADDR
    &clk_reg_name="GCC_UFS_RX_SYMBOL_1_CBCR"
    &clk_name="gcc_ufs_rx_symbol_1_clk"
    &clk_reg_cbcr_type="sm_cbc"
    &clk_vote_bit=-1.
    &clk_multiplier=1.

    gosub Print_Clk_Info_Line
  )

  &match=0
  &wild_head=0
  &wild_tail=0
  &clk_input_length=STRING.LENGTH("&clk")
  &clk_itr_length=STRING.LENGTH("gcc_ufs_tx_symbol_0_clk")

  if (STRING.SCAN("&clk", "*", 0)==0)
  (
    &wild_head=1
  )
  if (STRING.SCAN("&clk", "*", 1)==(STRING.LENGTH("&clk")-1))
  (
    &wild_tail=1
  )

  if ((&wild_head==1)&&(&wild_tail==1))
  (
    if (STRING.SCAN("gcc_ufs_tx_symbol_0_clk", STRING.MID("&clk", 1, &clk_input_length-2), 0)!=-1)
    ( 
      &match=1
    )
  )
  else if (&wild_head==1)
  (
    if (STRING.MID("gcc_ufs_tx_symbol_0_clk", &clk_itr_length-&clk_input_length+1, &clk_input_length-1)==STRING.CUT("&clk", 1))
    ( 
      &match=1
    )
  )
  else if (&wild_tail==1)
  (
    if (STRING.MID("gcc_ufs_tx_symbol_0_clk", 0, &clk_input_length-1)==STRING.CUT("&clk", -1))
    ( 
      &match=1
    )
  )
  else if ("gcc_ufs_tx_symbol_0_clk"=="&clk")
  (
    &match=1
  )
  
  if (&match==1)
  (
    &clk_test=&CLK_TEST_GCC_UFS_TX_SYMBOL_0_CLK
    &clk_reg=&HWIO_GCC_UFS_TX_SYMBOL_0_CBCR_ADDR
    &clk_reg_name="GCC_UFS_TX_SYMBOL_0_CBCR"
    &clk_name="gcc_ufs_tx_symbol_0_clk"
    &clk_reg_cbcr_type="sm_pscbc"
    &clk_vote_bit=-1.
    &clk_multiplier=1.

    gosub Print_Clk_Info_Line
  )

  &match=0
  &wild_head=0
  &wild_tail=0
  &clk_input_length=STRING.LENGTH("&clk")
  &clk_itr_length=STRING.LENGTH("gcc_periph_noc_usb20_ahb_clk")

  if (STRING.SCAN("&clk", "*", 0)==0)
  (
    &wild_head=1
  )
  if (STRING.SCAN("&clk", "*", 1)==(STRING.LENGTH("&clk")-1))
  (
    &wild_tail=1
  )

  if ((&wild_head==1)&&(&wild_tail==1))
  (
    if (STRING.SCAN("gcc_periph_noc_usb20_ahb_clk", STRING.MID("&clk", 1, &clk_input_length-2), 0)!=-1)
    ( 
      &match=1
    )
  )
  else if (&wild_head==1)
  (
    if (STRING.MID("gcc_periph_noc_usb20_ahb_clk", &clk_itr_length-&clk_input_length+1, &clk_input_length-1)==STRING.CUT("&clk", 1))
    ( 
      &match=1
    )
  )
  else if (&wild_tail==1)
  (
    if (STRING.MID("gcc_periph_noc_usb20_ahb_clk", 0, &clk_input_length-1)==STRING.CUT("&clk", -1))
    ( 
      &match=1
    )
  )
  else if ("gcc_periph_noc_usb20_ahb_clk"=="&clk")
  (
    &match=1
  )
  
  if (&match==1)
  (
    &clk_test=&CLK_TEST_GCC_PERIPH_NOC_USB20_AHB_CLK
    &clk_reg=&HWIO_GCC_PERIPH_NOC_USB20_AHB_CBCR_ADDR
    &clk_reg_name="GCC_PERIPH_NOC_USB20_AHB_CBCR"
    &clk_name="gcc_periph_noc_usb20_ahb_clk"
    &clk_reg_cbcr_type="sm_cbc"
    &clk_vote_bit=-1.
    &clk_multiplier=1.

    gosub Print_Clk_Info_Line
  )

  &match=0
  &wild_head=0
  &wild_tail=0
  &clk_input_length=STRING.LENGTH("&clk")
  &clk_itr_length=STRING.LENGTH("gcc_pnoc_bus_timeout0_ahb_clk")

  if (STRING.SCAN("&clk", "*", 0)==0)
  (
    &wild_head=1
  )
  if (STRING.SCAN("&clk", "*", 1)==(STRING.LENGTH("&clk")-1))
  (
    &wild_tail=1
  )

  if ((&wild_head==1)&&(&wild_tail==1))
  (
    if (STRING.SCAN("gcc_pnoc_bus_timeout0_ahb_clk", STRING.MID("&clk", 1, &clk_input_length-2), 0)!=-1)
    ( 
      &match=1
    )
  )
  else if (&wild_head==1)
  (
    if (STRING.MID("gcc_pnoc_bus_timeout0_ahb_clk", &clk_itr_length-&clk_input_length+1, &clk_input_length-1)==STRING.CUT("&clk", 1))
    ( 
      &match=1
    )
  )
  else if (&wild_tail==1)
  (
    if (STRING.MID("gcc_pnoc_bus_timeout0_ahb_clk", 0, &clk_input_length-1)==STRING.CUT("&clk", -1))
    ( 
      &match=1
    )
  )
  else if ("gcc_pnoc_bus_timeout0_ahb_clk"=="&clk")
  (
    &match=1
  )
  
  if (&match==1)
  (
    &clk_test=&CLK_TEST_GCC_PNOC_BUS_TIMEOUT0_AHB_CLK
    &clk_reg=&HWIO_GCC_PNOC_BUS_TIMEOUT0_AHB_CBCR_ADDR
    &clk_reg_name="GCC_PNOC_BUS_TIMEOUT0_AHB_CBCR"
    &clk_name="gcc_pnoc_bus_timeout0_ahb_clk"
    &clk_reg_cbcr_type="sm_cbc"
    &clk_vote_bit=-1.
    &clk_multiplier=1.

    gosub Print_Clk_Info_Line
  )

  &match=0
  &wild_head=0
  &wild_tail=0
  &clk_input_length=STRING.LENGTH("&clk")
  &clk_itr_length=STRING.LENGTH("gcc_usb20_master_clk")

  if (STRING.SCAN("&clk", "*", 0)==0)
  (
    &wild_head=1
  )
  if (STRING.SCAN("&clk", "*", 1)==(STRING.LENGTH("&clk")-1))
  (
    &wild_tail=1
  )

  if ((&wild_head==1)&&(&wild_tail==1))
  (
    if (STRING.SCAN("gcc_usb20_master_clk", STRING.MID("&clk", 1, &clk_input_length-2), 0)!=-1)
    ( 
      &match=1
    )
  )
  else if (&wild_head==1)
  (
    if (STRING.MID("gcc_usb20_master_clk", &clk_itr_length-&clk_input_length+1, &clk_input_length-1)==STRING.CUT("&clk", 1))
    ( 
      &match=1
    )
  )
  else if (&wild_tail==1)
  (
    if (STRING.MID("gcc_usb20_master_clk", 0, &clk_input_length-1)==STRING.CUT("&clk", -1))
    ( 
      &match=1
    )
  )
  else if ("gcc_usb20_master_clk"=="&clk")
  (
    &match=1
  )
  
  if (&match==1)
  (
    &clk_test=&CLK_TEST_GCC_USB20_MASTER_CLK
    &clk_reg=&HWIO_GCC_USB20_MASTER_CBCR_ADDR
    &clk_reg_name="GCC_USB20_MASTER_CBCR"
    &clk_name="gcc_usb20_master_clk"
    &clk_reg_cbcr_type="sm_pscbc"
    &clk_vote_bit=-1.
    &clk_multiplier=1.

    gosub Print_Clk_Info_Line
  )

  &match=0
  &wild_head=0
  &wild_tail=0
  &clk_input_length=STRING.LENGTH("&clk")
  &clk_itr_length=STRING.LENGTH("gcc_usb20_mock_utmi_clk")

  if (STRING.SCAN("&clk", "*", 0)==0)
  (
    &wild_head=1
  )
  if (STRING.SCAN("&clk", "*", 1)==(STRING.LENGTH("&clk")-1))
  (
    &wild_tail=1
  )

  if ((&wild_head==1)&&(&wild_tail==1))
  (
    if (STRING.SCAN("gcc_usb20_mock_utmi_clk", STRING.MID("&clk", 1, &clk_input_length-2), 0)!=-1)
    ( 
      &match=1
    )
  )
  else if (&wild_head==1)
  (
    if (STRING.MID("gcc_usb20_mock_utmi_clk", &clk_itr_length-&clk_input_length+1, &clk_input_length-1)==STRING.CUT("&clk", 1))
    ( 
      &match=1
    )
  )
  else if (&wild_tail==1)
  (
    if (STRING.MID("gcc_usb20_mock_utmi_clk", 0, &clk_input_length-1)==STRING.CUT("&clk", -1))
    ( 
      &match=1
    )
  )
  else if ("gcc_usb20_mock_utmi_clk"=="&clk")
  (
    &match=1
  )
  
  if (&match==1)
  (
    &clk_test=&CLK_TEST_GCC_USB20_MOCK_UTMI_CLK
    &clk_reg=&HWIO_GCC_USB20_MOCK_UTMI_CBCR_ADDR
    &clk_reg_name="GCC_USB20_MOCK_UTMI_CBCR"
    &clk_name="gcc_usb20_mock_utmi_clk"
    &clk_reg_cbcr_type="sm_cbc"
    &clk_vote_bit=-1.
    &clk_multiplier=1.

    gosub Print_Clk_Info_Line
  )

  &match=0
  &wild_head=0
  &wild_tail=0
  &clk_input_length=STRING.LENGTH("&clk")
  &clk_itr_length=STRING.LENGTH("gcc_aggre2_usb3_axi_clk")

  if (STRING.SCAN("&clk", "*", 0)==0)
  (
    &wild_head=1
  )
  if (STRING.SCAN("&clk", "*", 1)==(STRING.LENGTH("&clk")-1))
  (
    &wild_tail=1
  )

  if ((&wild_head==1)&&(&wild_tail==1))
  (
    if (STRING.SCAN("gcc_aggre2_usb3_axi_clk", STRING.MID("&clk", 1, &clk_input_length-2), 0)!=-1)
    ( 
      &match=1
    )
  )
  else if (&wild_head==1)
  (
    if (STRING.MID("gcc_aggre2_usb3_axi_clk", &clk_itr_length-&clk_input_length+1, &clk_input_length-1)==STRING.CUT("&clk", 1))
    ( 
      &match=1
    )
  )
  else if (&wild_tail==1)
  (
    if (STRING.MID("gcc_aggre2_usb3_axi_clk", 0, &clk_input_length-1)==STRING.CUT("&clk", -1))
    ( 
      &match=1
    )
  )
  else if ("gcc_aggre2_usb3_axi_clk"=="&clk")
  (
    &match=1
  )
  
  if (&match==1)
  (
    &clk_test=&CLK_TEST_GCC_AGGRE2_USB3_AXI_CLK
    &clk_reg=&HWIO_GCC_AGGRE2_USB3_AXI_CBCR_ADDR
    &clk_reg_name="GCC_AGGRE2_USB3_AXI_CBCR"
    &clk_name="gcc_aggre2_usb3_axi_clk"
    &clk_reg_cbcr_type="sm_cbc"
    &clk_vote_bit=-1.
    &clk_multiplier=1.

    gosub Print_Clk_Info_Line
  )

  &match=0
  &wild_head=0
  &wild_tail=0
  &clk_input_length=STRING.LENGTH("&clk")
  &clk_itr_length=STRING.LENGTH("gcc_snoc_bus_timeout2_ahb_clk")

  if (STRING.SCAN("&clk", "*", 0)==0)
  (
    &wild_head=1
  )
  if (STRING.SCAN("&clk", "*", 1)==(STRING.LENGTH("&clk")-1))
  (
    &wild_tail=1
  )

  if ((&wild_head==1)&&(&wild_tail==1))
  (
    if (STRING.SCAN("gcc_snoc_bus_timeout2_ahb_clk", STRING.MID("&clk", 1, &clk_input_length-2), 0)!=-1)
    ( 
      &match=1
    )
  )
  else if (&wild_head==1)
  (
    if (STRING.MID("gcc_snoc_bus_timeout2_ahb_clk", &clk_itr_length-&clk_input_length+1, &clk_input_length-1)==STRING.CUT("&clk", 1))
    ( 
      &match=1
    )
  )
  else if (&wild_tail==1)
  (
    if (STRING.MID("gcc_snoc_bus_timeout2_ahb_clk", 0, &clk_input_length-1)==STRING.CUT("&clk", -1))
    ( 
      &match=1
    )
  )
  else if ("gcc_snoc_bus_timeout2_ahb_clk"=="&clk")
  (
    &match=1
  )
  
  if (&match==1)
  (
    &clk_test=&CLK_TEST_GCC_SNOC_BUS_TIMEOUT2_AHB_CLK
    &clk_reg=&HWIO_GCC_SNOC_BUS_TIMEOUT2_AHB_CBCR_ADDR
    &clk_reg_name="GCC_SNOC_BUS_TIMEOUT2_AHB_CBCR"
    &clk_name="gcc_snoc_bus_timeout2_ahb_clk"
    &clk_reg_cbcr_type="sm_cbc"
    &clk_vote_bit=-1.
    &clk_multiplier=1.

    gosub Print_Clk_Info_Line
  )

  &match=0
  &wild_head=0
  &wild_tail=0
  &clk_input_length=STRING.LENGTH("&clk")
  &clk_itr_length=STRING.LENGTH("gcc_sys_noc_usb3_axi_clk")

  if (STRING.SCAN("&clk", "*", 0)==0)
  (
    &wild_head=1
  )
  if (STRING.SCAN("&clk", "*", 1)==(STRING.LENGTH("&clk")-1))
  (
    &wild_tail=1
  )

  if ((&wild_head==1)&&(&wild_tail==1))
  (
    if (STRING.SCAN("gcc_sys_noc_usb3_axi_clk", STRING.MID("&clk", 1, &clk_input_length-2), 0)!=-1)
    ( 
      &match=1
    )
  )
  else if (&wild_head==1)
  (
    if (STRING.MID("gcc_sys_noc_usb3_axi_clk", &clk_itr_length-&clk_input_length+1, &clk_input_length-1)==STRING.CUT("&clk", 1))
    ( 
      &match=1
    )
  )
  else if (&wild_tail==1)
  (
    if (STRING.MID("gcc_sys_noc_usb3_axi_clk", 0, &clk_input_length-1)==STRING.CUT("&clk", -1))
    ( 
      &match=1
    )
  )
  else if ("gcc_sys_noc_usb3_axi_clk"=="&clk")
  (
    &match=1
  )
  
  if (&match==1)
  (
    &clk_test=&CLK_TEST_GCC_SYS_NOC_USB3_AXI_CLK
    &clk_reg=&HWIO_GCC_SYS_NOC_USB3_AXI_CBCR_ADDR
    &clk_reg_name="GCC_SYS_NOC_USB3_AXI_CBCR"
    &clk_name="gcc_sys_noc_usb3_axi_clk"
    &clk_reg_cbcr_type="sm_cbc"
    &clk_vote_bit=-1.
    &clk_multiplier=1.

    gosub Print_Clk_Info_Line
  )

  &match=0
  &wild_head=0
  &wild_tail=0
  &clk_input_length=STRING.LENGTH("&clk")
  &clk_itr_length=STRING.LENGTH("gcc_usb30_master_clk")

  if (STRING.SCAN("&clk", "*", 0)==0)
  (
    &wild_head=1
  )
  if (STRING.SCAN("&clk", "*", 1)==(STRING.LENGTH("&clk")-1))
  (
    &wild_tail=1
  )

  if ((&wild_head==1)&&(&wild_tail==1))
  (
    if (STRING.SCAN("gcc_usb30_master_clk", STRING.MID("&clk", 1, &clk_input_length-2), 0)!=-1)
    ( 
      &match=1
    )
  )
  else if (&wild_head==1)
  (
    if (STRING.MID("gcc_usb30_master_clk", &clk_itr_length-&clk_input_length+1, &clk_input_length-1)==STRING.CUT("&clk", 1))
    ( 
      &match=1
    )
  )
  else if (&wild_tail==1)
  (
    if (STRING.MID("gcc_usb30_master_clk", 0, &clk_input_length-1)==STRING.CUT("&clk", -1))
    ( 
      &match=1
    )
  )
  else if ("gcc_usb30_master_clk"=="&clk")
  (
    &match=1
  )
  
  if (&match==1)
  (
    &clk_test=&CLK_TEST_GCC_USB30_MASTER_CLK
    &clk_reg=&HWIO_GCC_USB30_MASTER_CBCR_ADDR
    &clk_reg_name="GCC_USB30_MASTER_CBCR"
    &clk_name="gcc_usb30_master_clk"
    &clk_reg_cbcr_type="sm_pscbc"
    &clk_vote_bit=-1.
    &clk_multiplier=1.

    gosub Print_Clk_Info_Line
  )

  &match=0
  &wild_head=0
  &wild_tail=0
  &clk_input_length=STRING.LENGTH("&clk")
  &clk_itr_length=STRING.LENGTH("gcc_usb30_mock_utmi_clk")

  if (STRING.SCAN("&clk", "*", 0)==0)
  (
    &wild_head=1
  )
  if (STRING.SCAN("&clk", "*", 1)==(STRING.LENGTH("&clk")-1))
  (
    &wild_tail=1
  )

  if ((&wild_head==1)&&(&wild_tail==1))
  (
    if (STRING.SCAN("gcc_usb30_mock_utmi_clk", STRING.MID("&clk", 1, &clk_input_length-2), 0)!=-1)
    ( 
      &match=1
    )
  )
  else if (&wild_head==1)
  (
    if (STRING.MID("gcc_usb30_mock_utmi_clk", &clk_itr_length-&clk_input_length+1, &clk_input_length-1)==STRING.CUT("&clk", 1))
    ( 
      &match=1
    )
  )
  else if (&wild_tail==1)
  (
    if (STRING.MID("gcc_usb30_mock_utmi_clk", 0, &clk_input_length-1)==STRING.CUT("&clk", -1))
    ( 
      &match=1
    )
  )
  else if ("gcc_usb30_mock_utmi_clk"=="&clk")
  (
    &match=1
  )
  
  if (&match==1)
  (
    &clk_test=&CLK_TEST_GCC_USB30_MOCK_UTMI_CLK
    &clk_reg=&HWIO_GCC_USB30_MOCK_UTMI_CBCR_ADDR
    &clk_reg_name="GCC_USB30_MOCK_UTMI_CBCR"
    &clk_name="gcc_usb30_mock_utmi_clk"
    &clk_reg_cbcr_type="sm_cbc"
    &clk_vote_bit=-1.
    &clk_multiplier=1.

    gosub Print_Clk_Info_Line
  )

  &match=0
  &wild_head=0
  &wild_tail=0
  &clk_input_length=STRING.LENGTH("&clk")
  &clk_itr_length=STRING.LENGTH("gcc_usb3_phy_aux_clk")

  if (STRING.SCAN("&clk", "*", 0)==0)
  (
    &wild_head=1
  )
  if (STRING.SCAN("&clk", "*", 1)==(STRING.LENGTH("&clk")-1))
  (
    &wild_tail=1
  )

  if ((&wild_head==1)&&(&wild_tail==1))
  (
    if (STRING.SCAN("gcc_usb3_phy_aux_clk", STRING.MID("&clk", 1, &clk_input_length-2), 0)!=-1)
    ( 
      &match=1
    )
  )
  else if (&wild_head==1)
  (
    if (STRING.MID("gcc_usb3_phy_aux_clk", &clk_itr_length-&clk_input_length+1, &clk_input_length-1)==STRING.CUT("&clk", 1))
    ( 
      &match=1
    )
  )
  else if (&wild_tail==1)
  (
    if (STRING.MID("gcc_usb3_phy_aux_clk", 0, &clk_input_length-1)==STRING.CUT("&clk", -1))
    ( 
      &match=1
    )
  )
  else if ("gcc_usb3_phy_aux_clk"=="&clk")
  (
    &match=1
  )
  
  if (&match==1)
  (
    &clk_test=&CLK_TEST_GCC_USB3_PHY_AUX_CLK
    &clk_reg=&HWIO_GCC_USB3_PHY_AUX_CBCR_ADDR
    &clk_reg_name="GCC_USB3_PHY_AUX_CBCR"
    &clk_name="gcc_usb3_phy_aux_clk"
    &clk_reg_cbcr_type="sm_cbc"
    &clk_vote_bit=-1.
    &clk_multiplier=1.

    gosub Print_Clk_Info_Line
  )

  &match=0
  &wild_head=0
  &wild_tail=0
  &clk_input_length=STRING.LENGTH("&clk")
  &clk_itr_length=STRING.LENGTH("gcc_usb3_phy_pipe_clk")

  if (STRING.SCAN("&clk", "*", 0)==0)
  (
    &wild_head=1
  )
  if (STRING.SCAN("&clk", "*", 1)==(STRING.LENGTH("&clk")-1))
  (
    &wild_tail=1
  )

  if ((&wild_head==1)&&(&wild_tail==1))
  (
    if (STRING.SCAN("gcc_usb3_phy_pipe_clk", STRING.MID("&clk", 1, &clk_input_length-2), 0)!=-1)
    ( 
      &match=1
    )
  )
  else if (&wild_head==1)
  (
    if (STRING.MID("gcc_usb3_phy_pipe_clk", &clk_itr_length-&clk_input_length+1, &clk_input_length-1)==STRING.CUT("&clk", 1))
    ( 
      &match=1
    )
  )
  else if (&wild_tail==1)
  (
    if (STRING.MID("gcc_usb3_phy_pipe_clk", 0, &clk_input_length-1)==STRING.CUT("&clk", -1))
    ( 
      &match=1
    )
  )
  else if ("gcc_usb3_phy_pipe_clk"=="&clk")
  (
    &match=1
  )
  
  if (&match==1)
  (
    &clk_test=&CLK_TEST_GCC_USB3_PHY_PIPE_CLK
    &clk_reg=&HWIO_GCC_USB3_PHY_PIPE_CBCR_ADDR
    &clk_reg_name="GCC_USB3_PHY_PIPE_CBCR"
    &clk_name="gcc_usb3_phy_pipe_clk"
    &clk_reg_cbcr_type="sm_cbc"
    &clk_vote_bit=-1.
    &clk_multiplier=1.

    gosub Print_Clk_Info_Line
  )

  &match=0
  &wild_head=0
  &wild_tail=0
  &clk_input_length=STRING.LENGTH("&clk")
  &clk_itr_length=STRING.LENGTH("gcc_vdda_vs_clk")

  if (STRING.SCAN("&clk", "*", 0)==0)
  (
    &wild_head=1
  )
  if (STRING.SCAN("&clk", "*", 1)==(STRING.LENGTH("&clk")-1))
  (
    &wild_tail=1
  )

  if ((&wild_head==1)&&(&wild_tail==1))
  (
    if (STRING.SCAN("gcc_vdda_vs_clk", STRING.MID("&clk", 1, &clk_input_length-2), 0)!=-1)
    ( 
      &match=1
    )
  )
  else if (&wild_head==1)
  (
    if (STRING.MID("gcc_vdda_vs_clk", &clk_itr_length-&clk_input_length+1, &clk_input_length-1)==STRING.CUT("&clk", 1))
    ( 
      &match=1
    )
  )
  else if (&wild_tail==1)
  (
    if (STRING.MID("gcc_vdda_vs_clk", 0, &clk_input_length-1)==STRING.CUT("&clk", -1))
    ( 
      &match=1
    )
  )
  else if ("gcc_vdda_vs_clk"=="&clk")
  (
    &match=1
  )
  
  if (&match==1)
  (
    &clk_test=&CLK_TEST_GCC_VDDA_VS_CLK
    &clk_reg=&HWIO_GCC_VDDA_VS_CBCR_ADDR
    &clk_reg_name="GCC_VDDA_VS_CBCR"
    &clk_name="gcc_vdda_vs_clk"
    &clk_reg_cbcr_type="sm_cbc"
    &clk_vote_bit=-1.
    &clk_multiplier=1.

    gosub Print_Clk_Info_Line
  )

  &match=0
  &wild_head=0
  &wild_tail=0
  &clk_input_length=STRING.LENGTH("&clk")
  &clk_itr_length=STRING.LENGTH("gcc_vddcx_vs_clk")

  if (STRING.SCAN("&clk", "*", 0)==0)
  (
    &wild_head=1
  )
  if (STRING.SCAN("&clk", "*", 1)==(STRING.LENGTH("&clk")-1))
  (
    &wild_tail=1
  )

  if ((&wild_head==1)&&(&wild_tail==1))
  (
    if (STRING.SCAN("gcc_vddcx_vs_clk", STRING.MID("&clk", 1, &clk_input_length-2), 0)!=-1)
    ( 
      &match=1
    )
  )
  else if (&wild_head==1)
  (
    if (STRING.MID("gcc_vddcx_vs_clk", &clk_itr_length-&clk_input_length+1, &clk_input_length-1)==STRING.CUT("&clk", 1))
    ( 
      &match=1
    )
  )
  else if (&wild_tail==1)
  (
    if (STRING.MID("gcc_vddcx_vs_clk", 0, &clk_input_length-1)==STRING.CUT("&clk", -1))
    ( 
      &match=1
    )
  )
  else if ("gcc_vddcx_vs_clk"=="&clk")
  (
    &match=1
  )
  
  if (&match==1)
  (
    &clk_test=&CLK_TEST_GCC_VDDCX_VS_CLK
    &clk_reg=&HWIO_GCC_VDDCX_VS_CBCR_ADDR
    &clk_reg_name="GCC_VDDCX_VS_CBCR"
    &clk_name="gcc_vddcx_vs_clk"
    &clk_reg_cbcr_type="sm_cbc"
    &clk_vote_bit=-1.
    &clk_multiplier=1.

    gosub Print_Clk_Info_Line
  )

  &match=0
  &wild_head=0
  &wild_tail=0
  &clk_input_length=STRING.LENGTH("&clk")
  &clk_itr_length=STRING.LENGTH("gcc_vddmx_vs_clk")

  if (STRING.SCAN("&clk", "*", 0)==0)
  (
    &wild_head=1
  )
  if (STRING.SCAN("&clk", "*", 1)==(STRING.LENGTH("&clk")-1))
  (
    &wild_tail=1
  )

  if ((&wild_head==1)&&(&wild_tail==1))
  (
    if (STRING.SCAN("gcc_vddmx_vs_clk", STRING.MID("&clk", 1, &clk_input_length-2), 0)!=-1)
    ( 
      &match=1
    )
  )
  else if (&wild_head==1)
  (
    if (STRING.MID("gcc_vddmx_vs_clk", &clk_itr_length-&clk_input_length+1, &clk_input_length-1)==STRING.CUT("&clk", 1))
    ( 
      &match=1
    )
  )
  else if (&wild_tail==1)
  (
    if (STRING.MID("gcc_vddmx_vs_clk", 0, &clk_input_length-1)==STRING.CUT("&clk", -1))
    ( 
      &match=1
    )
  )
  else if ("gcc_vddmx_vs_clk"=="&clk")
  (
    &match=1
  )
  
  if (&match==1)
  (
    &clk_test=&CLK_TEST_GCC_VDDMX_VS_CLK
    &clk_reg=&HWIO_GCC_VDDMX_VS_CBCR_ADDR
    &clk_reg_name="GCC_VDDMX_VS_CBCR"
    &clk_name="gcc_vddmx_vs_clk"
    &clk_reg_cbcr_type="sm_cbc"
    &clk_vote_bit=-1.
    &clk_multiplier=1.

    gosub Print_Clk_Info_Line
  )

  &match=0
  &wild_head=0
  &wild_tail=0
  &clk_input_length=STRING.LENGTH("&clk")
  &clk_itr_length=STRING.LENGTH("gcc_vs_ctrl_clk")

  if (STRING.SCAN("&clk", "*", 0)==0)
  (
    &wild_head=1
  )
  if (STRING.SCAN("&clk", "*", 1)==(STRING.LENGTH("&clk")-1))
  (
    &wild_tail=1
  )

  if ((&wild_head==1)&&(&wild_tail==1))
  (
    if (STRING.SCAN("gcc_vs_ctrl_clk", STRING.MID("&clk", 1, &clk_input_length-2), 0)!=-1)
    ( 
      &match=1
    )
  )
  else if (&wild_head==1)
  (
    if (STRING.MID("gcc_vs_ctrl_clk", &clk_itr_length-&clk_input_length+1, &clk_input_length-1)==STRING.CUT("&clk", 1))
    ( 
      &match=1
    )
  )
  else if (&wild_tail==1)
  (
    if (STRING.MID("gcc_vs_ctrl_clk", 0, &clk_input_length-1)==STRING.CUT("&clk", -1))
    ( 
      &match=1
    )
  )
  else if ("gcc_vs_ctrl_clk"=="&clk")
  (
    &match=1
  )
  
  if (&match==1)
  (
    &clk_test=&CLK_TEST_GCC_VS_CTRL_CLK
    &clk_reg=&HWIO_GCC_VS_CTRL_CBCR_ADDR
    &clk_reg_name="GCC_VS_CTRL_CBCR"
    &clk_name="gcc_vs_ctrl_clk"
    &clk_reg_cbcr_type="sm_cbc"
    &clk_vote_bit=-1.
    &clk_multiplier=1.

    gosub Print_Clk_Info_Line
  )

  &match=0
  &wild_head=0
  &wild_tail=0
  &clk_input_length=STRING.LENGTH("&clk")
  &clk_itr_length=STRING.LENGTH("gcc_aggre0_noc_qosgen_extref")

  if (STRING.SCAN("&clk", "*", 0)==0)
  (
    &wild_head=1
  )
  if (STRING.SCAN("&clk", "*", 1)==(STRING.LENGTH("&clk")-1))
  (
    &wild_tail=1
  )

  if ((&wild_head==1)&&(&wild_tail==1))
  (
    if (STRING.SCAN("gcc_aggre0_noc_qosgen_extref", STRING.MID("&clk", 1, &clk_input_length-2), 0)!=-1)
    ( 
      &match=1
    )
  )
  else if (&wild_head==1)
  (
    if (STRING.MID("gcc_aggre0_noc_qosgen_extref", &clk_itr_length-&clk_input_length+1, &clk_input_length-1)==STRING.CUT("&clk", 1))
    ( 
      &match=1
    )
  )
  else if (&wild_tail==1)
  (
    if (STRING.MID("gcc_aggre0_noc_qosgen_extref", 0, &clk_input_length-1)==STRING.CUT("&clk", -1))
    ( 
      &match=1
    )
  )
  else if ("gcc_aggre0_noc_qosgen_extref"=="&clk")
  (
    &match=1
  )
  
  if (&match==1)
  (
    &clk_test=&CLK_TEST_GCC_AGGRE0_NOC_QOSGEN_EXTREF
    &clk_reg=0
    &clk_reg_name="No CBCR"
    &clk_name="gcc_aggre0_noc_qosgen_extref"
    &clk_reg_cbcr_type=""
    &clk_vote_bit=-1.
    &clk_multiplier=1.

    gosub Print_Clk_Info_Line
  )

  &match=0
  &wild_head=0
  &wild_tail=0
  &clk_input_length=STRING.LENGTH("&clk")
  &clk_itr_length=STRING.LENGTH("gcc_aggre1_noc_qosgen_extref")

  if (STRING.SCAN("&clk", "*", 0)==0)
  (
    &wild_head=1
  )
  if (STRING.SCAN("&clk", "*", 1)==(STRING.LENGTH("&clk")-1))
  (
    &wild_tail=1
  )

  if ((&wild_head==1)&&(&wild_tail==1))
  (
    if (STRING.SCAN("gcc_aggre1_noc_qosgen_extref", STRING.MID("&clk", 1, &clk_input_length-2), 0)!=-1)
    ( 
      &match=1
    )
  )
  else if (&wild_head==1)
  (
    if (STRING.MID("gcc_aggre1_noc_qosgen_extref", &clk_itr_length-&clk_input_length+1, &clk_input_length-1)==STRING.CUT("&clk", 1))
    ( 
      &match=1
    )
  )
  else if (&wild_tail==1)
  (
    if (STRING.MID("gcc_aggre1_noc_qosgen_extref", 0, &clk_input_length-1)==STRING.CUT("&clk", -1))
    ( 
      &match=1
    )
  )
  else if ("gcc_aggre1_noc_qosgen_extref"=="&clk")
  (
    &match=1
  )
  
  if (&match==1)
  (
    &clk_test=&CLK_TEST_GCC_AGGRE1_NOC_QOSGEN_EXTREF
    &clk_reg=0
    &clk_reg_name="No CBCR"
    &clk_name="gcc_aggre1_noc_qosgen_extref"
    &clk_reg_cbcr_type=""
    &clk_vote_bit=-1.
    &clk_multiplier=1.

    gosub Print_Clk_Info_Line
  )

  &match=0
  &wild_head=0
  &wild_tail=0
  &clk_input_length=STRING.LENGTH("&clk")
  &clk_itr_length=STRING.LENGTH("gcc_aggre2_noc_qosgen_extref")

  if (STRING.SCAN("&clk", "*", 0)==0)
  (
    &wild_head=1
  )
  if (STRING.SCAN("&clk", "*", 1)==(STRING.LENGTH("&clk")-1))
  (
    &wild_tail=1
  )

  if ((&wild_head==1)&&(&wild_tail==1))
  (
    if (STRING.SCAN("gcc_aggre2_noc_qosgen_extref", STRING.MID("&clk", 1, &clk_input_length-2), 0)!=-1)
    ( 
      &match=1
    )
  )
  else if (&wild_head==1)
  (
    if (STRING.MID("gcc_aggre2_noc_qosgen_extref", &clk_itr_length-&clk_input_length+1, &clk_input_length-1)==STRING.CUT("&clk", 1))
    ( 
      &match=1
    )
  )
  else if (&wild_tail==1)
  (
    if (STRING.MID("gcc_aggre2_noc_qosgen_extref", 0, &clk_input_length-1)==STRING.CUT("&clk", -1))
    ( 
      &match=1
    )
  )
  else if ("gcc_aggre2_noc_qosgen_extref"=="&clk")
  (
    &match=1
  )
  
  if (&match==1)
  (
    &clk_test=&CLK_TEST_GCC_AGGRE2_NOC_QOSGEN_EXTREF
    &clk_reg=0
    &clk_reg_name="No CBCR"
    &clk_name="gcc_aggre2_noc_qosgen_extref"
    &clk_reg_cbcr_type=""
    &clk_vote_bit=-1.
    &clk_multiplier=1.

    gosub Print_Clk_Info_Line
  )

  &match=0
  &wild_head=0
  &wild_tail=0
  &clk_input_length=STRING.LENGTH("&clk")
  &clk_itr_length=STRING.LENGTH("gcc_cnoc_bus_timeout_extref")

  if (STRING.SCAN("&clk", "*", 0)==0)
  (
    &wild_head=1
  )
  if (STRING.SCAN("&clk", "*", 1)==(STRING.LENGTH("&clk")-1))
  (
    &wild_tail=1
  )

  if ((&wild_head==1)&&(&wild_tail==1))
  (
    if (STRING.SCAN("gcc_cnoc_bus_timeout_extref", STRING.MID("&clk", 1, &clk_input_length-2), 0)!=-1)
    ( 
      &match=1
    )
  )
  else if (&wild_head==1)
  (
    if (STRING.MID("gcc_cnoc_bus_timeout_extref", &clk_itr_length-&clk_input_length+1, &clk_input_length-1)==STRING.CUT("&clk", 1))
    ( 
      &match=1
    )
  )
  else if (&wild_tail==1)
  (
    if (STRING.MID("gcc_cnoc_bus_timeout_extref", 0, &clk_input_length-1)==STRING.CUT("&clk", -1))
    ( 
      &match=1
    )
  )
  else if ("gcc_cnoc_bus_timeout_extref"=="&clk")
  (
    &match=1
  )
  
  if (&match==1)
  (
    &clk_test=&CLK_TEST_GCC_CNOC_BUS_TIMEOUT_EXTREF
    &clk_reg=0
    &clk_reg_name="No CBCR"
    &clk_name="gcc_cnoc_bus_timeout_extref"
    &clk_reg_cbcr_type=""
    &clk_vote_bit=-1.
    &clk_multiplier=1.

    gosub Print_Clk_Info_Line
  )

  &match=0
  &wild_head=0
  &wild_tail=0
  &clk_input_length=STRING.LENGTH("&clk")
  &clk_itr_length=STRING.LENGTH("gcc_snoc_bus_timeout_extref")

  if (STRING.SCAN("&clk", "*", 0)==0)
  (
    &wild_head=1
  )
  if (STRING.SCAN("&clk", "*", 1)==(STRING.LENGTH("&clk")-1))
  (
    &wild_tail=1
  )

  if ((&wild_head==1)&&(&wild_tail==1))
  (
    if (STRING.SCAN("gcc_snoc_bus_timeout_extref", STRING.MID("&clk", 1, &clk_input_length-2), 0)!=-1)
    ( 
      &match=1
    )
  )
  else if (&wild_head==1)
  (
    if (STRING.MID("gcc_snoc_bus_timeout_extref", &clk_itr_length-&clk_input_length+1, &clk_input_length-1)==STRING.CUT("&clk", 1))
    ( 
      &match=1
    )
  )
  else if (&wild_tail==1)
  (
    if (STRING.MID("gcc_snoc_bus_timeout_extref", 0, &clk_input_length-1)==STRING.CUT("&clk", -1))
    ( 
      &match=1
    )
  )
  else if ("gcc_snoc_bus_timeout_extref"=="&clk")
  (
    &match=1
  )
  
  if (&match==1)
  (
    &clk_test=&CLK_TEST_GCC_SNOC_BUS_TIMEOUT_EXTREF
    &clk_reg=0
    &clk_reg_name="No CBCR"
    &clk_name="gcc_snoc_bus_timeout_extref"
    &clk_reg_cbcr_type=""
    &clk_vote_bit=-1.
    &clk_multiplier=1.

    gosub Print_Clk_Info_Line
  )

  &match=0
  &wild_head=0
  &wild_tail=0
  &clk_input_length=STRING.LENGTH("&clk")
  &clk_itr_length=STRING.LENGTH("gcc_snoc_qosgen_extref")

  if (STRING.SCAN("&clk", "*", 0)==0)
  (
    &wild_head=1
  )
  if (STRING.SCAN("&clk", "*", 1)==(STRING.LENGTH("&clk")-1))
  (
    &wild_tail=1
  )

  if ((&wild_head==1)&&(&wild_tail==1))
  (
    if (STRING.SCAN("gcc_snoc_qosgen_extref", STRING.MID("&clk", 1, &clk_input_length-2), 0)!=-1)
    ( 
      &match=1
    )
  )
  else if (&wild_head==1)
  (
    if (STRING.MID("gcc_snoc_qosgen_extref", &clk_itr_length-&clk_input_length+1, &clk_input_length-1)==STRING.CUT("&clk", 1))
    ( 
      &match=1
    )
  )
  else if (&wild_tail==1)
  (
    if (STRING.MID("gcc_snoc_qosgen_extref", 0, &clk_input_length-1)==STRING.CUT("&clk", -1))
    ( 
      &match=1
    )
  )
  else if ("gcc_snoc_qosgen_extref"=="&clk")
  (
    &match=1
  )
  
  if (&match==1)
  (
    &clk_test=&CLK_TEST_GCC_SNOC_QOSGEN_EXTREF
    &clk_reg=0
    &clk_reg_name="No CBCR"
    &clk_name="gcc_snoc_qosgen_extref"
    &clk_reg_cbcr_type=""
    &clk_vote_bit=-1.
    &clk_multiplier=1.

    gosub Print_Clk_Info_Line
  )

  &match=0
  &wild_head=0
  &wild_tail=0
  &clk_input_length=STRING.LENGTH("&clk")
  &clk_itr_length=STRING.LENGTH("gpll0_dtest")

  if (STRING.SCAN("&clk", "*", 0)==0)
  (
    &wild_head=1
  )
  if (STRING.SCAN("&clk", "*", 1)==(STRING.LENGTH("&clk")-1))
  (
    &wild_tail=1
  )

  if ((&wild_head==1)&&(&wild_tail==1))
  (
    if (STRING.SCAN("gpll0_dtest", STRING.MID("&clk", 1, &clk_input_length-2), 0)!=-1)
    ( 
      &match=1
    )
  )
  else if (&wild_head==1)
  (
    if (STRING.MID("gpll0_dtest", &clk_itr_length-&clk_input_length+1, &clk_input_length-1)==STRING.CUT("&clk", 1))
    ( 
      &match=1
    )
  )
  else if (&wild_tail==1)
  (
    if (STRING.MID("gpll0_dtest", 0, &clk_input_length-1)==STRING.CUT("&clk", -1))
    ( 
      &match=1
    )
  )
  else if ("gpll0_dtest"=="&clk")
  (
    &match=1
  )
  
  if (&match==1)
  (
    &clk_test=&CLK_TEST_GPLL0_DTEST
    &clk_reg=0
    &clk_reg_name="No CBCR"
    &clk_name="gpll0_dtest"
    &clk_reg_cbcr_type=""
    &clk_vote_bit=-1.
    &clk_multiplier=1.

    gosub Print_Clk_Info_Line
  )

  &match=0
  &wild_head=0
  &wild_tail=0
  &clk_input_length=STRING.LENGTH("&clk")
  &clk_itr_length=STRING.LENGTH("gpll0_lock_det")

  if (STRING.SCAN("&clk", "*", 0)==0)
  (
    &wild_head=1
  )
  if (STRING.SCAN("&clk", "*", 1)==(STRING.LENGTH("&clk")-1))
  (
    &wild_tail=1
  )

  if ((&wild_head==1)&&(&wild_tail==1))
  (
    if (STRING.SCAN("gpll0_lock_det", STRING.MID("&clk", 1, &clk_input_length-2), 0)!=-1)
    ( 
      &match=1
    )
  )
  else if (&wild_head==1)
  (
    if (STRING.MID("gpll0_lock_det", &clk_itr_length-&clk_input_length+1, &clk_input_length-1)==STRING.CUT("&clk", 1))
    ( 
      &match=1
    )
  )
  else if (&wild_tail==1)
  (
    if (STRING.MID("gpll0_lock_det", 0, &clk_input_length-1)==STRING.CUT("&clk", -1))
    ( 
      &match=1
    )
  )
  else if ("gpll0_lock_det"=="&clk")
  (
    &match=1
  )
  
  if (&match==1)
  (
    &clk_test=&CLK_TEST_GPLL0_LOCK_DET
    &clk_reg=0
    &clk_reg_name="No CBCR"
    &clk_name="gpll0_lock_det"
    &clk_reg_cbcr_type=""
    &clk_vote_bit=-1.
    &clk_multiplier=1.

    gosub Print_Clk_Info_Line
  )

  &match=0
  &wild_head=0
  &wild_tail=0
  &clk_input_length=STRING.LENGTH("&clk")
  &clk_itr_length=STRING.LENGTH("gpll1_dtest")

  if (STRING.SCAN("&clk", "*", 0)==0)
  (
    &wild_head=1
  )
  if (STRING.SCAN("&clk", "*", 1)==(STRING.LENGTH("&clk")-1))
  (
    &wild_tail=1
  )

  if ((&wild_head==1)&&(&wild_tail==1))
  (
    if (STRING.SCAN("gpll1_dtest", STRING.MID("&clk", 1, &clk_input_length-2), 0)!=-1)
    ( 
      &match=1
    )
  )
  else if (&wild_head==1)
  (
    if (STRING.MID("gpll1_dtest", &clk_itr_length-&clk_input_length+1, &clk_input_length-1)==STRING.CUT("&clk", 1))
    ( 
      &match=1
    )
  )
  else if (&wild_tail==1)
  (
    if (STRING.MID("gpll1_dtest", 0, &clk_input_length-1)==STRING.CUT("&clk", -1))
    ( 
      &match=1
    )
  )
  else if ("gpll1_dtest"=="&clk")
  (
    &match=1
  )
  
  if (&match==1)
  (
    &clk_test=&CLK_TEST_GPLL1_DTEST
    &clk_reg=0
    &clk_reg_name="No CBCR"
    &clk_name="gpll1_dtest"
    &clk_reg_cbcr_type=""
    &clk_vote_bit=-1.
    &clk_multiplier=1.

    gosub Print_Clk_Info_Line
  )

  &match=0
  &wild_head=0
  &wild_tail=0
  &clk_input_length=STRING.LENGTH("&clk")
  &clk_itr_length=STRING.LENGTH("gpll1_lock_det")

  if (STRING.SCAN("&clk", "*", 0)==0)
  (
    &wild_head=1
  )
  if (STRING.SCAN("&clk", "*", 1)==(STRING.LENGTH("&clk")-1))
  (
    &wild_tail=1
  )

  if ((&wild_head==1)&&(&wild_tail==1))
  (
    if (STRING.SCAN("gpll1_lock_det", STRING.MID("&clk", 1, &clk_input_length-2), 0)!=-1)
    ( 
      &match=1
    )
  )
  else if (&wild_head==1)
  (
    if (STRING.MID("gpll1_lock_det", &clk_itr_length-&clk_input_length+1, &clk_input_length-1)==STRING.CUT("&clk", 1))
    ( 
      &match=1
    )
  )
  else if (&wild_tail==1)
  (
    if (STRING.MID("gpll1_lock_det", 0, &clk_input_length-1)==STRING.CUT("&clk", -1))
    ( 
      &match=1
    )
  )
  else if ("gpll1_lock_det"=="&clk")
  (
    &match=1
  )
  
  if (&match==1)
  (
    &clk_test=&CLK_TEST_GPLL1_LOCK_DET
    &clk_reg=0
    &clk_reg_name="No CBCR"
    &clk_name="gpll1_lock_det"
    &clk_reg_cbcr_type=""
    &clk_vote_bit=-1.
    &clk_multiplier=1.

    gosub Print_Clk_Info_Line
  )

  &match=0
  &wild_head=0
  &wild_tail=0
  &clk_input_length=STRING.LENGTH("&clk")
  &clk_itr_length=STRING.LENGTH("gpll2_dtest")

  if (STRING.SCAN("&clk", "*", 0)==0)
  (
    &wild_head=1
  )
  if (STRING.SCAN("&clk", "*", 1)==(STRING.LENGTH("&clk")-1))
  (
    &wild_tail=1
  )

  if ((&wild_head==1)&&(&wild_tail==1))
  (
    if (STRING.SCAN("gpll2_dtest", STRING.MID("&clk", 1, &clk_input_length-2), 0)!=-1)
    ( 
      &match=1
    )
  )
  else if (&wild_head==1)
  (
    if (STRING.MID("gpll2_dtest", &clk_itr_length-&clk_input_length+1, &clk_input_length-1)==STRING.CUT("&clk", 1))
    ( 
      &match=1
    )
  )
  else if (&wild_tail==1)
  (
    if (STRING.MID("gpll2_dtest", 0, &clk_input_length-1)==STRING.CUT("&clk", -1))
    ( 
      &match=1
    )
  )
  else if ("gpll2_dtest"=="&clk")
  (
    &match=1
  )
  
  if (&match==1)
  (
    &clk_test=&CLK_TEST_GPLL2_DTEST
    &clk_reg=0
    &clk_reg_name="No CBCR"
    &clk_name="gpll2_dtest"
    &clk_reg_cbcr_type=""
    &clk_vote_bit=-1.
    &clk_multiplier=1.

    gosub Print_Clk_Info_Line
  )

  &match=0
  &wild_head=0
  &wild_tail=0
  &clk_input_length=STRING.LENGTH("&clk")
  &clk_itr_length=STRING.LENGTH("gpll2_lock_det")

  if (STRING.SCAN("&clk", "*", 0)==0)
  (
    &wild_head=1
  )
  if (STRING.SCAN("&clk", "*", 1)==(STRING.LENGTH("&clk")-1))
  (
    &wild_tail=1
  )

  if ((&wild_head==1)&&(&wild_tail==1))
  (
    if (STRING.SCAN("gpll2_lock_det", STRING.MID("&clk", 1, &clk_input_length-2), 0)!=-1)
    ( 
      &match=1
    )
  )
  else if (&wild_head==1)
  (
    if (STRING.MID("gpll2_lock_det", &clk_itr_length-&clk_input_length+1, &clk_input_length-1)==STRING.CUT("&clk", 1))
    ( 
      &match=1
    )
  )
  else if (&wild_tail==1)
  (
    if (STRING.MID("gpll2_lock_det", 0, &clk_input_length-1)==STRING.CUT("&clk", -1))
    ( 
      &match=1
    )
  )
  else if ("gpll2_lock_det"=="&clk")
  (
    &match=1
  )
  
  if (&match==1)
  (
    &clk_test=&CLK_TEST_GPLL2_LOCK_DET
    &clk_reg=0
    &clk_reg_name="No CBCR"
    &clk_name="gpll2_lock_det"
    &clk_reg_cbcr_type=""
    &clk_vote_bit=-1.
    &clk_multiplier=1.

    gosub Print_Clk_Info_Line
  )

  &match=0
  &wild_head=0
  &wild_tail=0
  &clk_input_length=STRING.LENGTH("&clk")
  &clk_itr_length=STRING.LENGTH("gpll3_dtest")

  if (STRING.SCAN("&clk", "*", 0)==0)
  (
    &wild_head=1
  )
  if (STRING.SCAN("&clk", "*", 1)==(STRING.LENGTH("&clk")-1))
  (
    &wild_tail=1
  )

  if ((&wild_head==1)&&(&wild_tail==1))
  (
    if (STRING.SCAN("gpll3_dtest", STRING.MID("&clk", 1, &clk_input_length-2), 0)!=-1)
    ( 
      &match=1
    )
  )
  else if (&wild_head==1)
  (
    if (STRING.MID("gpll3_dtest", &clk_itr_length-&clk_input_length+1, &clk_input_length-1)==STRING.CUT("&clk", 1))
    ( 
      &match=1
    )
  )
  else if (&wild_tail==1)
  (
    if (STRING.MID("gpll3_dtest", 0, &clk_input_length-1)==STRING.CUT("&clk", -1))
    ( 
      &match=1
    )
  )
  else if ("gpll3_dtest"=="&clk")
  (
    &match=1
  )
  
  if (&match==1)
  (
    &clk_test=&CLK_TEST_GPLL3_DTEST
    &clk_reg=0
    &clk_reg_name="No CBCR"
    &clk_name="gpll3_dtest"
    &clk_reg_cbcr_type=""
    &clk_vote_bit=-1.
    &clk_multiplier=1.

    gosub Print_Clk_Info_Line
  )

  &match=0
  &wild_head=0
  &wild_tail=0
  &clk_input_length=STRING.LENGTH("&clk")
  &clk_itr_length=STRING.LENGTH("gpll3_lock_det")

  if (STRING.SCAN("&clk", "*", 0)==0)
  (
    &wild_head=1
  )
  if (STRING.SCAN("&clk", "*", 1)==(STRING.LENGTH("&clk")-1))
  (
    &wild_tail=1
  )

  if ((&wild_head==1)&&(&wild_tail==1))
  (
    if (STRING.SCAN("gpll3_lock_det", STRING.MID("&clk", 1, &clk_input_length-2), 0)!=-1)
    ( 
      &match=1
    )
  )
  else if (&wild_head==1)
  (
    if (STRING.MID("gpll3_lock_det", &clk_itr_length-&clk_input_length+1, &clk_input_length-1)==STRING.CUT("&clk", 1))
    ( 
      &match=1
    )
  )
  else if (&wild_tail==1)
  (
    if (STRING.MID("gpll3_lock_det", 0, &clk_input_length-1)==STRING.CUT("&clk", -1))
    ( 
      &match=1
    )
  )
  else if ("gpll3_lock_det"=="&clk")
  (
    &match=1
  )
  
  if (&match==1)
  (
    &clk_test=&CLK_TEST_GPLL3_LOCK_DET
    &clk_reg=0
    &clk_reg_name="No CBCR"
    &clk_name="gpll3_lock_det"
    &clk_reg_cbcr_type=""
    &clk_vote_bit=-1.
    &clk_multiplier=1.

    gosub Print_Clk_Info_Line
  )

  &match=0
  &wild_head=0
  &wild_tail=0
  &clk_input_length=STRING.LENGTH("&clk")
  &clk_itr_length=STRING.LENGTH("gpll4_dtest")

  if (STRING.SCAN("&clk", "*", 0)==0)
  (
    &wild_head=1
  )
  if (STRING.SCAN("&clk", "*", 1)==(STRING.LENGTH("&clk")-1))
  (
    &wild_tail=1
  )

  if ((&wild_head==1)&&(&wild_tail==1))
  (
    if (STRING.SCAN("gpll4_dtest", STRING.MID("&clk", 1, &clk_input_length-2), 0)!=-1)
    ( 
      &match=1
    )
  )
  else if (&wild_head==1)
  (
    if (STRING.MID("gpll4_dtest", &clk_itr_length-&clk_input_length+1, &clk_input_length-1)==STRING.CUT("&clk", 1))
    ( 
      &match=1
    )
  )
  else if (&wild_tail==1)
  (
    if (STRING.MID("gpll4_dtest", 0, &clk_input_length-1)==STRING.CUT("&clk", -1))
    ( 
      &match=1
    )
  )
  else if ("gpll4_dtest"=="&clk")
  (
    &match=1
  )
  
  if (&match==1)
  (
    &clk_test=&CLK_TEST_GPLL4_DTEST
    &clk_reg=0
    &clk_reg_name="No CBCR"
    &clk_name="gpll4_dtest"
    &clk_reg_cbcr_type=""
    &clk_vote_bit=-1.
    &clk_multiplier=1.

    gosub Print_Clk_Info_Line
  )

  &match=0
  &wild_head=0
  &wild_tail=0
  &clk_input_length=STRING.LENGTH("&clk")
  &clk_itr_length=STRING.LENGTH("gpll4_lock_det")

  if (STRING.SCAN("&clk", "*", 0)==0)
  (
    &wild_head=1
  )
  if (STRING.SCAN("&clk", "*", 1)==(STRING.LENGTH("&clk")-1))
  (
    &wild_tail=1
  )

  if ((&wild_head==1)&&(&wild_tail==1))
  (
    if (STRING.SCAN("gpll4_lock_det", STRING.MID("&clk", 1, &clk_input_length-2), 0)!=-1)
    ( 
      &match=1
    )
  )
  else if (&wild_head==1)
  (
    if (STRING.MID("gpll4_lock_det", &clk_itr_length-&clk_input_length+1, &clk_input_length-1)==STRING.CUT("&clk", 1))
    ( 
      &match=1
    )
  )
  else if (&wild_tail==1)
  (
    if (STRING.MID("gpll4_lock_det", 0, &clk_input_length-1)==STRING.CUT("&clk", -1))
    ( 
      &match=1
    )
  )
  else if ("gpll4_lock_det"=="&clk")
  (
    &match=1
  )
  
  if (&match==1)
  (
    &clk_test=&CLK_TEST_GPLL4_LOCK_DET
    &clk_reg=0
    &clk_reg_name="No CBCR"
    &clk_name="gpll4_lock_det"
    &clk_reg_cbcr_type=""
    &clk_vote_bit=-1.
    &clk_multiplier=1.

    gosub Print_Clk_Info_Line
  )

  &match=0
  &wild_head=0
  &wild_tail=0
  &clk_input_length=STRING.LENGTH("&clk")
  &clk_itr_length=STRING.LENGTH("hmss_gcc_dbg_clk")

  if (STRING.SCAN("&clk", "*", 0)==0)
  (
    &wild_head=1
  )
  if (STRING.SCAN("&clk", "*", 1)==(STRING.LENGTH("&clk")-1))
  (
    &wild_tail=1
  )

  if ((&wild_head==1)&&(&wild_tail==1))
  (
    if (STRING.SCAN("hmss_gcc_dbg_clk", STRING.MID("&clk", 1, &clk_input_length-2), 0)!=-1)
    ( 
      &match=1
    )
  )
  else if (&wild_head==1)
  (
    if (STRING.MID("hmss_gcc_dbg_clk", &clk_itr_length-&clk_input_length+1, &clk_input_length-1)==STRING.CUT("&clk", 1))
    ( 
      &match=1
    )
  )
  else if (&wild_tail==1)
  (
    if (STRING.MID("hmss_gcc_dbg_clk", 0, &clk_input_length-1)==STRING.CUT("&clk", -1))
    ( 
      &match=1
    )
  )
  else if ("hmss_gcc_dbg_clk"=="&clk")
  (
    &match=1
  )
  
  if (&match==1)
  (
    &clk_test=&CLK_TEST_HMSS_GCC_DBG_CLK
    &clk_reg=0
    &clk_reg_name="No CBCR"
    &clk_name="hmss_gcc_dbg_clk"
    &clk_reg_cbcr_type=""
    &clk_vote_bit=-1.
    &clk_multiplier=1.

    gosub Print_Clk_Info_Line
  )

  &match=0
  &wild_head=0
  &wild_tail=0
  &clk_input_length=STRING.LENGTH("&clk")
  &clk_itr_length=STRING.LENGTH("lpass_gcc_dbg_clk")

  if (STRING.SCAN("&clk", "*", 0)==0)
  (
    &wild_head=1
  )
  if (STRING.SCAN("&clk", "*", 1)==(STRING.LENGTH("&clk")-1))
  (
    &wild_tail=1
  )

  if ((&wild_head==1)&&(&wild_tail==1))
  (
    if (STRING.SCAN("lpass_gcc_dbg_clk", STRING.MID("&clk", 1, &clk_input_length-2), 0)!=-1)
    ( 
      &match=1
    )
  )
  else if (&wild_head==1)
  (
    if (STRING.MID("lpass_gcc_dbg_clk", &clk_itr_length-&clk_input_length+1, &clk_input_length-1)==STRING.CUT("&clk", 1))
    ( 
      &match=1
    )
  )
  else if (&wild_tail==1)
  (
    if (STRING.MID("lpass_gcc_dbg_clk", 0, &clk_input_length-1)==STRING.CUT("&clk", -1))
    ( 
      &match=1
    )
  )
  else if ("lpass_gcc_dbg_clk"=="&clk")
  (
    &match=1
  )
  
  if (&match==1)
  (
    &clk_test=&CLK_TEST_LPASS_GCC_DBG_CLK
    &clk_reg=0
    &clk_reg_name="No CBCR"
    &clk_name="lpass_gcc_dbg_clk"
    &clk_reg_cbcr_type=""
    &clk_vote_bit=-1.
    &clk_multiplier=1.

    gosub Print_Clk_Info_Line
  )

  &match=0
  &wild_head=0
  &wild_tail=0
  &clk_input_length=STRING.LENGTH("&clk")
  &clk_itr_length=STRING.LENGTH("mmss_gcc_dbg_clk")

  if (STRING.SCAN("&clk", "*", 0)==0)
  (
    &wild_head=1
  )
  if (STRING.SCAN("&clk", "*", 1)==(STRING.LENGTH("&clk")-1))
  (
    &wild_tail=1
  )

  if ((&wild_head==1)&&(&wild_tail==1))
  (
    if (STRING.SCAN("mmss_gcc_dbg_clk", STRING.MID("&clk", 1, &clk_input_length-2), 0)!=-1)
    ( 
      &match=1
    )
  )
  else if (&wild_head==1)
  (
    if (STRING.MID("mmss_gcc_dbg_clk", &clk_itr_length-&clk_input_length+1, &clk_input_length-1)==STRING.CUT("&clk", 1))
    ( 
      &match=1
    )
  )
  else if (&wild_tail==1)
  (
    if (STRING.MID("mmss_gcc_dbg_clk", 0, &clk_input_length-1)==STRING.CUT("&clk", -1))
    ( 
      &match=1
    )
  )
  else if ("mmss_gcc_dbg_clk"=="&clk")
  (
    &match=1
  )
  
  if (&match==1)
  (
    &clk_test=&CLK_TEST_MMSS_GCC_DBG_CLK
    &clk_reg=0
    &clk_reg_name="No CBCR"
    &clk_name="mmss_gcc_dbg_clk"
    &clk_reg_cbcr_type=""
    &clk_vote_bit=-1.
    &clk_multiplier=1.

    gosub Print_Clk_Info_Line
  )

  &match=0
  &wild_head=0
  &wild_tail=0
  &clk_input_length=STRING.LENGTH("&clk")
  &clk_itr_length=STRING.LENGTH("mpm_gcc_temp0_sensor_ringosc_clk")

  if (STRING.SCAN("&clk", "*", 0)==0)
  (
    &wild_head=1
  )
  if (STRING.SCAN("&clk", "*", 1)==(STRING.LENGTH("&clk")-1))
  (
    &wild_tail=1
  )

  if ((&wild_head==1)&&(&wild_tail==1))
  (
    if (STRING.SCAN("mpm_gcc_temp0_sensor_ringosc_clk", STRING.MID("&clk", 1, &clk_input_length-2), 0)!=-1)
    ( 
      &match=1
    )
  )
  else if (&wild_head==1)
  (
    if (STRING.MID("mpm_gcc_temp0_sensor_ringosc_clk", &clk_itr_length-&clk_input_length+1, &clk_input_length-1)==STRING.CUT("&clk", 1))
    ( 
      &match=1
    )
  )
  else if (&wild_tail==1)
  (
    if (STRING.MID("mpm_gcc_temp0_sensor_ringosc_clk", 0, &clk_input_length-1)==STRING.CUT("&clk", -1))
    ( 
      &match=1
    )
  )
  else if ("mpm_gcc_temp0_sensor_ringosc_clk"=="&clk")
  (
    &match=1
  )
  
  if (&match==1)
  (
    &clk_test=&CLK_TEST_MPM_GCC_TEMP0_SENSOR_RINGOSC_CLK
    &clk_reg=0
    &clk_reg_name="No CBCR"
    &clk_name="mpm_gcc_temp0_sensor_ringosc_clk"
    &clk_reg_cbcr_type=""
    &clk_vote_bit=-1.
    &clk_multiplier=1.

    gosub Print_Clk_Info_Line
  )

  &match=0
  &wild_head=0
  &wild_tail=0
  &clk_input_length=STRING.LENGTH("&clk")
  &clk_itr_length=STRING.LENGTH("mpm_gcc_temp1_sensor_ringosc_clk")

  if (STRING.SCAN("&clk", "*", 0)==0)
  (
    &wild_head=1
  )
  if (STRING.SCAN("&clk", "*", 1)==(STRING.LENGTH("&clk")-1))
  (
    &wild_tail=1
  )

  if ((&wild_head==1)&&(&wild_tail==1))
  (
    if (STRING.SCAN("mpm_gcc_temp1_sensor_ringosc_clk", STRING.MID("&clk", 1, &clk_input_length-2), 0)!=-1)
    ( 
      &match=1
    )
  )
  else if (&wild_head==1)
  (
    if (STRING.MID("mpm_gcc_temp1_sensor_ringosc_clk", &clk_itr_length-&clk_input_length+1, &clk_input_length-1)==STRING.CUT("&clk", 1))
    ( 
      &match=1
    )
  )
  else if (&wild_tail==1)
  (
    if (STRING.MID("mpm_gcc_temp1_sensor_ringosc_clk", 0, &clk_input_length-1)==STRING.CUT("&clk", -1))
    ( 
      &match=1
    )
  )
  else if ("mpm_gcc_temp1_sensor_ringosc_clk"=="&clk")
  (
    &match=1
  )
  
  if (&match==1)
  (
    &clk_test=&CLK_TEST_MPM_GCC_TEMP1_SENSOR_RINGOSC_CLK
    &clk_reg=0
    &clk_reg_name="No CBCR"
    &clk_name="mpm_gcc_temp1_sensor_ringosc_clk"
    &clk_reg_cbcr_type=""
    &clk_vote_bit=-1.
    &clk_multiplier=1.

    gosub Print_Clk_Info_Line
  )

  &match=0
  &wild_head=0
  &wild_tail=0
  &clk_input_length=STRING.LENGTH("&clk")
  &clk_itr_length=STRING.LENGTH("mpm_gcc_temp_sensor_ringosc_clk")

  if (STRING.SCAN("&clk", "*", 0)==0)
  (
    &wild_head=1
  )
  if (STRING.SCAN("&clk", "*", 1)==(STRING.LENGTH("&clk")-1))
  (
    &wild_tail=1
  )

  if ((&wild_head==1)&&(&wild_tail==1))
  (
    if (STRING.SCAN("mpm_gcc_temp_sensor_ringosc_clk", STRING.MID("&clk", 1, &clk_input_length-2), 0)!=-1)
    ( 
      &match=1
    )
  )
  else if (&wild_head==1)
  (
    if (STRING.MID("mpm_gcc_temp_sensor_ringosc_clk", &clk_itr_length-&clk_input_length+1, &clk_input_length-1)==STRING.CUT("&clk", 1))
    ( 
      &match=1
    )
  )
  else if (&wild_tail==1)
  (
    if (STRING.MID("mpm_gcc_temp_sensor_ringosc_clk", 0, &clk_input_length-1)==STRING.CUT("&clk", -1))
    ( 
      &match=1
    )
  )
  else if ("mpm_gcc_temp_sensor_ringosc_clk"=="&clk")
  (
    &match=1
  )
  
  if (&match==1)
  (
    &clk_test=&CLK_TEST_MPM_GCC_TEMP_SENSOR_RINGOSC_CLK
    &clk_reg=0
    &clk_reg_name="No CBCR"
    &clk_name="mpm_gcc_temp_sensor_ringosc_clk"
    &clk_reg_cbcr_type=""
    &clk_vote_bit=-1.
    &clk_multiplier=1.

    gosub Print_Clk_Info_Line
  )

  &match=0
  &wild_head=0
  &wild_tail=0
  &clk_input_length=STRING.LENGTH("&clk")
  &clk_itr_length=STRING.LENGTH("mss_gcc_dbg_clk")

  if (STRING.SCAN("&clk", "*", 0)==0)
  (
    &wild_head=1
  )
  if (STRING.SCAN("&clk", "*", 1)==(STRING.LENGTH("&clk")-1))
  (
    &wild_tail=1
  )

  if ((&wild_head==1)&&(&wild_tail==1))
  (
    if (STRING.SCAN("mss_gcc_dbg_clk", STRING.MID("&clk", 1, &clk_input_length-2), 0)!=-1)
    ( 
      &match=1
    )
  )
  else if (&wild_head==1)
  (
    if (STRING.MID("mss_gcc_dbg_clk", &clk_itr_length-&clk_input_length+1, &clk_input_length-1)==STRING.CUT("&clk", 1))
    ( 
      &match=1
    )
  )
  else if (&wild_tail==1)
  (
    if (STRING.MID("mss_gcc_dbg_clk", 0, &clk_input_length-1)==STRING.CUT("&clk", -1))
    ( 
      &match=1
    )
  )
  else if ("mss_gcc_dbg_clk"=="&clk")
  (
    &match=1
  )
  
  if (&match==1)
  (
    &clk_test=&CLK_TEST_MSS_GCC_DBG_CLK
    &clk_reg=0
    &clk_reg_name="No CBCR"
    &clk_name="mss_gcc_dbg_clk"
    &clk_reg_cbcr_type=""
    &clk_vote_bit=-1.
    &clk_multiplier=1.

    gosub Print_Clk_Info_Line
  )

  &match=0
  &wild_head=0
  &wild_tail=0
  &clk_input_length=STRING.LENGTH("&clk")
  &clk_itr_length=STRING.LENGTH("qusb2phy_gcc_clk_test_prim")

  if (STRING.SCAN("&clk", "*", 0)==0)
  (
    &wild_head=1
  )
  if (STRING.SCAN("&clk", "*", 1)==(STRING.LENGTH("&clk")-1))
  (
    &wild_tail=1
  )

  if ((&wild_head==1)&&(&wild_tail==1))
  (
    if (STRING.SCAN("qusb2phy_gcc_clk_test_prim", STRING.MID("&clk", 1, &clk_input_length-2), 0)!=-1)
    ( 
      &match=1
    )
  )
  else if (&wild_head==1)
  (
    if (STRING.MID("qusb2phy_gcc_clk_test_prim", &clk_itr_length-&clk_input_length+1, &clk_input_length-1)==STRING.CUT("&clk", 1))
    ( 
      &match=1
    )
  )
  else if (&wild_tail==1)
  (
    if (STRING.MID("qusb2phy_gcc_clk_test_prim", 0, &clk_input_length-1)==STRING.CUT("&clk", -1))
    ( 
      &match=1
    )
  )
  else if ("qusb2phy_gcc_clk_test_prim"=="&clk")
  (
    &match=1
  )
  
  if (&match==1)
  (
    &clk_test=&CLK_TEST_QUSB2PHY_GCC_CLK_TEST_PRIM
    &clk_reg=0
    &clk_reg_name="No CBCR"
    &clk_name="qusb2phy_gcc_clk_test_prim"
    &clk_reg_cbcr_type=""
    &clk_vote_bit=-1.
    &clk_multiplier=1.

    gosub Print_Clk_Info_Line
  )

  &match=0
  &wild_head=0
  &wild_tail=0
  &clk_input_length=STRING.LENGTH("&clk")
  &clk_itr_length=STRING.LENGTH("qusb2phy_gcc_clk_test_sec")

  if (STRING.SCAN("&clk", "*", 0)==0)
  (
    &wild_head=1
  )
  if (STRING.SCAN("&clk", "*", 1)==(STRING.LENGTH("&clk")-1))
  (
    &wild_tail=1
  )

  if ((&wild_head==1)&&(&wild_tail==1))
  (
    if (STRING.SCAN("qusb2phy_gcc_clk_test_sec", STRING.MID("&clk", 1, &clk_input_length-2), 0)!=-1)
    ( 
      &match=1
    )
  )
  else if (&wild_head==1)
  (
    if (STRING.MID("qusb2phy_gcc_clk_test_sec", &clk_itr_length-&clk_input_length+1, &clk_input_length-1)==STRING.CUT("&clk", 1))
    ( 
      &match=1
    )
  )
  else if (&wild_tail==1)
  (
    if (STRING.MID("qusb2phy_gcc_clk_test_sec", 0, &clk_input_length-1)==STRING.CUT("&clk", -1))
    ( 
      &match=1
    )
  )
  else if ("qusb2phy_gcc_clk_test_sec"=="&clk")
  (
    &match=1
  )
  
  if (&match==1)
  (
    &clk_test=&CLK_TEST_QUSB2PHY_GCC_CLK_TEST_SEC
    &clk_reg=0
    &clk_reg_name="No CBCR"
    &clk_name="qusb2phy_gcc_clk_test_sec"
    &clk_reg_cbcr_type=""
    &clk_vote_bit=-1.
    &clk_multiplier=1.

    gosub Print_Clk_Info_Line
  )

  &match=0
  &wild_head=0
  &wild_tail=0
  &clk_input_length=STRING.LENGTH("&clk")
  &clk_itr_length=STRING.LENGTH("qusb2phy_prim_gcc_usb30_utmi_clk")

  if (STRING.SCAN("&clk", "*", 0)==0)
  (
    &wild_head=1
  )
  if (STRING.SCAN("&clk", "*", 1)==(STRING.LENGTH("&clk")-1))
  (
    &wild_tail=1
  )

  if ((&wild_head==1)&&(&wild_tail==1))
  (
    if (STRING.SCAN("qusb2phy_prim_gcc_usb30_utmi_clk", STRING.MID("&clk", 1, &clk_input_length-2), 0)!=-1)
    ( 
      &match=1
    )
  )
  else if (&wild_head==1)
  (
    if (STRING.MID("qusb2phy_prim_gcc_usb30_utmi_clk", &clk_itr_length-&clk_input_length+1, &clk_input_length-1)==STRING.CUT("&clk", 1))
    ( 
      &match=1
    )
  )
  else if (&wild_tail==1)
  (
    if (STRING.MID("qusb2phy_prim_gcc_usb30_utmi_clk", 0, &clk_input_length-1)==STRING.CUT("&clk", -1))
    ( 
      &match=1
    )
  )
  else if ("qusb2phy_prim_gcc_usb30_utmi_clk"=="&clk")
  (
    &match=1
  )
  
  if (&match==1)
  (
    &clk_test=&CLK_TEST_QUSB2PHY_PRIM_GCC_USB30_UTMI_CLK
    &clk_reg=0
    &clk_reg_name="No CBCR"
    &clk_name="qusb2phy_prim_gcc_usb30_utmi_clk"
    &clk_reg_cbcr_type=""
    &clk_vote_bit=-1.
    &clk_multiplier=1.

    gosub Print_Clk_Info_Line
  )

  &match=0
  &wild_head=0
  &wild_tail=0
  &clk_input_length=STRING.LENGTH("&clk")
  &clk_itr_length=STRING.LENGTH("qusb2phy_sec_gcc_usb20s_utmi_clk")

  if (STRING.SCAN("&clk", "*", 0)==0)
  (
    &wild_head=1
  )
  if (STRING.SCAN("&clk", "*", 1)==(STRING.LENGTH("&clk")-1))
  (
    &wild_tail=1
  )

  if ((&wild_head==1)&&(&wild_tail==1))
  (
    if (STRING.SCAN("qusb2phy_sec_gcc_usb20s_utmi_clk", STRING.MID("&clk", 1, &clk_input_length-2), 0)!=-1)
    ( 
      &match=1
    )
  )
  else if (&wild_head==1)
  (
    if (STRING.MID("qusb2phy_sec_gcc_usb20s_utmi_clk", &clk_itr_length-&clk_input_length+1, &clk_input_length-1)==STRING.CUT("&clk", 1))
    ( 
      &match=1
    )
  )
  else if (&wild_tail==1)
  (
    if (STRING.MID("qusb2phy_sec_gcc_usb20s_utmi_clk", 0, &clk_input_length-1)==STRING.CUT("&clk", -1))
    ( 
      &match=1
    )
  )
  else if ("qusb2phy_sec_gcc_usb20s_utmi_clk"=="&clk")
  (
    &match=1
  )
  
  if (&match==1)
  (
    &clk_test=&CLK_TEST_QUSB2PHY_SEC_GCC_USB20S_UTMI_CLK
    &clk_reg=0
    &clk_reg_name="No CBCR"
    &clk_name="qusb2phy_sec_gcc_usb20s_utmi_clk"
    &clk_reg_cbcr_type=""
    &clk_vote_bit=-1.
    &clk_multiplier=1.

    gosub Print_Clk_Info_Line
  )

  &match=0
  &wild_head=0
  &wild_tail=0
  &clk_input_length=STRING.LENGTH("&clk")
  &clk_itr_length=STRING.LENGTH("ssc_gcc_dbg_clk")

  if (STRING.SCAN("&clk", "*", 0)==0)
  (
    &wild_head=1
  )
  if (STRING.SCAN("&clk", "*", 1)==(STRING.LENGTH("&clk")-1))
  (
    &wild_tail=1
  )

  if ((&wild_head==1)&&(&wild_tail==1))
  (
    if (STRING.SCAN("ssc_gcc_dbg_clk", STRING.MID("&clk", 1, &clk_input_length-2), 0)!=-1)
    ( 
      &match=1
    )
  )
  else if (&wild_head==1)
  (
    if (STRING.MID("ssc_gcc_dbg_clk", &clk_itr_length-&clk_input_length+1, &clk_input_length-1)==STRING.CUT("&clk", 1))
    ( 
      &match=1
    )
  )
  else if (&wild_tail==1)
  (
    if (STRING.MID("ssc_gcc_dbg_clk", 0, &clk_input_length-1)==STRING.CUT("&clk", -1))
    ( 
      &match=1
    )
  )
  else if ("ssc_gcc_dbg_clk"=="&clk")
  (
    &match=1
  )
  
  if (&match==1)
  (
    &clk_test=&CLK_TEST_SSC_GCC_DBG_CLK
    &clk_reg=0
    &clk_reg_name="No CBCR"
    &clk_name="ssc_gcc_dbg_clk"
    &clk_reg_cbcr_type=""
    &clk_vote_bit=-1.
    &clk_multiplier=1.

    gosub Print_Clk_Info_Line
  )

  &match=0
  &wild_head=0
  &wild_tail=0
  &clk_input_length=STRING.LENGTH("&clk")
  &clk_itr_length=STRING.LENGTH("ufs_rx_symbol_0_clk")

  if (STRING.SCAN("&clk", "*", 0)==0)
  (
    &wild_head=1
  )
  if (STRING.SCAN("&clk", "*", 1)==(STRING.LENGTH("&clk")-1))
  (
    &wild_tail=1
  )

  if ((&wild_head==1)&&(&wild_tail==1))
  (
    if (STRING.SCAN("ufs_rx_symbol_0_clk", STRING.MID("&clk", 1, &clk_input_length-2), 0)!=-1)
    ( 
      &match=1
    )
  )
  else if (&wild_head==1)
  (
    if (STRING.MID("ufs_rx_symbol_0_clk", &clk_itr_length-&clk_input_length+1, &clk_input_length-1)==STRING.CUT("&clk", 1))
    ( 
      &match=1
    )
  )
  else if (&wild_tail==1)
  (
    if (STRING.MID("ufs_rx_symbol_0_clk", 0, &clk_input_length-1)==STRING.CUT("&clk", -1))
    ( 
      &match=1
    )
  )
  else if ("ufs_rx_symbol_0_clk"=="&clk")
  (
    &match=1
  )
  
  if (&match==1)
  (
    &clk_test=&CLK_TEST_UFS_RX_SYMBOL_0_CLK
    &clk_reg=0
    &clk_reg_name="No CBCR"
    &clk_name="ufs_rx_symbol_0_clk"
    &clk_reg_cbcr_type=""
    &clk_vote_bit=-1.
    &clk_multiplier=1.

    gosub Print_Clk_Info_Line
  )

  &match=0
  &wild_head=0
  &wild_tail=0
  &clk_input_length=STRING.LENGTH("&clk")
  &clk_itr_length=STRING.LENGTH("ufs_rx_symbol_1_clk")

  if (STRING.SCAN("&clk", "*", 0)==0)
  (
    &wild_head=1
  )
  if (STRING.SCAN("&clk", "*", 1)==(STRING.LENGTH("&clk")-1))
  (
    &wild_tail=1
  )

  if ((&wild_head==1)&&(&wild_tail==1))
  (
    if (STRING.SCAN("ufs_rx_symbol_1_clk", STRING.MID("&clk", 1, &clk_input_length-2), 0)!=-1)
    ( 
      &match=1
    )
  )
  else if (&wild_head==1)
  (
    if (STRING.MID("ufs_rx_symbol_1_clk", &clk_itr_length-&clk_input_length+1, &clk_input_length-1)==STRING.CUT("&clk", 1))
    ( 
      &match=1
    )
  )
  else if (&wild_tail==1)
  (
    if (STRING.MID("ufs_rx_symbol_1_clk", 0, &clk_input_length-1)==STRING.CUT("&clk", -1))
    ( 
      &match=1
    )
  )
  else if ("ufs_rx_symbol_1_clk"=="&clk")
  (
    &match=1
  )
  
  if (&match==1)
  (
    &clk_test=&CLK_TEST_UFS_RX_SYMBOL_1_CLK
    &clk_reg=0
    &clk_reg_name="No CBCR"
    &clk_name="ufs_rx_symbol_1_clk"
    &clk_reg_cbcr_type=""
    &clk_vote_bit=-1.
    &clk_multiplier=1.

    gosub Print_Clk_Info_Line
  )

  &match=0
  &wild_head=0
  &wild_tail=0
  &clk_input_length=STRING.LENGTH("&clk")
  &clk_itr_length=STRING.LENGTH("ufs_tx_symbol_0_clk")

  if (STRING.SCAN("&clk", "*", 0)==0)
  (
    &wild_head=1
  )
  if (STRING.SCAN("&clk", "*", 1)==(STRING.LENGTH("&clk")-1))
  (
    &wild_tail=1
  )

  if ((&wild_head==1)&&(&wild_tail==1))
  (
    if (STRING.SCAN("ufs_tx_symbol_0_clk", STRING.MID("&clk", 1, &clk_input_length-2), 0)!=-1)
    ( 
      &match=1
    )
  )
  else if (&wild_head==1)
  (
    if (STRING.MID("ufs_tx_symbol_0_clk", &clk_itr_length-&clk_input_length+1, &clk_input_length-1)==STRING.CUT("&clk", 1))
    ( 
      &match=1
    )
  )
  else if (&wild_tail==1)
  (
    if (STRING.MID("ufs_tx_symbol_0_clk", 0, &clk_input_length-1)==STRING.CUT("&clk", -1))
    ( 
      &match=1
    )
  )
  else if ("ufs_tx_symbol_0_clk"=="&clk")
  (
    &match=1
  )
  
  if (&match==1)
  (
    &clk_test=&CLK_TEST_UFS_TX_SYMBOL_0_CLK
    &clk_reg=0
    &clk_reg_name="No CBCR"
    &clk_name="ufs_tx_symbol_0_clk"
    &clk_reg_cbcr_type=""
    &clk_vote_bit=-1.
    &clk_multiplier=1.

    gosub Print_Clk_Info_Line
  )

  &match=0
  &wild_head=0
  &wild_tail=0
  &clk_input_length=STRING.LENGTH("&clk")
  &clk_itr_length=STRING.LENGTH("usb3_phy_wrapper_gcc_usb3_pipe_clk")

  if (STRING.SCAN("&clk", "*", 0)==0)
  (
    &wild_head=1
  )
  if (STRING.SCAN("&clk", "*", 1)==(STRING.LENGTH("&clk")-1))
  (
    &wild_tail=1
  )

  if ((&wild_head==1)&&(&wild_tail==1))
  (
    if (STRING.SCAN("usb3_phy_wrapper_gcc_usb3_pipe_clk", STRING.MID("&clk", 1, &clk_input_length-2), 0)!=-1)
    ( 
      &match=1
    )
  )
  else if (&wild_head==1)
  (
    if (STRING.MID("usb3_phy_wrapper_gcc_usb3_pipe_clk", &clk_itr_length-&clk_input_length+1, &clk_input_length-1)==STRING.CUT("&clk", 1))
    ( 
      &match=1
    )
  )
  else if (&wild_tail==1)
  (
    if (STRING.MID("usb3_phy_wrapper_gcc_usb3_pipe_clk", 0, &clk_input_length-1)==STRING.CUT("&clk", -1))
    ( 
      &match=1
    )
  )
  else if ("usb3_phy_wrapper_gcc_usb3_pipe_clk"=="&clk")
  (
    &match=1
  )
  
  if (&match==1)
  (
    &clk_test=&CLK_TEST_USB3_PHY_WRAPPER_GCC_USB3_PIPE_CLK
    &clk_reg=0
    &clk_reg_name="No CBCR"
    &clk_name="usb3_phy_wrapper_gcc_usb3_pipe_clk"
    &clk_reg_cbcr_type=""
    &clk_vote_bit=-1.
    &clk_multiplier=1.

    gosub Print_Clk_Info_Line
  )


  ; Set appropriate access mode for LPASS registers 
  &clk_access_mode="&lpass_access_mode"

  &match=0
  &wild_head=0
  &wild_tail=0
  &clk_input_length=STRING.LENGTH("&clk")
  &clk_itr_length=STRING.LENGTH("aon_clk_src")

  if (STRING.SCAN("&clk", "*", 0)==0)
  (
    &wild_head=1
  )
  if (STRING.SCAN("&clk", "*", 1)==(STRING.LENGTH("&clk")-1))
  (
    &wild_tail=1
  )

  if ((&wild_head==1)&&(&wild_tail==1))
  (
    if (STRING.SCAN("aon_clk_src", STRING.MID("&clk", 1, &clk_input_length-2), 0)!=-1)
    ( 
      &match=1
    )
  )
  else if (&wild_head==1)
  (
    if (STRING.MID("aon_clk_src", &clk_itr_length-&clk_input_length+1, &clk_input_length-1)==STRING.CUT("&clk", 1))
    ( 
      &match=1
    )
  )
  else if (&wild_tail==1)
  (
    if (STRING.MID("aon_clk_src", 0, &clk_input_length-1)==STRING.CUT("&clk", -1))
    ( 
      &match=1
    )
  )
  else if ("aon_clk_src"=="&clk")
  (
    &match=1
  )
  
  if (&match==1)
  (
    &clk_test=&CLK_TEST_AON_CLK_SRC
    &clk_reg=0
    &clk_reg_name="No CBCR"
    &clk_name="aon_clk_src"
    &clk_reg_cbcr_type=""
    &clk_vote_bit=-1.
    &clk_multiplier=1.

    gosub Print_Clk_Info_Line
  )

  &match=0
  &wild_head=0
  &wild_tail=0
  &clk_input_length=STRING.LENGTH("&clk")
  &clk_itr_length=STRING.LENGTH("audio_core_qdsp_sway_aon_clk")

  if (STRING.SCAN("&clk", "*", 0)==0)
  (
    &wild_head=1
  )
  if (STRING.SCAN("&clk", "*", 1)==(STRING.LENGTH("&clk")-1))
  (
    &wild_tail=1
  )

  if ((&wild_head==1)&&(&wild_tail==1))
  (
    if (STRING.SCAN("audio_core_qdsp_sway_aon_clk", STRING.MID("&clk", 1, &clk_input_length-2), 0)!=-1)
    ( 
      &match=1
    )
  )
  else if (&wild_head==1)
  (
    if (STRING.MID("audio_core_qdsp_sway_aon_clk", &clk_itr_length-&clk_input_length+1, &clk_input_length-1)==STRING.CUT("&clk", 1))
    ( 
      &match=1
    )
  )
  else if (&wild_tail==1)
  (
    if (STRING.MID("audio_core_qdsp_sway_aon_clk", 0, &clk_input_length-1)==STRING.CUT("&clk", -1))
    ( 
      &match=1
    )
  )
  else if ("audio_core_qdsp_sway_aon_clk"=="&clk")
  (
    &match=1
  )
  
  if (&match==1)
  (
    &clk_test=&CLK_TEST_AUDIO_CORE_QDSP_SWAY_AON_CLK
    &clk_reg=&HWIO_LPASS_AUDIO_CORE_QDSP_SWAY_AON_CBCR_ADDR
    &clk_reg_name="LPASS_AUDIO_CORE_QDSP_SWAY_AON_CBCR"
    &clk_name="audio_core_qdsp_sway_aon_clk"
    &clk_reg_cbcr_type="sm_cbc"
    &clk_vote_bit=-1.
    &clk_multiplier=1.

    gosub Print_Clk_Info_Line
  )

  &match=0
  &wild_head=0
  &wild_tail=0
  &clk_input_length=STRING.LENGTH("&clk")
  &clk_itr_length=STRING.LENGTH("audio_wrapper_aon_clk")

  if (STRING.SCAN("&clk", "*", 0)==0)
  (
    &wild_head=1
  )
  if (STRING.SCAN("&clk", "*", 1)==(STRING.LENGTH("&clk")-1))
  (
    &wild_tail=1
  )

  if ((&wild_head==1)&&(&wild_tail==1))
  (
    if (STRING.SCAN("audio_wrapper_aon_clk", STRING.MID("&clk", 1, &clk_input_length-2), 0)!=-1)
    ( 
      &match=1
    )
  )
  else if (&wild_head==1)
  (
    if (STRING.MID("audio_wrapper_aon_clk", &clk_itr_length-&clk_input_length+1, &clk_input_length-1)==STRING.CUT("&clk", 1))
    ( 
      &match=1
    )
  )
  else if (&wild_tail==1)
  (
    if (STRING.MID("audio_wrapper_aon_clk", 0, &clk_input_length-1)==STRING.CUT("&clk", -1))
    ( 
      &match=1
    )
  )
  else if ("audio_wrapper_aon_clk"=="&clk")
  (
    &match=1
  )
  
  if (&match==1)
  (
    &clk_test=&CLK_TEST_AUDIO_WRAPPER_AON_CLK
    &clk_reg=&HWIO_LPASS_AUDIO_WRAPPER_AON_CBCR_ADDR
    &clk_reg_name="LPASS_AUDIO_WRAPPER_AON_CBCR"
    &clk_name="audio_wrapper_aon_clk"
    &clk_reg_cbcr_type="sm_cbc"
    &clk_vote_bit=-1.
    &clk_multiplier=1.

    gosub Print_Clk_Info_Line
  )

  &match=0
  &wild_head=0
  &wild_tail=0
  &clk_input_length=STRING.LENGTH("&clk")
  &clk_itr_length=STRING.LENGTH("audio_wrapper_bus_timeout_aon_clk")

  if (STRING.SCAN("&clk", "*", 0)==0)
  (
    &wild_head=1
  )
  if (STRING.SCAN("&clk", "*", 1)==(STRING.LENGTH("&clk")-1))
  (
    &wild_tail=1
  )

  if ((&wild_head==1)&&(&wild_tail==1))
  (
    if (STRING.SCAN("audio_wrapper_bus_timeout_aon_clk", STRING.MID("&clk", 1, &clk_input_length-2), 0)!=-1)
    ( 
      &match=1
    )
  )
  else if (&wild_head==1)
  (
    if (STRING.MID("audio_wrapper_bus_timeout_aon_clk", &clk_itr_length-&clk_input_length+1, &clk_input_length-1)==STRING.CUT("&clk", 1))
    ( 
      &match=1
    )
  )
  else if (&wild_tail==1)
  (
    if (STRING.MID("audio_wrapper_bus_timeout_aon_clk", 0, &clk_input_length-1)==STRING.CUT("&clk", -1))
    ( 
      &match=1
    )
  )
  else if ("audio_wrapper_bus_timeout_aon_clk"=="&clk")
  (
    &match=1
  )
  
  if (&match==1)
  (
    &clk_test=&CLK_TEST_AUDIO_WRAPPER_BUS_TIMEOUT_AON_CLK
    &clk_reg=&HWIO_LPASS_AUDIO_WRAPPER_BUS_TIMEOUT_AON_CBCR_ADDR
    &clk_reg_name="LPASS_AUDIO_WRAPPER_BUS_TIMEOUT_AON_CBCR"
    &clk_name="audio_wrapper_bus_timeout_aon_clk"
    &clk_reg_cbcr_type="sm_cbc"
    &clk_vote_bit=-1.
    &clk_multiplier=1.

    gosub Print_Clk_Info_Line
  )

  &match=0
  &wild_head=0
  &wild_tail=0
  &clk_input_length=STRING.LENGTH("&clk")
  &clk_itr_length=STRING.LENGTH("audio_wrapper_mpu_cfg_aon_clk")

  if (STRING.SCAN("&clk", "*", 0)==0)
  (
    &wild_head=1
  )
  if (STRING.SCAN("&clk", "*", 1)==(STRING.LENGTH("&clk")-1))
  (
    &wild_tail=1
  )

  if ((&wild_head==1)&&(&wild_tail==1))
  (
    if (STRING.SCAN("audio_wrapper_mpu_cfg_aon_clk", STRING.MID("&clk", 1, &clk_input_length-2), 0)!=-1)
    ( 
      &match=1
    )
  )
  else if (&wild_head==1)
  (
    if (STRING.MID("audio_wrapper_mpu_cfg_aon_clk", &clk_itr_length-&clk_input_length+1, &clk_input_length-1)==STRING.CUT("&clk", 1))
    ( 
      &match=1
    )
  )
  else if (&wild_tail==1)
  (
    if (STRING.MID("audio_wrapper_mpu_cfg_aon_clk", 0, &clk_input_length-1)==STRING.CUT("&clk", -1))
    ( 
      &match=1
    )
  )
  else if ("audio_wrapper_mpu_cfg_aon_clk"=="&clk")
  (
    &match=1
  )
  
  if (&match==1)
  (
    &clk_test=&CLK_TEST_AUDIO_WRAPPER_MPU_CFG_AON_CLK
    &clk_reg=&HWIO_LPASS_AUDIO_WRAPPER_MPU_CFG_AON_CBCR_ADDR
    &clk_reg_name="LPASS_AUDIO_WRAPPER_MPU_CFG_AON_CBCR"
    &clk_name="audio_wrapper_mpu_cfg_aon_clk"
    &clk_reg_cbcr_type="sm_cbc"
    &clk_vote_bit=-1.
    &clk_multiplier=1.

    gosub Print_Clk_Info_Line
  )

  &match=0
  &wild_head=0
  &wild_tail=0
  &clk_input_length=STRING.LENGTH("&clk")
  &clk_itr_length=STRING.LENGTH("audio_wrapper_q6_ahbm_mpu_aon_clk")

  if (STRING.SCAN("&clk", "*", 0)==0)
  (
    &wild_head=1
  )
  if (STRING.SCAN("&clk", "*", 1)==(STRING.LENGTH("&clk")-1))
  (
    &wild_tail=1
  )

  if ((&wild_head==1)&&(&wild_tail==1))
  (
    if (STRING.SCAN("audio_wrapper_q6_ahbm_mpu_aon_clk", STRING.MID("&clk", 1, &clk_input_length-2), 0)!=-1)
    ( 
      &match=1
    )
  )
  else if (&wild_head==1)
  (
    if (STRING.MID("audio_wrapper_q6_ahbm_mpu_aon_clk", &clk_itr_length-&clk_input_length+1, &clk_input_length-1)==STRING.CUT("&clk", 1))
    ( 
      &match=1
    )
  )
  else if (&wild_tail==1)
  (
    if (STRING.MID("audio_wrapper_q6_ahbm_mpu_aon_clk", 0, &clk_input_length-1)==STRING.CUT("&clk", -1))
    ( 
      &match=1
    )
  )
  else if ("audio_wrapper_q6_ahbm_mpu_aon_clk"=="&clk")
  (
    &match=1
  )
  
  if (&match==1)
  (
    &clk_test=&CLK_TEST_AUDIO_WRAPPER_Q6_AHBM_MPU_AON_CLK
    &clk_reg=&HWIO_LPASS_AUDIO_WRAPPER_Q6_AHBM_MPU_AON_CBCR_ADDR
    &clk_reg_name="LPASS_AUDIO_WRAPPER_Q6_AHBM_MPU_AON_CBCR"
    &clk_name="audio_wrapper_q6_ahbm_mpu_aon_clk"
    &clk_reg_cbcr_type="sm_cbc"
    &clk_vote_bit=-1.
    &clk_multiplier=1.

    gosub Print_Clk_Info_Line
  )

  &match=0
  &wild_head=0
  &wild_tail=0
  &clk_input_length=STRING.LENGTH("&clk")
  &clk_itr_length=STRING.LENGTH("audio_wrapper_qos_ahbs_aon_clk")

  if (STRING.SCAN("&clk", "*", 0)==0)
  (
    &wild_head=1
  )
  if (STRING.SCAN("&clk", "*", 1)==(STRING.LENGTH("&clk")-1))
  (
    &wild_tail=1
  )

  if ((&wild_head==1)&&(&wild_tail==1))
  (
    if (STRING.SCAN("audio_wrapper_qos_ahbs_aon_clk", STRING.MID("&clk", 1, &clk_input_length-2), 0)!=-1)
    ( 
      &match=1
    )
  )
  else if (&wild_head==1)
  (
    if (STRING.MID("audio_wrapper_qos_ahbs_aon_clk", &clk_itr_length-&clk_input_length+1, &clk_input_length-1)==STRING.CUT("&clk", 1))
    ( 
      &match=1
    )
  )
  else if (&wild_tail==1)
  (
    if (STRING.MID("audio_wrapper_qos_ahbs_aon_clk", 0, &clk_input_length-1)==STRING.CUT("&clk", -1))
    ( 
      &match=1
    )
  )
  else if ("audio_wrapper_qos_ahbs_aon_clk"=="&clk")
  (
    &match=1
  )
  
  if (&match==1)
  (
    &clk_test=&CLK_TEST_AUDIO_WRAPPER_QOS_AHBS_AON_CLK
    &clk_reg=&HWIO_LPASS_AUDIO_WRAPPER_QOS_AHBS_AON_CBCR_ADDR
    &clk_reg_name="LPASS_AUDIO_WRAPPER_QOS_AHBS_AON_CBCR"
    &clk_name="audio_wrapper_qos_ahbs_aon_clk"
    &clk_reg_cbcr_type="sm_cbc"
    &clk_vote_bit=-1.
    &clk_multiplier=1.

    gosub Print_Clk_Info_Line
  )

  &match=0
  &wild_head=0
  &wild_tail=0
  &clk_input_length=STRING.LENGTH("&clk")
  &clk_itr_length=STRING.LENGTH("audio_wrapper_sysnoc_sway_aon_clk")

  if (STRING.SCAN("&clk", "*", 0)==0)
  (
    &wild_head=1
  )
  if (STRING.SCAN("&clk", "*", 1)==(STRING.LENGTH("&clk")-1))
  (
    &wild_tail=1
  )

  if ((&wild_head==1)&&(&wild_tail==1))
  (
    if (STRING.SCAN("audio_wrapper_sysnoc_sway_aon_clk", STRING.MID("&clk", 1, &clk_input_length-2), 0)!=-1)
    ( 
      &match=1
    )
  )
  else if (&wild_head==1)
  (
    if (STRING.MID("audio_wrapper_sysnoc_sway_aon_clk", &clk_itr_length-&clk_input_length+1, &clk_input_length-1)==STRING.CUT("&clk", 1))
    ( 
      &match=1
    )
  )
  else if (&wild_tail==1)
  (
    if (STRING.MID("audio_wrapper_sysnoc_sway_aon_clk", 0, &clk_input_length-1)==STRING.CUT("&clk", -1))
    ( 
      &match=1
    )
  )
  else if ("audio_wrapper_sysnoc_sway_aon_clk"=="&clk")
  (
    &match=1
  )
  
  if (&match==1)
  (
    &clk_test=&CLK_TEST_AUDIO_WRAPPER_SYSNOC_SWAY_AON_CLK
    &clk_reg=&HWIO_LPASS_AUDIO_WRAPPER_SYSNOC_SWAY_AON_CBCR_ADDR
    &clk_reg_name="LPASS_AUDIO_WRAPPER_SYSNOC_SWAY_AON_CBCR"
    &clk_name="audio_wrapper_sysnoc_sway_aon_clk"
    &clk_reg_cbcr_type="sm_cbc"
    &clk_vote_bit=-1.
    &clk_multiplier=1.

    gosub Print_Clk_Info_Line
  )

  &match=0
  &wild_head=0
  &wild_tail=0
  &clk_input_length=STRING.LENGTH("&clk")
  &clk_itr_length=STRING.LENGTH("q6ss_ahbm_aon_clk")

  if (STRING.SCAN("&clk", "*", 0)==0)
  (
    &wild_head=1
  )
  if (STRING.SCAN("&clk", "*", 1)==(STRING.LENGTH("&clk")-1))
  (
    &wild_tail=1
  )

  if ((&wild_head==1)&&(&wild_tail==1))
  (
    if (STRING.SCAN("q6ss_ahbm_aon_clk", STRING.MID("&clk", 1, &clk_input_length-2), 0)!=-1)
    ( 
      &match=1
    )
  )
  else if (&wild_head==1)
  (
    if (STRING.MID("q6ss_ahbm_aon_clk", &clk_itr_length-&clk_input_length+1, &clk_input_length-1)==STRING.CUT("&clk", 1))
    ( 
      &match=1
    )
  )
  else if (&wild_tail==1)
  (
    if (STRING.MID("q6ss_ahbm_aon_clk", 0, &clk_input_length-1)==STRING.CUT("&clk", -1))
    ( 
      &match=1
    )
  )
  else if ("q6ss_ahbm_aon_clk"=="&clk")
  (
    &match=1
  )
  
  if (&match==1)
  (
    &clk_test=&CLK_TEST_Q6SS_AHBM_AON_CLK
    &clk_reg=&HWIO_LPASS_Q6SS_AHBM_AON_CBCR_ADDR
    &clk_reg_name="LPASS_Q6SS_AHBM_AON_CBCR"
    &clk_name="q6ss_ahbm_aon_clk"
    &clk_reg_cbcr_type="sm_cbc"
    &clk_vote_bit=-1.
    &clk_multiplier=1.

    gosub Print_Clk_Info_Line
  )

  &match=0
  &wild_head=0
  &wild_tail=0
  &clk_input_length=STRING.LENGTH("&clk")
  &clk_itr_length=STRING.LENGTH("q6ss_ahbs_aon_clk")

  if (STRING.SCAN("&clk", "*", 0)==0)
  (
    &wild_head=1
  )
  if (STRING.SCAN("&clk", "*", 1)==(STRING.LENGTH("&clk")-1))
  (
    &wild_tail=1
  )

  if ((&wild_head==1)&&(&wild_tail==1))
  (
    if (STRING.SCAN("q6ss_ahbs_aon_clk", STRING.MID("&clk", 1, &clk_input_length-2), 0)!=-1)
    ( 
      &match=1
    )
  )
  else if (&wild_head==1)
  (
    if (STRING.MID("q6ss_ahbs_aon_clk", &clk_itr_length-&clk_input_length+1, &clk_input_length-1)==STRING.CUT("&clk", 1))
    ( 
      &match=1
    )
  )
  else if (&wild_tail==1)
  (
    if (STRING.MID("q6ss_ahbs_aon_clk", 0, &clk_input_length-1)==STRING.CUT("&clk", -1))
    ( 
      &match=1
    )
  )
  else if ("q6ss_ahbs_aon_clk"=="&clk")
  (
    &match=1
  )
  
  if (&match==1)
  (
    &clk_test=&CLK_TEST_Q6SS_AHBS_AON_CLK
    &clk_reg=&HWIO_LPASS_Q6SS_AHBS_AON_CBCR_ADDR
    &clk_reg_name="LPASS_Q6SS_AHBS_AON_CBCR"
    &clk_name="q6ss_ahbs_aon_clk"
    &clk_reg_cbcr_type="sm_cbc"
    &clk_vote_bit=-1.
    &clk_multiplier=1.

    gosub Print_Clk_Info_Line
  )

  &match=0
  &wild_head=0
  &wild_tail=0
  &clk_input_length=STRING.LENGTH("&clk")
  &clk_itr_length=STRING.LENGTH("atime_clk_src")

  if (STRING.SCAN("&clk", "*", 0)==0)
  (
    &wild_head=1
  )
  if (STRING.SCAN("&clk", "*", 1)==(STRING.LENGTH("&clk")-1))
  (
    &wild_tail=1
  )

  if ((&wild_head==1)&&(&wild_tail==1))
  (
    if (STRING.SCAN("atime_clk_src", STRING.MID("&clk", 1, &clk_input_length-2), 0)!=-1)
    ( 
      &match=1
    )
  )
  else if (&wild_head==1)
  (
    if (STRING.MID("atime_clk_src", &clk_itr_length-&clk_input_length+1, &clk_input_length-1)==STRING.CUT("&clk", 1))
    ( 
      &match=1
    )
  )
  else if (&wild_tail==1)
  (
    if (STRING.MID("atime_clk_src", 0, &clk_input_length-1)==STRING.CUT("&clk", -1))
    ( 
      &match=1
    )
  )
  else if ("atime_clk_src"=="&clk")
  (
    &match=1
  )
  
  if (&match==1)
  (
    &clk_test=&CLK_TEST_ATIME_CLK_SRC
    &clk_reg=0
    &clk_reg_name="No CBCR"
    &clk_name="atime_clk_src"
    &clk_reg_cbcr_type=""
    &clk_vote_bit=-1.
    &clk_multiplier=1.

    gosub Print_Clk_Info_Line
  )

  &match=0
  &wild_head=0
  &wild_tail=0
  &clk_input_length=STRING.LENGTH("&clk")
  &clk_itr_length=STRING.LENGTH("lpass_core_avsync_atime_clk")

  if (STRING.SCAN("&clk", "*", 0)==0)
  (
    &wild_head=1
  )
  if (STRING.SCAN("&clk", "*", 1)==(STRING.LENGTH("&clk")-1))
  (
    &wild_tail=1
  )

  if ((&wild_head==1)&&(&wild_tail==1))
  (
    if (STRING.SCAN("lpass_core_avsync_atime_clk", STRING.MID("&clk", 1, &clk_input_length-2), 0)!=-1)
    ( 
      &match=1
    )
  )
  else if (&wild_head==1)
  (
    if (STRING.MID("lpass_core_avsync_atime_clk", &clk_itr_length-&clk_input_length+1, &clk_input_length-1)==STRING.CUT("&clk", 1))
    ( 
      &match=1
    )
  )
  else if (&wild_tail==1)
  (
    if (STRING.MID("lpass_core_avsync_atime_clk", 0, &clk_input_length-1)==STRING.CUT("&clk", -1))
    ( 
      &match=1
    )
  )
  else if ("lpass_core_avsync_atime_clk"=="&clk")
  (
    &match=1
  )
  
  if (&match==1)
  (
    &clk_test=&CLK_TEST_LPASS_CORE_AVSYNC_ATIME_CLK
    &clk_reg=&HWIO_LPASS_AUDIO_CORE_AVSYNC_ATIME_CBCR_ADDR
    &clk_reg_name="LPASS_AUDIO_CORE_AVSYNC_ATIME_CBCR"
    &clk_name="lpass_core_avsync_atime_clk"
    &clk_reg_cbcr_type="sm_cbc"
    &clk_vote_bit=-1.
    &clk_multiplier=1.

    gosub Print_Clk_Info_Line
  )

  &match=0
  &wild_head=0
  &wild_tail=0
  &clk_input_length=STRING.LENGTH("&clk")
  &clk_itr_length=STRING.LENGTH("aud_slimbus_clk_src")

  if (STRING.SCAN("&clk", "*", 0)==0)
  (
    &wild_head=1
  )
  if (STRING.SCAN("&clk", "*", 1)==(STRING.LENGTH("&clk")-1))
  (
    &wild_tail=1
  )

  if ((&wild_head==1)&&(&wild_tail==1))
  (
    if (STRING.SCAN("aud_slimbus_clk_src", STRING.MID("&clk", 1, &clk_input_length-2), 0)!=-1)
    ( 
      &match=1
    )
  )
  else if (&wild_head==1)
  (
    if (STRING.MID("aud_slimbus_clk_src", &clk_itr_length-&clk_input_length+1, &clk_input_length-1)==STRING.CUT("&clk", 1))
    ( 
      &match=1
    )
  )
  else if (&wild_tail==1)
  (
    if (STRING.MID("aud_slimbus_clk_src", 0, &clk_input_length-1)==STRING.CUT("&clk", -1))
    ( 
      &match=1
    )
  )
  else if ("aud_slimbus_clk_src"=="&clk")
  (
    &match=1
  )
  
  if (&match==1)
  (
    &clk_test=&CLK_TEST_AUD_SLIMBUS_CLK_SRC
    &clk_reg=0
    &clk_reg_name="No CBCR"
    &clk_name="aud_slimbus_clk_src"
    &clk_reg_cbcr_type=""
    &clk_vote_bit=-1.
    &clk_multiplier=1.

    gosub Print_Clk_Info_Line
  )

  &match=0
  &wild_head=0
  &wild_tail=0
  &clk_input_length=STRING.LENGTH("&clk")
  &clk_itr_length=STRING.LENGTH("audio_core_aud_slimbus_clk")

  if (STRING.SCAN("&clk", "*", 0)==0)
  (
    &wild_head=1
  )
  if (STRING.SCAN("&clk", "*", 1)==(STRING.LENGTH("&clk")-1))
  (
    &wild_tail=1
  )

  if ((&wild_head==1)&&(&wild_tail==1))
  (
    if (STRING.SCAN("audio_core_aud_slimbus_clk", STRING.MID("&clk", 1, &clk_input_length-2), 0)!=-1)
    ( 
      &match=1
    )
  )
  else if (&wild_head==1)
  (
    if (STRING.MID("audio_core_aud_slimbus_clk", &clk_itr_length-&clk_input_length+1, &clk_input_length-1)==STRING.CUT("&clk", 1))
    ( 
      &match=1
    )
  )
  else if (&wild_tail==1)
  (
    if (STRING.MID("audio_core_aud_slimbus_clk", 0, &clk_input_length-1)==STRING.CUT("&clk", -1))
    ( 
      &match=1
    )
  )
  else if ("audio_core_aud_slimbus_clk"=="&clk")
  (
    &match=1
  )
  
  if (&match==1)
  (
    &clk_test=&CLK_TEST_AUDIO_CORE_AUD_SLIMBUS_CLK
    &clk_reg=&HWIO_LPASS_AUDIO_CORE_AUD_SLIMBUS_CBCR_ADDR
    &clk_reg_name="LPASS_AUDIO_CORE_AUD_SLIMBUS_CBCR"
    &clk_name="audio_core_aud_slimbus_clk"
    &clk_reg_cbcr_type="sm_cbc"
    &clk_vote_bit=-1.
    &clk_multiplier=1.

    gosub Print_Clk_Info_Line
  )

  &match=0
  &wild_head=0
  &wild_tail=0
  &clk_input_length=STRING.LENGTH("&clk")
  &clk_itr_length=STRING.LENGTH("audio_core_peripheral_smmu_cfg_cnoc_clk")

  if (STRING.SCAN("&clk", "*", 0)==0)
  (
    &wild_head=1
  )
  if (STRING.SCAN("&clk", "*", 1)==(STRING.LENGTH("&clk")-1))
  (
    &wild_tail=1
  )

  if ((&wild_head==1)&&(&wild_tail==1))
  (
    if (STRING.SCAN("audio_core_peripheral_smmu_cfg_cnoc_clk", STRING.MID("&clk", 1, &clk_input_length-2), 0)!=-1)
    ( 
      &match=1
    )
  )
  else if (&wild_head==1)
  (
    if (STRING.MID("audio_core_peripheral_smmu_cfg_cnoc_clk", &clk_itr_length-&clk_input_length+1, &clk_input_length-1)==STRING.CUT("&clk", 1))
    ( 
      &match=1
    )
  )
  else if (&wild_tail==1)
  (
    if (STRING.MID("audio_core_peripheral_smmu_cfg_cnoc_clk", 0, &clk_input_length-1)==STRING.CUT("&clk", -1))
    ( 
      &match=1
    )
  )
  else if ("audio_core_peripheral_smmu_cfg_cnoc_clk"=="&clk")
  (
    &match=1
  )
  
  if (&match==1)
  (
    &clk_test=&CLK_TEST_AUDIO_CORE_PERIPHERAL_SMMU_CFG_CNOC_CLK
    &clk_reg=&HWIO_LPASS_AUDIO_CORE_PERIPHERAL_SMMU_CFG_CNOC_CBCR_ADDR
    &clk_reg_name="LPASS_AUDIO_CORE_PERIPHERAL_SMMU_CFG_CNOC_CBCR"
    &clk_name="audio_core_peripheral_smmu_cfg_cnoc_clk"
    &clk_reg_cbcr_type="sm_cbc"
    &clk_vote_bit=-1.
    &clk_multiplier=1.

    gosub Print_Clk_Info_Line
  )

  &match=0
  &wild_head=0
  &wild_tail=0
  &clk_input_length=STRING.LENGTH("&clk")
  &clk_itr_length=STRING.LENGTH("audio_wrapper_q6_smmu_cfg_cnoc_clk")

  if (STRING.SCAN("&clk", "*", 0)==0)
  (
    &wild_head=1
  )
  if (STRING.SCAN("&clk", "*", 1)==(STRING.LENGTH("&clk")-1))
  (
    &wild_tail=1
  )

  if ((&wild_head==1)&&(&wild_tail==1))
  (
    if (STRING.SCAN("audio_wrapper_q6_smmu_cfg_cnoc_clk", STRING.MID("&clk", 1, &clk_input_length-2), 0)!=-1)
    ( 
      &match=1
    )
  )
  else if (&wild_head==1)
  (
    if (STRING.MID("audio_wrapper_q6_smmu_cfg_cnoc_clk", &clk_itr_length-&clk_input_length+1, &clk_input_length-1)==STRING.CUT("&clk", 1))
    ( 
      &match=1
    )
  )
  else if (&wild_tail==1)
  (
    if (STRING.MID("audio_wrapper_q6_smmu_cfg_cnoc_clk", 0, &clk_input_length-1)==STRING.CUT("&clk", -1))
    ( 
      &match=1
    )
  )
  else if ("audio_wrapper_q6_smmu_cfg_cnoc_clk"=="&clk")
  (
    &match=1
  )
  
  if (&match==1)
  (
    &clk_test=0
    &clk_reg=&HWIO_LPASS_AUDIO_WRAPPER_Q6_SMMU_CFG_CNOC_CBCR_ADDR
    &clk_reg_name="LPASS_AUDIO_WRAPPER_Q6_SMMU_CFG_CNOC_CBCR"
    &clk_name="audio_wrapper_q6_smmu_cfg_cnoc_clk"
    &clk_reg_cbcr_type="sm_cbc"
    &clk_vote_bit=-1.
    &clk_multiplier=1.

    gosub Print_Clk_Info_Line
  )

  &match=0
  &wild_head=0
  &wild_tail=0
  &clk_input_length=STRING.LENGTH("&clk")
  &clk_itr_length=STRING.LENGTH("audio_wrapper_q6_smmu_axi_clk")

  if (STRING.SCAN("&clk", "*", 0)==0)
  (
    &wild_head=1
  )
  if (STRING.SCAN("&clk", "*", 1)==(STRING.LENGTH("&clk")-1))
  (
    &wild_tail=1
  )

  if ((&wild_head==1)&&(&wild_tail==1))
  (
    if (STRING.SCAN("audio_wrapper_q6_smmu_axi_clk", STRING.MID("&clk", 1, &clk_input_length-2), 0)!=-1)
    ( 
      &match=1
    )
  )
  else if (&wild_head==1)
  (
    if (STRING.MID("audio_wrapper_q6_smmu_axi_clk", &clk_itr_length-&clk_input_length+1, &clk_input_length-1)==STRING.CUT("&clk", 1))
    ( 
      &match=1
    )
  )
  else if (&wild_tail==1)
  (
    if (STRING.MID("audio_wrapper_q6_smmu_axi_clk", 0, &clk_input_length-1)==STRING.CUT("&clk", -1))
    ( 
      &match=1
    )
  )
  else if ("audio_wrapper_q6_smmu_axi_clk"=="&clk")
  (
    &match=1
  )
  
  if (&match==1)
  (
    &clk_test=0
    &clk_reg=&HWIO_LPASS_AUDIO_WRAPPER_Q6_SMMU_AXI_CBCR_ADDR
    &clk_reg_name="LPASS_AUDIO_WRAPPER_Q6_SMMU_AXI_CBCR"
    &clk_name="audio_wrapper_q6_smmu_axi_clk"
    &clk_reg_cbcr_type="sm_cbc"
    &clk_vote_bit=-1.
    &clk_multiplier=1.

    gosub Print_Clk_Info_Line
  )

  &match=0
  &wild_head=0
  &wild_tail=0
  &clk_input_length=STRING.LENGTH("&clk")
  &clk_itr_length=STRING.LENGTH("q6ss_q6_axim_clk")

  if (STRING.SCAN("&clk", "*", 0)==0)
  (
    &wild_head=1
  )
  if (STRING.SCAN("&clk", "*", 1)==(STRING.LENGTH("&clk")-1))
  (
    &wild_tail=1
  )

  if ((&wild_head==1)&&(&wild_tail==1))
  (
    if (STRING.SCAN("q6ss_q6_axim_clk", STRING.MID("&clk", 1, &clk_input_length-2), 0)!=-1)
    ( 
      &match=1
    )
  )
  else if (&wild_head==1)
  (
    if (STRING.MID("q6ss_q6_axim_clk", &clk_itr_length-&clk_input_length+1, &clk_input_length-1)==STRING.CUT("&clk", 1))
    ( 
      &match=1
    )
  )
  else if (&wild_tail==1)
  (
    if (STRING.MID("q6ss_q6_axim_clk", 0, &clk_input_length-1)==STRING.CUT("&clk", -1))
    ( 
      &match=1
    )
  )
  else if ("q6ss_q6_axim_clk"=="&clk")
  (
    &match=1
  )
  
  if (&match==1)
  (
    &clk_test=0
    &clk_reg=&HWIO_LPASS_Q6SS_Q6_AXIM_CBCR_ADDR
    &clk_reg_name="LPASS_Q6SS_Q6_AXIM_CBCR"
    &clk_name="q6ss_q6_axim_clk"
    &clk_reg_cbcr_type="sm_cbc"
    &clk_vote_bit=-1.
    &clk_multiplier=1.

    gosub Print_Clk_Info_Line
  )

  &match=0
  &wild_head=0
  &wild_tail=0
  &clk_input_length=STRING.LENGTH("&clk")
  &clk_itr_length=STRING.LENGTH("audio_core_sysnoc_sway_snoc_clk")

  if (STRING.SCAN("&clk", "*", 0)==0)
  (
    &wild_head=1
  )
  if (STRING.SCAN("&clk", "*", 1)==(STRING.LENGTH("&clk")-1))
  (
    &wild_tail=1
  )

  if ((&wild_head==1)&&(&wild_tail==1))
  (
    if (STRING.SCAN("audio_core_sysnoc_sway_snoc_clk", STRING.MID("&clk", 1, &clk_input_length-2), 0)!=-1)
    ( 
      &match=1
    )
  )
  else if (&wild_head==1)
  (
    if (STRING.MID("audio_core_sysnoc_sway_snoc_clk", &clk_itr_length-&clk_input_length+1, &clk_input_length-1)==STRING.CUT("&clk", 1))
    ( 
      &match=1
    )
  )
  else if (&wild_tail==1)
  (
    if (STRING.MID("audio_core_sysnoc_sway_snoc_clk", 0, &clk_input_length-1)==STRING.CUT("&clk", -1))
    ( 
      &match=1
    )
  )
  else if ("audio_core_sysnoc_sway_snoc_clk"=="&clk")
  (
    &match=1
  )
  
  if (&match==1)
  (
    &clk_test=&CLK_TEST_AUDIO_CORE_SYSNOC_SWAY_SNOC_CLK
    &clk_reg=&HWIO_LPASS_AUDIO_CORE_SYSNOC_SWAY_SNOC_CBCR_ADDR
    &clk_reg_name="LPASS_AUDIO_CORE_SYSNOC_SWAY_SNOC_CBCR"
    &clk_name="audio_core_sysnoc_sway_snoc_clk"
    &clk_reg_cbcr_type="sm_cbc"
    &clk_vote_bit=-1.
    &clk_multiplier=1.

    gosub Print_Clk_Info_Line
  )

  &match=0
  &wild_head=0
  &wild_tail=0
  &clk_input_length=STRING.LENGTH("&clk")
  &clk_itr_length=STRING.LENGTH("audio_wrapper_sysnoc_sway_snoc_clk")

  if (STRING.SCAN("&clk", "*", 0)==0)
  (
    &wild_head=1
  )
  if (STRING.SCAN("&clk", "*", 1)==(STRING.LENGTH("&clk")-1))
  (
    &wild_tail=1
  )

  if ((&wild_head==1)&&(&wild_tail==1))
  (
    if (STRING.SCAN("audio_wrapper_sysnoc_sway_snoc_clk", STRING.MID("&clk", 1, &clk_input_length-2), 0)!=-1)
    ( 
      &match=1
    )
  )
  else if (&wild_head==1)
  (
    if (STRING.MID("audio_wrapper_sysnoc_sway_snoc_clk", &clk_itr_length-&clk_input_length+1, &clk_input_length-1)==STRING.CUT("&clk", 1))
    ( 
      &match=1
    )
  )
  else if (&wild_tail==1)
  (
    if (STRING.MID("audio_wrapper_sysnoc_sway_snoc_clk", 0, &clk_input_length-1)==STRING.CUT("&clk", -1))
    ( 
      &match=1
    )
  )
  else if ("audio_wrapper_sysnoc_sway_snoc_clk"=="&clk")
  (
    &match=1
  )
  
  if (&match==1)
  (
    &clk_test=&CLK_TEST_AUDIO_WRAPPER_SYSNOC_SWAY_SNOC_CLK
    &clk_reg=&HWIO_LPASS_AUDIO_WRAPPER_SYSNOC_SWAY_SNOC_CBCR_ADDR
    &clk_reg_name="LPASS_AUDIO_WRAPPER_SYSNOC_SWAY_SNOC_CBCR"
    &clk_name="audio_wrapper_sysnoc_sway_snoc_clk"
    &clk_reg_cbcr_type="sm_cbc"
    &clk_vote_bit=-1.
    &clk_multiplier=1.

    gosub Print_Clk_Info_Line
  )

  &match=0
  &wild_head=0
  &wild_tail=0
  &clk_input_length=STRING.LENGTH("&clk")
  &clk_itr_length=STRING.LENGTH("core_clk_src")

  if (STRING.SCAN("&clk", "*", 0)==0)
  (
    &wild_head=1
  )
  if (STRING.SCAN("&clk", "*", 1)==(STRING.LENGTH("&clk")-1))
  (
    &wild_tail=1
  )

  if ((&wild_head==1)&&(&wild_tail==1))
  (
    if (STRING.SCAN("core_clk_src", STRING.MID("&clk", 1, &clk_input_length-2), 0)!=-1)
    ( 
      &match=1
    )
  )
  else if (&wild_head==1)
  (
    if (STRING.MID("core_clk_src", &clk_itr_length-&clk_input_length+1, &clk_input_length-1)==STRING.CUT("&clk", 1))
    ( 
      &match=1
    )
  )
  else if (&wild_tail==1)
  (
    if (STRING.MID("core_clk_src", 0, &clk_input_length-1)==STRING.CUT("&clk", -1))
    ( 
      &match=1
    )
  )
  else if ("core_clk_src"=="&clk")
  (
    &match=1
  )
  
  if (&match==1)
  (
    &clk_test=&CLK_TEST_CORE_CLK_SRC
    &clk_reg=0
    &clk_reg_name="No CBCR"
    &clk_name="core_clk_src"
    &clk_reg_cbcr_type=""
    &clk_vote_bit=-1.
    &clk_multiplier=1.

    gosub Print_Clk_Info_Line
  )

  &match=0
  &wild_head=0
  &wild_tail=0
  &clk_input_length=STRING.LENGTH("&clk")
  &clk_itr_length=STRING.LENGTH("audio_core_aud_slimbus_core_clk")

  if (STRING.SCAN("&clk", "*", 0)==0)
  (
    &wild_head=1
  )
  if (STRING.SCAN("&clk", "*", 1)==(STRING.LENGTH("&clk")-1))
  (
    &wild_tail=1
  )

  if ((&wild_head==1)&&(&wild_tail==1))
  (
    if (STRING.SCAN("audio_core_aud_slimbus_core_clk", STRING.MID("&clk", 1, &clk_input_length-2), 0)!=-1)
    ( 
      &match=1
    )
  )
  else if (&wild_head==1)
  (
    if (STRING.MID("audio_core_aud_slimbus_core_clk", &clk_itr_length-&clk_input_length+1, &clk_input_length-1)==STRING.CUT("&clk", 1))
    ( 
      &match=1
    )
  )
  else if (&wild_tail==1)
  (
    if (STRING.MID("audio_core_aud_slimbus_core_clk", 0, &clk_input_length-1)==STRING.CUT("&clk", -1))
    ( 
      &match=1
    )
  )
  else if ("audio_core_aud_slimbus_core_clk"=="&clk")
  (
    &match=1
  )
  
  if (&match==1)
  (
    &clk_test=&CLK_TEST_AUDIO_CORE_AUD_SLIMBUS_CORE_CLK
    &clk_reg=&HWIO_LPASS_AUDIO_CORE_AUD_SLIMBUS_CORE_CBCR_ADDR
    &clk_reg_name="LPASS_AUDIO_CORE_AUD_SLIMBUS_CORE_CBCR"
    &clk_name="audio_core_aud_slimbus_core_clk"
    &clk_reg_cbcr_type="sm_pscbc"
    &clk_vote_bit=-1.
    &clk_multiplier=1.

    gosub Print_Clk_Info_Line
  )

  &match=0
  &wild_head=0
  &wild_tail=0
  &clk_input_length=STRING.LENGTH("&clk")
  &clk_itr_length=STRING.LENGTH("audio_core_core_clk")

  if (STRING.SCAN("&clk", "*", 0)==0)
  (
    &wild_head=1
  )
  if (STRING.SCAN("&clk", "*", 1)==(STRING.LENGTH("&clk")-1))
  (
    &wild_tail=1
  )

  if ((&wild_head==1)&&(&wild_tail==1))
  (
    if (STRING.SCAN("audio_core_core_clk", STRING.MID("&clk", 1, &clk_input_length-2), 0)!=-1)
    ( 
      &match=1
    )
  )
  else if (&wild_head==1)
  (
    if (STRING.MID("audio_core_core_clk", &clk_itr_length-&clk_input_length+1, &clk_input_length-1)==STRING.CUT("&clk", 1))
    ( 
      &match=1
    )
  )
  else if (&wild_tail==1)
  (
    if (STRING.MID("audio_core_core_clk", 0, &clk_input_length-1)==STRING.CUT("&clk", -1))
    ( 
      &match=1
    )
  )
  else if ("audio_core_core_clk"=="&clk")
  (
    &match=1
  )
  
  if (&match==1)
  (
    &clk_test=&CLK_TEST_AUDIO_CORE_CORE_CLK
    &clk_reg=&HWIO_LPASS_AUDIO_CORE_CORE_CBCR_ADDR
    &clk_reg_name="LPASS_AUDIO_CORE_CORE_CBCR"
    &clk_name="audio_core_core_clk"
    &clk_reg_cbcr_type="sm_cbc"
    &clk_vote_bit=-1.
    &clk_multiplier=1.

    gosub Print_Clk_Info_Line
  )

  &match=0
  &wild_head=0
  &wild_tail=0
  &clk_input_length=STRING.LENGTH("&clk")
  &clk_itr_length=STRING.LENGTH("audio_core_lpm_core_clk")

  if (STRING.SCAN("&clk", "*", 0)==0)
  (
    &wild_head=1
  )
  if (STRING.SCAN("&clk", "*", 1)==(STRING.LENGTH("&clk")-1))
  (
    &wild_tail=1
  )

  if ((&wild_head==1)&&(&wild_tail==1))
  (
    if (STRING.SCAN("audio_core_lpm_core_clk", STRING.MID("&clk", 1, &clk_input_length-2), 0)!=-1)
    ( 
      &match=1
    )
  )
  else if (&wild_head==1)
  (
    if (STRING.MID("audio_core_lpm_core_clk", &clk_itr_length-&clk_input_length+1, &clk_input_length-1)==STRING.CUT("&clk", 1))
    ( 
      &match=1
    )
  )
  else if (&wild_tail==1)
  (
    if (STRING.MID("audio_core_lpm_core_clk", 0, &clk_input_length-1)==STRING.CUT("&clk", -1))
    ( 
      &match=1
    )
  )
  else if ("audio_core_lpm_core_clk"=="&clk")
  (
    &match=1
  )
  
  if (&match==1)
  (
    &clk_test=&CLK_TEST_AUDIO_CORE_LPM_CORE_CLK
    &clk_reg=&HWIO_LPASS_AUDIO_CORE_LPM_CORE_CBCR_ADDR
    &clk_reg_name="LPASS_AUDIO_CORE_LPM_CORE_CBCR"
    &clk_name="audio_core_lpm_core_clk"
    &clk_reg_cbcr_type="sm_pscbc"
    &clk_vote_bit=-1.
    &clk_multiplier=1.

    gosub Print_Clk_Info_Line
  )

  &match=0
  &wild_head=0
  &wild_tail=0
  &clk_input_length=STRING.LENGTH("&clk")
  &clk_itr_length=STRING.LENGTH("audio_core_peripheral_smmu_client_core_clk")

  if (STRING.SCAN("&clk", "*", 0)==0)
  (
    &wild_head=1
  )
  if (STRING.SCAN("&clk", "*", 1)==(STRING.LENGTH("&clk")-1))
  (
    &wild_tail=1
  )

  if ((&wild_head==1)&&(&wild_tail==1))
  (
    if (STRING.SCAN("audio_core_peripheral_smmu_client_core_clk", STRING.MID("&clk", 1, &clk_input_length-2), 0)!=-1)
    ( 
      &match=1
    )
  )
  else if (&wild_head==1)
  (
    if (STRING.MID("audio_core_peripheral_smmu_client_core_clk", &clk_itr_length-&clk_input_length+1, &clk_input_length-1)==STRING.CUT("&clk", 1))
    ( 
      &match=1
    )
  )
  else if (&wild_tail==1)
  (
    if (STRING.MID("audio_core_peripheral_smmu_client_core_clk", 0, &clk_input_length-1)==STRING.CUT("&clk", -1))
    ( 
      &match=1
    )
  )
  else if ("audio_core_peripheral_smmu_client_core_clk"=="&clk")
  (
    &match=1
  )
  
  if (&match==1)
  (
    &clk_test=&CLK_TEST_AUDIO_CORE_PERIPHERAL_SMMU_CLIENT_CORE_CLK
    &clk_reg=&HWIO_LPASS_AUDIO_CORE_PERIPHERAL_SMMU_CLIENT_CORE_CBCR_ADDR
    &clk_reg_name="LPASS_AUDIO_CORE_PERIPHERAL_SMMU_CLIENT_CORE_CBCR"
    &clk_name="audio_core_peripheral_smmu_client_core_clk"
    &clk_reg_cbcr_type="sm_pscbc"
    &clk_vote_bit=-1.
    &clk_multiplier=1.

    gosub Print_Clk_Info_Line
  )

  &match=0
  &wild_head=0
  &wild_tail=0
  &clk_input_length=STRING.LENGTH("&clk")
  &clk_itr_length=STRING.LENGTH("audio_core_qca_slimbus_core_clk")

  if (STRING.SCAN("&clk", "*", 0)==0)
  (
    &wild_head=1
  )
  if (STRING.SCAN("&clk", "*", 1)==(STRING.LENGTH("&clk")-1))
  (
    &wild_tail=1
  )

  if ((&wild_head==1)&&(&wild_tail==1))
  (
    if (STRING.SCAN("audio_core_qca_slimbus_core_clk", STRING.MID("&clk", 1, &clk_input_length-2), 0)!=-1)
    ( 
      &match=1
    )
  )
  else if (&wild_head==1)
  (
    if (STRING.MID("audio_core_qca_slimbus_core_clk", &clk_itr_length-&clk_input_length+1, &clk_input_length-1)==STRING.CUT("&clk", 1))
    ( 
      &match=1
    )
  )
  else if (&wild_tail==1)
  (
    if (STRING.MID("audio_core_qca_slimbus_core_clk", 0, &clk_input_length-1)==STRING.CUT("&clk", -1))
    ( 
      &match=1
    )
  )
  else if ("audio_core_qca_slimbus_core_clk"=="&clk")
  (
    &match=1
  )
  
  if (&match==1)
  (
    &clk_test=&CLK_TEST_AUDIO_CORE_QCA_SLIMBUS_CORE_CLK
    &clk_reg=&HWIO_LPASS_AUDIO_CORE_QCA_SLIMBUS_CORE_CBCR_ADDR
    &clk_reg_name="LPASS_AUDIO_CORE_QCA_SLIMBUS_CORE_CBCR"
    &clk_name="audio_core_qca_slimbus_core_clk"
    &clk_reg_cbcr_type="sm_pscbc"
    &clk_vote_bit=-1.
    &clk_multiplier=1.

    gosub Print_Clk_Info_Line
  )

  &match=0
  &wild_head=0
  &wild_tail=0
  &clk_input_length=STRING.LENGTH("&clk")
  &clk_itr_length=STRING.LENGTH("audio_core_sysnoc_mport_core_clk")

  if (STRING.SCAN("&clk", "*", 0)==0)
  (
    &wild_head=1
  )
  if (STRING.SCAN("&clk", "*", 1)==(STRING.LENGTH("&clk")-1))
  (
    &wild_tail=1
  )

  if ((&wild_head==1)&&(&wild_tail==1))
  (
    if (STRING.SCAN("audio_core_sysnoc_mport_core_clk", STRING.MID("&clk", 1, &clk_input_length-2), 0)!=-1)
    ( 
      &match=1
    )
  )
  else if (&wild_head==1)
  (
    if (STRING.MID("audio_core_sysnoc_mport_core_clk", &clk_itr_length-&clk_input_length+1, &clk_input_length-1)==STRING.CUT("&clk", 1))
    ( 
      &match=1
    )
  )
  else if (&wild_tail==1)
  (
    if (STRING.MID("audio_core_sysnoc_mport_core_clk", 0, &clk_input_length-1)==STRING.CUT("&clk", -1))
    ( 
      &match=1
    )
  )
  else if ("audio_core_sysnoc_mport_core_clk"=="&clk")
  (
    &match=1
  )
  
  if (&match==1)
  (
    &clk_test=&CLK_TEST_AUDIO_CORE_SYSNOC_MPORT_CORE_CLK
    &clk_reg=&HWIO_LPASS_AUDIO_CORE_SYSNOC_MPORT_CORE_CBCR_ADDR
    &clk_reg_name="LPASS_AUDIO_CORE_SYSNOC_MPORT_CORE_CBCR"
    &clk_name="audio_core_sysnoc_mport_core_clk"
    &clk_reg_cbcr_type="sm_cbc"
    &clk_vote_bit=-1.
    &clk_multiplier=1.

    gosub Print_Clk_Info_Line
  )

  &match=0
  &wild_head=0
  &wild_tail=0
  &clk_input_length=STRING.LENGTH("&clk")
  &clk_itr_length=STRING.LENGTH("audio_core_bus_timeout_core_clk")

  if (STRING.SCAN("&clk", "*", 0)==0)
  (
    &wild_head=1
  )
  if (STRING.SCAN("&clk", "*", 1)==(STRING.LENGTH("&clk")-1))
  (
    &wild_tail=1
  )

  if ((&wild_head==1)&&(&wild_tail==1))
  (
    if (STRING.SCAN("audio_core_bus_timeout_core_clk", STRING.MID("&clk", 1, &clk_input_length-2), 0)!=-1)
    ( 
      &match=1
    )
  )
  else if (&wild_head==1)
  (
    if (STRING.MID("audio_core_bus_timeout_core_clk", &clk_itr_length-&clk_input_length+1, &clk_input_length-1)==STRING.CUT("&clk", 1))
    ( 
      &match=1
    )
  )
  else if (&wild_tail==1)
  (
    if (STRING.MID("audio_core_bus_timeout_core_clk", 0, &clk_input_length-1)==STRING.CUT("&clk", -1))
    ( 
      &match=1
    )
  )
  else if ("audio_core_bus_timeout_core_clk"=="&clk")
  (
    &match=1
  )
  
  if (&match==1)
  (
    &clk_test=&CLK_TEST_AUDIO_CORE_BUS_TIMEOUT_CORE_CLK
    &clk_reg=&HWIO_LPASS_AUDIO_CORE_BUS_TIMEOUT_CORE_CBCR_ADDR
    &clk_reg_name="LPASS_AUDIO_CORE_BUS_TIMEOUT_CORE_CBCR"
    &clk_name="audio_core_bus_timeout_core_clk"
    &clk_reg_cbcr_type="sm_cbc"
    &clk_vote_bit=-1.
    &clk_multiplier=1.

    gosub Print_Clk_Info_Line
  )

  &match=0
  &wild_head=0
  &wild_tail=0
  &clk_input_length=STRING.LENGTH("&clk")
  &clk_itr_length=STRING.LENGTH("ext_mclk0_clk_src")

  if (STRING.SCAN("&clk", "*", 0)==0)
  (
    &wild_head=1
  )
  if (STRING.SCAN("&clk", "*", 1)==(STRING.LENGTH("&clk")-1))
  (
    &wild_tail=1
  )

  if ((&wild_head==1)&&(&wild_tail==1))
  (
    if (STRING.SCAN("ext_mclk0_clk_src", STRING.MID("&clk", 1, &clk_input_length-2), 0)!=-1)
    ( 
      &match=1
    )
  )
  else if (&wild_head==1)
  (
    if (STRING.MID("ext_mclk0_clk_src", &clk_itr_length-&clk_input_length+1, &clk_input_length-1)==STRING.CUT("&clk", 1))
    ( 
      &match=1
    )
  )
  else if (&wild_tail==1)
  (
    if (STRING.MID("ext_mclk0_clk_src", 0, &clk_input_length-1)==STRING.CUT("&clk", -1))
    ( 
      &match=1
    )
  )
  else if ("ext_mclk0_clk_src"=="&clk")
  (
    &match=1
  )
  
  if (&match==1)
  (
    &clk_test=&CLK_TEST_EXT_MCLK0_CLK_SRC
    &clk_reg=0
    &clk_reg_name="No CBCR"
    &clk_name="ext_mclk0_clk_src"
    &clk_reg_cbcr_type=""
    &clk_vote_bit=-1.
    &clk_multiplier=1.

    gosub Print_Clk_Info_Line
  )

  &match=0
  &wild_head=0
  &wild_tail=0
  &clk_input_length=STRING.LENGTH("&clk")
  &clk_itr_length=STRING.LENGTH("audio_wrapper_ext_mclk0_clk")

  if (STRING.SCAN("&clk", "*", 0)==0)
  (
    &wild_head=1
  )
  if (STRING.SCAN("&clk", "*", 1)==(STRING.LENGTH("&clk")-1))
  (
    &wild_tail=1
  )

  if ((&wild_head==1)&&(&wild_tail==1))
  (
    if (STRING.SCAN("audio_wrapper_ext_mclk0_clk", STRING.MID("&clk", 1, &clk_input_length-2), 0)!=-1)
    ( 
      &match=1
    )
  )
  else if (&wild_head==1)
  (
    if (STRING.MID("audio_wrapper_ext_mclk0_clk", &clk_itr_length-&clk_input_length+1, &clk_input_length-1)==STRING.CUT("&clk", 1))
    ( 
      &match=1
    )
  )
  else if (&wild_tail==1)
  (
    if (STRING.MID("audio_wrapper_ext_mclk0_clk", 0, &clk_input_length-1)==STRING.CUT("&clk", -1))
    ( 
      &match=1
    )
  )
  else if ("audio_wrapper_ext_mclk0_clk"=="&clk")
  (
    &match=1
  )
  
  if (&match==1)
  (
    &clk_test=&CLK_TEST_AUDIO_WRAPPER_EXT_MCLK0_CLK
    &clk_reg=&HWIO_LPASS_AUDIO_WRAPPER_EXT_MCLK0_CBCR_ADDR
    &clk_reg_name="LPASS_AUDIO_WRAPPER_EXT_MCLK0_CBCR"
    &clk_name="audio_wrapper_ext_mclk0_clk"
    &clk_reg_cbcr_type="sm_cbc"
    &clk_vote_bit=-1.
    &clk_multiplier=1.

    gosub Print_Clk_Info_Line
  )

  &match=0
  &wild_head=0
  &wild_tail=0
  &clk_input_length=STRING.LENGTH("&clk")
  &clk_itr_length=STRING.LENGTH("ext_mclk1_clk_src")

  if (STRING.SCAN("&clk", "*", 0)==0)
  (
    &wild_head=1
  )
  if (STRING.SCAN("&clk", "*", 1)==(STRING.LENGTH("&clk")-1))
  (
    &wild_tail=1
  )

  if ((&wild_head==1)&&(&wild_tail==1))
  (
    if (STRING.SCAN("ext_mclk1_clk_src", STRING.MID("&clk", 1, &clk_input_length-2), 0)!=-1)
    ( 
      &match=1
    )
  )
  else if (&wild_head==1)
  (
    if (STRING.MID("ext_mclk1_clk_src", &clk_itr_length-&clk_input_length+1, &clk_input_length-1)==STRING.CUT("&clk", 1))
    ( 
      &match=1
    )
  )
  else if (&wild_tail==1)
  (
    if (STRING.MID("ext_mclk1_clk_src", 0, &clk_input_length-1)==STRING.CUT("&clk", -1))
    ( 
      &match=1
    )
  )
  else if ("ext_mclk1_clk_src"=="&clk")
  (
    &match=1
  )
  
  if (&match==1)
  (
    &clk_test=&CLK_TEST_EXT_MCLK1_CLK_SRC
    &clk_reg=0
    &clk_reg_name="No CBCR"
    &clk_name="ext_mclk1_clk_src"
    &clk_reg_cbcr_type=""
    &clk_vote_bit=-1.
    &clk_multiplier=1.

    gosub Print_Clk_Info_Line
  )

  &match=0
  &wild_head=0
  &wild_tail=0
  &clk_input_length=STRING.LENGTH("&clk")
  &clk_itr_length=STRING.LENGTH("audio_wrapper_ext_mclk1_clk")

  if (STRING.SCAN("&clk", "*", 0)==0)
  (
    &wild_head=1
  )
  if (STRING.SCAN("&clk", "*", 1)==(STRING.LENGTH("&clk")-1))
  (
    &wild_tail=1
  )

  if ((&wild_head==1)&&(&wild_tail==1))
  (
    if (STRING.SCAN("audio_wrapper_ext_mclk1_clk", STRING.MID("&clk", 1, &clk_input_length-2), 0)!=-1)
    ( 
      &match=1
    )
  )
  else if (&wild_head==1)
  (
    if (STRING.MID("audio_wrapper_ext_mclk1_clk", &clk_itr_length-&clk_input_length+1, &clk_input_length-1)==STRING.CUT("&clk", 1))
    ( 
      &match=1
    )
  )
  else if (&wild_tail==1)
  (
    if (STRING.MID("audio_wrapper_ext_mclk1_clk", 0, &clk_input_length-1)==STRING.CUT("&clk", -1))
    ( 
      &match=1
    )
  )
  else if ("audio_wrapper_ext_mclk1_clk"=="&clk")
  (
    &match=1
  )
  
  if (&match==1)
  (
    &clk_test=&CLK_TEST_AUDIO_WRAPPER_EXT_MCLK1_CLK
    &clk_reg=&HWIO_LPASS_AUDIO_WRAPPER_EXT_MCLK1_CBCR_ADDR
    &clk_reg_name="LPASS_AUDIO_WRAPPER_EXT_MCLK1_CBCR"
    &clk_name="audio_wrapper_ext_mclk1_clk"
    &clk_reg_cbcr_type="sm_cbc"
    &clk_vote_bit=-1.
    &clk_multiplier=1.

    gosub Print_Clk_Info_Line
  )

  &match=0
  &wild_head=0
  &wild_tail=0
  &clk_input_length=STRING.LENGTH("&clk")
  &clk_itr_length=STRING.LENGTH("ext_mclk2_clk_src")

  if (STRING.SCAN("&clk", "*", 0)==0)
  (
    &wild_head=1
  )
  if (STRING.SCAN("&clk", "*", 1)==(STRING.LENGTH("&clk")-1))
  (
    &wild_tail=1
  )

  if ((&wild_head==1)&&(&wild_tail==1))
  (
    if (STRING.SCAN("ext_mclk2_clk_src", STRING.MID("&clk", 1, &clk_input_length-2), 0)!=-1)
    ( 
      &match=1
    )
  )
  else if (&wild_head==1)
  (
    if (STRING.MID("ext_mclk2_clk_src", &clk_itr_length-&clk_input_length+1, &clk_input_length-1)==STRING.CUT("&clk", 1))
    ( 
      &match=1
    )
  )
  else if (&wild_tail==1)
  (
    if (STRING.MID("ext_mclk2_clk_src", 0, &clk_input_length-1)==STRING.CUT("&clk", -1))
    ( 
      &match=1
    )
  )
  else if ("ext_mclk2_clk_src"=="&clk")
  (
    &match=1
  )
  
  if (&match==1)
  (
    &clk_test=&CLK_TEST_EXT_MCLK2_CLK_SRC
    &clk_reg=0
    &clk_reg_name="No CBCR"
    &clk_name="ext_mclk2_clk_src"
    &clk_reg_cbcr_type=""
    &clk_vote_bit=-1.
    &clk_multiplier=1.

    gosub Print_Clk_Info_Line
  )

  &match=0
  &wild_head=0
  &wild_tail=0
  &clk_input_length=STRING.LENGTH("&clk")
  &clk_itr_length=STRING.LENGTH("audio_wrapper_ext_mclk2_clk")

  if (STRING.SCAN("&clk", "*", 0)==0)
  (
    &wild_head=1
  )
  if (STRING.SCAN("&clk", "*", 1)==(STRING.LENGTH("&clk")-1))
  (
    &wild_tail=1
  )

  if ((&wild_head==1)&&(&wild_tail==1))
  (
    if (STRING.SCAN("audio_wrapper_ext_mclk2_clk", STRING.MID("&clk", 1, &clk_input_length-2), 0)!=-1)
    ( 
      &match=1
    )
  )
  else if (&wild_head==1)
  (
    if (STRING.MID("audio_wrapper_ext_mclk2_clk", &clk_itr_length-&clk_input_length+1, &clk_input_length-1)==STRING.CUT("&clk", 1))
    ( 
      &match=1
    )
  )
  else if (&wild_tail==1)
  (
    if (STRING.MID("audio_wrapper_ext_mclk2_clk", 0, &clk_input_length-1)==STRING.CUT("&clk", -1))
    ( 
      &match=1
    )
  )
  else if ("audio_wrapper_ext_mclk2_clk"=="&clk")
  (
    &match=1
  )
  
  if (&match==1)
  (
    &clk_test=&CLK_TEST_AUDIO_WRAPPER_EXT_MCLK2_CLK
    &clk_reg=&HWIO_LPASS_AUDIO_WRAPPER_EXT_MCLK2_CBCR_ADDR
    &clk_reg_name="LPASS_AUDIO_WRAPPER_EXT_MCLK2_CBCR"
    &clk_name="audio_wrapper_ext_mclk2_clk"
    &clk_reg_cbcr_type="sm_cbc"
    &clk_vote_bit=-1.
    &clk_multiplier=1.

    gosub Print_Clk_Info_Line
  )

  &match=0
  &wild_head=0
  &wild_tail=0
  &clk_input_length=STRING.LENGTH("&clk")
  &clk_itr_length=STRING.LENGTH("q6ss_q6_camss_dsp_streaming_0_clk")

  if (STRING.SCAN("&clk", "*", 0)==0)
  (
    &wild_head=1
  )
  if (STRING.SCAN("&clk", "*", 1)==(STRING.LENGTH("&clk")-1))
  (
    &wild_tail=1
  )

  if ((&wild_head==1)&&(&wild_tail==1))
  (
    if (STRING.SCAN("q6ss_q6_camss_dsp_streaming_0_clk", STRING.MID("&clk", 1, &clk_input_length-2), 0)!=-1)
    ( 
      &match=1
    )
  )
  else if (&wild_head==1)
  (
    if (STRING.MID("q6ss_q6_camss_dsp_streaming_0_clk", &clk_itr_length-&clk_input_length+1, &clk_input_length-1)==STRING.CUT("&clk", 1))
    ( 
      &match=1
    )
  )
  else if (&wild_tail==1)
  (
    if (STRING.MID("q6ss_q6_camss_dsp_streaming_0_clk", 0, &clk_input_length-1)==STRING.CUT("&clk", -1))
    ( 
      &match=1
    )
  )
  else if ("q6ss_q6_camss_dsp_streaming_0_clk"=="&clk")
  (
    &match=1
  )
  
  if (&match==1)
  (
    &clk_test=0
    &clk_reg=&HWIO_LPASS_Q6SS_Q6_CAMSS_DSP_STREAMING_0_CBCR_ADDR
    &clk_reg_name="LPASS_Q6SS_Q6_CAMSS_DSP_STREAMING_0_CBCR"
    &clk_name="q6ss_q6_camss_dsp_streaming_0_clk"
    &clk_reg_cbcr_type="sm_cbc"
    &clk_vote_bit=-1.
    &clk_multiplier=1.

    gosub Print_Clk_Info_Line
  )

  &match=0
  &wild_head=0
  &wild_tail=0
  &clk_input_length=STRING.LENGTH("&clk")
  &clk_itr_length=STRING.LENGTH("q6ss_q6_camss_dsp_streaming_1_clk")

  if (STRING.SCAN("&clk", "*", 0)==0)
  (
    &wild_head=1
  )
  if (STRING.SCAN("&clk", "*", 1)==(STRING.LENGTH("&clk")-1))
  (
    &wild_tail=1
  )

  if ((&wild_head==1)&&(&wild_tail==1))
  (
    if (STRING.SCAN("q6ss_q6_camss_dsp_streaming_1_clk", STRING.MID("&clk", 1, &clk_input_length-2), 0)!=-1)
    ( 
      &match=1
    )
  )
  else if (&wild_head==1)
  (
    if (STRING.MID("q6ss_q6_camss_dsp_streaming_1_clk", &clk_itr_length-&clk_input_length+1, &clk_input_length-1)==STRING.CUT("&clk", 1))
    ( 
      &match=1
    )
  )
  else if (&wild_tail==1)
  (
    if (STRING.MID("q6ss_q6_camss_dsp_streaming_1_clk", 0, &clk_input_length-1)==STRING.CUT("&clk", -1))
    ( 
      &match=1
    )
  )
  else if ("q6ss_q6_camss_dsp_streaming_1_clk"=="&clk")
  (
    &match=1
  )
  
  if (&match==1)
  (
    &clk_test=0
    &clk_reg=&HWIO_LPASS_Q6SS_Q6_CAMSS_DSP_STREAMING_1_CBCR_ADDR
    &clk_reg_name="LPASS_Q6SS_Q6_CAMSS_DSP_STREAMING_1_CBCR"
    &clk_name="q6ss_q6_camss_dsp_streaming_1_clk"
    &clk_reg_cbcr_type="sm_cbc"
    &clk_vote_bit=-1.
    &clk_multiplier=1.

    gosub Print_Clk_Info_Line
  )

  &match=0
  &wild_head=0
  &wild_tail=0
  &clk_input_length=STRING.LENGTH("&clk")
  &clk_itr_length=STRING.LENGTH("lpaif_pcmoe_clk_src")

  if (STRING.SCAN("&clk", "*", 0)==0)
  (
    &wild_head=1
  )
  if (STRING.SCAN("&clk", "*", 1)==(STRING.LENGTH("&clk")-1))
  (
    &wild_tail=1
  )

  if ((&wild_head==1)&&(&wild_tail==1))
  (
    if (STRING.SCAN("lpaif_pcmoe_clk_src", STRING.MID("&clk", 1, &clk_input_length-2), 0)!=-1)
    ( 
      &match=1
    )
  )
  else if (&wild_head==1)
  (
    if (STRING.MID("lpaif_pcmoe_clk_src", &clk_itr_length-&clk_input_length+1, &clk_input_length-1)==STRING.CUT("&clk", 1))
    ( 
      &match=1
    )
  )
  else if (&wild_tail==1)
  (
    if (STRING.MID("lpaif_pcmoe_clk_src", 0, &clk_input_length-1)==STRING.CUT("&clk", -1))
    ( 
      &match=1
    )
  )
  else if ("lpaif_pcmoe_clk_src"=="&clk")
  (
    &match=1
  )
  
  if (&match==1)
  (
    &clk_test=&CLK_TEST_LPAIF_PCMOE_CLK_SRC
    &clk_reg=0
    &clk_reg_name="No CBCR"
    &clk_name="lpaif_pcmoe_clk_src"
    &clk_reg_cbcr_type=""
    &clk_vote_bit=-1.
    &clk_multiplier=1.

    gosub Print_Clk_Info_Line
  )

  &match=0
  &wild_head=0
  &wild_tail=0
  &clk_input_length=STRING.LENGTH("&clk")
  &clk_itr_length=STRING.LENGTH("audio_core_lpaif_pcm_data_oe_clk")

  if (STRING.SCAN("&clk", "*", 0)==0)
  (
    &wild_head=1
  )
  if (STRING.SCAN("&clk", "*", 1)==(STRING.LENGTH("&clk")-1))
  (
    &wild_tail=1
  )

  if ((&wild_head==1)&&(&wild_tail==1))
  (
    if (STRING.SCAN("audio_core_lpaif_pcm_data_oe_clk", STRING.MID("&clk", 1, &clk_input_length-2), 0)!=-1)
    ( 
      &match=1
    )
  )
  else if (&wild_head==1)
  (
    if (STRING.MID("audio_core_lpaif_pcm_data_oe_clk", &clk_itr_length-&clk_input_length+1, &clk_input_length-1)==STRING.CUT("&clk", 1))
    ( 
      &match=1
    )
  )
  else if (&wild_tail==1)
  (
    if (STRING.MID("audio_core_lpaif_pcm_data_oe_clk", 0, &clk_input_length-1)==STRING.CUT("&clk", -1))
    ( 
      &match=1
    )
  )
  else if ("audio_core_lpaif_pcm_data_oe_clk"=="&clk")
  (
    &match=1
  )
  
  if (&match==1)
  (
    &clk_test=&CLK_TEST_AUDIO_CORE_LPAIF_PCM_DATA_OE_CLK
    &clk_reg=&HWIO_LPASS_AUDIO_CORE_LPAIF_PCM_DATA_OE_CBCR_ADDR
    &clk_reg_name="LPASS_AUDIO_CORE_LPAIF_PCM_DATA_OE_CBCR"
    &clk_name="audio_core_lpaif_pcm_data_oe_clk"
    &clk_reg_cbcr_type="sm_cbc"
    &clk_vote_bit=-1.
    &clk_multiplier=1.

    gosub Print_Clk_Info_Line
  )

  &match=0
  &wild_head=0
  &wild_tail=0
  &clk_input_length=STRING.LENGTH("&clk")
  &clk_itr_length=STRING.LENGTH("lpaif_pri_clk_src")

  if (STRING.SCAN("&clk", "*", 0)==0)
  (
    &wild_head=1
  )
  if (STRING.SCAN("&clk", "*", 1)==(STRING.LENGTH("&clk")-1))
  (
    &wild_tail=1
  )

  if ((&wild_head==1)&&(&wild_tail==1))
  (
    if (STRING.SCAN("lpaif_pri_clk_src", STRING.MID("&clk", 1, &clk_input_length-2), 0)!=-1)
    ( 
      &match=1
    )
  )
  else if (&wild_head==1)
  (
    if (STRING.MID("lpaif_pri_clk_src", &clk_itr_length-&clk_input_length+1, &clk_input_length-1)==STRING.CUT("&clk", 1))
    ( 
      &match=1
    )
  )
  else if (&wild_tail==1)
  (
    if (STRING.MID("lpaif_pri_clk_src", 0, &clk_input_length-1)==STRING.CUT("&clk", -1))
    ( 
      &match=1
    )
  )
  else if ("lpaif_pri_clk_src"=="&clk")
  (
    &match=1
  )
  
  if (&match==1)
  (
    &clk_test=&CLK_TEST_LPAIF_PRI_CLK_SRC
    &clk_reg=0
    &clk_reg_name="No CBCR"
    &clk_name="lpaif_pri_clk_src"
    &clk_reg_cbcr_type=""
    &clk_vote_bit=-1.
    &clk_multiplier=1.

    gosub Print_Clk_Info_Line
  )

  &match=0
  &wild_head=0
  &wild_tail=0
  &clk_input_length=STRING.LENGTH("&clk")
  &clk_itr_length=STRING.LENGTH("audio_core_lpaif_pri_ibit_clk")

  if (STRING.SCAN("&clk", "*", 0)==0)
  (
    &wild_head=1
  )
  if (STRING.SCAN("&clk", "*", 1)==(STRING.LENGTH("&clk")-1))
  (
    &wild_tail=1
  )

  if ((&wild_head==1)&&(&wild_tail==1))
  (
    if (STRING.SCAN("audio_core_lpaif_pri_ibit_clk", STRING.MID("&clk", 1, &clk_input_length-2), 0)!=-1)
    ( 
      &match=1
    )
  )
  else if (&wild_head==1)
  (
    if (STRING.MID("audio_core_lpaif_pri_ibit_clk", &clk_itr_length-&clk_input_length+1, &clk_input_length-1)==STRING.CUT("&clk", 1))
    ( 
      &match=1
    )
  )
  else if (&wild_tail==1)
  (
    if (STRING.MID("audio_core_lpaif_pri_ibit_clk", 0, &clk_input_length-1)==STRING.CUT("&clk", -1))
    ( 
      &match=1
    )
  )
  else if ("audio_core_lpaif_pri_ibit_clk"=="&clk")
  (
    &match=1
  )
  
  if (&match==1)
  (
    &clk_test=&CLK_TEST_AUDIO_CORE_LPAIF_PRI_IBIT_CLK
    &clk_reg=&HWIO_LPASS_AUDIO_CORE_LPAIF_PRI_IBIT_CBCR_ADDR
    &clk_reg_name="LPASS_AUDIO_CORE_LPAIF_PRI_IBIT_CBCR"
    &clk_name="audio_core_lpaif_pri_ibit_clk"
    &clk_reg_cbcr_type="sm_cbc"
    &clk_vote_bit=-1.
    &clk_multiplier=1.

    gosub Print_Clk_Info_Line
  )

  &match=0
  &wild_head=0
  &wild_tail=0
  &clk_input_length=STRING.LENGTH("&clk")
  &clk_itr_length=STRING.LENGTH("lpaif_quad_clk_src")

  if (STRING.SCAN("&clk", "*", 0)==0)
  (
    &wild_head=1
  )
  if (STRING.SCAN("&clk", "*", 1)==(STRING.LENGTH("&clk")-1))
  (
    &wild_tail=1
  )

  if ((&wild_head==1)&&(&wild_tail==1))
  (
    if (STRING.SCAN("lpaif_quad_clk_src", STRING.MID("&clk", 1, &clk_input_length-2), 0)!=-1)
    ( 
      &match=1
    )
  )
  else if (&wild_head==1)
  (
    if (STRING.MID("lpaif_quad_clk_src", &clk_itr_length-&clk_input_length+1, &clk_input_length-1)==STRING.CUT("&clk", 1))
    ( 
      &match=1
    )
  )
  else if (&wild_tail==1)
  (
    if (STRING.MID("lpaif_quad_clk_src", 0, &clk_input_length-1)==STRING.CUT("&clk", -1))
    ( 
      &match=1
    )
  )
  else if ("lpaif_quad_clk_src"=="&clk")
  (
    &match=1
  )
  
  if (&match==1)
  (
    &clk_test=&CLK_TEST_LPAIF_QUAD_CLK_SRC
    &clk_reg=0
    &clk_reg_name="No CBCR"
    &clk_name="lpaif_quad_clk_src"
    &clk_reg_cbcr_type=""
    &clk_vote_bit=-1.
    &clk_multiplier=1.

    gosub Print_Clk_Info_Line
  )

  &match=0
  &wild_head=0
  &wild_tail=0
  &clk_input_length=STRING.LENGTH("&clk")
  &clk_itr_length=STRING.LENGTH("audio_core_lpaif_quad_ibit_clk")

  if (STRING.SCAN("&clk", "*", 0)==0)
  (
    &wild_head=1
  )
  if (STRING.SCAN("&clk", "*", 1)==(STRING.LENGTH("&clk")-1))
  (
    &wild_tail=1
  )

  if ((&wild_head==1)&&(&wild_tail==1))
  (
    if (STRING.SCAN("audio_core_lpaif_quad_ibit_clk", STRING.MID("&clk", 1, &clk_input_length-2), 0)!=-1)
    ( 
      &match=1
    )
  )
  else if (&wild_head==1)
  (
    if (STRING.MID("audio_core_lpaif_quad_ibit_clk", &clk_itr_length-&clk_input_length+1, &clk_input_length-1)==STRING.CUT("&clk", 1))
    ( 
      &match=1
    )
  )
  else if (&wild_tail==1)
  (
    if (STRING.MID("audio_core_lpaif_quad_ibit_clk", 0, &clk_input_length-1)==STRING.CUT("&clk", -1))
    ( 
      &match=1
    )
  )
  else if ("audio_core_lpaif_quad_ibit_clk"=="&clk")
  (
    &match=1
  )
  
  if (&match==1)
  (
    &clk_test=&CLK_TEST_AUDIO_CORE_LPAIF_QUAD_IBIT_CLK
    &clk_reg=&HWIO_LPASS_AUDIO_CORE_LPAIF_QUAD_IBIT_CBCR_ADDR
    &clk_reg_name="LPASS_AUDIO_CORE_LPAIF_QUAD_IBIT_CBCR"
    &clk_name="audio_core_lpaif_quad_ibit_clk"
    &clk_reg_cbcr_type="sm_cbc"
    &clk_vote_bit=-1.
    &clk_multiplier=1.

    gosub Print_Clk_Info_Line
  )

  &match=0
  &wild_head=0
  &wild_tail=0
  &clk_input_length=STRING.LENGTH("&clk")
  &clk_itr_length=STRING.LENGTH("lpaif_sec_clk_src")

  if (STRING.SCAN("&clk", "*", 0)==0)
  (
    &wild_head=1
  )
  if (STRING.SCAN("&clk", "*", 1)==(STRING.LENGTH("&clk")-1))
  (
    &wild_tail=1
  )

  if ((&wild_head==1)&&(&wild_tail==1))
  (
    if (STRING.SCAN("lpaif_sec_clk_src", STRING.MID("&clk", 1, &clk_input_length-2), 0)!=-1)
    ( 
      &match=1
    )
  )
  else if (&wild_head==1)
  (
    if (STRING.MID("lpaif_sec_clk_src", &clk_itr_length-&clk_input_length+1, &clk_input_length-1)==STRING.CUT("&clk", 1))
    ( 
      &match=1
    )
  )
  else if (&wild_tail==1)
  (
    if (STRING.MID("lpaif_sec_clk_src", 0, &clk_input_length-1)==STRING.CUT("&clk", -1))
    ( 
      &match=1
    )
  )
  else if ("lpaif_sec_clk_src"=="&clk")
  (
    &match=1
  )
  
  if (&match==1)
  (
    &clk_test=&CLK_TEST_LPAIF_SEC_CLK_SRC
    &clk_reg=0
    &clk_reg_name="No CBCR"
    &clk_name="lpaif_sec_clk_src"
    &clk_reg_cbcr_type=""
    &clk_vote_bit=-1.
    &clk_multiplier=1.

    gosub Print_Clk_Info_Line
  )

  &match=0
  &wild_head=0
  &wild_tail=0
  &clk_input_length=STRING.LENGTH("&clk")
  &clk_itr_length=STRING.LENGTH("audio_core_lpaif_sec_ibit_clk")

  if (STRING.SCAN("&clk", "*", 0)==0)
  (
    &wild_head=1
  )
  if (STRING.SCAN("&clk", "*", 1)==(STRING.LENGTH("&clk")-1))
  (
    &wild_tail=1
  )

  if ((&wild_head==1)&&(&wild_tail==1))
  (
    if (STRING.SCAN("audio_core_lpaif_sec_ibit_clk", STRING.MID("&clk", 1, &clk_input_length-2), 0)!=-1)
    ( 
      &match=1
    )
  )
  else if (&wild_head==1)
  (
    if (STRING.MID("audio_core_lpaif_sec_ibit_clk", &clk_itr_length-&clk_input_length+1, &clk_input_length-1)==STRING.CUT("&clk", 1))
    ( 
      &match=1
    )
  )
  else if (&wild_tail==1)
  (
    if (STRING.MID("audio_core_lpaif_sec_ibit_clk", 0, &clk_input_length-1)==STRING.CUT("&clk", -1))
    ( 
      &match=1
    )
  )
  else if ("audio_core_lpaif_sec_ibit_clk"=="&clk")
  (
    &match=1
  )
  
  if (&match==1)
  (
    &clk_test=&CLK_TEST_AUDIO_CORE_LPAIF_SEC_IBIT_CLK
    &clk_reg=&HWIO_LPASS_AUDIO_CORE_LPAIF_SEC_IBIT_CBCR_ADDR
    &clk_reg_name="LPASS_AUDIO_CORE_LPAIF_SEC_IBIT_CBCR"
    &clk_name="audio_core_lpaif_sec_ibit_clk"
    &clk_reg_cbcr_type="sm_cbc"
    &clk_vote_bit=-1.
    &clk_multiplier=1.

    gosub Print_Clk_Info_Line
  )

  &match=0
  &wild_head=0
  &wild_tail=0
  &clk_input_length=STRING.LENGTH("&clk")
  &clk_itr_length=STRING.LENGTH("lpaif_spkr_clk_src")

  if (STRING.SCAN("&clk", "*", 0)==0)
  (
    &wild_head=1
  )
  if (STRING.SCAN("&clk", "*", 1)==(STRING.LENGTH("&clk")-1))
  (
    &wild_tail=1
  )

  if ((&wild_head==1)&&(&wild_tail==1))
  (
    if (STRING.SCAN("lpaif_spkr_clk_src", STRING.MID("&clk", 1, &clk_input_length-2), 0)!=-1)
    ( 
      &match=1
    )
  )
  else if (&wild_head==1)
  (
    if (STRING.MID("lpaif_spkr_clk_src", &clk_itr_length-&clk_input_length+1, &clk_input_length-1)==STRING.CUT("&clk", 1))
    ( 
      &match=1
    )
  )
  else if (&wild_tail==1)
  (
    if (STRING.MID("lpaif_spkr_clk_src", 0, &clk_input_length-1)==STRING.CUT("&clk", -1))
    ( 
      &match=1
    )
  )
  else if ("lpaif_spkr_clk_src"=="&clk")
  (
    &match=1
  )
  
  if (&match==1)
  (
    &clk_test=&CLK_TEST_LPAIF_SPKR_CLK_SRC
    &clk_reg=0
    &clk_reg_name="No CBCR"
    &clk_name="lpaif_spkr_clk_src"
    &clk_reg_cbcr_type=""
    &clk_vote_bit=-1.
    &clk_multiplier=1.

    gosub Print_Clk_Info_Line
  )

  &match=0
  &wild_head=0
  &wild_tail=0
  &clk_input_length=STRING.LENGTH("&clk")
  &clk_itr_length=STRING.LENGTH("audio_core_lpaif_codec_spkr_ibit_clk")

  if (STRING.SCAN("&clk", "*", 0)==0)
  (
    &wild_head=1
  )
  if (STRING.SCAN("&clk", "*", 1)==(STRING.LENGTH("&clk")-1))
  (
    &wild_tail=1
  )

  if ((&wild_head==1)&&(&wild_tail==1))
  (
    if (STRING.SCAN("audio_core_lpaif_codec_spkr_ibit_clk", STRING.MID("&clk", 1, &clk_input_length-2), 0)!=-1)
    ( 
      &match=1
    )
  )
  else if (&wild_head==1)
  (
    if (STRING.MID("audio_core_lpaif_codec_spkr_ibit_clk", &clk_itr_length-&clk_input_length+1, &clk_input_length-1)==STRING.CUT("&clk", 1))
    ( 
      &match=1
    )
  )
  else if (&wild_tail==1)
  (
    if (STRING.MID("audio_core_lpaif_codec_spkr_ibit_clk", 0, &clk_input_length-1)==STRING.CUT("&clk", -1))
    ( 
      &match=1
    )
  )
  else if ("audio_core_lpaif_codec_spkr_ibit_clk"=="&clk")
  (
    &match=1
  )
  
  if (&match==1)
  (
    &clk_test=&CLK_TEST_AUDIO_CORE_LPAIF_CODEC_SPKR_IBIT_CLK
    &clk_reg=&HWIO_LPASS_AUDIO_CORE_LPAIF_CODEC_SPKR_IBIT_CBCR_ADDR
    &clk_reg_name="LPASS_AUDIO_CORE_LPAIF_CODEC_SPKR_IBIT_CBCR"
    &clk_name="audio_core_lpaif_codec_spkr_ibit_clk"
    &clk_reg_cbcr_type="sm_cbc"
    &clk_vote_bit=-1.
    &clk_multiplier=1.

    gosub Print_Clk_Info_Line
  )

  &match=0
  &wild_head=0
  &wild_tail=0
  &clk_input_length=STRING.LENGTH("&clk")
  &clk_itr_length=STRING.LENGTH("audio_core_lpaif_codec_spkr_osr_clk")

  if (STRING.SCAN("&clk", "*", 0)==0)
  (
    &wild_head=1
  )
  if (STRING.SCAN("&clk", "*", 1)==(STRING.LENGTH("&clk")-1))
  (
    &wild_tail=1
  )

  if ((&wild_head==1)&&(&wild_tail==1))
  (
    if (STRING.SCAN("audio_core_lpaif_codec_spkr_osr_clk", STRING.MID("&clk", 1, &clk_input_length-2), 0)!=-1)
    ( 
      &match=1
    )
  )
  else if (&wild_head==1)
  (
    if (STRING.MID("audio_core_lpaif_codec_spkr_osr_clk", &clk_itr_length-&clk_input_length+1, &clk_input_length-1)==STRING.CUT("&clk", 1))
    ( 
      &match=1
    )
  )
  else if (&wild_tail==1)
  (
    if (STRING.MID("audio_core_lpaif_codec_spkr_osr_clk", 0, &clk_input_length-1)==STRING.CUT("&clk", -1))
    ( 
      &match=1
    )
  )
  else if ("audio_core_lpaif_codec_spkr_osr_clk"=="&clk")
  (
    &match=1
  )
  
  if (&match==1)
  (
    &clk_test=&CLK_TEST_AUDIO_CORE_LPAIF_CODEC_SPKR_OSR_CLK
    &clk_reg=&HWIO_LPASS_AUDIO_CORE_LPAIF_CODEC_SPKR_OSR_CBCR_ADDR
    &clk_reg_name="LPASS_AUDIO_CORE_LPAIF_CODEC_SPKR_OSR_CBCR"
    &clk_name="audio_core_lpaif_codec_spkr_osr_clk"
    &clk_reg_cbcr_type="sm_cbc"
    &clk_vote_bit=-1.
    &clk_multiplier=1.

    gosub Print_Clk_Info_Line
  )

  &match=0
  &wild_head=0
  &wild_tail=0
  &clk_input_length=STRING.LENGTH("&clk")
  &clk_itr_length=STRING.LENGTH("lpaif_ter_clk_src")

  if (STRING.SCAN("&clk", "*", 0)==0)
  (
    &wild_head=1
  )
  if (STRING.SCAN("&clk", "*", 1)==(STRING.LENGTH("&clk")-1))
  (
    &wild_tail=1
  )

  if ((&wild_head==1)&&(&wild_tail==1))
  (
    if (STRING.SCAN("lpaif_ter_clk_src", STRING.MID("&clk", 1, &clk_input_length-2), 0)!=-1)
    ( 
      &match=1
    )
  )
  else if (&wild_head==1)
  (
    if (STRING.MID("lpaif_ter_clk_src", &clk_itr_length-&clk_input_length+1, &clk_input_length-1)==STRING.CUT("&clk", 1))
    ( 
      &match=1
    )
  )
  else if (&wild_tail==1)
  (
    if (STRING.MID("lpaif_ter_clk_src", 0, &clk_input_length-1)==STRING.CUT("&clk", -1))
    ( 
      &match=1
    )
  )
  else if ("lpaif_ter_clk_src"=="&clk")
  (
    &match=1
  )
  
  if (&match==1)
  (
    &clk_test=&CLK_TEST_LPAIF_TER_CLK_SRC
    &clk_reg=0
    &clk_reg_name="No CBCR"
    &clk_name="lpaif_ter_clk_src"
    &clk_reg_cbcr_type=""
    &clk_vote_bit=-1.
    &clk_multiplier=1.

    gosub Print_Clk_Info_Line
  )

  &match=0
  &wild_head=0
  &wild_tail=0
  &clk_input_length=STRING.LENGTH("&clk")
  &clk_itr_length=STRING.LENGTH("audio_core_lpaif_ter_ibit_clk")

  if (STRING.SCAN("&clk", "*", 0)==0)
  (
    &wild_head=1
  )
  if (STRING.SCAN("&clk", "*", 1)==(STRING.LENGTH("&clk")-1))
  (
    &wild_tail=1
  )

  if ((&wild_head==1)&&(&wild_tail==1))
  (
    if (STRING.SCAN("audio_core_lpaif_ter_ibit_clk", STRING.MID("&clk", 1, &clk_input_length-2), 0)!=-1)
    ( 
      &match=1
    )
  )
  else if (&wild_head==1)
  (
    if (STRING.MID("audio_core_lpaif_ter_ibit_clk", &clk_itr_length-&clk_input_length+1, &clk_input_length-1)==STRING.CUT("&clk", 1))
    ( 
      &match=1
    )
  )
  else if (&wild_tail==1)
  (
    if (STRING.MID("audio_core_lpaif_ter_ibit_clk", 0, &clk_input_length-1)==STRING.CUT("&clk", -1))
    ( 
      &match=1
    )
  )
  else if ("audio_core_lpaif_ter_ibit_clk"=="&clk")
  (
    &match=1
  )
  
  if (&match==1)
  (
    &clk_test=&CLK_TEST_AUDIO_CORE_LPAIF_TER_IBIT_CLK
    &clk_reg=&HWIO_LPASS_AUDIO_CORE_LPAIF_TER_IBIT_CBCR_ADDR
    &clk_reg_name="LPASS_AUDIO_CORE_LPAIF_TER_IBIT_CBCR"
    &clk_name="audio_core_lpaif_ter_ibit_clk"
    &clk_reg_cbcr_type="sm_cbc"
    &clk_vote_bit=-1.
    &clk_multiplier=1.

    gosub Print_Clk_Info_Line
  )

  &match=0
  &wild_head=0
  &wild_tail=0
  &clk_input_length=STRING.LENGTH("&clk")
  &clk_itr_length=STRING.LENGTH("audio_core_lpaif_pri_ebit_clk")

  if (STRING.SCAN("&clk", "*", 0)==0)
  (
    &wild_head=1
  )
  if (STRING.SCAN("&clk", "*", 1)==(STRING.LENGTH("&clk")-1))
  (
    &wild_tail=1
  )

  if ((&wild_head==1)&&(&wild_tail==1))
  (
    if (STRING.SCAN("audio_core_lpaif_pri_ebit_clk", STRING.MID("&clk", 1, &clk_input_length-2), 0)!=-1)
    ( 
      &match=1
    )
  )
  else if (&wild_head==1)
  (
    if (STRING.MID("audio_core_lpaif_pri_ebit_clk", &clk_itr_length-&clk_input_length+1, &clk_input_length-1)==STRING.CUT("&clk", 1))
    ( 
      &match=1
    )
  )
  else if (&wild_tail==1)
  (
    if (STRING.MID("audio_core_lpaif_pri_ebit_clk", 0, &clk_input_length-1)==STRING.CUT("&clk", -1))
    ( 
      &match=1
    )
  )
  else if ("audio_core_lpaif_pri_ebit_clk"=="&clk")
  (
    &match=1
  )
  
  if (&match==1)
  (
    &clk_test=0
    &clk_reg=&HWIO_LPASS_AUDIO_CORE_LPAIF_PRI_EBIT_CBCR_ADDR
    &clk_reg_name="LPASS_AUDIO_CORE_LPAIF_PRI_EBIT_CBCR"
    &clk_name="audio_core_lpaif_pri_ebit_clk"
    &clk_reg_cbcr_type="sm_cbc"
    &clk_vote_bit=-1.
    &clk_multiplier=1.

    gosub Print_Clk_Info_Line
  )

  &match=0
  &wild_head=0
  &wild_tail=0
  &clk_input_length=STRING.LENGTH("&clk")
  &clk_itr_length=STRING.LENGTH("qca_slimbus_clk_src")

  if (STRING.SCAN("&clk", "*", 0)==0)
  (
    &wild_head=1
  )
  if (STRING.SCAN("&clk", "*", 1)==(STRING.LENGTH("&clk")-1))
  (
    &wild_tail=1
  )

  if ((&wild_head==1)&&(&wild_tail==1))
  (
    if (STRING.SCAN("qca_slimbus_clk_src", STRING.MID("&clk", 1, &clk_input_length-2), 0)!=-1)
    ( 
      &match=1
    )
  )
  else if (&wild_head==1)
  (
    if (STRING.MID("qca_slimbus_clk_src", &clk_itr_length-&clk_input_length+1, &clk_input_length-1)==STRING.CUT("&clk", 1))
    ( 
      &match=1
    )
  )
  else if (&wild_tail==1)
  (
    if (STRING.MID("qca_slimbus_clk_src", 0, &clk_input_length-1)==STRING.CUT("&clk", -1))
    ( 
      &match=1
    )
  )
  else if ("qca_slimbus_clk_src"=="&clk")
  (
    &match=1
  )
  
  if (&match==1)
  (
    &clk_test=&CLK_TEST_QCA_SLIMBUS_CLK_SRC
    &clk_reg=0
    &clk_reg_name="No CBCR"
    &clk_name="qca_slimbus_clk_src"
    &clk_reg_cbcr_type=""
    &clk_vote_bit=-1.
    &clk_multiplier=1.

    gosub Print_Clk_Info_Line
  )

  &match=0
  &wild_head=0
  &wild_tail=0
  &clk_input_length=STRING.LENGTH("&clk")
  &clk_itr_length=STRING.LENGTH("audio_core_qca_slimbus_clk")

  if (STRING.SCAN("&clk", "*", 0)==0)
  (
    &wild_head=1
  )
  if (STRING.SCAN("&clk", "*", 1)==(STRING.LENGTH("&clk")-1))
  (
    &wild_tail=1
  )

  if ((&wild_head==1)&&(&wild_tail==1))
  (
    if (STRING.SCAN("audio_core_qca_slimbus_clk", STRING.MID("&clk", 1, &clk_input_length-2), 0)!=-1)
    ( 
      &match=1
    )
  )
  else if (&wild_head==1)
  (
    if (STRING.MID("audio_core_qca_slimbus_clk", &clk_itr_length-&clk_input_length+1, &clk_input_length-1)==STRING.CUT("&clk", 1))
    ( 
      &match=1
    )
  )
  else if (&wild_tail==1)
  (
    if (STRING.MID("audio_core_qca_slimbus_clk", 0, &clk_input_length-1)==STRING.CUT("&clk", -1))
    ( 
      &match=1
    )
  )
  else if ("audio_core_qca_slimbus_clk"=="&clk")
  (
    &match=1
  )
  
  if (&match==1)
  (
    &clk_test=&CLK_TEST_AUDIO_CORE_QCA_SLIMBUS_CLK
    &clk_reg=&HWIO_LPASS_AUDIO_CORE_QCA_SLIMBUS_CBCR_ADDR
    &clk_reg_name="LPASS_AUDIO_CORE_QCA_SLIMBUS_CBCR"
    &clk_name="audio_core_qca_slimbus_clk"
    &clk_reg_cbcr_type="sm_cbc"
    &clk_vote_bit=-1.
    &clk_multiplier=1.

    gosub Print_Clk_Info_Line
  )

  &match=0
  &wild_head=0
  &wild_tail=0
  &clk_input_length=STRING.LENGTH("&clk")
  &clk_itr_length=STRING.LENGTH("qos_fixed_lat_counter_src")

  if (STRING.SCAN("&clk", "*", 0)==0)
  (
    &wild_head=1
  )
  if (STRING.SCAN("&clk", "*", 1)==(STRING.LENGTH("&clk")-1))
  (
    &wild_tail=1
  )

  if ((&wild_head==1)&&(&wild_tail==1))
  (
    if (STRING.SCAN("qos_fixed_lat_counter_src", STRING.MID("&clk", 1, &clk_input_length-2), 0)!=-1)
    ( 
      &match=1
    )
  )
  else if (&wild_head==1)
  (
    if (STRING.MID("qos_fixed_lat_counter_src", &clk_itr_length-&clk_input_length+1, &clk_input_length-1)==STRING.CUT("&clk", 1))
    ( 
      &match=1
    )
  )
  else if (&wild_tail==1)
  (
    if (STRING.MID("qos_fixed_lat_counter_src", 0, &clk_input_length-1)==STRING.CUT("&clk", -1))
    ( 
      &match=1
    )
  )
  else if ("qos_fixed_lat_counter_src"=="&clk")
  (
    &match=1
  )
  
  if (&match==1)
  (
    &clk_test=&CLK_TEST_QOS_FIXED_LAT_COUNTER_SRC
    &clk_reg=0
    &clk_reg_name="No CBCR"
    &clk_name="qos_fixed_lat_counter_src"
    &clk_reg_cbcr_type=""
    &clk_vote_bit=-1.
    &clk_multiplier=1.

    gosub Print_Clk_Info_Line
  )

  &match=0
  &wild_head=0
  &wild_tail=0
  &clk_input_length=STRING.LENGTH("&clk")
  &clk_itr_length=STRING.LENGTH("audio_core_qos_dmonitor_fixed_lat_counter_clk")

  if (STRING.SCAN("&clk", "*", 0)==0)
  (
    &wild_head=1
  )
  if (STRING.SCAN("&clk", "*", 1)==(STRING.LENGTH("&clk")-1))
  (
    &wild_tail=1
  )

  if ((&wild_head==1)&&(&wild_tail==1))
  (
    if (STRING.SCAN("audio_core_qos_dmonitor_fixed_lat_counter_clk", STRING.MID("&clk", 1, &clk_input_length-2), 0)!=-1)
    ( 
      &match=1
    )
  )
  else if (&wild_head==1)
  (
    if (STRING.MID("audio_core_qos_dmonitor_fixed_lat_counter_clk", &clk_itr_length-&clk_input_length+1, &clk_input_length-1)==STRING.CUT("&clk", 1))
    ( 
      &match=1
    )
  )
  else if (&wild_tail==1)
  (
    if (STRING.MID("audio_core_qos_dmonitor_fixed_lat_counter_clk", 0, &clk_input_length-1)==STRING.CUT("&clk", -1))
    ( 
      &match=1
    )
  )
  else if ("audio_core_qos_dmonitor_fixed_lat_counter_clk"=="&clk")
  (
    &match=1
  )
  
  if (&match==1)
  (
    &clk_test=&CLK_TEST_AUDIO_CORE_QOS_DMONITOR_FIXED_LAT_COUNTER_CLK
    &clk_reg=&MACRO_TOO_LONG_1
    &clk_reg_name="LPASS_AUDIO_CORE_QOS_DMONITOR_FIXED_LAT_COUNTER_CBCR"
    &clk_name="audio_core_qos_dmonitor_fixed_lat_counter_clk"
    &clk_reg_cbcr_type="sm_cbc"
    &clk_vote_bit=-1.
    &clk_multiplier=1.

    gosub Print_Clk_Info_Line
  )

  &match=0
  &wild_head=0
  &wild_tail=0
  &clk_input_length=STRING.LENGTH("&clk")
  &clk_itr_length=STRING.LENGTH("audio_wrapper_qos_danger_fixed_lat_counter_clk")

  if (STRING.SCAN("&clk", "*", 0)==0)
  (
    &wild_head=1
  )
  if (STRING.SCAN("&clk", "*", 1)==(STRING.LENGTH("&clk")-1))
  (
    &wild_tail=1
  )

  if ((&wild_head==1)&&(&wild_tail==1))
  (
    if (STRING.SCAN("audio_wrapper_qos_danger_fixed_lat_counter_clk", STRING.MID("&clk", 1, &clk_input_length-2), 0)!=-1)
    ( 
      &match=1
    )
  )
  else if (&wild_head==1)
  (
    if (STRING.MID("audio_wrapper_qos_danger_fixed_lat_counter_clk", &clk_itr_length-&clk_input_length+1, &clk_input_length-1)==STRING.CUT("&clk", 1))
    ( 
      &match=1
    )
  )
  else if (&wild_tail==1)
  (
    if (STRING.MID("audio_wrapper_qos_danger_fixed_lat_counter_clk", 0, &clk_input_length-1)==STRING.CUT("&clk", -1))
    ( 
      &match=1
    )
  )
  else if ("audio_wrapper_qos_danger_fixed_lat_counter_clk"=="&clk")
  (
    &match=1
  )
  
  if (&match==1)
  (
    &clk_test=&CLK_TEST_AUDIO_WRAPPER_QOS_DANGER_FIXED_LAT_COUNTER_CLK
    &clk_reg=&MACRO_TOO_LONG_2
    &clk_reg_name="LPASS_AUDIO_WRAPPER_QOS_DANGER_FIXED_LAT_COUNTER_CBCR"
    &clk_name="audio_wrapper_qos_danger_fixed_lat_counter_clk"
    &clk_reg_cbcr_type="sm_cbc"
    &clk_vote_bit=-1.
    &clk_multiplier=1.

    gosub Print_Clk_Info_Line
  )

  &match=0
  &wild_head=0
  &wild_tail=0
  &clk_input_length=STRING.LENGTH("&clk")
  &clk_itr_length=STRING.LENGTH("audio_wrapper_qos_dmonitor_fixed_lat_counter_clk")

  if (STRING.SCAN("&clk", "*", 0)==0)
  (
    &wild_head=1
  )
  if (STRING.SCAN("&clk", "*", 1)==(STRING.LENGTH("&clk")-1))
  (
    &wild_tail=1
  )

  if ((&wild_head==1)&&(&wild_tail==1))
  (
    if (STRING.SCAN("audio_wrapper_qos_dmonitor_fixed_lat_counter_clk", STRING.MID("&clk", 1, &clk_input_length-2), 0)!=-1)
    ( 
      &match=1
    )
  )
  else if (&wild_head==1)
  (
    if (STRING.MID("audio_wrapper_qos_dmonitor_fixed_lat_counter_clk", &clk_itr_length-&clk_input_length+1, &clk_input_length-1)==STRING.CUT("&clk", 1))
    ( 
      &match=1
    )
  )
  else if (&wild_tail==1)
  (
    if (STRING.MID("audio_wrapper_qos_dmonitor_fixed_lat_counter_clk", 0, &clk_input_length-1)==STRING.CUT("&clk", -1))
    ( 
      &match=1
    )
  )
  else if ("audio_wrapper_qos_dmonitor_fixed_lat_counter_clk"=="&clk")
  (
    &match=1
  )
  
  if (&match==1)
  (
    &clk_test=&CLK_TEST_AUDIO_WRAPPER_QOS_DMONITOR_FIXED_LAT_COUNTER_CLK
    &clk_reg=&MACRO_TOO_LONG_3
    &clk_reg_name="LPASS_AUDIO_WRAPPER_QOS_DMONITOR_FIXED_LAT_COUNTER_CBCR"
    &clk_name="audio_wrapper_qos_dmonitor_fixed_lat_counter_clk"
    &clk_reg_cbcr_type="sm_cbc"
    &clk_vote_bit=-1.
    &clk_multiplier=1.

    gosub Print_Clk_Info_Line
  )

  &match=0
  &wild_head=0
  &wild_tail=0
  &clk_input_length=STRING.LENGTH("&clk")
  &clk_itr_length=STRING.LENGTH("audio_core_lpaif_quad_ebit_clk")

  if (STRING.SCAN("&clk", "*", 0)==0)
  (
    &wild_head=1
  )
  if (STRING.SCAN("&clk", "*", 1)==(STRING.LENGTH("&clk")-1))
  (
    &wild_tail=1
  )

  if ((&wild_head==1)&&(&wild_tail==1))
  (
    if (STRING.SCAN("audio_core_lpaif_quad_ebit_clk", STRING.MID("&clk", 1, &clk_input_length-2), 0)!=-1)
    ( 
      &match=1
    )
  )
  else if (&wild_head==1)
  (
    if (STRING.MID("audio_core_lpaif_quad_ebit_clk", &clk_itr_length-&clk_input_length+1, &clk_input_length-1)==STRING.CUT("&clk", 1))
    ( 
      &match=1
    )
  )
  else if (&wild_tail==1)
  (
    if (STRING.MID("audio_core_lpaif_quad_ebit_clk", 0, &clk_input_length-1)==STRING.CUT("&clk", -1))
    ( 
      &match=1
    )
  )
  else if ("audio_core_lpaif_quad_ebit_clk"=="&clk")
  (
    &match=1
  )
  
  if (&match==1)
  (
    &clk_test=0
    &clk_reg=&HWIO_LPASS_AUDIO_CORE_LPAIF_QUAD_EBIT_CBCR_ADDR
    &clk_reg_name="LPASS_AUDIO_CORE_LPAIF_QUAD_EBIT_CBCR"
    &clk_name="audio_core_lpaif_quad_ebit_clk"
    &clk_reg_cbcr_type="sm_cbc"
    &clk_vote_bit=-1.
    &clk_multiplier=1.

    gosub Print_Clk_Info_Line
  )

  &match=0
  &wild_head=0
  &wild_tail=0
  &clk_input_length=STRING.LENGTH("&clk")
  &clk_itr_length=STRING.LENGTH("resampler_clk_src")

  if (STRING.SCAN("&clk", "*", 0)==0)
  (
    &wild_head=1
  )
  if (STRING.SCAN("&clk", "*", 1)==(STRING.LENGTH("&clk")-1))
  (
    &wild_tail=1
  )

  if ((&wild_head==1)&&(&wild_tail==1))
  (
    if (STRING.SCAN("resampler_clk_src", STRING.MID("&clk", 1, &clk_input_length-2), 0)!=-1)
    ( 
      &match=1
    )
  )
  else if (&wild_head==1)
  (
    if (STRING.MID("resampler_clk_src", &clk_itr_length-&clk_input_length+1, &clk_input_length-1)==STRING.CUT("&clk", 1))
    ( 
      &match=1
    )
  )
  else if (&wild_tail==1)
  (
    if (STRING.MID("resampler_clk_src", 0, &clk_input_length-1)==STRING.CUT("&clk", -1))
    ( 
      &match=1
    )
  )
  else if ("resampler_clk_src"=="&clk")
  (
    &match=1
  )
  
  if (&match==1)
  (
    &clk_test=&CLK_TEST_RESAMPLER_CLK_SRC
    &clk_reg=0
    &clk_reg_name="No CBCR"
    &clk_name="resampler_clk_src"
    &clk_reg_cbcr_type=""
    &clk_vote_bit=-1.
    &clk_multiplier=1.

    gosub Print_Clk_Info_Line
  )

  &match=0
  &wild_head=0
  &wild_tail=0
  &clk_input_length=STRING.LENGTH("&clk")
  &clk_itr_length=STRING.LENGTH("audio_core_resampler_core_clk")

  if (STRING.SCAN("&clk", "*", 0)==0)
  (
    &wild_head=1
  )
  if (STRING.SCAN("&clk", "*", 1)==(STRING.LENGTH("&clk")-1))
  (
    &wild_tail=1
  )

  if ((&wild_head==1)&&(&wild_tail==1))
  (
    if (STRING.SCAN("audio_core_resampler_core_clk", STRING.MID("&clk", 1, &clk_input_length-2), 0)!=-1)
    ( 
      &match=1
    )
  )
  else if (&wild_head==1)
  (
    if (STRING.MID("audio_core_resampler_core_clk", &clk_itr_length-&clk_input_length+1, &clk_input_length-1)==STRING.CUT("&clk", 1))
    ( 
      &match=1
    )
  )
  else if (&wild_tail==1)
  (
    if (STRING.MID("audio_core_resampler_core_clk", 0, &clk_input_length-1)==STRING.CUT("&clk", -1))
    ( 
      &match=1
    )
  )
  else if ("audio_core_resampler_core_clk"=="&clk")
  (
    &match=1
  )
  
  if (&match==1)
  (
    &clk_test=&CLK_TEST_AUDIO_CORE_RESAMPLER_CORE_CLK
    &clk_reg=&HWIO_LPASS_AUDIO_CORE_RESAMPLER_CBCR_ADDR
    &clk_reg_name="LPASS_AUDIO_CORE_RESAMPLER_CBCR"
    &clk_name="audio_core_resampler_core_clk"
    &clk_reg_cbcr_type="sm_pscbc"
    &clk_vote_bit=-1.
    &clk_multiplier=1.

    gosub Print_Clk_Info_Line
  )

  &match=0
  &wild_head=0
  &wild_tail=0
  &clk_input_length=STRING.LENGTH("&clk")
  &clk_itr_length=STRING.LENGTH("audio_core_lpaif_sec_ebit_clk")

  if (STRING.SCAN("&clk", "*", 0)==0)
  (
    &wild_head=1
  )
  if (STRING.SCAN("&clk", "*", 1)==(STRING.LENGTH("&clk")-1))
  (
    &wild_tail=1
  )

  if ((&wild_head==1)&&(&wild_tail==1))
  (
    if (STRING.SCAN("audio_core_lpaif_sec_ebit_clk", STRING.MID("&clk", 1, &clk_input_length-2), 0)!=-1)
    ( 
      &match=1
    )
  )
  else if (&wild_head==1)
  (
    if (STRING.MID("audio_core_lpaif_sec_ebit_clk", &clk_itr_length-&clk_input_length+1, &clk_input_length-1)==STRING.CUT("&clk", 1))
    ( 
      &match=1
    )
  )
  else if (&wild_tail==1)
  (
    if (STRING.MID("audio_core_lpaif_sec_ebit_clk", 0, &clk_input_length-1)==STRING.CUT("&clk", -1))
    ( 
      &match=1
    )
  )
  else if ("audio_core_lpaif_sec_ebit_clk"=="&clk")
  (
    &match=1
  )
  
  if (&match==1)
  (
    &clk_test=0
    &clk_reg=&HWIO_LPASS_AUDIO_CORE_LPAIF_SEC_EBIT_CBCR_ADDR
    &clk_reg_name="LPASS_AUDIO_CORE_LPAIF_SEC_EBIT_CBCR"
    &clk_name="audio_core_lpaif_sec_ebit_clk"
    &clk_reg_cbcr_type="sm_cbc"
    &clk_vote_bit=-1.
    &clk_multiplier=1.

    gosub Print_Clk_Info_Line
  )

  &match=0
  &wild_head=0
  &wild_tail=0
  &clk_input_length=STRING.LENGTH("&clk")
  &clk_itr_length=STRING.LENGTH("sleep_clk_src")

  if (STRING.SCAN("&clk", "*", 0)==0)
  (
    &wild_head=1
  )
  if (STRING.SCAN("&clk", "*", 1)==(STRING.LENGTH("&clk")-1))
  (
    &wild_tail=1
  )

  if ((&wild_head==1)&&(&wild_tail==1))
  (
    if (STRING.SCAN("sleep_clk_src", STRING.MID("&clk", 1, &clk_input_length-2), 0)!=-1)
    ( 
      &match=1
    )
  )
  else if (&wild_head==1)
  (
    if (STRING.MID("sleep_clk_src", &clk_itr_length-&clk_input_length+1, &clk_input_length-1)==STRING.CUT("&clk", 1))
    ( 
      &match=1
    )
  )
  else if (&wild_tail==1)
  (
    if (STRING.MID("sleep_clk_src", 0, &clk_input_length-1)==STRING.CUT("&clk", -1))
    ( 
      &match=1
    )
  )
  else if ("sleep_clk_src"=="&clk")
  (
    &match=1
  )
  
  if (&match==1)
  (
    &clk_test=&CLK_TEST_SLEEP_CLK_SRC
    &clk_reg=0
    &clk_reg_name="No CBCR"
    &clk_name="sleep_clk_src"
    &clk_reg_cbcr_type=""
    &clk_vote_bit=-1.
    &clk_multiplier=1.

    gosub Print_Clk_Info_Line
  )

  &match=0
  &wild_head=0
  &wild_tail=0
  &clk_input_length=STRING.LENGTH("&clk")
  &clk_itr_length=STRING.LENGTH("audio_core_bcr_slp_clk")

  if (STRING.SCAN("&clk", "*", 0)==0)
  (
    &wild_head=1
  )
  if (STRING.SCAN("&clk", "*", 1)==(STRING.LENGTH("&clk")-1))
  (
    &wild_tail=1
  )

  if ((&wild_head==1)&&(&wild_tail==1))
  (
    if (STRING.SCAN("audio_core_bcr_slp_clk", STRING.MID("&clk", 1, &clk_input_length-2), 0)!=-1)
    ( 
      &match=1
    )
  )
  else if (&wild_head==1)
  (
    if (STRING.MID("audio_core_bcr_slp_clk", &clk_itr_length-&clk_input_length+1, &clk_input_length-1)==STRING.CUT("&clk", 1))
    ( 
      &match=1
    )
  )
  else if (&wild_tail==1)
  (
    if (STRING.MID("audio_core_bcr_slp_clk", 0, &clk_input_length-1)==STRING.CUT("&clk", -1))
    ( 
      &match=1
    )
  )
  else if ("audio_core_bcr_slp_clk"=="&clk")
  (
    &match=1
  )
  
  if (&match==1)
  (
    &clk_test=&CLK_TEST_AUDIO_CORE_BCR_SLP_CLK
    &clk_reg=&HWIO_LPASS_AUDIO_CORE_BCR_SLP_CBCR_ADDR
    &clk_reg_name="LPASS_AUDIO_CORE_BCR_SLP_CBCR"
    &clk_name="audio_core_bcr_slp_clk"
    &clk_reg_cbcr_type="sm_cbc"
    &clk_vote_bit=-1.
    &clk_multiplier=1.

    gosub Print_Clk_Info_Line
  )

  &match=0
  &wild_head=0
  &wild_tail=0
  &clk_input_length=STRING.LENGTH("&clk")
  &clk_itr_length=STRING.LENGTH("q6ss_bcr_slp_clk")

  if (STRING.SCAN("&clk", "*", 0)==0)
  (
    &wild_head=1
  )
  if (STRING.SCAN("&clk", "*", 1)==(STRING.LENGTH("&clk")-1))
  (
    &wild_tail=1
  )

  if ((&wild_head==1)&&(&wild_tail==1))
  (
    if (STRING.SCAN("q6ss_bcr_slp_clk", STRING.MID("&clk", 1, &clk_input_length-2), 0)!=-1)
    ( 
      &match=1
    )
  )
  else if (&wild_head==1)
  (
    if (STRING.MID("q6ss_bcr_slp_clk", &clk_itr_length-&clk_input_length+1, &clk_input_length-1)==STRING.CUT("&clk", 1))
    ( 
      &match=1
    )
  )
  else if (&wild_tail==1)
  (
    if (STRING.MID("q6ss_bcr_slp_clk", 0, &clk_input_length-1)==STRING.CUT("&clk", -1))
    ( 
      &match=1
    )
  )
  else if ("q6ss_bcr_slp_clk"=="&clk")
  (
    &match=1
  )
  
  if (&match==1)
  (
    &clk_test=&CLK_TEST_Q6SS_BCR_SLP_CLK
    &clk_reg=&HWIO_LPASS_Q6SS_BCR_SLP_CBCR_ADDR
    &clk_reg_name="LPASS_Q6SS_BCR_SLP_CBCR"
    &clk_name="q6ss_bcr_slp_clk"
    &clk_reg_cbcr_type="sm_cbc"
    &clk_vote_bit=-1.
    &clk_multiplier=1.

    gosub Print_Clk_Info_Line
  )

  &match=0
  &wild_head=0
  &wild_tail=0
  &clk_input_length=STRING.LENGTH("&clk")
  &clk_itr_length=STRING.LENGTH("q6ss_slp_clk")

  if (STRING.SCAN("&clk", "*", 0)==0)
  (
    &wild_head=1
  )
  if (STRING.SCAN("&clk", "*", 1)==(STRING.LENGTH("&clk")-1))
  (
    &wild_tail=1
  )

  if ((&wild_head==1)&&(&wild_tail==1))
  (
    if (STRING.SCAN("q6ss_slp_clk", STRING.MID("&clk", 1, &clk_input_length-2), 0)!=-1)
    ( 
      &match=1
    )
  )
  else if (&wild_head==1)
  (
    if (STRING.MID("q6ss_slp_clk", &clk_itr_length-&clk_input_length+1, &clk_input_length-1)==STRING.CUT("&clk", 1))
    ( 
      &match=1
    )
  )
  else if (&wild_tail==1)
  (
    if (STRING.MID("q6ss_slp_clk", 0, &clk_input_length-1)==STRING.CUT("&clk", -1))
    ( 
      &match=1
    )
  )
  else if ("q6ss_slp_clk"=="&clk")
  (
    &match=1
  )
  
  if (&match==1)
  (
    &clk_test=0
    &clk_reg=&HWIO_LPASS_QDSP6SS_SLEEP_CBCR_ADDR
    &clk_reg_name="LPASS_QDSP6SS_SLEEP_CBCR"
    &clk_name="q6ss_slp_clk"
    &clk_reg_cbcr_type="sm_cbc"
    &clk_vote_bit=-1.
    &clk_multiplier=1.

    gosub Print_Clk_Info_Line
  )

  &match=0
  &wild_head=0
  &wild_tail=0
  &clk_input_length=STRING.LENGTH("&clk")
  &clk_itr_length=STRING.LENGTH("audio_core_lpaif_codec_spkr_ebit_clk")

  if (STRING.SCAN("&clk", "*", 0)==0)
  (
    &wild_head=1
  )
  if (STRING.SCAN("&clk", "*", 1)==(STRING.LENGTH("&clk")-1))
  (
    &wild_tail=1
  )

  if ((&wild_head==1)&&(&wild_tail==1))
  (
    if (STRING.SCAN("audio_core_lpaif_codec_spkr_ebit_clk", STRING.MID("&clk", 1, &clk_input_length-2), 0)!=-1)
    ( 
      &match=1
    )
  )
  else if (&wild_head==1)
  (
    if (STRING.MID("audio_core_lpaif_codec_spkr_ebit_clk", &clk_itr_length-&clk_input_length+1, &clk_input_length-1)==STRING.CUT("&clk", 1))
    ( 
      &match=1
    )
  )
  else if (&wild_tail==1)
  (
    if (STRING.MID("audio_core_lpaif_codec_spkr_ebit_clk", 0, &clk_input_length-1)==STRING.CUT("&clk", -1))
    ( 
      &match=1
    )
  )
  else if ("audio_core_lpaif_codec_spkr_ebit_clk"=="&clk")
  (
    &match=1
  )
  
  if (&match==1)
  (
    &clk_test=0
    &clk_reg=&HWIO_LPASS_AUDIO_CORE_LPAIF_CODEC_SPKR_EBIT_CBCR_ADDR
    &clk_reg_name="LPASS_AUDIO_CORE_LPAIF_CODEC_SPKR_EBIT_CBCR"
    &clk_name="audio_core_lpaif_codec_spkr_ebit_clk"
    &clk_reg_cbcr_type="sm_cbc"
    &clk_vote_bit=-1.
    &clk_multiplier=1.

    gosub Print_Clk_Info_Line
  )

  &match=0
  &wild_head=0
  &wild_tail=0
  &clk_input_length=STRING.LENGTH("&clk")
  &clk_itr_length=STRING.LENGTH("audio_core_lpaif_ter_ebit_clk")

  if (STRING.SCAN("&clk", "*", 0)==0)
  (
    &wild_head=1
  )
  if (STRING.SCAN("&clk", "*", 1)==(STRING.LENGTH("&clk")-1))
  (
    &wild_tail=1
  )

  if ((&wild_head==1)&&(&wild_tail==1))
  (
    if (STRING.SCAN("audio_core_lpaif_ter_ebit_clk", STRING.MID("&clk", 1, &clk_input_length-2), 0)!=-1)
    ( 
      &match=1
    )
  )
  else if (&wild_head==1)
  (
    if (STRING.MID("audio_core_lpaif_ter_ebit_clk", &clk_itr_length-&clk_input_length+1, &clk_input_length-1)==STRING.CUT("&clk", 1))
    ( 
      &match=1
    )
  )
  else if (&wild_tail==1)
  (
    if (STRING.MID("audio_core_lpaif_ter_ebit_clk", 0, &clk_input_length-1)==STRING.CUT("&clk", -1))
    ( 
      &match=1
    )
  )
  else if ("audio_core_lpaif_ter_ebit_clk"=="&clk")
  (
    &match=1
  )
  
  if (&match==1)
  (
    &clk_test=0
    &clk_reg=&HWIO_LPASS_AUDIO_CORE_LPAIF_TER_EBIT_CBCR_ADDR
    &clk_reg_name="LPASS_AUDIO_CORE_LPAIF_TER_EBIT_CBCR"
    &clk_name="audio_core_lpaif_ter_ebit_clk"
    &clk_reg_cbcr_type="sm_cbc"
    &clk_vote_bit=-1.
    &clk_multiplier=1.

    gosub Print_Clk_Info_Line
  )

  &match=0
  &wild_head=0
  &wild_tail=0
  &clk_input_length=STRING.LENGTH("&clk")
  &clk_itr_length=STRING.LENGTH("xo_clk_src")

  if (STRING.SCAN("&clk", "*", 0)==0)
  (
    &wild_head=1
  )
  if (STRING.SCAN("&clk", "*", 1)==(STRING.LENGTH("&clk")-1))
  (
    &wild_tail=1
  )

  if ((&wild_head==1)&&(&wild_tail==1))
  (
    if (STRING.SCAN("xo_clk_src", STRING.MID("&clk", 1, &clk_input_length-2), 0)!=-1)
    ( 
      &match=1
    )
  )
  else if (&wild_head==1)
  (
    if (STRING.MID("xo_clk_src", &clk_itr_length-&clk_input_length+1, &clk_input_length-1)==STRING.CUT("&clk", 1))
    ( 
      &match=1
    )
  )
  else if (&wild_tail==1)
  (
    if (STRING.MID("xo_clk_src", 0, &clk_input_length-1)==STRING.CUT("&clk", -1))
    ( 
      &match=1
    )
  )
  else if ("xo_clk_src"=="&clk")
  (
    &match=1
  )
  
  if (&match==1)
  (
    &clk_test=&CLK_TEST_XO_CLK_SRC
    &clk_reg=0
    &clk_reg_name="No CBCR"
    &clk_name="xo_clk_src"
    &clk_reg_cbcr_type=""
    &clk_vote_bit=-1.
    &clk_multiplier=1.

    gosub Print_Clk_Info_Line
  )

  &match=0
  &wild_head=0
  &wild_tail=0
  &clk_input_length=STRING.LENGTH("&clk")
  &clk_itr_length=STRING.LENGTH("audio_core_avsync_stc_xo_clk")

  if (STRING.SCAN("&clk", "*", 0)==0)
  (
    &wild_head=1
  )
  if (STRING.SCAN("&clk", "*", 1)==(STRING.LENGTH("&clk")-1))
  (
    &wild_tail=1
  )

  if ((&wild_head==1)&&(&wild_tail==1))
  (
    if (STRING.SCAN("audio_core_avsync_stc_xo_clk", STRING.MID("&clk", 1, &clk_input_length-2), 0)!=-1)
    ( 
      &match=1
    )
  )
  else if (&wild_head==1)
  (
    if (STRING.MID("audio_core_avsync_stc_xo_clk", &clk_itr_length-&clk_input_length+1, &clk_input_length-1)==STRING.CUT("&clk", 1))
    ( 
      &match=1
    )
  )
  else if (&wild_tail==1)
  (
    if (STRING.MID("audio_core_avsync_stc_xo_clk", 0, &clk_input_length-1)==STRING.CUT("&clk", -1))
    ( 
      &match=1
    )
  )
  else if ("audio_core_avsync_stc_xo_clk"=="&clk")
  (
    &match=1
  )
  
  if (&match==1)
  (
    &clk_test=&CLK_TEST_AUDIO_CORE_AVSYNC_STC_XO_CLK
    &clk_reg=&HWIO_LPASS_AUDIO_CORE_AVSYNC_STC_CBCR_ADDR
    &clk_reg_name="LPASS_AUDIO_CORE_AVSYNC_STC_CBCR"
    &clk_name="audio_core_avsync_stc_xo_clk"
    &clk_reg_cbcr_type="sm_cbc"
    &clk_vote_bit=-1.
    &clk_multiplier=1.

    gosub Print_Clk_Info_Line
  )

  &match=0
  &wild_head=0
  &wild_tail=0
  &clk_input_length=STRING.LENGTH("&clk")
  &clk_itr_length=STRING.LENGTH("audio_core_gdsc_xo_clk")

  if (STRING.SCAN("&clk", "*", 0)==0)
  (
    &wild_head=1
  )
  if (STRING.SCAN("&clk", "*", 1)==(STRING.LENGTH("&clk")-1))
  (
    &wild_tail=1
  )

  if ((&wild_head==1)&&(&wild_tail==1))
  (
    if (STRING.SCAN("audio_core_gdsc_xo_clk", STRING.MID("&clk", 1, &clk_input_length-2), 0)!=-1)
    ( 
      &match=1
    )
  )
  else if (&wild_head==1)
  (
    if (STRING.MID("audio_core_gdsc_xo_clk", &clk_itr_length-&clk_input_length+1, &clk_input_length-1)==STRING.CUT("&clk", 1))
    ( 
      &match=1
    )
  )
  else if (&wild_tail==1)
  (
    if (STRING.MID("audio_core_gdsc_xo_clk", 0, &clk_input_length-1)==STRING.CUT("&clk", -1))
    ( 
      &match=1
    )
  )
  else if ("audio_core_gdsc_xo_clk"=="&clk")
  (
    &match=1
  )
  
  if (&match==1)
  (
    &clk_test=&CLK_TEST_AUDIO_CORE_GDSC_XO_CLK
    &clk_reg=&HWIO_LPASS_AUDIO_CORE_GDSC_XO_CBCR_ADDR
    &clk_reg_name="LPASS_AUDIO_CORE_GDSC_XO_CBCR"
    &clk_name="audio_core_gdsc_xo_clk"
    &clk_reg_cbcr_type="sm_cbc"
    &clk_vote_bit=-1.
    &clk_multiplier=1.

    gosub Print_Clk_Info_Line
  )

  &match=0
  &wild_head=0
  &wild_tail=0
  &clk_input_length=STRING.LENGTH("&clk")
  &clk_itr_length=STRING.LENGTH("audio_wrapper_q6_smmu_gdsc_xo_clk")

  if (STRING.SCAN("&clk", "*", 0)==0)
  (
    &wild_head=1
  )
  if (STRING.SCAN("&clk", "*", 1)==(STRING.LENGTH("&clk")-1))
  (
    &wild_tail=1
  )

  if ((&wild_head==1)&&(&wild_tail==1))
  (
    if (STRING.SCAN("audio_wrapper_q6_smmu_gdsc_xo_clk", STRING.MID("&clk", 1, &clk_input_length-2), 0)!=-1)
    ( 
      &match=1
    )
  )
  else if (&wild_head==1)
  (
    if (STRING.MID("audio_wrapper_q6_smmu_gdsc_xo_clk", &clk_itr_length-&clk_input_length+1, &clk_input_length-1)==STRING.CUT("&clk", 1))
    ( 
      &match=1
    )
  )
  else if (&wild_tail==1)
  (
    if (STRING.MID("audio_wrapper_q6_smmu_gdsc_xo_clk", 0, &clk_input_length-1)==STRING.CUT("&clk", -1))
    ( 
      &match=1
    )
  )
  else if ("audio_wrapper_q6_smmu_gdsc_xo_clk"=="&clk")
  (
    &match=1
  )
  
  if (&match==1)
  (
    &clk_test=&CLK_TEST_AUDIO_WRAPPER_Q6_SMMU_GDSC_XO_CLK
    &clk_reg=&HWIO_LPASS_AUDIO_WRAPPER_Q6_SMMU_GDSC_XO_CBCR_ADDR
    &clk_reg_name="LPASS_AUDIO_WRAPPER_Q6_SMMU_GDSC_XO_CBCR"
    &clk_name="audio_wrapper_q6_smmu_gdsc_xo_clk"
    &clk_reg_cbcr_type="sm_cbc"
    &clk_vote_bit=-1.
    &clk_multiplier=1.

    gosub Print_Clk_Info_Line
  )

  &match=0
  &wild_head=0
  &wild_tail=0
  &clk_input_length=STRING.LENGTH("&clk")
  &clk_itr_length=STRING.LENGTH("audio_wrapper_qos_xo_lat_counter_clk")

  if (STRING.SCAN("&clk", "*", 0)==0)
  (
    &wild_head=1
  )
  if (STRING.SCAN("&clk", "*", 1)==(STRING.LENGTH("&clk")-1))
  (
    &wild_tail=1
  )

  if ((&wild_head==1)&&(&wild_tail==1))
  (
    if (STRING.SCAN("audio_wrapper_qos_xo_lat_counter_clk", STRING.MID("&clk", 1, &clk_input_length-2), 0)!=-1)
    ( 
      &match=1
    )
  )
  else if (&wild_head==1)
  (
    if (STRING.MID("audio_wrapper_qos_xo_lat_counter_clk", &clk_itr_length-&clk_input_length+1, &clk_input_length-1)==STRING.CUT("&clk", 1))
    ( 
      &match=1
    )
  )
  else if (&wild_tail==1)
  (
    if (STRING.MID("audio_wrapper_qos_xo_lat_counter_clk", 0, &clk_input_length-1)==STRING.CUT("&clk", -1))
    ( 
      &match=1
    )
  )
  else if ("audio_wrapper_qos_xo_lat_counter_clk"=="&clk")
  (
    &match=1
  )
  
  if (&match==1)
  (
    &clk_test=&CLK_TEST_AUDIO_WRAPPER_QOS_XO_LAT_COUNTER_CLK
    &clk_reg=&HWIO_LPASS_AUDIO_WRAPPER_QOS_XO_LAT_COUNTER_CBCR_ADDR
    &clk_reg_name="LPASS_AUDIO_WRAPPER_QOS_XO_LAT_COUNTER_CBCR"
    &clk_name="audio_wrapper_qos_xo_lat_counter_clk"
    &clk_reg_cbcr_type="sm_cbc"
    &clk_vote_bit=-1.
    &clk_multiplier=1.

    gosub Print_Clk_Info_Line
  )

  &match=0
  &wild_head=0
  &wild_tail=0
  &clk_input_length=STRING.LENGTH("&clk")
  &clk_itr_length=STRING.LENGTH("q6ss_xo_clk")

  if (STRING.SCAN("&clk", "*", 0)==0)
  (
    &wild_head=1
  )
  if (STRING.SCAN("&clk", "*", 1)==(STRING.LENGTH("&clk")-1))
  (
    &wild_tail=1
  )

  if ((&wild_head==1)&&(&wild_tail==1))
  (
    if (STRING.SCAN("q6ss_xo_clk", STRING.MID("&clk", 1, &clk_input_length-2), 0)!=-1)
    ( 
      &match=1
    )
  )
  else if (&wild_head==1)
  (
    if (STRING.MID("q6ss_xo_clk", &clk_itr_length-&clk_input_length+1, &clk_input_length-1)==STRING.CUT("&clk", 1))
    ( 
      &match=1
    )
  )
  else if (&wild_tail==1)
  (
    if (STRING.MID("q6ss_xo_clk", 0, &clk_input_length-1)==STRING.CUT("&clk", -1))
    ( 
      &match=1
    )
  )
  else if ("q6ss_xo_clk"=="&clk")
  (
    &match=1
  )
  
  if (&match==1)
  (
    &clk_test=0
    &clk_reg=&HWIO_LPASS_QDSP6SS_XO_CBCR_ADDR
    &clk_reg_name="LPASS_QDSP6SS_XO_CBCR"
    &clk_name="q6ss_xo_clk"
    &clk_reg_cbcr_type="sm_cbc"
    &clk_vote_bit=-1.
    &clk_multiplier=1.

    gosub Print_Clk_Info_Line
  )

  &match=0
  &wild_head=0
  &wild_tail=0
  &clk_input_length=STRING.LENGTH("&clk")
  &clk_itr_length=STRING.LENGTH("lpass_qdsp6ss_q6_core_clk")

  if (STRING.SCAN("&clk", "*", 0)==0)
  (
    &wild_head=1
  )
  if (STRING.SCAN("&clk", "*", 1)==(STRING.LENGTH("&clk")-1))
  (
    &wild_tail=1
  )

  if ((&wild_head==1)&&(&wild_tail==1))
  (
    if (STRING.SCAN("lpass_qdsp6ss_q6_core_clk", STRING.MID("&clk", 1, &clk_input_length-2), 0)!=-1)
    ( 
      &match=1
    )
  )
  else if (&wild_head==1)
  (
    if (STRING.MID("lpass_qdsp6ss_q6_core_clk", &clk_itr_length-&clk_input_length+1, &clk_input_length-1)==STRING.CUT("&clk", 1))
    ( 
      &match=1
    )
  )
  else if (&wild_tail==1)
  (
    if (STRING.MID("lpass_qdsp6ss_q6_core_clk", 0, &clk_input_length-1)==STRING.CUT("&clk", -1))
    ( 
      &match=1
    )
  )
  else if ("lpass_qdsp6ss_q6_core_clk"=="&clk")||("cpus"=="&clk")
  (
    &match=1
  )
  
  if (&match==1)
  (
    &clk_test=&CLK_TEST_LPASS_QDSP6SS_Q6_CORE_CLK
    &clk_reg=0
    &clk_reg_name="No CBCR"
    &clk_name="lpass_qdsp6ss_q6_core_clk"
    &clk_reg_cbcr_type=""
    &clk_vote_bit=-1.
    &clk_multiplier=1.

    gosub Print_Clk_Info_Line
  )

  &match=0
  &wild_head=0
  &wild_tail=0
  &clk_input_length=STRING.LENGTH("&clk")
  &clk_itr_length=STRING.LENGTH("lpass_qdsp6ss_axi_m_clk")

  if (STRING.SCAN("&clk", "*", 0)==0)
  (
    &wild_head=1
  )
  if (STRING.SCAN("&clk", "*", 1)==(STRING.LENGTH("&clk")-1))
  (
    &wild_tail=1
  )

  if ((&wild_head==1)&&(&wild_tail==1))
  (
    if (STRING.SCAN("lpass_qdsp6ss_axi_m_clk", STRING.MID("&clk", 1, &clk_input_length-2), 0)!=-1)
    ( 
      &match=1
    )
  )
  else if (&wild_head==1)
  (
    if (STRING.MID("lpass_qdsp6ss_axi_m_clk", &clk_itr_length-&clk_input_length+1, &clk_input_length-1)==STRING.CUT("&clk", 1))
    ( 
      &match=1
    )
  )
  else if (&wild_tail==1)
  (
    if (STRING.MID("lpass_qdsp6ss_axi_m_clk", 0, &clk_input_length-1)==STRING.CUT("&clk", -1))
    ( 
      &match=1
    )
  )
  else if ("lpass_qdsp6ss_axi_m_clk"=="&clk")
  (
    &match=1
  )
  
  if (&match==1)
  (
    &clk_test=&CLK_TEST_LPASS_QDSP6SS_AXI_M_CLK
    &clk_reg=0
    &clk_reg_name="No CBCR"
    &clk_name="lpass_qdsp6ss_axi_m_clk"
    &clk_reg_cbcr_type=""
    &clk_vote_bit=-1.
    &clk_multiplier=1.

    gosub Print_Clk_Info_Line
  )

  &match=0
  &wild_head=0
  &wild_tail=0
  &clk_input_length=STRING.LENGTH("&clk")
  &clk_itr_length=STRING.LENGTH("lpass_qdsp6ss_ldo_nmo_out")

  if (STRING.SCAN("&clk", "*", 0)==0)
  (
    &wild_head=1
  )
  if (STRING.SCAN("&clk", "*", 1)==(STRING.LENGTH("&clk")-1))
  (
    &wild_tail=1
  )

  if ((&wild_head==1)&&(&wild_tail==1))
  (
    if (STRING.SCAN("lpass_qdsp6ss_ldo_nmo_out", STRING.MID("&clk", 1, &clk_input_length-2), 0)!=-1)
    ( 
      &match=1
    )
  )
  else if (&wild_head==1)
  (
    if (STRING.MID("lpass_qdsp6ss_ldo_nmo_out", &clk_itr_length-&clk_input_length+1, &clk_input_length-1)==STRING.CUT("&clk", 1))
    ( 
      &match=1
    )
  )
  else if (&wild_tail==1)
  (
    if (STRING.MID("lpass_qdsp6ss_ldo_nmo_out", 0, &clk_input_length-1)==STRING.CUT("&clk", -1))
    ( 
      &match=1
    )
  )
  else if ("lpass_qdsp6ss_ldo_nmo_out"=="&clk")
  (
    &match=1
  )
  
  if (&match==1)
  (
    &clk_test=&CLK_TEST_LPASS_QDSP6SS_LDO_NMO_OUT
    &clk_reg=0
    &clk_reg_name="No CBCR"
    &clk_name="lpass_qdsp6ss_ldo_nmo_out"
    &clk_reg_cbcr_type=""
    &clk_vote_bit=-1.
    &clk_multiplier=1.

    gosub Print_Clk_Info_Line
  )

  &match=0
  &wild_head=0
  &wild_tail=0
  &clk_input_length=STRING.LENGTH("&clk")
  &clk_itr_length=STRING.LENGTH("lpass_qdsp6ss_ahb_m_clk")

  if (STRING.SCAN("&clk", "*", 0)==0)
  (
    &wild_head=1
  )
  if (STRING.SCAN("&clk", "*", 1)==(STRING.LENGTH("&clk")-1))
  (
    &wild_tail=1
  )

  if ((&wild_head==1)&&(&wild_tail==1))
  (
    if (STRING.SCAN("lpass_qdsp6ss_ahb_m_clk", STRING.MID("&clk", 1, &clk_input_length-2), 0)!=-1)
    ( 
      &match=1
    )
  )
  else if (&wild_head==1)
  (
    if (STRING.MID("lpass_qdsp6ss_ahb_m_clk", &clk_itr_length-&clk_input_length+1, &clk_input_length-1)==STRING.CUT("&clk", 1))
    ( 
      &match=1
    )
  )
  else if (&wild_tail==1)
  (
    if (STRING.MID("lpass_qdsp6ss_ahb_m_clk", 0, &clk_input_length-1)==STRING.CUT("&clk", -1))
    ( 
      &match=1
    )
  )
  else if ("lpass_qdsp6ss_ahb_m_clk"=="&clk")
  (
    &match=1
  )
  
  if (&match==1)
  (
    &clk_test=&CLK_TEST_LPASS_QDSP6SS_AHB_M_CLK
    &clk_reg=0
    &clk_reg_name="No CBCR"
    &clk_name="lpass_qdsp6ss_ahb_m_clk"
    &clk_reg_cbcr_type=""
    &clk_vote_bit=-1.
    &clk_multiplier=1.

    gosub Print_Clk_Info_Line
  )

  &match=0
  &wild_head=0
  &wild_tail=0
  &clk_input_length=STRING.LENGTH("&clk")
  &clk_itr_length=STRING.LENGTH("lpass_qdsp6ss_ahb_s_clk")

  if (STRING.SCAN("&clk", "*", 0)==0)
  (
    &wild_head=1
  )
  if (STRING.SCAN("&clk", "*", 1)==(STRING.LENGTH("&clk")-1))
  (
    &wild_tail=1
  )

  if ((&wild_head==1)&&(&wild_tail==1))
  (
    if (STRING.SCAN("lpass_qdsp6ss_ahb_s_clk", STRING.MID("&clk", 1, &clk_input_length-2), 0)!=-1)
    ( 
      &match=1
    )
  )
  else if (&wild_head==1)
  (
    if (STRING.MID("lpass_qdsp6ss_ahb_s_clk", &clk_itr_length-&clk_input_length+1, &clk_input_length-1)==STRING.CUT("&clk", 1))
    ( 
      &match=1
    )
  )
  else if (&wild_tail==1)
  (
    if (STRING.MID("lpass_qdsp6ss_ahb_s_clk", 0, &clk_input_length-1)==STRING.CUT("&clk", -1))
    ( 
      &match=1
    )
  )
  else if ("lpass_qdsp6ss_ahb_s_clk"=="&clk")
  (
    &match=1
  )
  
  if (&match==1)
  (
    &clk_test=&CLK_TEST_LPASS_QDSP6SS_AHB_S_CLK
    &clk_reg=0
    &clk_reg_name="No CBCR"
    &clk_name="lpass_qdsp6ss_ahb_s_clk"
    &clk_reg_cbcr_type=""
    &clk_vote_bit=-1.
    &clk_multiplier=1.

    gosub Print_Clk_Info_Line
  )

  &match=0
  &wild_head=0
  &wild_tail=0
  &clk_input_length=STRING.LENGTH("&clk")
  &clk_itr_length=STRING.LENGTH("lpass_qdsp6ss_xo_clk")

  if (STRING.SCAN("&clk", "*", 0)==0)
  (
    &wild_head=1
  )
  if (STRING.SCAN("&clk", "*", 1)==(STRING.LENGTH("&clk")-1))
  (
    &wild_tail=1
  )

  if ((&wild_head==1)&&(&wild_tail==1))
  (
    if (STRING.SCAN("lpass_qdsp6ss_xo_clk", STRING.MID("&clk", 1, &clk_input_length-2), 0)!=-1)
    ( 
      &match=1
    )
  )
  else if (&wild_head==1)
  (
    if (STRING.MID("lpass_qdsp6ss_xo_clk", &clk_itr_length-&clk_input_length+1, &clk_input_length-1)==STRING.CUT("&clk", 1))
    ( 
      &match=1
    )
  )
  else if (&wild_tail==1)
  (
    if (STRING.MID("lpass_qdsp6ss_xo_clk", 0, &clk_input_length-1)==STRING.CUT("&clk", -1))
    ( 
      &match=1
    )
  )
  else if ("lpass_qdsp6ss_xo_clk"=="&clk")
  (
    &match=1
  )
  
  if (&match==1)
  (
    &clk_test=&CLK_TEST_LPASS_QDSP6SS_XO_CLK
    &clk_reg=0
    &clk_reg_name="No CBCR"
    &clk_name="lpass_qdsp6ss_xo_clk"
    &clk_reg_cbcr_type=""
    &clk_vote_bit=-1.
    &clk_multiplier=1.

    gosub Print_Clk_Info_Line
  )

  &match=0
  &wild_head=0
  &wild_tail=0
  &clk_input_length=STRING.LENGTH("&clk")
  &clk_itr_length=STRING.LENGTH("lpass_qdsp6ss_sleep_clk")

  if (STRING.SCAN("&clk", "*", 0)==0)
  (
    &wild_head=1
  )
  if (STRING.SCAN("&clk", "*", 1)==(STRING.LENGTH("&clk")-1))
  (
    &wild_tail=1
  )

  if ((&wild_head==1)&&(&wild_tail==1))
  (
    if (STRING.SCAN("lpass_qdsp6ss_sleep_clk", STRING.MID("&clk", 1, &clk_input_length-2), 0)!=-1)
    ( 
      &match=1
    )
  )
  else if (&wild_head==1)
  (
    if (STRING.MID("lpass_qdsp6ss_sleep_clk", &clk_itr_length-&clk_input_length+1, &clk_input_length-1)==STRING.CUT("&clk", 1))
    ( 
      &match=1
    )
  )
  else if (&wild_tail==1)
  (
    if (STRING.MID("lpass_qdsp6ss_sleep_clk", 0, &clk_input_length-1)==STRING.CUT("&clk", -1))
    ( 
      &match=1
    )
  )
  else if ("lpass_qdsp6ss_sleep_clk"=="&clk")
  (
    &match=1
  )
  
  if (&match==1)
  (
    &clk_test=&CLK_TEST_LPASS_QDSP6SS_SLEEP_CLK
    &clk_reg=0
    &clk_reg_name="No CBCR"
    &clk_name="lpass_qdsp6ss_sleep_clk"
    &clk_reg_cbcr_type=""
    &clk_vote_bit=-1.
    &clk_multiplier=1.

    gosub Print_Clk_Info_Line
  )

  &match=0
  &wild_head=0
  &wild_tail=0
  &clk_input_length=STRING.LENGTH("&clk")
  &clk_itr_length=STRING.LENGTH("lpass_qdsp6ss_jtag_tck")

  if (STRING.SCAN("&clk", "*", 0)==0)
  (
    &wild_head=1
  )
  if (STRING.SCAN("&clk", "*", 1)==(STRING.LENGTH("&clk")-1))
  (
    &wild_tail=1
  )

  if ((&wild_head==1)&&(&wild_tail==1))
  (
    if (STRING.SCAN("lpass_qdsp6ss_jtag_tck", STRING.MID("&clk", 1, &clk_input_length-2), 0)!=-1)
    ( 
      &match=1
    )
  )
  else if (&wild_head==1)
  (
    if (STRING.MID("lpass_qdsp6ss_jtag_tck", &clk_itr_length-&clk_input_length+1, &clk_input_length-1)==STRING.CUT("&clk", 1))
    ( 
      &match=1
    )
  )
  else if (&wild_tail==1)
  (
    if (STRING.MID("lpass_qdsp6ss_jtag_tck", 0, &clk_input_length-1)==STRING.CUT("&clk", -1))
    ( 
      &match=1
    )
  )
  else if ("lpass_qdsp6ss_jtag_tck"=="&clk")
  (
    &match=1
  )
  
  if (&match==1)
  (
    &clk_test=&CLK_TEST_LPASS_QDSP6SS_JTAG_TCK
    &clk_reg=0
    &clk_reg_name="No CBCR"
    &clk_name="lpass_qdsp6ss_jtag_tck"
    &clk_reg_cbcr_type=""
    &clk_vote_bit=-1.
    &clk_multiplier=1.

    gosub Print_Clk_Info_Line
  )

  &match=0
  &wild_head=0
  &wild_tail=0
  &clk_input_length=STRING.LENGTH("&clk")
  &clk_itr_length=STRING.LENGTH("lpass_qdsp6ss_atb_clk")

  if (STRING.SCAN("&clk", "*", 0)==0)
  (
    &wild_head=1
  )
  if (STRING.SCAN("&clk", "*", 1)==(STRING.LENGTH("&clk")-1))
  (
    &wild_tail=1
  )

  if ((&wild_head==1)&&(&wild_tail==1))
  (
    if (STRING.SCAN("lpass_qdsp6ss_atb_clk", STRING.MID("&clk", 1, &clk_input_length-2), 0)!=-1)
    ( 
      &match=1
    )
  )
  else if (&wild_head==1)
  (
    if (STRING.MID("lpass_qdsp6ss_atb_clk", &clk_itr_length-&clk_input_length+1, &clk_input_length-1)==STRING.CUT("&clk", 1))
    ( 
      &match=1
    )
  )
  else if (&wild_tail==1)
  (
    if (STRING.MID("lpass_qdsp6ss_atb_clk", 0, &clk_input_length-1)==STRING.CUT("&clk", -1))
    ( 
      &match=1
    )
  )
  else if ("lpass_qdsp6ss_atb_clk"=="&clk")
  (
    &match=1
  )
  
  if (&match==1)
  (
    &clk_test=&CLK_TEST_LPASS_QDSP6SS_ATB_CLK
    &clk_reg=0
    &clk_reg_name="No CBCR"
    &clk_name="lpass_qdsp6ss_atb_clk"
    &clk_reg_cbcr_type=""
    &clk_vote_bit=-1.
    &clk_multiplier=1.

    gosub Print_Clk_Info_Line
  )

  &match=0
  &wild_head=0
  &wild_tail=0
  &clk_input_length=STRING.LENGTH("&clk")
  &clk_itr_length=STRING.LENGTH("lpass_qdsp6ss_apb_clk")

  if (STRING.SCAN("&clk", "*", 0)==0)
  (
    &wild_head=1
  )
  if (STRING.SCAN("&clk", "*", 1)==(STRING.LENGTH("&clk")-1))
  (
    &wild_tail=1
  )

  if ((&wild_head==1)&&(&wild_tail==1))
  (
    if (STRING.SCAN("lpass_qdsp6ss_apb_clk", STRING.MID("&clk", 1, &clk_input_length-2), 0)!=-1)
    ( 
      &match=1
    )
  )
  else if (&wild_head==1)
  (
    if (STRING.MID("lpass_qdsp6ss_apb_clk", &clk_itr_length-&clk_input_length+1, &clk_input_length-1)==STRING.CUT("&clk", 1))
    ( 
      &match=1
    )
  )
  else if (&wild_tail==1)
  (
    if (STRING.MID("lpass_qdsp6ss_apb_clk", 0, &clk_input_length-1)==STRING.CUT("&clk", -1))
    ( 
      &match=1
    )
  )
  else if ("lpass_qdsp6ss_apb_clk"=="&clk")
  (
    &match=1
  )
  
  if (&match==1)
  (
    &clk_test=&CLK_TEST_LPASS_QDSP6SS_APB_CLK
    &clk_reg=0
    &clk_reg_name="No CBCR"
    &clk_name="lpass_qdsp6ss_apb_clk"
    &clk_reg_cbcr_type=""
    &clk_vote_bit=-1.
    &clk_multiplier=1.

    gosub Print_Clk_Info_Line
  )

  &match=0
  &wild_head=0
  &wild_tail=0
  &clk_input_length=STRING.LENGTH("&clk")
  &clk_itr_length=STRING.LENGTH("lpass_qdsp6ss_timestamp_clk")

  if (STRING.SCAN("&clk", "*", 0)==0)
  (
    &wild_head=1
  )
  if (STRING.SCAN("&clk", "*", 1)==(STRING.LENGTH("&clk")-1))
  (
    &wild_tail=1
  )

  if ((&wild_head==1)&&(&wild_tail==1))
  (
    if (STRING.SCAN("lpass_qdsp6ss_timestamp_clk", STRING.MID("&clk", 1, &clk_input_length-2), 0)!=-1)
    ( 
      &match=1
    )
  )
  else if (&wild_head==1)
  (
    if (STRING.MID("lpass_qdsp6ss_timestamp_clk", &clk_itr_length-&clk_input_length+1, &clk_input_length-1)==STRING.CUT("&clk", 1))
    ( 
      &match=1
    )
  )
  else if (&wild_tail==1)
  (
    if (STRING.MID("lpass_qdsp6ss_timestamp_clk", 0, &clk_input_length-1)==STRING.CUT("&clk", -1))
    ( 
      &match=1
    )
  )
  else if ("lpass_qdsp6ss_timestamp_clk"=="&clk")
  (
    &match=1
  )
  
  if (&match==1)
  (
    &clk_test=&CLK_TEST_LPASS_QDSP6SS_TIMESTAMP_CLK
    &clk_reg=0
    &clk_reg_name="No CBCR"
    &clk_name="lpass_qdsp6ss_timestamp_clk"
    &clk_reg_cbcr_type=""
    &clk_vote_bit=-1.
    &clk_multiplier=1.

    gosub Print_Clk_Info_Line
  )


  ; Set appropriate access mode for MMSS registers 
  &clk_access_mode="&mmss_access_mode"

  &match=0
  &wild_head=0
  &wild_tail=0
  &clk_input_length=STRING.LENGTH("&clk")
  &clk_itr_length=STRING.LENGTH("camss_ahb_clk")

  if (STRING.SCAN("&clk", "*", 0)==0)
  (
    &wild_head=1
  )
  if (STRING.SCAN("&clk", "*", 1)==(STRING.LENGTH("&clk")-1))
  (
    &wild_tail=1
  )

  if ((&wild_head==1)&&(&wild_tail==1))
  (
    if (STRING.SCAN("camss_ahb_clk", STRING.MID("&clk", 1, &clk_input_length-2), 0)!=-1)
    ( 
      &match=1
    )
  )
  else if (&wild_head==1)
  (
    if (STRING.MID("camss_ahb_clk", &clk_itr_length-&clk_input_length+1, &clk_input_length-1)==STRING.CUT("&clk", 1))
    ( 
      &match=1
    )
  )
  else if (&wild_tail==1)
  (
    if (STRING.MID("camss_ahb_clk", 0, &clk_input_length-1)==STRING.CUT("&clk", -1))
    ( 
      &match=1
    )
  )
  else if ("camss_ahb_clk"=="&clk")
  (
    &match=1
  )
  
  if (&match==1)
  (
    &clk_test=&CLK_TEST_CAMSS_AHB_CLK
    &clk_reg=&HWIO_MMSS_CAMSS_AHB_CBCR_ADDR
    &clk_reg_name="MMSS_CAMSS_AHB_CBCR"
    &clk_name="camss_ahb_clk"
    &clk_reg_cbcr_type="sm_cbc"
    &clk_vote_bit=-1.
    &clk_multiplier=3.

    gosub Print_Clk_Info_Line
  )

  &match=0
  &wild_head=0
  &wild_tail=0
  &clk_input_length=STRING.LENGTH("&clk")
  &clk_itr_length=STRING.LENGTH("camss_cci_ahb_clk")

  if (STRING.SCAN("&clk", "*", 0)==0)
  (
    &wild_head=1
  )
  if (STRING.SCAN("&clk", "*", 1)==(STRING.LENGTH("&clk")-1))
  (
    &wild_tail=1
  )

  if ((&wild_head==1)&&(&wild_tail==1))
  (
    if (STRING.SCAN("camss_cci_ahb_clk", STRING.MID("&clk", 1, &clk_input_length-2), 0)!=-1)
    ( 
      &match=1
    )
  )
  else if (&wild_head==1)
  (
    if (STRING.MID("camss_cci_ahb_clk", &clk_itr_length-&clk_input_length+1, &clk_input_length-1)==STRING.CUT("&clk", 1))
    ( 
      &match=1
    )
  )
  else if (&wild_tail==1)
  (
    if (STRING.MID("camss_cci_ahb_clk", 0, &clk_input_length-1)==STRING.CUT("&clk", -1))
    ( 
      &match=1
    )
  )
  else if ("camss_cci_ahb_clk"=="&clk")
  (
    &match=1
  )
  
  if (&match==1)
  (
    &clk_test=&CLK_TEST_CAMSS_CCI_AHB_CLK
    &clk_reg=&HWIO_MMSS_CAMSS_CCI_AHB_CBCR_ADDR
    &clk_reg_name="MMSS_CAMSS_CCI_AHB_CBCR"
    &clk_name="camss_cci_ahb_clk"
    &clk_reg_cbcr_type="sm_cbc"
    &clk_vote_bit=-1.
    &clk_multiplier=3.

    gosub Print_Clk_Info_Line
  )

  &match=0
  &wild_head=0
  &wild_tail=0
  &clk_input_length=STRING.LENGTH("&clk")
  &clk_itr_length=STRING.LENGTH("camss_cpp_ahb_clk")

  if (STRING.SCAN("&clk", "*", 0)==0)
  (
    &wild_head=1
  )
  if (STRING.SCAN("&clk", "*", 1)==(STRING.LENGTH("&clk")-1))
  (
    &wild_tail=1
  )

  if ((&wild_head==1)&&(&wild_tail==1))
  (
    if (STRING.SCAN("camss_cpp_ahb_clk", STRING.MID("&clk", 1, &clk_input_length-2), 0)!=-1)
    ( 
      &match=1
    )
  )
  else if (&wild_head==1)
  (
    if (STRING.MID("camss_cpp_ahb_clk", &clk_itr_length-&clk_input_length+1, &clk_input_length-1)==STRING.CUT("&clk", 1))
    ( 
      &match=1
    )
  )
  else if (&wild_tail==1)
  (
    if (STRING.MID("camss_cpp_ahb_clk", 0, &clk_input_length-1)==STRING.CUT("&clk", -1))
    ( 
      &match=1
    )
  )
  else if ("camss_cpp_ahb_clk"=="&clk")
  (
    &match=1
  )
  
  if (&match==1)
  (
    &clk_test=&CLK_TEST_CAMSS_CPP_AHB_CLK
    &clk_reg=&HWIO_MMSS_CAMSS_CPP_AHB_CBCR_ADDR
    &clk_reg_name="MMSS_CAMSS_CPP_AHB_CBCR"
    &clk_name="camss_cpp_ahb_clk"
    &clk_reg_cbcr_type="sm_cbc"
    &clk_vote_bit=-1.
    &clk_multiplier=3.

    gosub Print_Clk_Info_Line
  )

  &match=0
  &wild_head=0
  &wild_tail=0
  &clk_input_length=STRING.LENGTH("&clk")
  &clk_itr_length=STRING.LENGTH("camss_cpp_vbif_ahb_clk")

  if (STRING.SCAN("&clk", "*", 0)==0)
  (
    &wild_head=1
  )
  if (STRING.SCAN("&clk", "*", 1)==(STRING.LENGTH("&clk")-1))
  (
    &wild_tail=1
  )

  if ((&wild_head==1)&&(&wild_tail==1))
  (
    if (STRING.SCAN("camss_cpp_vbif_ahb_clk", STRING.MID("&clk", 1, &clk_input_length-2), 0)!=-1)
    ( 
      &match=1
    )
  )
  else if (&wild_head==1)
  (
    if (STRING.MID("camss_cpp_vbif_ahb_clk", &clk_itr_length-&clk_input_length+1, &clk_input_length-1)==STRING.CUT("&clk", 1))
    ( 
      &match=1
    )
  )
  else if (&wild_tail==1)
  (
    if (STRING.MID("camss_cpp_vbif_ahb_clk", 0, &clk_input_length-1)==STRING.CUT("&clk", -1))
    ( 
      &match=1
    )
  )
  else if ("camss_cpp_vbif_ahb_clk"=="&clk")
  (
    &match=1
  )
  
  if (&match==1)
  (
    &clk_test=&CLK_TEST_CAMSS_CPP_VBIF_AHB_CLK
    &clk_reg=&HWIO_MMSS_CAMSS_CPP_VBIF_AHB_CBCR_ADDR
    &clk_reg_name="MMSS_CAMSS_CPP_VBIF_AHB_CBCR"
    &clk_name="camss_cpp_vbif_ahb_clk"
    &clk_reg_cbcr_type="sm_cbc"
    &clk_vote_bit=-1.
    &clk_multiplier=3.

    gosub Print_Clk_Info_Line
  )

  &match=0
  &wild_head=0
  &wild_tail=0
  &clk_input_length=STRING.LENGTH("&clk")
  &clk_itr_length=STRING.LENGTH("camss_csi0_ahb_clk")

  if (STRING.SCAN("&clk", "*", 0)==0)
  (
    &wild_head=1
  )
  if (STRING.SCAN("&clk", "*", 1)==(STRING.LENGTH("&clk")-1))
  (
    &wild_tail=1
  )

  if ((&wild_head==1)&&(&wild_tail==1))
  (
    if (STRING.SCAN("camss_csi0_ahb_clk", STRING.MID("&clk", 1, &clk_input_length-2), 0)!=-1)
    ( 
      &match=1
    )
  )
  else if (&wild_head==1)
  (
    if (STRING.MID("camss_csi0_ahb_clk", &clk_itr_length-&clk_input_length+1, &clk_input_length-1)==STRING.CUT("&clk", 1))
    ( 
      &match=1
    )
  )
  else if (&wild_tail==1)
  (
    if (STRING.MID("camss_csi0_ahb_clk", 0, &clk_input_length-1)==STRING.CUT("&clk", -1))
    ( 
      &match=1
    )
  )
  else if ("camss_csi0_ahb_clk"=="&clk")
  (
    &match=1
  )
  
  if (&match==1)
  (
    &clk_test=&CLK_TEST_CAMSS_CSI0_AHB_CLK
    &clk_reg=&HWIO_MMSS_CAMSS_CSI0_AHB_CBCR_ADDR
    &clk_reg_name="MMSS_CAMSS_CSI0_AHB_CBCR"
    &clk_name="camss_csi0_ahb_clk"
    &clk_reg_cbcr_type="sm_cbc"
    &clk_vote_bit=-1.
    &clk_multiplier=3.

    gosub Print_Clk_Info_Line
  )

  &match=0
  &wild_head=0
  &wild_tail=0
  &clk_input_length=STRING.LENGTH("&clk")
  &clk_itr_length=STRING.LENGTH("camss_csi1_ahb_clk")

  if (STRING.SCAN("&clk", "*", 0)==0)
  (
    &wild_head=1
  )
  if (STRING.SCAN("&clk", "*", 1)==(STRING.LENGTH("&clk")-1))
  (
    &wild_tail=1
  )

  if ((&wild_head==1)&&(&wild_tail==1))
  (
    if (STRING.SCAN("camss_csi1_ahb_clk", STRING.MID("&clk", 1, &clk_input_length-2), 0)!=-1)
    ( 
      &match=1
    )
  )
  else if (&wild_head==1)
  (
    if (STRING.MID("camss_csi1_ahb_clk", &clk_itr_length-&clk_input_length+1, &clk_input_length-1)==STRING.CUT("&clk", 1))
    ( 
      &match=1
    )
  )
  else if (&wild_tail==1)
  (
    if (STRING.MID("camss_csi1_ahb_clk", 0, &clk_input_length-1)==STRING.CUT("&clk", -1))
    ( 
      &match=1
    )
  )
  else if ("camss_csi1_ahb_clk"=="&clk")
  (
    &match=1
  )
  
  if (&match==1)
  (
    &clk_test=&CLK_TEST_CAMSS_CSI1_AHB_CLK
    &clk_reg=&HWIO_MMSS_CAMSS_CSI1_AHB_CBCR_ADDR
    &clk_reg_name="MMSS_CAMSS_CSI1_AHB_CBCR"
    &clk_name="camss_csi1_ahb_clk"
    &clk_reg_cbcr_type="sm_cbc"
    &clk_vote_bit=-1.
    &clk_multiplier=3.

    gosub Print_Clk_Info_Line
  )

  &match=0
  &wild_head=0
  &wild_tail=0
  &clk_input_length=STRING.LENGTH("&clk")
  &clk_itr_length=STRING.LENGTH("camss_csi2_ahb_clk")

  if (STRING.SCAN("&clk", "*", 0)==0)
  (
    &wild_head=1
  )
  if (STRING.SCAN("&clk", "*", 1)==(STRING.LENGTH("&clk")-1))
  (
    &wild_tail=1
  )

  if ((&wild_head==1)&&(&wild_tail==1))
  (
    if (STRING.SCAN("camss_csi2_ahb_clk", STRING.MID("&clk", 1, &clk_input_length-2), 0)!=-1)
    ( 
      &match=1
    )
  )
  else if (&wild_head==1)
  (
    if (STRING.MID("camss_csi2_ahb_clk", &clk_itr_length-&clk_input_length+1, &clk_input_length-1)==STRING.CUT("&clk", 1))
    ( 
      &match=1
    )
  )
  else if (&wild_tail==1)
  (
    if (STRING.MID("camss_csi2_ahb_clk", 0, &clk_input_length-1)==STRING.CUT("&clk", -1))
    ( 
      &match=1
    )
  )
  else if ("camss_csi2_ahb_clk"=="&clk")
  (
    &match=1
  )
  
  if (&match==1)
  (
    &clk_test=&CLK_TEST_CAMSS_CSI2_AHB_CLK
    &clk_reg=&HWIO_MMSS_CAMSS_CSI2_AHB_CBCR_ADDR
    &clk_reg_name="MMSS_CAMSS_CSI2_AHB_CBCR"
    &clk_name="camss_csi2_ahb_clk"
    &clk_reg_cbcr_type="sm_cbc"
    &clk_vote_bit=-1.
    &clk_multiplier=3.

    gosub Print_Clk_Info_Line
  )

  &match=0
  &wild_head=0
  &wild_tail=0
  &clk_input_length=STRING.LENGTH("&clk")
  &clk_itr_length=STRING.LENGTH("camss_csi3_ahb_clk")

  if (STRING.SCAN("&clk", "*", 0)==0)
  (
    &wild_head=1
  )
  if (STRING.SCAN("&clk", "*", 1)==(STRING.LENGTH("&clk")-1))
  (
    &wild_tail=1
  )

  if ((&wild_head==1)&&(&wild_tail==1))
  (
    if (STRING.SCAN("camss_csi3_ahb_clk", STRING.MID("&clk", 1, &clk_input_length-2), 0)!=-1)
    ( 
      &match=1
    )
  )
  else if (&wild_head==1)
  (
    if (STRING.MID("camss_csi3_ahb_clk", &clk_itr_length-&clk_input_length+1, &clk_input_length-1)==STRING.CUT("&clk", 1))
    ( 
      &match=1
    )
  )
  else if (&wild_tail==1)
  (
    if (STRING.MID("camss_csi3_ahb_clk", 0, &clk_input_length-1)==STRING.CUT("&clk", -1))
    ( 
      &match=1
    )
  )
  else if ("camss_csi3_ahb_clk"=="&clk")
  (
    &match=1
  )
  
  if (&match==1)
  (
    &clk_test=&CLK_TEST_CAMSS_CSI3_AHB_CLK
    &clk_reg=&HWIO_MMSS_CAMSS_CSI3_AHB_CBCR_ADDR
    &clk_reg_name="MMSS_CAMSS_CSI3_AHB_CBCR"
    &clk_name="camss_csi3_ahb_clk"
    &clk_reg_cbcr_type="sm_cbc"
    &clk_vote_bit=-1.
    &clk_multiplier=3.

    gosub Print_Clk_Info_Line
  )

  &match=0
  &wild_head=0
  &wild_tail=0
  &clk_input_length=STRING.LENGTH("&clk")
  &clk_itr_length=STRING.LENGTH("camss_ispif_ahb_clk")

  if (STRING.SCAN("&clk", "*", 0)==0)
  (
    &wild_head=1
  )
  if (STRING.SCAN("&clk", "*", 1)==(STRING.LENGTH("&clk")-1))
  (
    &wild_tail=1
  )

  if ((&wild_head==1)&&(&wild_tail==1))
  (
    if (STRING.SCAN("camss_ispif_ahb_clk", STRING.MID("&clk", 1, &clk_input_length-2), 0)!=-1)
    ( 
      &match=1
    )
  )
  else if (&wild_head==1)
  (
    if (STRING.MID("camss_ispif_ahb_clk", &clk_itr_length-&clk_input_length+1, &clk_input_length-1)==STRING.CUT("&clk", 1))
    ( 
      &match=1
    )
  )
  else if (&wild_tail==1)
  (
    if (STRING.MID("camss_ispif_ahb_clk", 0, &clk_input_length-1)==STRING.CUT("&clk", -1))
    ( 
      &match=1
    )
  )
  else if ("camss_ispif_ahb_clk"=="&clk")
  (
    &match=1
  )
  
  if (&match==1)
  (
    &clk_test=&CLK_TEST_CAMSS_ISPIF_AHB_CLK
    &clk_reg=&HWIO_MMSS_CAMSS_ISPIF_AHB_CBCR_ADDR
    &clk_reg_name="MMSS_CAMSS_ISPIF_AHB_CBCR"
    &clk_name="camss_ispif_ahb_clk"
    &clk_reg_cbcr_type="sm_cbc"
    &clk_vote_bit=-1.
    &clk_multiplier=3.

    gosub Print_Clk_Info_Line
  )

  &match=0
  &wild_head=0
  &wild_tail=0
  &clk_input_length=STRING.LENGTH("&clk")
  &clk_itr_length=STRING.LENGTH("camss_jpeg_ahb_clk")

  if (STRING.SCAN("&clk", "*", 0)==0)
  (
    &wild_head=1
  )
  if (STRING.SCAN("&clk", "*", 1)==(STRING.LENGTH("&clk")-1))
  (
    &wild_tail=1
  )

  if ((&wild_head==1)&&(&wild_tail==1))
  (
    if (STRING.SCAN("camss_jpeg_ahb_clk", STRING.MID("&clk", 1, &clk_input_length-2), 0)!=-1)
    ( 
      &match=1
    )
  )
  else if (&wild_head==1)
  (
    if (STRING.MID("camss_jpeg_ahb_clk", &clk_itr_length-&clk_input_length+1, &clk_input_length-1)==STRING.CUT("&clk", 1))
    ( 
      &match=1
    )
  )
  else if (&wild_tail==1)
  (
    if (STRING.MID("camss_jpeg_ahb_clk", 0, &clk_input_length-1)==STRING.CUT("&clk", -1))
    ( 
      &match=1
    )
  )
  else if ("camss_jpeg_ahb_clk"=="&clk")
  (
    &match=1
  )
  
  if (&match==1)
  (
    &clk_test=&CLK_TEST_CAMSS_JPEG_AHB_CLK
    &clk_reg=&HWIO_MMSS_CAMSS_JPEG_AHB_CBCR_ADDR
    &clk_reg_name="MMSS_CAMSS_JPEG_AHB_CBCR"
    &clk_name="camss_jpeg_ahb_clk"
    &clk_reg_cbcr_type="sm_cbc"
    &clk_vote_bit=-1.
    &clk_multiplier=3.

    gosub Print_Clk_Info_Line
  )

  &match=0
  &wild_head=0
  &wild_tail=0
  &clk_input_length=STRING.LENGTH("&clk")
  &clk_itr_length=STRING.LENGTH("camss_micro_ahb_clk")

  if (STRING.SCAN("&clk", "*", 0)==0)
  (
    &wild_head=1
  )
  if (STRING.SCAN("&clk", "*", 1)==(STRING.LENGTH("&clk")-1))
  (
    &wild_tail=1
  )

  if ((&wild_head==1)&&(&wild_tail==1))
  (
    if (STRING.SCAN("camss_micro_ahb_clk", STRING.MID("&clk", 1, &clk_input_length-2), 0)!=-1)
    ( 
      &match=1
    )
  )
  else if (&wild_head==1)
  (
    if (STRING.MID("camss_micro_ahb_clk", &clk_itr_length-&clk_input_length+1, &clk_input_length-1)==STRING.CUT("&clk", 1))
    ( 
      &match=1
    )
  )
  else if (&wild_tail==1)
  (
    if (STRING.MID("camss_micro_ahb_clk", 0, &clk_input_length-1)==STRING.CUT("&clk", -1))
    ( 
      &match=1
    )
  )
  else if ("camss_micro_ahb_clk"=="&clk")
  (
    &match=1
  )
  
  if (&match==1)
  (
    &clk_test=&CLK_TEST_CAMSS_MICRO_AHB_CLK
    &clk_reg=&HWIO_MMSS_CAMSS_MICRO_AHB_CBCR_ADDR
    &clk_reg_name="MMSS_CAMSS_MICRO_AHB_CBCR"
    &clk_name="camss_micro_ahb_clk"
    &clk_reg_cbcr_type="sm_pscbc"
    &clk_vote_bit=-1.
    &clk_multiplier=3.

    gosub Print_Clk_Info_Line
  )

  &match=0
  &wild_head=0
  &wild_tail=0
  &clk_input_length=STRING.LENGTH("&clk")
  &clk_itr_length=STRING.LENGTH("camss_top_ahb_clk")

  if (STRING.SCAN("&clk", "*", 0)==0)
  (
    &wild_head=1
  )
  if (STRING.SCAN("&clk", "*", 1)==(STRING.LENGTH("&clk")-1))
  (
    &wild_tail=1
  )

  if ((&wild_head==1)&&(&wild_tail==1))
  (
    if (STRING.SCAN("camss_top_ahb_clk", STRING.MID("&clk", 1, &clk_input_length-2), 0)!=-1)
    ( 
      &match=1
    )
  )
  else if (&wild_head==1)
  (
    if (STRING.MID("camss_top_ahb_clk", &clk_itr_length-&clk_input_length+1, &clk_input_length-1)==STRING.CUT("&clk", 1))
    ( 
      &match=1
    )
  )
  else if (&wild_tail==1)
  (
    if (STRING.MID("camss_top_ahb_clk", 0, &clk_input_length-1)==STRING.CUT("&clk", -1))
    ( 
      &match=1
    )
  )
  else if ("camss_top_ahb_clk"=="&clk")
  (
    &match=1
  )
  
  if (&match==1)
  (
    &clk_test=&CLK_TEST_CAMSS_TOP_AHB_CLK
    &clk_reg=&HWIO_MMSS_CAMSS_TOP_AHB_CBCR_ADDR
    &clk_reg_name="MMSS_CAMSS_TOP_AHB_CBCR"
    &clk_name="camss_top_ahb_clk"
    &clk_reg_cbcr_type="sm_cbc"
    &clk_vote_bit=-1.
    &clk_multiplier=3.

    gosub Print_Clk_Info_Line
  )

  &match=0
  &wild_head=0
  &wild_tail=0
  &clk_input_length=STRING.LENGTH("&clk")
  &clk_itr_length=STRING.LENGTH("camss_vfe0_ahb_clk")

  if (STRING.SCAN("&clk", "*", 0)==0)
  (
    &wild_head=1
  )
  if (STRING.SCAN("&clk", "*", 1)==(STRING.LENGTH("&clk")-1))
  (
    &wild_tail=1
  )

  if ((&wild_head==1)&&(&wild_tail==1))
  (
    if (STRING.SCAN("camss_vfe0_ahb_clk", STRING.MID("&clk", 1, &clk_input_length-2), 0)!=-1)
    ( 
      &match=1
    )
  )
  else if (&wild_head==1)
  (
    if (STRING.MID("camss_vfe0_ahb_clk", &clk_itr_length-&clk_input_length+1, &clk_input_length-1)==STRING.CUT("&clk", 1))
    ( 
      &match=1
    )
  )
  else if (&wild_tail==1)
  (
    if (STRING.MID("camss_vfe0_ahb_clk", 0, &clk_input_length-1)==STRING.CUT("&clk", -1))
    ( 
      &match=1
    )
  )
  else if ("camss_vfe0_ahb_clk"=="&clk")
  (
    &match=1
  )
  
  if (&match==1)
  (
    &clk_test=&CLK_TEST_CAMSS_VFE0_AHB_CLK
    &clk_reg=&HWIO_MMSS_CAMSS_VFE0_AHB_CBCR_ADDR
    &clk_reg_name="MMSS_CAMSS_VFE0_AHB_CBCR"
    &clk_name="camss_vfe0_ahb_clk"
    &clk_reg_cbcr_type="sm_cbc"
    &clk_vote_bit=-1.
    &clk_multiplier=3.

    gosub Print_Clk_Info_Line
  )

  &match=0
  &wild_head=0
  &wild_tail=0
  &clk_input_length=STRING.LENGTH("&clk")
  &clk_itr_length=STRING.LENGTH("camss_vfe1_ahb_clk")

  if (STRING.SCAN("&clk", "*", 0)==0)
  (
    &wild_head=1
  )
  if (STRING.SCAN("&clk", "*", 1)==(STRING.LENGTH("&clk")-1))
  (
    &wild_tail=1
  )

  if ((&wild_head==1)&&(&wild_tail==1))
  (
    if (STRING.SCAN("camss_vfe1_ahb_clk", STRING.MID("&clk", 1, &clk_input_length-2), 0)!=-1)
    ( 
      &match=1
    )
  )
  else if (&wild_head==1)
  (
    if (STRING.MID("camss_vfe1_ahb_clk", &clk_itr_length-&clk_input_length+1, &clk_input_length-1)==STRING.CUT("&clk", 1))
    ( 
      &match=1
    )
  )
  else if (&wild_tail==1)
  (
    if (STRING.MID("camss_vfe1_ahb_clk", 0, &clk_input_length-1)==STRING.CUT("&clk", -1))
    ( 
      &match=1
    )
  )
  else if ("camss_vfe1_ahb_clk"=="&clk")
  (
    &match=1
  )
  
  if (&match==1)
  (
    &clk_test=&CLK_TEST_CAMSS_VFE1_AHB_CLK
    &clk_reg=&HWIO_MMSS_CAMSS_VFE1_AHB_CBCR_ADDR
    &clk_reg_name="MMSS_CAMSS_VFE1_AHB_CBCR"
    &clk_name="camss_vfe1_ahb_clk"
    &clk_reg_cbcr_type="sm_cbc"
    &clk_vote_bit=-1.
    &clk_multiplier=3.

    gosub Print_Clk_Info_Line
  )

  &match=0
  &wild_head=0
  &wild_tail=0
  &clk_input_length=STRING.LENGTH("&clk")
  &clk_itr_length=STRING.LENGTH("camss_vfe_ahb_clk")

  if (STRING.SCAN("&clk", "*", 0)==0)
  (
    &wild_head=1
  )
  if (STRING.SCAN("&clk", "*", 1)==(STRING.LENGTH("&clk")-1))
  (
    &wild_tail=1
  )

  if ((&wild_head==1)&&(&wild_tail==1))
  (
    if (STRING.SCAN("camss_vfe_ahb_clk", STRING.MID("&clk", 1, &clk_input_length-2), 0)!=-1)
    ( 
      &match=1
    )
  )
  else if (&wild_head==1)
  (
    if (STRING.MID("camss_vfe_ahb_clk", &clk_itr_length-&clk_input_length+1, &clk_input_length-1)==STRING.CUT("&clk", 1))
    ( 
      &match=1
    )
  )
  else if (&wild_tail==1)
  (
    if (STRING.MID("camss_vfe_ahb_clk", 0, &clk_input_length-1)==STRING.CUT("&clk", -1))
    ( 
      &match=1
    )
  )
  else if ("camss_vfe_ahb_clk"=="&clk")
  (
    &match=1
  )
  
  if (&match==1)
  (
    &clk_test=&CLK_TEST_CAMSS_VFE_AHB_CLK
    &clk_reg=&HWIO_MMSS_CAMSS_VFE_AHB_CBCR_ADDR
    &clk_reg_name="MMSS_CAMSS_VFE_AHB_CBCR"
    &clk_name="camss_vfe_ahb_clk"
    &clk_reg_cbcr_type="sm_cbc"
    &clk_vote_bit=-1.
    &clk_multiplier=3.

    gosub Print_Clk_Info_Line
  )

  &match=0
  &wild_head=0
  &wild_tail=0
  &clk_input_length=STRING.LENGTH("&clk")
  &clk_itr_length=STRING.LENGTH("fd_ahb_clk")

  if (STRING.SCAN("&clk", "*", 0)==0)
  (
    &wild_head=1
  )
  if (STRING.SCAN("&clk", "*", 1)==(STRING.LENGTH("&clk")-1))
  (
    &wild_tail=1
  )

  if ((&wild_head==1)&&(&wild_tail==1))
  (
    if (STRING.SCAN("fd_ahb_clk", STRING.MID("&clk", 1, &clk_input_length-2), 0)!=-1)
    ( 
      &match=1
    )
  )
  else if (&wild_head==1)
  (
    if (STRING.MID("fd_ahb_clk", &clk_itr_length-&clk_input_length+1, &clk_input_length-1)==STRING.CUT("&clk", 1))
    ( 
      &match=1
    )
  )
  else if (&wild_tail==1)
  (
    if (STRING.MID("fd_ahb_clk", 0, &clk_input_length-1)==STRING.CUT("&clk", -1))
    ( 
      &match=1
    )
  )
  else if ("fd_ahb_clk"=="&clk")
  (
    &match=1
  )
  
  if (&match==1)
  (
    &clk_test=&CLK_TEST_FD_AHB_CLK
    &clk_reg=&HWIO_MMSS_FD_AHB_CBCR_ADDR
    &clk_reg_name="MMSS_FD_AHB_CBCR"
    &clk_name="fd_ahb_clk"
    &clk_reg_cbcr_type="sm_cbc"
    &clk_vote_bit=-1.
    &clk_multiplier=3.

    gosub Print_Clk_Info_Line
  )

  &match=0
  &wild_head=0
  &wild_tail=0
  &clk_input_length=STRING.LENGTH("&clk")
  &clk_itr_length=STRING.LENGTH("gpu_ahb_clk")

  if (STRING.SCAN("&clk", "*", 0)==0)
  (
    &wild_head=1
  )
  if (STRING.SCAN("&clk", "*", 1)==(STRING.LENGTH("&clk")-1))
  (
    &wild_tail=1
  )

  if ((&wild_head==1)&&(&wild_tail==1))
  (
    if (STRING.SCAN("gpu_ahb_clk", STRING.MID("&clk", 1, &clk_input_length-2), 0)!=-1)
    ( 
      &match=1
    )
  )
  else if (&wild_head==1)
  (
    if (STRING.MID("gpu_ahb_clk", &clk_itr_length-&clk_input_length+1, &clk_input_length-1)==STRING.CUT("&clk", 1))
    ( 
      &match=1
    )
  )
  else if (&wild_tail==1)
  (
    if (STRING.MID("gpu_ahb_clk", 0, &clk_input_length-1)==STRING.CUT("&clk", -1))
    ( 
      &match=1
    )
  )
  else if ("gpu_ahb_clk"=="&clk")
  (
    &match=1
  )
  
  if (&match==1)
  (
    &clk_test=&CLK_TEST_GPU_AHB_CLK
    &clk_reg=&HWIO_MMSS_GPU_AHB_CBCR_ADDR
    &clk_reg_name="MMSS_GPU_AHB_CBCR"
    &clk_name="gpu_ahb_clk"
    &clk_reg_cbcr_type="sm_cbc"
    &clk_vote_bit=-1.
    &clk_multiplier=3.

    gosub Print_Clk_Info_Line
  )

  &match=0
  &wild_head=0
  &wild_tail=0
  &clk_input_length=STRING.LENGTH("&clk")
  &clk_itr_length=STRING.LENGTH("mdss_ahb_clk")

  if (STRING.SCAN("&clk", "*", 0)==0)
  (
    &wild_head=1
  )
  if (STRING.SCAN("&clk", "*", 1)==(STRING.LENGTH("&clk")-1))
  (
    &wild_tail=1
  )

  if ((&wild_head==1)&&(&wild_tail==1))
  (
    if (STRING.SCAN("mdss_ahb_clk", STRING.MID("&clk", 1, &clk_input_length-2), 0)!=-1)
    ( 
      &match=1
    )
  )
  else if (&wild_head==1)
  (
    if (STRING.MID("mdss_ahb_clk", &clk_itr_length-&clk_input_length+1, &clk_input_length-1)==STRING.CUT("&clk", 1))
    ( 
      &match=1
    )
  )
  else if (&wild_tail==1)
  (
    if (STRING.MID("mdss_ahb_clk", 0, &clk_input_length-1)==STRING.CUT("&clk", -1))
    ( 
      &match=1
    )
  )
  else if ("mdss_ahb_clk"=="&clk")
  (
    &match=1
  )
  
  if (&match==1)
  (
    &clk_test=&CLK_TEST_MDSS_AHB_CLK
    &clk_reg=&HWIO_MMSS_MDSS_AHB_CBCR_ADDR
    &clk_reg_name="MMSS_MDSS_AHB_CBCR"
    &clk_name="mdss_ahb_clk"
    &clk_reg_cbcr_type="sm_cbc"
    &clk_vote_bit=-1.
    &clk_multiplier=3.

    gosub Print_Clk_Info_Line
  )

  &match=0
  &wild_head=0
  &wild_tail=0
  &clk_input_length=STRING.LENGTH("&clk")
  &clk_itr_length=STRING.LENGTH("mdss_hdmi_ahb_clk")

  if (STRING.SCAN("&clk", "*", 0)==0)
  (
    &wild_head=1
  )
  if (STRING.SCAN("&clk", "*", 1)==(STRING.LENGTH("&clk")-1))
  (
    &wild_tail=1
  )

  if ((&wild_head==1)&&(&wild_tail==1))
  (
    if (STRING.SCAN("mdss_hdmi_ahb_clk", STRING.MID("&clk", 1, &clk_input_length-2), 0)!=-1)
    ( 
      &match=1
    )
  )
  else if (&wild_head==1)
  (
    if (STRING.MID("mdss_hdmi_ahb_clk", &clk_itr_length-&clk_input_length+1, &clk_input_length-1)==STRING.CUT("&clk", 1))
    ( 
      &match=1
    )
  )
  else if (&wild_tail==1)
  (
    if (STRING.MID("mdss_hdmi_ahb_clk", 0, &clk_input_length-1)==STRING.CUT("&clk", -1))
    ( 
      &match=1
    )
  )
  else if ("mdss_hdmi_ahb_clk"=="&clk")
  (
    &match=1
  )
  
  if (&match==1)
  (
    &clk_test=&CLK_TEST_MDSS_HDMI_AHB_CLK
    &clk_reg=&HWIO_MMSS_MDSS_HDMI_AHB_CBCR_ADDR
    &clk_reg_name="MMSS_MDSS_HDMI_AHB_CBCR"
    &clk_name="mdss_hdmi_ahb_clk"
    &clk_reg_cbcr_type="sm_cbc"
    &clk_vote_bit=-1.
    &clk_multiplier=3.

    gosub Print_Clk_Info_Line
  )

  &match=0
  &wild_head=0
  &wild_tail=0
  &clk_input_length=STRING.LENGTH("&clk")
  &clk_itr_length=STRING.LENGTH("mmss_bto_ahb_clk")

  if (STRING.SCAN("&clk", "*", 0)==0)
  (
    &wild_head=1
  )
  if (STRING.SCAN("&clk", "*", 1)==(STRING.LENGTH("&clk")-1))
  (
    &wild_tail=1
  )

  if ((&wild_head==1)&&(&wild_tail==1))
  (
    if (STRING.SCAN("mmss_bto_ahb_clk", STRING.MID("&clk", 1, &clk_input_length-2), 0)!=-1)
    ( 
      &match=1
    )
  )
  else if (&wild_head==1)
  (
    if (STRING.MID("mmss_bto_ahb_clk", &clk_itr_length-&clk_input_length+1, &clk_input_length-1)==STRING.CUT("&clk", 1))
    ( 
      &match=1
    )
  )
  else if (&wild_tail==1)
  (
    if (STRING.MID("mmss_bto_ahb_clk", 0, &clk_input_length-1)==STRING.CUT("&clk", -1))
    ( 
      &match=1
    )
  )
  else if ("mmss_bto_ahb_clk"=="&clk")
  (
    &match=1
  )
  
  if (&match==1)
  (
    &clk_test=&CLK_TEST_MMSS_BTO_AHB_CLK
    &clk_reg=&HWIO_MMSS_MMSS_BTO_AHB_CBCR_ADDR
    &clk_reg_name="MMSS_MMSS_BTO_AHB_CBCR"
    &clk_name="mmss_bto_ahb_clk"
    &clk_reg_cbcr_type="sm_cbc"
    &clk_vote_bit=-1.
    &clk_multiplier=3.

    gosub Print_Clk_Info_Line
  )

  &match=0
  &wild_head=0
  &wild_tail=0
  &clk_input_length=STRING.LENGTH("&clk")
  &clk_itr_length=STRING.LENGTH("mmss_misc_ahb_clk")

  if (STRING.SCAN("&clk", "*", 0)==0)
  (
    &wild_head=1
  )
  if (STRING.SCAN("&clk", "*", 1)==(STRING.LENGTH("&clk")-1))
  (
    &wild_tail=1
  )

  if ((&wild_head==1)&&(&wild_tail==1))
  (
    if (STRING.SCAN("mmss_misc_ahb_clk", STRING.MID("&clk", 1, &clk_input_length-2), 0)!=-1)
    ( 
      &match=1
    )
  )
  else if (&wild_head==1)
  (
    if (STRING.MID("mmss_misc_ahb_clk", &clk_itr_length-&clk_input_length+1, &clk_input_length-1)==STRING.CUT("&clk", 1))
    ( 
      &match=1
    )
  )
  else if (&wild_tail==1)
  (
    if (STRING.MID("mmss_misc_ahb_clk", 0, &clk_input_length-1)==STRING.CUT("&clk", -1))
    ( 
      &match=1
    )
  )
  else if ("mmss_misc_ahb_clk"=="&clk")
  (
    &match=1
  )
  
  if (&match==1)
  (
    &clk_test=&CLK_TEST_MMSS_MISC_AHB_CLK
    &clk_reg=&HWIO_MMSS_MMSS_MISC_AHB_CBCR_ADDR
    &clk_reg_name="MMSS_MMSS_MISC_AHB_CBCR"
    &clk_name="mmss_misc_ahb_clk"
    &clk_reg_cbcr_type="sm_cbc"
    &clk_vote_bit=-1.
    &clk_multiplier=3.

    gosub Print_Clk_Info_Line
  )

  &match=0
  &wild_head=0
  &wild_tail=0
  &clk_input_length=STRING.LENGTH("&clk")
  &clk_itr_length=STRING.LENGTH("mmss_mmagic_ahb_clk")

  if (STRING.SCAN("&clk", "*", 0)==0)
  (
    &wild_head=1
  )
  if (STRING.SCAN("&clk", "*", 1)==(STRING.LENGTH("&clk")-1))
  (
    &wild_tail=1
  )

  if ((&wild_head==1)&&(&wild_tail==1))
  (
    if (STRING.SCAN("mmss_mmagic_ahb_clk", STRING.MID("&clk", 1, &clk_input_length-2), 0)!=-1)
    ( 
      &match=1
    )
  )
  else if (&wild_head==1)
  (
    if (STRING.MID("mmss_mmagic_ahb_clk", &clk_itr_length-&clk_input_length+1, &clk_input_length-1)==STRING.CUT("&clk", 1))
    ( 
      &match=1
    )
  )
  else if (&wild_tail==1)
  (
    if (STRING.MID("mmss_mmagic_ahb_clk", 0, &clk_input_length-1)==STRING.CUT("&clk", -1))
    ( 
      &match=1
    )
  )
  else if ("mmss_mmagic_ahb_clk"=="&clk")||("buses"=="&clk")
  (
    &match=1
  )
  
  if (&match==1)
  (
    &clk_test=&CLK_TEST_MMSS_MMAGIC_AHB_CLK
    &clk_reg=&HWIO_MMSS_MMSS_MMAGIC_AHB_CBCR_ADDR
    &clk_reg_name="MMSS_MMSS_MMAGIC_AHB_CBCR"
    &clk_name="mmss_mmagic_ahb_clk"
    &clk_reg_cbcr_type="sm_cbc"
    &clk_vote_bit=-1.
    &clk_multiplier=3.

    gosub Print_Clk_Info_Line
  )

  &match=0
  &wild_head=0
  &wild_tail=0
  &clk_input_length=STRING.LENGTH("&clk")
  &clk_itr_length=STRING.LENGTH("mmss_mmagic_cfg_ahb_clk")

  if (STRING.SCAN("&clk", "*", 0)==0)
  (
    &wild_head=1
  )
  if (STRING.SCAN("&clk", "*", 1)==(STRING.LENGTH("&clk")-1))
  (
    &wild_tail=1
  )

  if ((&wild_head==1)&&(&wild_tail==1))
  (
    if (STRING.SCAN("mmss_mmagic_cfg_ahb_clk", STRING.MID("&clk", 1, &clk_input_length-2), 0)!=-1)
    ( 
      &match=1
    )
  )
  else if (&wild_head==1)
  (
    if (STRING.MID("mmss_mmagic_cfg_ahb_clk", &clk_itr_length-&clk_input_length+1, &clk_input_length-1)==STRING.CUT("&clk", 1))
    ( 
      &match=1
    )
  )
  else if (&wild_tail==1)
  (
    if (STRING.MID("mmss_mmagic_cfg_ahb_clk", 0, &clk_input_length-1)==STRING.CUT("&clk", -1))
    ( 
      &match=1
    )
  )
  else if ("mmss_mmagic_cfg_ahb_clk"=="&clk")
  (
    &match=1
  )
  
  if (&match==1)
  (
    &clk_test=&CLK_TEST_MMSS_MMAGIC_CFG_AHB_CLK
    &clk_reg=&HWIO_MMSS_MMSS_MMAGIC_CFG_AHB_CBCR_ADDR
    &clk_reg_name="MMSS_MMSS_MMAGIC_CFG_AHB_CBCR"
    &clk_name="mmss_mmagic_cfg_ahb_clk"
    &clk_reg_cbcr_type="sm_cbc"
    &clk_vote_bit=-1.
    &clk_multiplier=3.

    gosub Print_Clk_Info_Line
  )

  &match=0
  &wild_head=0
  &wild_tail=0
  &clk_input_length=STRING.LENGTH("&clk")
  &clk_itr_length=STRING.LENGTH("mmss_rbcpr_ahb_clk")

  if (STRING.SCAN("&clk", "*", 0)==0)
  (
    &wild_head=1
  )
  if (STRING.SCAN("&clk", "*", 1)==(STRING.LENGTH("&clk")-1))
  (
    &wild_tail=1
  )

  if ((&wild_head==1)&&(&wild_tail==1))
  (
    if (STRING.SCAN("mmss_rbcpr_ahb_clk", STRING.MID("&clk", 1, &clk_input_length-2), 0)!=-1)
    ( 
      &match=1
    )
  )
  else if (&wild_head==1)
  (
    if (STRING.MID("mmss_rbcpr_ahb_clk", &clk_itr_length-&clk_input_length+1, &clk_input_length-1)==STRING.CUT("&clk", 1))
    ( 
      &match=1
    )
  )
  else if (&wild_tail==1)
  (
    if (STRING.MID("mmss_rbcpr_ahb_clk", 0, &clk_input_length-1)==STRING.CUT("&clk", -1))
    ( 
      &match=1
    )
  )
  else if ("mmss_rbcpr_ahb_clk"=="&clk")
  (
    &match=1
  )
  
  if (&match==1)
  (
    &clk_test=&CLK_TEST_MMSS_RBCPR_AHB_CLK
    &clk_reg=&HWIO_MMSS_MMSS_RBCPR_AHB_CBCR_ADDR
    &clk_reg_name="MMSS_MMSS_RBCPR_AHB_CBCR"
    &clk_name="mmss_rbcpr_ahb_clk"
    &clk_reg_cbcr_type="sm_cbc"
    &clk_vote_bit=-1.
    &clk_multiplier=3.

    gosub Print_Clk_Info_Line
  )

  &match=0
  &wild_head=0
  &wild_tail=0
  &clk_input_length=STRING.LENGTH("&clk")
  &clk_itr_length=STRING.LENGTH("mmss_spdm_ahb_clk")

  if (STRING.SCAN("&clk", "*", 0)==0)
  (
    &wild_head=1
  )
  if (STRING.SCAN("&clk", "*", 1)==(STRING.LENGTH("&clk")-1))
  (
    &wild_tail=1
  )

  if ((&wild_head==1)&&(&wild_tail==1))
  (
    if (STRING.SCAN("mmss_spdm_ahb_clk", STRING.MID("&clk", 1, &clk_input_length-2), 0)!=-1)
    ( 
      &match=1
    )
  )
  else if (&wild_head==1)
  (
    if (STRING.MID("mmss_spdm_ahb_clk", &clk_itr_length-&clk_input_length+1, &clk_input_length-1)==STRING.CUT("&clk", 1))
    ( 
      &match=1
    )
  )
  else if (&wild_tail==1)
  (
    if (STRING.MID("mmss_spdm_ahb_clk", 0, &clk_input_length-1)==STRING.CUT("&clk", -1))
    ( 
      &match=1
    )
  )
  else if ("mmss_spdm_ahb_clk"=="&clk")
  (
    &match=1
  )
  
  if (&match==1)
  (
    &clk_test=&CLK_TEST_MMSS_SPDM_AHB_CLK
    &clk_reg=&HWIO_MMSS_MMSS_SPDM_AHB_CBCR_ADDR
    &clk_reg_name="MMSS_MMSS_SPDM_AHB_CBCR"
    &clk_name="mmss_spdm_ahb_clk"
    &clk_reg_cbcr_type="sm_cbc"
    &clk_vote_bit=-1.
    &clk_multiplier=3.

    gosub Print_Clk_Info_Line
  )

  &match=0
  &wild_head=0
  &wild_tail=0
  &clk_input_length=STRING.LENGTH("&clk")
  &clk_itr_length=STRING.LENGTH("smmu_cpp_ahb_clk")

  if (STRING.SCAN("&clk", "*", 0)==0)
  (
    &wild_head=1
  )
  if (STRING.SCAN("&clk", "*", 1)==(STRING.LENGTH("&clk")-1))
  (
    &wild_tail=1
  )

  if ((&wild_head==1)&&(&wild_tail==1))
  (
    if (STRING.SCAN("smmu_cpp_ahb_clk", STRING.MID("&clk", 1, &clk_input_length-2), 0)!=-1)
    ( 
      &match=1
    )
  )
  else if (&wild_head==1)
  (
    if (STRING.MID("smmu_cpp_ahb_clk", &clk_itr_length-&clk_input_length+1, &clk_input_length-1)==STRING.CUT("&clk", 1))
    ( 
      &match=1
    )
  )
  else if (&wild_tail==1)
  (
    if (STRING.MID("smmu_cpp_ahb_clk", 0, &clk_input_length-1)==STRING.CUT("&clk", -1))
    ( 
      &match=1
    )
  )
  else if ("smmu_cpp_ahb_clk"=="&clk")
  (
    &match=1
  )
  
  if (&match==1)
  (
    &clk_test=&CLK_TEST_SMMU_CPP_AHB_CLK
    &clk_reg=&HWIO_MMSS_SMMU_CPP_AHB_CBCR_ADDR
    &clk_reg_name="MMSS_SMMU_CPP_AHB_CBCR"
    &clk_name="smmu_cpp_ahb_clk"
    &clk_reg_cbcr_type="sm_cbc"
    &clk_vote_bit=-1.
    &clk_multiplier=3.

    gosub Print_Clk_Info_Line
  )

  &match=0
  &wild_head=0
  &wild_tail=0
  &clk_input_length=STRING.LENGTH("&clk")
  &clk_itr_length=STRING.LENGTH("smmu_jpeg_ahb_clk")

  if (STRING.SCAN("&clk", "*", 0)==0)
  (
    &wild_head=1
  )
  if (STRING.SCAN("&clk", "*", 1)==(STRING.LENGTH("&clk")-1))
  (
    &wild_tail=1
  )

  if ((&wild_head==1)&&(&wild_tail==1))
  (
    if (STRING.SCAN("smmu_jpeg_ahb_clk", STRING.MID("&clk", 1, &clk_input_length-2), 0)!=-1)
    ( 
      &match=1
    )
  )
  else if (&wild_head==1)
  (
    if (STRING.MID("smmu_jpeg_ahb_clk", &clk_itr_length-&clk_input_length+1, &clk_input_length-1)==STRING.CUT("&clk", 1))
    ( 
      &match=1
    )
  )
  else if (&wild_tail==1)
  (
    if (STRING.MID("smmu_jpeg_ahb_clk", 0, &clk_input_length-1)==STRING.CUT("&clk", -1))
    ( 
      &match=1
    )
  )
  else if ("smmu_jpeg_ahb_clk"=="&clk")
  (
    &match=1
  )
  
  if (&match==1)
  (
    &clk_test=&CLK_TEST_SMMU_JPEG_AHB_CLK
    &clk_reg=&HWIO_MMSS_SMMU_JPEG_AHB_CBCR_ADDR
    &clk_reg_name="MMSS_SMMU_JPEG_AHB_CBCR"
    &clk_name="smmu_jpeg_ahb_clk"
    &clk_reg_cbcr_type="sm_cbc"
    &clk_vote_bit=-1.
    &clk_multiplier=3.

    gosub Print_Clk_Info_Line
  )

  &match=0
  &wild_head=0
  &wild_tail=0
  &clk_input_length=STRING.LENGTH("&clk")
  &clk_itr_length=STRING.LENGTH("smmu_mdp_ahb_clk")

  if (STRING.SCAN("&clk", "*", 0)==0)
  (
    &wild_head=1
  )
  if (STRING.SCAN("&clk", "*", 1)==(STRING.LENGTH("&clk")-1))
  (
    &wild_tail=1
  )

  if ((&wild_head==1)&&(&wild_tail==1))
  (
    if (STRING.SCAN("smmu_mdp_ahb_clk", STRING.MID("&clk", 1, &clk_input_length-2), 0)!=-1)
    ( 
      &match=1
    )
  )
  else if (&wild_head==1)
  (
    if (STRING.MID("smmu_mdp_ahb_clk", &clk_itr_length-&clk_input_length+1, &clk_input_length-1)==STRING.CUT("&clk", 1))
    ( 
      &match=1
    )
  )
  else if (&wild_tail==1)
  (
    if (STRING.MID("smmu_mdp_ahb_clk", 0, &clk_input_length-1)==STRING.CUT("&clk", -1))
    ( 
      &match=1
    )
  )
  else if ("smmu_mdp_ahb_clk"=="&clk")
  (
    &match=1
  )
  
  if (&match==1)
  (
    &clk_test=&CLK_TEST_SMMU_MDP_AHB_CLK
    &clk_reg=&HWIO_MMSS_SMMU_MDP_AHB_CBCR_ADDR
    &clk_reg_name="MMSS_SMMU_MDP_AHB_CBCR"
    &clk_name="smmu_mdp_ahb_clk"
    &clk_reg_cbcr_type="sm_cbc"
    &clk_vote_bit=-1.
    &clk_multiplier=3.

    gosub Print_Clk_Info_Line
  )

  &match=0
  &wild_head=0
  &wild_tail=0
  &clk_input_length=STRING.LENGTH("&clk")
  &clk_itr_length=STRING.LENGTH("smmu_rot_ahb_clk")

  if (STRING.SCAN("&clk", "*", 0)==0)
  (
    &wild_head=1
  )
  if (STRING.SCAN("&clk", "*", 1)==(STRING.LENGTH("&clk")-1))
  (
    &wild_tail=1
  )

  if ((&wild_head==1)&&(&wild_tail==1))
  (
    if (STRING.SCAN("smmu_rot_ahb_clk", STRING.MID("&clk", 1, &clk_input_length-2), 0)!=-1)
    ( 
      &match=1
    )
  )
  else if (&wild_head==1)
  (
    if (STRING.MID("smmu_rot_ahb_clk", &clk_itr_length-&clk_input_length+1, &clk_input_length-1)==STRING.CUT("&clk", 1))
    ( 
      &match=1
    )
  )
  else if (&wild_tail==1)
  (
    if (STRING.MID("smmu_rot_ahb_clk", 0, &clk_input_length-1)==STRING.CUT("&clk", -1))
    ( 
      &match=1
    )
  )
  else if ("smmu_rot_ahb_clk"=="&clk")
  (
    &match=1
  )
  
  if (&match==1)
  (
    &clk_test=&CLK_TEST_SMMU_ROT_AHB_CLK
    &clk_reg=&HWIO_MMSS_SMMU_ROT_AHB_CBCR_ADDR
    &clk_reg_name="MMSS_SMMU_ROT_AHB_CBCR"
    &clk_name="smmu_rot_ahb_clk"
    &clk_reg_cbcr_type="sm_cbc"
    &clk_vote_bit=-1.
    &clk_multiplier=3.

    gosub Print_Clk_Info_Line
  )

  &match=0
  &wild_head=0
  &wild_tail=0
  &clk_input_length=STRING.LENGTH("&clk")
  &clk_itr_length=STRING.LENGTH("smmu_vfe_ahb_clk")

  if (STRING.SCAN("&clk", "*", 0)==0)
  (
    &wild_head=1
  )
  if (STRING.SCAN("&clk", "*", 1)==(STRING.LENGTH("&clk")-1))
  (
    &wild_tail=1
  )

  if ((&wild_head==1)&&(&wild_tail==1))
  (
    if (STRING.SCAN("smmu_vfe_ahb_clk", STRING.MID("&clk", 1, &clk_input_length-2), 0)!=-1)
    ( 
      &match=1
    )
  )
  else if (&wild_head==1)
  (
    if (STRING.MID("smmu_vfe_ahb_clk", &clk_itr_length-&clk_input_length+1, &clk_input_length-1)==STRING.CUT("&clk", 1))
    ( 
      &match=1
    )
  )
  else if (&wild_tail==1)
  (
    if (STRING.MID("smmu_vfe_ahb_clk", 0, &clk_input_length-1)==STRING.CUT("&clk", -1))
    ( 
      &match=1
    )
  )
  else if ("smmu_vfe_ahb_clk"=="&clk")
  (
    &match=1
  )
  
  if (&match==1)
  (
    &clk_test=&CLK_TEST_SMMU_VFE_AHB_CLK
    &clk_reg=&HWIO_MMSS_SMMU_VFE_AHB_CBCR_ADDR
    &clk_reg_name="MMSS_SMMU_VFE_AHB_CBCR"
    &clk_name="smmu_vfe_ahb_clk"
    &clk_reg_cbcr_type="sm_cbc"
    &clk_vote_bit=-1.
    &clk_multiplier=3.

    gosub Print_Clk_Info_Line
  )

  &match=0
  &wild_head=0
  &wild_tail=0
  &clk_input_length=STRING.LENGTH("&clk")
  &clk_itr_length=STRING.LENGTH("smmu_video_ahb_clk")

  if (STRING.SCAN("&clk", "*", 0)==0)
  (
    &wild_head=1
  )
  if (STRING.SCAN("&clk", "*", 1)==(STRING.LENGTH("&clk")-1))
  (
    &wild_tail=1
  )

  if ((&wild_head==1)&&(&wild_tail==1))
  (
    if (STRING.SCAN("smmu_video_ahb_clk", STRING.MID("&clk", 1, &clk_input_length-2), 0)!=-1)
    ( 
      &match=1
    )
  )
  else if (&wild_head==1)
  (
    if (STRING.MID("smmu_video_ahb_clk", &clk_itr_length-&clk_input_length+1, &clk_input_length-1)==STRING.CUT("&clk", 1))
    ( 
      &match=1
    )
  )
  else if (&wild_tail==1)
  (
    if (STRING.MID("smmu_video_ahb_clk", 0, &clk_input_length-1)==STRING.CUT("&clk", -1))
    ( 
      &match=1
    )
  )
  else if ("smmu_video_ahb_clk"=="&clk")
  (
    &match=1
  )
  
  if (&match==1)
  (
    &clk_test=&CLK_TEST_SMMU_VIDEO_AHB_CLK
    &clk_reg=&HWIO_MMSS_SMMU_VIDEO_AHB_CBCR_ADDR
    &clk_reg_name="MMSS_SMMU_VIDEO_AHB_CBCR"
    &clk_name="smmu_video_ahb_clk"
    &clk_reg_cbcr_type="sm_cbc"
    &clk_vote_bit=-1.
    &clk_multiplier=3.

    gosub Print_Clk_Info_Line
  )

  &match=0
  &wild_head=0
  &wild_tail=0
  &clk_input_length=STRING.LENGTH("&clk")
  &clk_itr_length=STRING.LENGTH("throttle_camss_ahb_clk")

  if (STRING.SCAN("&clk", "*", 0)==0)
  (
    &wild_head=1
  )
  if (STRING.SCAN("&clk", "*", 1)==(STRING.LENGTH("&clk")-1))
  (
    &wild_tail=1
  )

  if ((&wild_head==1)&&(&wild_tail==1))
  (
    if (STRING.SCAN("throttle_camss_ahb_clk", STRING.MID("&clk", 1, &clk_input_length-2), 0)!=-1)
    ( 
      &match=1
    )
  )
  else if (&wild_head==1)
  (
    if (STRING.MID("throttle_camss_ahb_clk", &clk_itr_length-&clk_input_length+1, &clk_input_length-1)==STRING.CUT("&clk", 1))
    ( 
      &match=1
    )
  )
  else if (&wild_tail==1)
  (
    if (STRING.MID("throttle_camss_ahb_clk", 0, &clk_input_length-1)==STRING.CUT("&clk", -1))
    ( 
      &match=1
    )
  )
  else if ("throttle_camss_ahb_clk"=="&clk")
  (
    &match=1
  )
  
  if (&match==1)
  (
    &clk_test=&CLK_TEST_THROTTLE_CAMSS_AHB_CLK
    &clk_reg=&HWIO_MMSS_THROTTLE_CAMSS_AHB_CBCR_ADDR
    &clk_reg_name="MMSS_THROTTLE_CAMSS_AHB_CBCR"
    &clk_name="throttle_camss_ahb_clk"
    &clk_reg_cbcr_type="sm_cbc"
    &clk_vote_bit=-1.
    &clk_multiplier=3.

    gosub Print_Clk_Info_Line
  )

  &match=0
  &wild_head=0
  &wild_tail=0
  &clk_input_length=STRING.LENGTH("&clk")
  &clk_itr_length=STRING.LENGTH("throttle_mdss_ahb_clk")

  if (STRING.SCAN("&clk", "*", 0)==0)
  (
    &wild_head=1
  )
  if (STRING.SCAN("&clk", "*", 1)==(STRING.LENGTH("&clk")-1))
  (
    &wild_tail=1
  )

  if ((&wild_head==1)&&(&wild_tail==1))
  (
    if (STRING.SCAN("throttle_mdss_ahb_clk", STRING.MID("&clk", 1, &clk_input_length-2), 0)!=-1)
    ( 
      &match=1
    )
  )
  else if (&wild_head==1)
  (
    if (STRING.MID("throttle_mdss_ahb_clk", &clk_itr_length-&clk_input_length+1, &clk_input_length-1)==STRING.CUT("&clk", 1))
    ( 
      &match=1
    )
  )
  else if (&wild_tail==1)
  (
    if (STRING.MID("throttle_mdss_ahb_clk", 0, &clk_input_length-1)==STRING.CUT("&clk", -1))
    ( 
      &match=1
    )
  )
  else if ("throttle_mdss_ahb_clk"=="&clk")
  (
    &match=1
  )
  
  if (&match==1)
  (
    &clk_test=&CLK_TEST_THROTTLE_MDSS_AHB_CLK
    &clk_reg=&HWIO_MMSS_THROTTLE_MDSS_AHB_CBCR_ADDR
    &clk_reg_name="MMSS_THROTTLE_MDSS_AHB_CBCR"
    &clk_name="throttle_mdss_ahb_clk"
    &clk_reg_cbcr_type="sm_cbc"
    &clk_vote_bit=-1.
    &clk_multiplier=3.

    gosub Print_Clk_Info_Line
  )

  &match=0
  &wild_head=0
  &wild_tail=0
  &clk_input_length=STRING.LENGTH("&clk")
  &clk_itr_length=STRING.LENGTH("throttle_video_ahb_clk")

  if (STRING.SCAN("&clk", "*", 0)==0)
  (
    &wild_head=1
  )
  if (STRING.SCAN("&clk", "*", 1)==(STRING.LENGTH("&clk")-1))
  (
    &wild_tail=1
  )

  if ((&wild_head==1)&&(&wild_tail==1))
  (
    if (STRING.SCAN("throttle_video_ahb_clk", STRING.MID("&clk", 1, &clk_input_length-2), 0)!=-1)
    ( 
      &match=1
    )
  )
  else if (&wild_head==1)
  (
    if (STRING.MID("throttle_video_ahb_clk", &clk_itr_length-&clk_input_length+1, &clk_input_length-1)==STRING.CUT("&clk", 1))
    ( 
      &match=1
    )
  )
  else if (&wild_tail==1)
  (
    if (STRING.MID("throttle_video_ahb_clk", 0, &clk_input_length-1)==STRING.CUT("&clk", -1))
    ( 
      &match=1
    )
  )
  else if ("throttle_video_ahb_clk"=="&clk")
  (
    &match=1
  )
  
  if (&match==1)
  (
    &clk_test=&CLK_TEST_THROTTLE_VIDEO_AHB_CLK
    &clk_reg=&HWIO_MMSS_THROTTLE_VIDEO_AHB_CBCR_ADDR
    &clk_reg_name="MMSS_THROTTLE_VIDEO_AHB_CBCR"
    &clk_name="throttle_video_ahb_clk"
    &clk_reg_cbcr_type="sm_cbc"
    &clk_vote_bit=-1.
    &clk_multiplier=3.

    gosub Print_Clk_Info_Line
  )

  &match=0
  &wild_head=0
  &wild_tail=0
  &clk_input_length=STRING.LENGTH("&clk")
  &clk_itr_length=STRING.LENGTH("video_ahb_clk")

  if (STRING.SCAN("&clk", "*", 0)==0)
  (
    &wild_head=1
  )
  if (STRING.SCAN("&clk", "*", 1)==(STRING.LENGTH("&clk")-1))
  (
    &wild_tail=1
  )

  if ((&wild_head==1)&&(&wild_tail==1))
  (
    if (STRING.SCAN("video_ahb_clk", STRING.MID("&clk", 1, &clk_input_length-2), 0)!=-1)
    ( 
      &match=1
    )
  )
  else if (&wild_head==1)
  (
    if (STRING.MID("video_ahb_clk", &clk_itr_length-&clk_input_length+1, &clk_input_length-1)==STRING.CUT("&clk", 1))
    ( 
      &match=1
    )
  )
  else if (&wild_tail==1)
  (
    if (STRING.MID("video_ahb_clk", 0, &clk_input_length-1)==STRING.CUT("&clk", -1))
    ( 
      &match=1
    )
  )
  else if ("video_ahb_clk"=="&clk")
  (
    &match=1
  )
  
  if (&match==1)
  (
    &clk_test=&CLK_TEST_VIDEO_AHB_CLK
    &clk_reg=&HWIO_MMSS_VIDEO_AHB_CBCR_ADDR
    &clk_reg_name="MMSS_VIDEO_AHB_CBCR"
    &clk_name="video_ahb_clk"
    &clk_reg_cbcr_type="sm_cbc"
    &clk_vote_bit=-1.
    &clk_multiplier=3.

    gosub Print_Clk_Info_Line
  )

  &match=0
  &wild_head=0
  &wild_tail=0
  &clk_input_length=STRING.LENGTH("&clk")
  &clk_itr_length=STRING.LENGTH("vmem_ahb_clk")

  if (STRING.SCAN("&clk", "*", 0)==0)
  (
    &wild_head=1
  )
  if (STRING.SCAN("&clk", "*", 1)==(STRING.LENGTH("&clk")-1))
  (
    &wild_tail=1
  )

  if ((&wild_head==1)&&(&wild_tail==1))
  (
    if (STRING.SCAN("vmem_ahb_clk", STRING.MID("&clk", 1, &clk_input_length-2), 0)!=-1)
    ( 
      &match=1
    )
  )
  else if (&wild_head==1)
  (
    if (STRING.MID("vmem_ahb_clk", &clk_itr_length-&clk_input_length+1, &clk_input_length-1)==STRING.CUT("&clk", 1))
    ( 
      &match=1
    )
  )
  else if (&wild_tail==1)
  (
    if (STRING.MID("vmem_ahb_clk", 0, &clk_input_length-1)==STRING.CUT("&clk", -1))
    ( 
      &match=1
    )
  )
  else if ("vmem_ahb_clk"=="&clk")
  (
    &match=1
  )
  
  if (&match==1)
  (
    &clk_test=&CLK_TEST_VMEM_AHB_CLK
    &clk_reg=&HWIO_MMSS_VMEM_AHB_CBCR_ADDR
    &clk_reg_name="MMSS_VMEM_AHB_CBCR"
    &clk_name="vmem_ahb_clk"
    &clk_reg_cbcr_type="sm_cbc"
    &clk_vote_bit=-1.
    &clk_multiplier=3.

    gosub Print_Clk_Info_Line
  )

  &match=0
  &wild_head=0
  &wild_tail=0
  &clk_input_length=STRING.LENGTH("&clk")
  &clk_itr_length=STRING.LENGTH("camss_cpp_axi_clk")

  if (STRING.SCAN("&clk", "*", 0)==0)
  (
    &wild_head=1
  )
  if (STRING.SCAN("&clk", "*", 1)==(STRING.LENGTH("&clk")-1))
  (
    &wild_tail=1
  )

  if ((&wild_head==1)&&(&wild_tail==1))
  (
    if (STRING.SCAN("camss_cpp_axi_clk", STRING.MID("&clk", 1, &clk_input_length-2), 0)!=-1)
    ( 
      &match=1
    )
  )
  else if (&wild_head==1)
  (
    if (STRING.MID("camss_cpp_axi_clk", &clk_itr_length-&clk_input_length+1, &clk_input_length-1)==STRING.CUT("&clk", 1))
    ( 
      &match=1
    )
  )
  else if (&wild_tail==1)
  (
    if (STRING.MID("camss_cpp_axi_clk", 0, &clk_input_length-1)==STRING.CUT("&clk", -1))
    ( 
      &match=1
    )
  )
  else if ("camss_cpp_axi_clk"=="&clk")
  (
    &match=1
  )
  
  if (&match==1)
  (
    &clk_test=&CLK_TEST_CAMSS_CPP_AXI_CLK
    &clk_reg=&HWIO_MMSS_CAMSS_CPP_AXI_CBCR_ADDR
    &clk_reg_name="MMSS_CAMSS_CPP_AXI_CBCR"
    &clk_name="camss_cpp_axi_clk"
    &clk_reg_cbcr_type="sm_pscbc"
    &clk_vote_bit=-1.
    &clk_multiplier=3.

    gosub Print_Clk_Info_Line
  )

  &match=0
  &wild_head=0
  &wild_tail=0
  &clk_input_length=STRING.LENGTH("&clk")
  &clk_itr_length=STRING.LENGTH("camss_jpeg_axi_clk")

  if (STRING.SCAN("&clk", "*", 0)==0)
  (
    &wild_head=1
  )
  if (STRING.SCAN("&clk", "*", 1)==(STRING.LENGTH("&clk")-1))
  (
    &wild_tail=1
  )

  if ((&wild_head==1)&&(&wild_tail==1))
  (
    if (STRING.SCAN("camss_jpeg_axi_clk", STRING.MID("&clk", 1, &clk_input_length-2), 0)!=-1)
    ( 
      &match=1
    )
  )
  else if (&wild_head==1)
  (
    if (STRING.MID("camss_jpeg_axi_clk", &clk_itr_length-&clk_input_length+1, &clk_input_length-1)==STRING.CUT("&clk", 1))
    ( 
      &match=1
    )
  )
  else if (&wild_tail==1)
  (
    if (STRING.MID("camss_jpeg_axi_clk", 0, &clk_input_length-1)==STRING.CUT("&clk", -1))
    ( 
      &match=1
    )
  )
  else if ("camss_jpeg_axi_clk"=="&clk")
  (
    &match=1
  )
  
  if (&match==1)
  (
    &clk_test=&CLK_TEST_CAMSS_JPEG_AXI_CLK
    &clk_reg=&HWIO_MMSS_CAMSS_JPEG_AXI_CBCR_ADDR
    &clk_reg_name="MMSS_CAMSS_JPEG_AXI_CBCR"
    &clk_name="camss_jpeg_axi_clk"
    &clk_reg_cbcr_type="sm_pscbc"
    &clk_vote_bit=-1.
    &clk_multiplier=3.

    gosub Print_Clk_Info_Line
  )

  &match=0
  &wild_head=0
  &wild_tail=0
  &clk_input_length=STRING.LENGTH("&clk")
  &clk_itr_length=STRING.LENGTH("camss_vfe_axi_clk")

  if (STRING.SCAN("&clk", "*", 0)==0)
  (
    &wild_head=1
  )
  if (STRING.SCAN("&clk", "*", 1)==(STRING.LENGTH("&clk")-1))
  (
    &wild_tail=1
  )

  if ((&wild_head==1)&&(&wild_tail==1))
  (
    if (STRING.SCAN("camss_vfe_axi_clk", STRING.MID("&clk", 1, &clk_input_length-2), 0)!=-1)
    ( 
      &match=1
    )
  )
  else if (&wild_head==1)
  (
    if (STRING.MID("camss_vfe_axi_clk", &clk_itr_length-&clk_input_length+1, &clk_input_length-1)==STRING.CUT("&clk", 1))
    ( 
      &match=1
    )
  )
  else if (&wild_tail==1)
  (
    if (STRING.MID("camss_vfe_axi_clk", 0, &clk_input_length-1)==STRING.CUT("&clk", -1))
    ( 
      &match=1
    )
  )
  else if ("camss_vfe_axi_clk"=="&clk")
  (
    &match=1
  )
  
  if (&match==1)
  (
    &clk_test=&CLK_TEST_CAMSS_VFE_AXI_CLK
    &clk_reg=&HWIO_MMSS_CAMSS_VFE_AXI_CBCR_ADDR
    &clk_reg_name="MMSS_CAMSS_VFE_AXI_CBCR"
    &clk_name="camss_vfe_axi_clk"
    &clk_reg_cbcr_type="sm_pscbc"
    &clk_vote_bit=-1.
    &clk_multiplier=3.

    gosub Print_Clk_Info_Line
  )

  &match=0
  &wild_head=0
  &wild_tail=0
  &clk_input_length=STRING.LENGTH("&clk")
  &clk_itr_length=STRING.LENGTH("mdss_axi_clk")

  if (STRING.SCAN("&clk", "*", 0)==0)
  (
    &wild_head=1
  )
  if (STRING.SCAN("&clk", "*", 1)==(STRING.LENGTH("&clk")-1))
  (
    &wild_tail=1
  )

  if ((&wild_head==1)&&(&wild_tail==1))
  (
    if (STRING.SCAN("mdss_axi_clk", STRING.MID("&clk", 1, &clk_input_length-2), 0)!=-1)
    ( 
      &match=1
    )
  )
  else if (&wild_head==1)
  (
    if (STRING.MID("mdss_axi_clk", &clk_itr_length-&clk_input_length+1, &clk_input_length-1)==STRING.CUT("&clk", 1))
    ( 
      &match=1
    )
  )
  else if (&wild_tail==1)
  (
    if (STRING.MID("mdss_axi_clk", 0, &clk_input_length-1)==STRING.CUT("&clk", -1))
    ( 
      &match=1
    )
  )
  else if ("mdss_axi_clk"=="&clk")
  (
    &match=1
  )
  
  if (&match==1)
  (
    &clk_test=&CLK_TEST_MDSS_AXI_CLK
    &clk_reg=&HWIO_MMSS_MDSS_AXI_CBCR_ADDR
    &clk_reg_name="MMSS_MDSS_AXI_CBCR"
    &clk_name="mdss_axi_clk"
    &clk_reg_cbcr_type="sm_pscbc"
    &clk_vote_bit=-1.
    &clk_multiplier=3.

    gosub Print_Clk_Info_Line
  )

  &match=0
  &wild_head=0
  &wild_tail=0
  &clk_input_length=STRING.LENGTH("&clk")
  &clk_itr_length=STRING.LENGTH("mmagic_bimc_axi_clk")

  if (STRING.SCAN("&clk", "*", 0)==0)
  (
    &wild_head=1
  )
  if (STRING.SCAN("&clk", "*", 1)==(STRING.LENGTH("&clk")-1))
  (
    &wild_tail=1
  )

  if ((&wild_head==1)&&(&wild_tail==1))
  (
    if (STRING.SCAN("mmagic_bimc_axi_clk", STRING.MID("&clk", 1, &clk_input_length-2), 0)!=-1)
    ( 
      &match=1
    )
  )
  else if (&wild_head==1)
  (
    if (STRING.MID("mmagic_bimc_axi_clk", &clk_itr_length-&clk_input_length+1, &clk_input_length-1)==STRING.CUT("&clk", 1))
    ( 
      &match=1
    )
  )
  else if (&wild_tail==1)
  (
    if (STRING.MID("mmagic_bimc_axi_clk", 0, &clk_input_length-1)==STRING.CUT("&clk", -1))
    ( 
      &match=1
    )
  )
  else if ("mmagic_bimc_axi_clk"=="&clk")
  (
    &match=1
  )
  
  if (&match==1)
  (
    &clk_test=&CLK_TEST_MMAGIC_BIMC_AXI_CLK
    &clk_reg=&HWIO_MMSS_MMAGIC_BIMC_AXI_CBCR_ADDR
    &clk_reg_name="MMSS_MMAGIC_BIMC_AXI_CBCR"
    &clk_name="mmagic_bimc_axi_clk"
    &clk_reg_cbcr_type="sm_cbc"
    &clk_vote_bit=-1.
    &clk_multiplier=3.

    gosub Print_Clk_Info_Line
  )

  &match=0
  &wild_head=0
  &wild_tail=0
  &clk_input_length=STRING.LENGTH("&clk")
  &clk_itr_length=STRING.LENGTH("mmagic_camss_axi_clk")

  if (STRING.SCAN("&clk", "*", 0)==0)
  (
    &wild_head=1
  )
  if (STRING.SCAN("&clk", "*", 1)==(STRING.LENGTH("&clk")-1))
  (
    &wild_tail=1
  )

  if ((&wild_head==1)&&(&wild_tail==1))
  (
    if (STRING.SCAN("mmagic_camss_axi_clk", STRING.MID("&clk", 1, &clk_input_length-2), 0)!=-1)
    ( 
      &match=1
    )
  )
  else if (&wild_head==1)
  (
    if (STRING.MID("mmagic_camss_axi_clk", &clk_itr_length-&clk_input_length+1, &clk_input_length-1)==STRING.CUT("&clk", 1))
    ( 
      &match=1
    )
  )
  else if (&wild_tail==1)
  (
    if (STRING.MID("mmagic_camss_axi_clk", 0, &clk_input_length-1)==STRING.CUT("&clk", -1))
    ( 
      &match=1
    )
  )
  else if ("mmagic_camss_axi_clk"=="&clk")
  (
    &match=1
  )
  
  if (&match==1)
  (
    &clk_test=&CLK_TEST_MMAGIC_CAMSS_AXI_CLK
    &clk_reg=&HWIO_MMSS_MMAGIC_CAMSS_AXI_CBCR_ADDR
    &clk_reg_name="MMSS_MMAGIC_CAMSS_AXI_CBCR"
    &clk_name="mmagic_camss_axi_clk"
    &clk_reg_cbcr_type="sm_cbc"
    &clk_vote_bit=-1.
    &clk_multiplier=3.

    gosub Print_Clk_Info_Line
  )

  &match=0
  &wild_head=0
  &wild_tail=0
  &clk_input_length=STRING.LENGTH("&clk")
  &clk_itr_length=STRING.LENGTH("mmagic_mdss_axi_clk")

  if (STRING.SCAN("&clk", "*", 0)==0)
  (
    &wild_head=1
  )
  if (STRING.SCAN("&clk", "*", 1)==(STRING.LENGTH("&clk")-1))
  (
    &wild_tail=1
  )

  if ((&wild_head==1)&&(&wild_tail==1))
  (
    if (STRING.SCAN("mmagic_mdss_axi_clk", STRING.MID("&clk", 1, &clk_input_length-2), 0)!=-1)
    ( 
      &match=1
    )
  )
  else if (&wild_head==1)
  (
    if (STRING.MID("mmagic_mdss_axi_clk", &clk_itr_length-&clk_input_length+1, &clk_input_length-1)==STRING.CUT("&clk", 1))
    ( 
      &match=1
    )
  )
  else if (&wild_tail==1)
  (
    if (STRING.MID("mmagic_mdss_axi_clk", 0, &clk_input_length-1)==STRING.CUT("&clk", -1))
    ( 
      &match=1
    )
  )
  else if ("mmagic_mdss_axi_clk"=="&clk")
  (
    &match=1
  )
  
  if (&match==1)
  (
    &clk_test=&CLK_TEST_MMAGIC_MDSS_AXI_CLK
    &clk_reg=&HWIO_MMSS_MMAGIC_MDSS_AXI_CBCR_ADDR
    &clk_reg_name="MMSS_MMAGIC_MDSS_AXI_CBCR"
    &clk_name="mmagic_mdss_axi_clk"
    &clk_reg_cbcr_type="sm_cbc"
    &clk_vote_bit=-1.
    &clk_multiplier=3.

    gosub Print_Clk_Info_Line
  )

  &match=0
  &wild_head=0
  &wild_tail=0
  &clk_input_length=STRING.LENGTH("&clk")
  &clk_itr_length=STRING.LENGTH("mmagic_video_axi_clk")

  if (STRING.SCAN("&clk", "*", 0)==0)
  (
    &wild_head=1
  )
  if (STRING.SCAN("&clk", "*", 1)==(STRING.LENGTH("&clk")-1))
  (
    &wild_tail=1
  )

  if ((&wild_head==1)&&(&wild_tail==1))
  (
    if (STRING.SCAN("mmagic_video_axi_clk", STRING.MID("&clk", 1, &clk_input_length-2), 0)!=-1)
    ( 
      &match=1
    )
  )
  else if (&wild_head==1)
  (
    if (STRING.MID("mmagic_video_axi_clk", &clk_itr_length-&clk_input_length+1, &clk_input_length-1)==STRING.CUT("&clk", 1))
    ( 
      &match=1
    )
  )
  else if (&wild_tail==1)
  (
    if (STRING.MID("mmagic_video_axi_clk", 0, &clk_input_length-1)==STRING.CUT("&clk", -1))
    ( 
      &match=1
    )
  )
  else if ("mmagic_video_axi_clk"=="&clk")
  (
    &match=1
  )
  
  if (&match==1)
  (
    &clk_test=&CLK_TEST_MMAGIC_VIDEO_AXI_CLK
    &clk_reg=&HWIO_MMSS_MMAGIC_VIDEO_AXI_CBCR_ADDR
    &clk_reg_name="MMSS_MMAGIC_VIDEO_AXI_CBCR"
    &clk_name="mmagic_video_axi_clk"
    &clk_reg_cbcr_type="sm_cbc"
    &clk_vote_bit=-1.
    &clk_multiplier=3.

    gosub Print_Clk_Info_Line
  )

  &match=0
  &wild_head=0
  &wild_tail=0
  &clk_input_length=STRING.LENGTH("&clk")
  &clk_itr_length=STRING.LENGTH("mmss_mmagic_axi_clk")

  if (STRING.SCAN("&clk", "*", 0)==0)
  (
    &wild_head=1
  )
  if (STRING.SCAN("&clk", "*", 1)==(STRING.LENGTH("&clk")-1))
  (
    &wild_tail=1
  )

  if ((&wild_head==1)&&(&wild_tail==1))
  (
    if (STRING.SCAN("mmss_mmagic_axi_clk", STRING.MID("&clk", 1, &clk_input_length-2), 0)!=-1)
    ( 
      &match=1
    )
  )
  else if (&wild_head==1)
  (
    if (STRING.MID("mmss_mmagic_axi_clk", &clk_itr_length-&clk_input_length+1, &clk_input_length-1)==STRING.CUT("&clk", 1))
    ( 
      &match=1
    )
  )
  else if (&wild_tail==1)
  (
    if (STRING.MID("mmss_mmagic_axi_clk", 0, &clk_input_length-1)==STRING.CUT("&clk", -1))
    ( 
      &match=1
    )
  )
  else if ("mmss_mmagic_axi_clk"=="&clk")||("buses"=="&clk")
  (
    &match=1
  )
  
  if (&match==1)
  (
    &clk_test=&CLK_TEST_MMSS_MMAGIC_AXI_CLK
    &clk_reg=&HWIO_MMSS_MMSS_MMAGIC_AXI_CBCR_ADDR
    &clk_reg_name="MMSS_MMSS_MMAGIC_AXI_CBCR"
    &clk_name="mmss_mmagic_axi_clk"
    &clk_reg_cbcr_type="sm_cbc"
    &clk_vote_bit=-1.
    &clk_multiplier=3.

    gosub Print_Clk_Info_Line
  )

  &match=0
  &wild_head=0
  &wild_tail=0
  &clk_input_length=STRING.LENGTH("&clk")
  &clk_itr_length=STRING.LENGTH("mmss_s0_axi_clk")

  if (STRING.SCAN("&clk", "*", 0)==0)
  (
    &wild_head=1
  )
  if (STRING.SCAN("&clk", "*", 1)==(STRING.LENGTH("&clk")-1))
  (
    &wild_tail=1
  )

  if ((&wild_head==1)&&(&wild_tail==1))
  (
    if (STRING.SCAN("mmss_s0_axi_clk", STRING.MID("&clk", 1, &clk_input_length-2), 0)!=-1)
    ( 
      &match=1
    )
  )
  else if (&wild_head==1)
  (
    if (STRING.MID("mmss_s0_axi_clk", &clk_itr_length-&clk_input_length+1, &clk_input_length-1)==STRING.CUT("&clk", 1))
    ( 
      &match=1
    )
  )
  else if (&wild_tail==1)
  (
    if (STRING.MID("mmss_s0_axi_clk", 0, &clk_input_length-1)==STRING.CUT("&clk", -1))
    ( 
      &match=1
    )
  )
  else if ("mmss_s0_axi_clk"=="&clk")
  (
    &match=1
  )
  
  if (&match==1)
  (
    &clk_test=&CLK_TEST_MMSS_S0_AXI_CLK
    &clk_reg=&HWIO_MMSS_MMSS_S0_AXI_CBCR_ADDR
    &clk_reg_name="MMSS_MMSS_S0_AXI_CBCR"
    &clk_name="mmss_s0_axi_clk"
    &clk_reg_cbcr_type="sm_cbc"
    &clk_vote_bit=-1.
    &clk_multiplier=3.

    gosub Print_Clk_Info_Line
  )

  &match=0
  &wild_head=0
  &wild_tail=0
  &clk_input_length=STRING.LENGTH("&clk")
  &clk_itr_length=STRING.LENGTH("mmss_spdm_axi_clk")

  if (STRING.SCAN("&clk", "*", 0)==0)
  (
    &wild_head=1
  )
  if (STRING.SCAN("&clk", "*", 1)==(STRING.LENGTH("&clk")-1))
  (
    &wild_tail=1
  )

  if ((&wild_head==1)&&(&wild_tail==1))
  (
    if (STRING.SCAN("mmss_spdm_axi_clk", STRING.MID("&clk", 1, &clk_input_length-2), 0)!=-1)
    ( 
      &match=1
    )
  )
  else if (&wild_head==1)
  (
    if (STRING.MID("mmss_spdm_axi_clk", &clk_itr_length-&clk_input_length+1, &clk_input_length-1)==STRING.CUT("&clk", 1))
    ( 
      &match=1
    )
  )
  else if (&wild_tail==1)
  (
    if (STRING.MID("mmss_spdm_axi_clk", 0, &clk_input_length-1)==STRING.CUT("&clk", -1))
    ( 
      &match=1
    )
  )
  else if ("mmss_spdm_axi_clk"=="&clk")
  (
    &match=1
  )
  
  if (&match==1)
  (
    &clk_test=&CLK_TEST_MMSS_SPDM_AXI_CLK
    &clk_reg=&HWIO_MMSS_MMSS_SPDM_AXI_CBCR_ADDR
    &clk_reg_name="MMSS_MMSS_SPDM_AXI_CBCR"
    &clk_name="mmss_spdm_axi_clk"
    &clk_reg_cbcr_type="sm_cbc"
    &clk_vote_bit=-1.
    &clk_multiplier=3.

    gosub Print_Clk_Info_Line
  )

  &match=0
  &wild_head=0
  &wild_tail=0
  &clk_input_length=STRING.LENGTH("&clk")
  &clk_itr_length=STRING.LENGTH("mmss_spdm_rm_axi_clk")

  if (STRING.SCAN("&clk", "*", 0)==0)
  (
    &wild_head=1
  )
  if (STRING.SCAN("&clk", "*", 1)==(STRING.LENGTH("&clk")-1))
  (
    &wild_tail=1
  )

  if ((&wild_head==1)&&(&wild_tail==1))
  (
    if (STRING.SCAN("mmss_spdm_rm_axi_clk", STRING.MID("&clk", 1, &clk_input_length-2), 0)!=-1)
    ( 
      &match=1
    )
  )
  else if (&wild_head==1)
  (
    if (STRING.MID("mmss_spdm_rm_axi_clk", &clk_itr_length-&clk_input_length+1, &clk_input_length-1)==STRING.CUT("&clk", 1))
    ( 
      &match=1
    )
  )
  else if (&wild_tail==1)
  (
    if (STRING.MID("mmss_spdm_rm_axi_clk", 0, &clk_input_length-1)==STRING.CUT("&clk", -1))
    ( 
      &match=1
    )
  )
  else if ("mmss_spdm_rm_axi_clk"=="&clk")
  (
    &match=1
  )
  
  if (&match==1)
  (
    &clk_test=&CLK_TEST_MMSS_SPDM_RM_AXI_CLK
    &clk_reg=&HWIO_MMSS_MMSS_SPDM_RM_AXI_CBCR_ADDR
    &clk_reg_name="MMSS_MMSS_SPDM_RM_AXI_CBCR"
    &clk_name="mmss_spdm_rm_axi_clk"
    &clk_reg_cbcr_type="sm_cbc"
    &clk_vote_bit=-1.
    &clk_multiplier=3.

    gosub Print_Clk_Info_Line
  )

  &match=0
  &wild_head=0
  &wild_tail=0
  &clk_input_length=STRING.LENGTH("&clk")
  &clk_itr_length=STRING.LENGTH("smmu_cpp_axi_clk")

  if (STRING.SCAN("&clk", "*", 0)==0)
  (
    &wild_head=1
  )
  if (STRING.SCAN("&clk", "*", 1)==(STRING.LENGTH("&clk")-1))
  (
    &wild_tail=1
  )

  if ((&wild_head==1)&&(&wild_tail==1))
  (
    if (STRING.SCAN("smmu_cpp_axi_clk", STRING.MID("&clk", 1, &clk_input_length-2), 0)!=-1)
    ( 
      &match=1
    )
  )
  else if (&wild_head==1)
  (
    if (STRING.MID("smmu_cpp_axi_clk", &clk_itr_length-&clk_input_length+1, &clk_input_length-1)==STRING.CUT("&clk", 1))
    ( 
      &match=1
    )
  )
  else if (&wild_tail==1)
  (
    if (STRING.MID("smmu_cpp_axi_clk", 0, &clk_input_length-1)==STRING.CUT("&clk", -1))
    ( 
      &match=1
    )
  )
  else if ("smmu_cpp_axi_clk"=="&clk")
  (
    &match=1
  )
  
  if (&match==1)
  (
    &clk_test=&CLK_TEST_SMMU_CPP_AXI_CLK
    &clk_reg=&HWIO_MMSS_SMMU_CPP_AXI_CBCR_ADDR
    &clk_reg_name="MMSS_SMMU_CPP_AXI_CBCR"
    &clk_name="smmu_cpp_axi_clk"
    &clk_reg_cbcr_type="sm_pscbc"
    &clk_vote_bit=-1.
    &clk_multiplier=3.

    gosub Print_Clk_Info_Line
  )

  &match=0
  &wild_head=0
  &wild_tail=0
  &clk_input_length=STRING.LENGTH("&clk")
  &clk_itr_length=STRING.LENGTH("smmu_jpeg_axi_clk")

  if (STRING.SCAN("&clk", "*", 0)==0)
  (
    &wild_head=1
  )
  if (STRING.SCAN("&clk", "*", 1)==(STRING.LENGTH("&clk")-1))
  (
    &wild_tail=1
  )

  if ((&wild_head==1)&&(&wild_tail==1))
  (
    if (STRING.SCAN("smmu_jpeg_axi_clk", STRING.MID("&clk", 1, &clk_input_length-2), 0)!=-1)
    ( 
      &match=1
    )
  )
  else if (&wild_head==1)
  (
    if (STRING.MID("smmu_jpeg_axi_clk", &clk_itr_length-&clk_input_length+1, &clk_input_length-1)==STRING.CUT("&clk", 1))
    ( 
      &match=1
    )
  )
  else if (&wild_tail==1)
  (
    if (STRING.MID("smmu_jpeg_axi_clk", 0, &clk_input_length-1)==STRING.CUT("&clk", -1))
    ( 
      &match=1
    )
  )
  else if ("smmu_jpeg_axi_clk"=="&clk")
  (
    &match=1
  )
  
  if (&match==1)
  (
    &clk_test=&CLK_TEST_SMMU_JPEG_AXI_CLK
    &clk_reg=&HWIO_MMSS_SMMU_JPEG_AXI_CBCR_ADDR
    &clk_reg_name="MMSS_SMMU_JPEG_AXI_CBCR"
    &clk_name="smmu_jpeg_axi_clk"
    &clk_reg_cbcr_type="sm_pscbc"
    &clk_vote_bit=-1.
    &clk_multiplier=3.

    gosub Print_Clk_Info_Line
  )

  &match=0
  &wild_head=0
  &wild_tail=0
  &clk_input_length=STRING.LENGTH("&clk")
  &clk_itr_length=STRING.LENGTH("smmu_mdp_axi_clk")

  if (STRING.SCAN("&clk", "*", 0)==0)
  (
    &wild_head=1
  )
  if (STRING.SCAN("&clk", "*", 1)==(STRING.LENGTH("&clk")-1))
  (
    &wild_tail=1
  )

  if ((&wild_head==1)&&(&wild_tail==1))
  (
    if (STRING.SCAN("smmu_mdp_axi_clk", STRING.MID("&clk", 1, &clk_input_length-2), 0)!=-1)
    ( 
      &match=1
    )
  )
  else if (&wild_head==1)
  (
    if (STRING.MID("smmu_mdp_axi_clk", &clk_itr_length-&clk_input_length+1, &clk_input_length-1)==STRING.CUT("&clk", 1))
    ( 
      &match=1
    )
  )
  else if (&wild_tail==1)
  (
    if (STRING.MID("smmu_mdp_axi_clk", 0, &clk_input_length-1)==STRING.CUT("&clk", -1))
    ( 
      &match=1
    )
  )
  else if ("smmu_mdp_axi_clk"=="&clk")
  (
    &match=1
  )
  
  if (&match==1)
  (
    &clk_test=&CLK_TEST_SMMU_MDP_AXI_CLK
    &clk_reg=&HWIO_MMSS_SMMU_MDP_AXI_CBCR_ADDR
    &clk_reg_name="MMSS_SMMU_MDP_AXI_CBCR"
    &clk_name="smmu_mdp_axi_clk"
    &clk_reg_cbcr_type="sm_pscbc"
    &clk_vote_bit=-1.
    &clk_multiplier=3.

    gosub Print_Clk_Info_Line
  )

  &match=0
  &wild_head=0
  &wild_tail=0
  &clk_input_length=STRING.LENGTH("&clk")
  &clk_itr_length=STRING.LENGTH("smmu_rot_axi_clk")

  if (STRING.SCAN("&clk", "*", 0)==0)
  (
    &wild_head=1
  )
  if (STRING.SCAN("&clk", "*", 1)==(STRING.LENGTH("&clk")-1))
  (
    &wild_tail=1
  )

  if ((&wild_head==1)&&(&wild_tail==1))
  (
    if (STRING.SCAN("smmu_rot_axi_clk", STRING.MID("&clk", 1, &clk_input_length-2), 0)!=-1)
    ( 
      &match=1
    )
  )
  else if (&wild_head==1)
  (
    if (STRING.MID("smmu_rot_axi_clk", &clk_itr_length-&clk_input_length+1, &clk_input_length-1)==STRING.CUT("&clk", 1))
    ( 
      &match=1
    )
  )
  else if (&wild_tail==1)
  (
    if (STRING.MID("smmu_rot_axi_clk", 0, &clk_input_length-1)==STRING.CUT("&clk", -1))
    ( 
      &match=1
    )
  )
  else if ("smmu_rot_axi_clk"=="&clk")
  (
    &match=1
  )
  
  if (&match==1)
  (
    &clk_test=&CLK_TEST_SMMU_ROT_AXI_CLK
    &clk_reg=&HWIO_MMSS_SMMU_ROT_AXI_CBCR_ADDR
    &clk_reg_name="MMSS_SMMU_ROT_AXI_CBCR"
    &clk_name="smmu_rot_axi_clk"
    &clk_reg_cbcr_type="sm_pscbc"
    &clk_vote_bit=-1.
    &clk_multiplier=3.

    gosub Print_Clk_Info_Line
  )

  &match=0
  &wild_head=0
  &wild_tail=0
  &clk_input_length=STRING.LENGTH("&clk")
  &clk_itr_length=STRING.LENGTH("smmu_vfe_axi_clk")

  if (STRING.SCAN("&clk", "*", 0)==0)
  (
    &wild_head=1
  )
  if (STRING.SCAN("&clk", "*", 1)==(STRING.LENGTH("&clk")-1))
  (
    &wild_tail=1
  )

  if ((&wild_head==1)&&(&wild_tail==1))
  (
    if (STRING.SCAN("smmu_vfe_axi_clk", STRING.MID("&clk", 1, &clk_input_length-2), 0)!=-1)
    ( 
      &match=1
    )
  )
  else if (&wild_head==1)
  (
    if (STRING.MID("smmu_vfe_axi_clk", &clk_itr_length-&clk_input_length+1, &clk_input_length-1)==STRING.CUT("&clk", 1))
    ( 
      &match=1
    )
  )
  else if (&wild_tail==1)
  (
    if (STRING.MID("smmu_vfe_axi_clk", 0, &clk_input_length-1)==STRING.CUT("&clk", -1))
    ( 
      &match=1
    )
  )
  else if ("smmu_vfe_axi_clk"=="&clk")
  (
    &match=1
  )
  
  if (&match==1)
  (
    &clk_test=&CLK_TEST_SMMU_VFE_AXI_CLK
    &clk_reg=&HWIO_MMSS_SMMU_VFE_AXI_CBCR_ADDR
    &clk_reg_name="MMSS_SMMU_VFE_AXI_CBCR"
    &clk_name="smmu_vfe_axi_clk"
    &clk_reg_cbcr_type="sm_pscbc"
    &clk_vote_bit=-1.
    &clk_multiplier=3.

    gosub Print_Clk_Info_Line
  )

  &match=0
  &wild_head=0
  &wild_tail=0
  &clk_input_length=STRING.LENGTH("&clk")
  &clk_itr_length=STRING.LENGTH("smmu_video_axi_clk")

  if (STRING.SCAN("&clk", "*", 0)==0)
  (
    &wild_head=1
  )
  if (STRING.SCAN("&clk", "*", 1)==(STRING.LENGTH("&clk")-1))
  (
    &wild_tail=1
  )

  if ((&wild_head==1)&&(&wild_tail==1))
  (
    if (STRING.SCAN("smmu_video_axi_clk", STRING.MID("&clk", 1, &clk_input_length-2), 0)!=-1)
    ( 
      &match=1
    )
  )
  else if (&wild_head==1)
  (
    if (STRING.MID("smmu_video_axi_clk", &clk_itr_length-&clk_input_length+1, &clk_input_length-1)==STRING.CUT("&clk", 1))
    ( 
      &match=1
    )
  )
  else if (&wild_tail==1)
  (
    if (STRING.MID("smmu_video_axi_clk", 0, &clk_input_length-1)==STRING.CUT("&clk", -1))
    ( 
      &match=1
    )
  )
  else if ("smmu_video_axi_clk"=="&clk")
  (
    &match=1
  )
  
  if (&match==1)
  (
    &clk_test=&CLK_TEST_SMMU_VIDEO_AXI_CLK
    &clk_reg=&HWIO_MMSS_SMMU_VIDEO_AXI_CBCR_ADDR
    &clk_reg_name="MMSS_SMMU_VIDEO_AXI_CBCR"
    &clk_name="smmu_video_axi_clk"
    &clk_reg_cbcr_type="sm_pscbc"
    &clk_vote_bit=-1.
    &clk_multiplier=3.

    gosub Print_Clk_Info_Line
  )

  &match=0
  &wild_head=0
  &wild_tail=0
  &clk_input_length=STRING.LENGTH("&clk")
  &clk_itr_length=STRING.LENGTH("throttle_camss_axi_clk")

  if (STRING.SCAN("&clk", "*", 0)==0)
  (
    &wild_head=1
  )
  if (STRING.SCAN("&clk", "*", 1)==(STRING.LENGTH("&clk")-1))
  (
    &wild_tail=1
  )

  if ((&wild_head==1)&&(&wild_tail==1))
  (
    if (STRING.SCAN("throttle_camss_axi_clk", STRING.MID("&clk", 1, &clk_input_length-2), 0)!=-1)
    ( 
      &match=1
    )
  )
  else if (&wild_head==1)
  (
    if (STRING.MID("throttle_camss_axi_clk", &clk_itr_length-&clk_input_length+1, &clk_input_length-1)==STRING.CUT("&clk", 1))
    ( 
      &match=1
    )
  )
  else if (&wild_tail==1)
  (
    if (STRING.MID("throttle_camss_axi_clk", 0, &clk_input_length-1)==STRING.CUT("&clk", -1))
    ( 
      &match=1
    )
  )
  else if ("throttle_camss_axi_clk"=="&clk")
  (
    &match=1
  )
  
  if (&match==1)
  (
    &clk_test=&CLK_TEST_THROTTLE_CAMSS_AXI_CLK
    &clk_reg=&HWIO_MMSS_THROTTLE_CAMSS_AXI_CBCR_ADDR
    &clk_reg_name="MMSS_THROTTLE_CAMSS_AXI_CBCR"
    &clk_name="throttle_camss_axi_clk"
    &clk_reg_cbcr_type="sm_cbc"
    &clk_vote_bit=-1.
    &clk_multiplier=3.

    gosub Print_Clk_Info_Line
  )

  &match=0
  &wild_head=0
  &wild_tail=0
  &clk_input_length=STRING.LENGTH("&clk")
  &clk_itr_length=STRING.LENGTH("throttle_mdss_axi_clk")

  if (STRING.SCAN("&clk", "*", 0)==0)
  (
    &wild_head=1
  )
  if (STRING.SCAN("&clk", "*", 1)==(STRING.LENGTH("&clk")-1))
  (
    &wild_tail=1
  )

  if ((&wild_head==1)&&(&wild_tail==1))
  (
    if (STRING.SCAN("throttle_mdss_axi_clk", STRING.MID("&clk", 1, &clk_input_length-2), 0)!=-1)
    ( 
      &match=1
    )
  )
  else if (&wild_head==1)
  (
    if (STRING.MID("throttle_mdss_axi_clk", &clk_itr_length-&clk_input_length+1, &clk_input_length-1)==STRING.CUT("&clk", 1))
    ( 
      &match=1
    )
  )
  else if (&wild_tail==1)
  (
    if (STRING.MID("throttle_mdss_axi_clk", 0, &clk_input_length-1)==STRING.CUT("&clk", -1))
    ( 
      &match=1
    )
  )
  else if ("throttle_mdss_axi_clk"=="&clk")
  (
    &match=1
  )
  
  if (&match==1)
  (
    &clk_test=&CLK_TEST_THROTTLE_MDSS_AXI_CLK
    &clk_reg=&HWIO_MMSS_THROTTLE_MDSS_AXI_CBCR_ADDR
    &clk_reg_name="MMSS_THROTTLE_MDSS_AXI_CBCR"
    &clk_name="throttle_mdss_axi_clk"
    &clk_reg_cbcr_type="sm_cbc"
    &clk_vote_bit=-1.
    &clk_multiplier=3.

    gosub Print_Clk_Info_Line
  )

  &match=0
  &wild_head=0
  &wild_tail=0
  &clk_input_length=STRING.LENGTH("&clk")
  &clk_itr_length=STRING.LENGTH("throttle_video_axi_clk")

  if (STRING.SCAN("&clk", "*", 0)==0)
  (
    &wild_head=1
  )
  if (STRING.SCAN("&clk", "*", 1)==(STRING.LENGTH("&clk")-1))
  (
    &wild_tail=1
  )

  if ((&wild_head==1)&&(&wild_tail==1))
  (
    if (STRING.SCAN("throttle_video_axi_clk", STRING.MID("&clk", 1, &clk_input_length-2), 0)!=-1)
    ( 
      &match=1
    )
  )
  else if (&wild_head==1)
  (
    if (STRING.MID("throttle_video_axi_clk", &clk_itr_length-&clk_input_length+1, &clk_input_length-1)==STRING.CUT("&clk", 1))
    ( 
      &match=1
    )
  )
  else if (&wild_tail==1)
  (
    if (STRING.MID("throttle_video_axi_clk", 0, &clk_input_length-1)==STRING.CUT("&clk", -1))
    ( 
      &match=1
    )
  )
  else if ("throttle_video_axi_clk"=="&clk")
  (
    &match=1
  )
  
  if (&match==1)
  (
    &clk_test=&CLK_TEST_THROTTLE_VIDEO_AXI_CLK
    &clk_reg=&HWIO_MMSS_THROTTLE_VIDEO_AXI_CBCR_ADDR
    &clk_reg_name="MMSS_THROTTLE_VIDEO_AXI_CBCR"
    &clk_name="throttle_video_axi_clk"
    &clk_reg_cbcr_type="sm_cbc"
    &clk_vote_bit=-1.
    &clk_multiplier=3.

    gosub Print_Clk_Info_Line
  )

  &match=0
  &wild_head=0
  &wild_tail=0
  &clk_input_length=STRING.LENGTH("&clk")
  &clk_itr_length=STRING.LENGTH("video_axi_clk")

  if (STRING.SCAN("&clk", "*", 0)==0)
  (
    &wild_head=1
  )
  if (STRING.SCAN("&clk", "*", 1)==(STRING.LENGTH("&clk")-1))
  (
    &wild_tail=1
  )

  if ((&wild_head==1)&&(&wild_tail==1))
  (
    if (STRING.SCAN("video_axi_clk", STRING.MID("&clk", 1, &clk_input_length-2), 0)!=-1)
    ( 
      &match=1
    )
  )
  else if (&wild_head==1)
  (
    if (STRING.MID("video_axi_clk", &clk_itr_length-&clk_input_length+1, &clk_input_length-1)==STRING.CUT("&clk", 1))
    ( 
      &match=1
    )
  )
  else if (&wild_tail==1)
  (
    if (STRING.MID("video_axi_clk", 0, &clk_input_length-1)==STRING.CUT("&clk", -1))
    ( 
      &match=1
    )
  )
  else if ("video_axi_clk"=="&clk")
  (
    &match=1
  )
  
  if (&match==1)
  (
    &clk_test=&CLK_TEST_VIDEO_AXI_CLK
    &clk_reg=&HWIO_MMSS_VIDEO_AXI_CBCR_ADDR
    &clk_reg_name="MMSS_VIDEO_AXI_CBCR"
    &clk_name="video_axi_clk"
    &clk_reg_cbcr_type="sm_pscbc"
    &clk_vote_bit=-1.
    &clk_multiplier=3.

    gosub Print_Clk_Info_Line
  )

  &match=0
  &wild_head=0
  &wild_tail=0
  &clk_input_length=STRING.LENGTH("&clk")
  &clk_itr_length=STRING.LENGTH("mdss_byte0_clk")

  if (STRING.SCAN("&clk", "*", 0)==0)
  (
    &wild_head=1
  )
  if (STRING.SCAN("&clk", "*", 1)==(STRING.LENGTH("&clk")-1))
  (
    &wild_tail=1
  )

  if ((&wild_head==1)&&(&wild_tail==1))
  (
    if (STRING.SCAN("mdss_byte0_clk", STRING.MID("&clk", 1, &clk_input_length-2), 0)!=-1)
    ( 
      &match=1
    )
  )
  else if (&wild_head==1)
  (
    if (STRING.MID("mdss_byte0_clk", &clk_itr_length-&clk_input_length+1, &clk_input_length-1)==STRING.CUT("&clk", 1))
    ( 
      &match=1
    )
  )
  else if (&wild_tail==1)
  (
    if (STRING.MID("mdss_byte0_clk", 0, &clk_input_length-1)==STRING.CUT("&clk", -1))
    ( 
      &match=1
    )
  )
  else if ("mdss_byte0_clk"=="&clk")
  (
    &match=1
  )
  
  if (&match==1)
  (
    &clk_test=&CLK_TEST_MDSS_BYTE0_CLK
    &clk_reg=&HWIO_MMSS_MDSS_BYTE0_CBCR_ADDR
    &clk_reg_name="MMSS_MDSS_BYTE0_CBCR"
    &clk_name="mdss_byte0_clk"
    &clk_reg_cbcr_type="sm_cbc"
    &clk_vote_bit=-1.
    &clk_multiplier=3.

    gosub Print_Clk_Info_Line
  )

  &match=0
  &wild_head=0
  &wild_tail=0
  &clk_input_length=STRING.LENGTH("&clk")
  &clk_itr_length=STRING.LENGTH("mdss_byte1_clk")

  if (STRING.SCAN("&clk", "*", 0)==0)
  (
    &wild_head=1
  )
  if (STRING.SCAN("&clk", "*", 1)==(STRING.LENGTH("&clk")-1))
  (
    &wild_tail=1
  )

  if ((&wild_head==1)&&(&wild_tail==1))
  (
    if (STRING.SCAN("mdss_byte1_clk", STRING.MID("&clk", 1, &clk_input_length-2), 0)!=-1)
    ( 
      &match=1
    )
  )
  else if (&wild_head==1)
  (
    if (STRING.MID("mdss_byte1_clk", &clk_itr_length-&clk_input_length+1, &clk_input_length-1)==STRING.CUT("&clk", 1))
    ( 
      &match=1
    )
  )
  else if (&wild_tail==1)
  (
    if (STRING.MID("mdss_byte1_clk", 0, &clk_input_length-1)==STRING.CUT("&clk", -1))
    ( 
      &match=1
    )
  )
  else if ("mdss_byte1_clk"=="&clk")
  (
    &match=1
  )
  
  if (&match==1)
  (
    &clk_test=&CLK_TEST_MDSS_BYTE1_CLK
    &clk_reg=&HWIO_MMSS_MDSS_BYTE1_CBCR_ADDR
    &clk_reg_name="MMSS_MDSS_BYTE1_CBCR"
    &clk_name="mdss_byte1_clk"
    &clk_reg_cbcr_type="sm_cbc"
    &clk_vote_bit=-1.
    &clk_multiplier=3.

    gosub Print_Clk_Info_Line
  )

  &match=0
  &wild_head=0
  &wild_tail=0
  &clk_input_length=STRING.LENGTH("&clk")
  &clk_itr_length=STRING.LENGTH("camss_gp0_clk")

  if (STRING.SCAN("&clk", "*", 0)==0)
  (
    &wild_head=1
  )
  if (STRING.SCAN("&clk", "*", 1)==(STRING.LENGTH("&clk")-1))
  (
    &wild_tail=1
  )

  if ((&wild_head==1)&&(&wild_tail==1))
  (
    if (STRING.SCAN("camss_gp0_clk", STRING.MID("&clk", 1, &clk_input_length-2), 0)!=-1)
    ( 
      &match=1
    )
  )
  else if (&wild_head==1)
  (
    if (STRING.MID("camss_gp0_clk", &clk_itr_length-&clk_input_length+1, &clk_input_length-1)==STRING.CUT("&clk", 1))
    ( 
      &match=1
    )
  )
  else if (&wild_tail==1)
  (
    if (STRING.MID("camss_gp0_clk", 0, &clk_input_length-1)==STRING.CUT("&clk", -1))
    ( 
      &match=1
    )
  )
  else if ("camss_gp0_clk"=="&clk")
  (
    &match=1
  )
  
  if (&match==1)
  (
    &clk_test=&CLK_TEST_CAMSS_GP0_CLK
    &clk_reg=&HWIO_MMSS_CAMSS_GP0_CBCR_ADDR
    &clk_reg_name="MMSS_CAMSS_GP0_CBCR"
    &clk_name="camss_gp0_clk"
    &clk_reg_cbcr_type="sm_cbc"
    &clk_vote_bit=-1.
    &clk_multiplier=3.

    gosub Print_Clk_Info_Line
  )

  &match=0
  &wild_head=0
  &wild_tail=0
  &clk_input_length=STRING.LENGTH("&clk")
  &clk_itr_length=STRING.LENGTH("camss_gp1_clk")

  if (STRING.SCAN("&clk", "*", 0)==0)
  (
    &wild_head=1
  )
  if (STRING.SCAN("&clk", "*", 1)==(STRING.LENGTH("&clk")-1))
  (
    &wild_tail=1
  )

  if ((&wild_head==1)&&(&wild_tail==1))
  (
    if (STRING.SCAN("camss_gp1_clk", STRING.MID("&clk", 1, &clk_input_length-2), 0)!=-1)
    ( 
      &match=1
    )
  )
  else if (&wild_head==1)
  (
    if (STRING.MID("camss_gp1_clk", &clk_itr_length-&clk_input_length+1, &clk_input_length-1)==STRING.CUT("&clk", 1))
    ( 
      &match=1
    )
  )
  else if (&wild_tail==1)
  (
    if (STRING.MID("camss_gp1_clk", 0, &clk_input_length-1)==STRING.CUT("&clk", -1))
    ( 
      &match=1
    )
  )
  else if ("camss_gp1_clk"=="&clk")
  (
    &match=1
  )
  
  if (&match==1)
  (
    &clk_test=&CLK_TEST_CAMSS_GP1_CLK
    &clk_reg=&HWIO_MMSS_CAMSS_GP1_CBCR_ADDR
    &clk_reg_name="MMSS_CAMSS_GP1_CBCR"
    &clk_name="camss_gp1_clk"
    &clk_reg_cbcr_type="sm_cbc"
    &clk_vote_bit=-1.
    &clk_multiplier=3.

    gosub Print_Clk_Info_Line
  )

  &match=0
  &wild_head=0
  &wild_tail=0
  &clk_input_length=STRING.LENGTH("&clk")
  &clk_itr_length=STRING.LENGTH("camss_cci_clk")

  if (STRING.SCAN("&clk", "*", 0)==0)
  (
    &wild_head=1
  )
  if (STRING.SCAN("&clk", "*", 1)==(STRING.LENGTH("&clk")-1))
  (
    &wild_tail=1
  )

  if ((&wild_head==1)&&(&wild_tail==1))
  (
    if (STRING.SCAN("camss_cci_clk", STRING.MID("&clk", 1, &clk_input_length-2), 0)!=-1)
    ( 
      &match=1
    )
  )
  else if (&wild_head==1)
  (
    if (STRING.MID("camss_cci_clk", &clk_itr_length-&clk_input_length+1, &clk_input_length-1)==STRING.CUT("&clk", 1))
    ( 
      &match=1
    )
  )
  else if (&wild_tail==1)
  (
    if (STRING.MID("camss_cci_clk", 0, &clk_input_length-1)==STRING.CUT("&clk", -1))
    ( 
      &match=1
    )
  )
  else if ("camss_cci_clk"=="&clk")
  (
    &match=1
  )
  
  if (&match==1)
  (
    &clk_test=&CLK_TEST_CAMSS_CCI_CLK
    &clk_reg=&HWIO_MMSS_CAMSS_CCI_CBCR_ADDR
    &clk_reg_name="MMSS_CAMSS_CCI_CBCR"
    &clk_name="camss_cci_clk"
    &clk_reg_cbcr_type="sm_cbc"
    &clk_vote_bit=-1.
    &clk_multiplier=3.

    gosub Print_Clk_Info_Line
  )

  &match=0
  &wild_head=0
  &wild_tail=0
  &clk_input_length=STRING.LENGTH("&clk")
  &clk_itr_length=STRING.LENGTH("mmss_sleepclk_clk")

  if (STRING.SCAN("&clk", "*", 0)==0)
  (
    &wild_head=1
  )
  if (STRING.SCAN("&clk", "*", 1)==(STRING.LENGTH("&clk")-1))
  (
    &wild_tail=1
  )

  if ((&wild_head==1)&&(&wild_tail==1))
  (
    if (STRING.SCAN("mmss_sleepclk_clk", STRING.MID("&clk", 1, &clk_input_length-2), 0)!=-1)
    ( 
      &match=1
    )
  )
  else if (&wild_head==1)
  (
    if (STRING.MID("mmss_sleepclk_clk", &clk_itr_length-&clk_input_length+1, &clk_input_length-1)==STRING.CUT("&clk", 1))
    ( 
      &match=1
    )
  )
  else if (&wild_tail==1)
  (
    if (STRING.MID("mmss_sleepclk_clk", 0, &clk_input_length-1)==STRING.CUT("&clk", -1))
    ( 
      &match=1
    )
  )
  else if ("mmss_sleepclk_clk"=="&clk")
  (
    &match=1
  )
  
  if (&match==1)
  (
    &clk_test=0
    &clk_reg=&HWIO_MMSS_MMSS_SLEEPCLK_CBCR_ADDR
    &clk_reg_name="MMSS_MMSS_SLEEPCLK_CBCR"
    &clk_name="mmss_sleepclk_clk"
    &clk_reg_cbcr_type="sm_cbc"
    &clk_vote_bit=-1.
    &clk_multiplier=3.

    gosub Print_Clk_Info_Line
  )

  &match=0
  &wild_head=0
  &wild_tail=0
  &clk_input_length=STRING.LENGTH("&clk")
  &clk_itr_length=STRING.LENGTH("camss_cpp_clk")

  if (STRING.SCAN("&clk", "*", 0)==0)
  (
    &wild_head=1
  )
  if (STRING.SCAN("&clk", "*", 1)==(STRING.LENGTH("&clk")-1))
  (
    &wild_tail=1
  )

  if ((&wild_head==1)&&(&wild_tail==1))
  (
    if (STRING.SCAN("camss_cpp_clk", STRING.MID("&clk", 1, &clk_input_length-2), 0)!=-1)
    ( 
      &match=1
    )
  )
  else if (&wild_head==1)
  (
    if (STRING.MID("camss_cpp_clk", &clk_itr_length-&clk_input_length+1, &clk_input_length-1)==STRING.CUT("&clk", 1))
    ( 
      &match=1
    )
  )
  else if (&wild_tail==1)
  (
    if (STRING.MID("camss_cpp_clk", 0, &clk_input_length-1)==STRING.CUT("&clk", -1))
    ( 
      &match=1
    )
  )
  else if ("camss_cpp_clk"=="&clk")
  (
    &match=1
  )
  
  if (&match==1)
  (
    &clk_test=&CLK_TEST_CAMSS_CPP_CLK
    &clk_reg=&HWIO_MMSS_CAMSS_CPP_CBCR_ADDR
    &clk_reg_name="MMSS_CAMSS_CPP_CBCR"
    &clk_name="camss_cpp_clk"
    &clk_reg_cbcr_type="sm_pscbc"
    &clk_vote_bit=-1.
    &clk_multiplier=3.

    gosub Print_Clk_Info_Line
  )

  &match=0
  &wild_head=0
  &wild_tail=0
  &clk_input_length=STRING.LENGTH("&clk")
  &clk_itr_length=STRING.LENGTH("mmss_spdm_cpp_clk")

  if (STRING.SCAN("&clk", "*", 0)==0)
  (
    &wild_head=1
  )
  if (STRING.SCAN("&clk", "*", 1)==(STRING.LENGTH("&clk")-1))
  (
    &wild_tail=1
  )

  if ((&wild_head==1)&&(&wild_tail==1))
  (
    if (STRING.SCAN("mmss_spdm_cpp_clk", STRING.MID("&clk", 1, &clk_input_length-2), 0)!=-1)
    ( 
      &match=1
    )
  )
  else if (&wild_head==1)
  (
    if (STRING.MID("mmss_spdm_cpp_clk", &clk_itr_length-&clk_input_length+1, &clk_input_length-1)==STRING.CUT("&clk", 1))
    ( 
      &match=1
    )
  )
  else if (&wild_tail==1)
  (
    if (STRING.MID("mmss_spdm_cpp_clk", 0, &clk_input_length-1)==STRING.CUT("&clk", -1))
    ( 
      &match=1
    )
  )
  else if ("mmss_spdm_cpp_clk"=="&clk")
  (
    &match=1
  )
  
  if (&match==1)
  (
    &clk_test=&CLK_TEST_MMSS_SPDM_CPP_CLK
    &clk_reg=&HWIO_MMSS_MMSS_SPDM_CPP_CBCR_ADDR
    &clk_reg_name="MMSS_MMSS_SPDM_CPP_CBCR"
    &clk_name="mmss_spdm_cpp_clk"
    &clk_reg_cbcr_type="sm_cbc"
    &clk_vote_bit=-1.
    &clk_multiplier=3.

    gosub Print_Clk_Info_Line
  )

  &match=0
  &wild_head=0
  &wild_tail=0
  &clk_input_length=STRING.LENGTH("&clk")
  &clk_itr_length=STRING.LENGTH("camss_csi0_clk")

  if (STRING.SCAN("&clk", "*", 0)==0)
  (
    &wild_head=1
  )
  if (STRING.SCAN("&clk", "*", 1)==(STRING.LENGTH("&clk")-1))
  (
    &wild_tail=1
  )

  if ((&wild_head==1)&&(&wild_tail==1))
  (
    if (STRING.SCAN("camss_csi0_clk", STRING.MID("&clk", 1, &clk_input_length-2), 0)!=-1)
    ( 
      &match=1
    )
  )
  else if (&wild_head==1)
  (
    if (STRING.MID("camss_csi0_clk", &clk_itr_length-&clk_input_length+1, &clk_input_length-1)==STRING.CUT("&clk", 1))
    ( 
      &match=1
    )
  )
  else if (&wild_tail==1)
  (
    if (STRING.MID("camss_csi0_clk", 0, &clk_input_length-1)==STRING.CUT("&clk", -1))
    ( 
      &match=1
    )
  )
  else if ("camss_csi0_clk"=="&clk")
  (
    &match=1
  )
  
  if (&match==1)
  (
    &clk_test=&CLK_TEST_CAMSS_CSI0_CLK
    &clk_reg=&HWIO_MMSS_CAMSS_CSI0_CBCR_ADDR
    &clk_reg_name="MMSS_CAMSS_CSI0_CBCR"
    &clk_name="camss_csi0_clk"
    &clk_reg_cbcr_type="sm_cbc"
    &clk_vote_bit=-1.
    &clk_multiplier=3.

    gosub Print_Clk_Info_Line
  )

  &match=0
  &wild_head=0
  &wild_tail=0
  &clk_input_length=STRING.LENGTH("&clk")
  &clk_itr_length=STRING.LENGTH("camss_csi0phy_clk")

  if (STRING.SCAN("&clk", "*", 0)==0)
  (
    &wild_head=1
  )
  if (STRING.SCAN("&clk", "*", 1)==(STRING.LENGTH("&clk")-1))
  (
    &wild_tail=1
  )

  if ((&wild_head==1)&&(&wild_tail==1))
  (
    if (STRING.SCAN("camss_csi0phy_clk", STRING.MID("&clk", 1, &clk_input_length-2), 0)!=-1)
    ( 
      &match=1
    )
  )
  else if (&wild_head==1)
  (
    if (STRING.MID("camss_csi0phy_clk", &clk_itr_length-&clk_input_length+1, &clk_input_length-1)==STRING.CUT("&clk", 1))
    ( 
      &match=1
    )
  )
  else if (&wild_tail==1)
  (
    if (STRING.MID("camss_csi0phy_clk", 0, &clk_input_length-1)==STRING.CUT("&clk", -1))
    ( 
      &match=1
    )
  )
  else if ("camss_csi0phy_clk"=="&clk")
  (
    &match=1
  )
  
  if (&match==1)
  (
    &clk_test=&CLK_TEST_CAMSS_CSI0PHY_CLK
    &clk_reg=&HWIO_MMSS_CAMSS_CSI0PHY_CBCR_ADDR
    &clk_reg_name="MMSS_CAMSS_CSI0PHY_CBCR"
    &clk_name="camss_csi0phy_clk"
    &clk_reg_cbcr_type="sm_cbc"
    &clk_vote_bit=-1.
    &clk_multiplier=3.

    gosub Print_Clk_Info_Line
  )

  &match=0
  &wild_head=0
  &wild_tail=0
  &clk_input_length=STRING.LENGTH("&clk")
  &clk_itr_length=STRING.LENGTH("camss_csi0pix_clk")

  if (STRING.SCAN("&clk", "*", 0)==0)
  (
    &wild_head=1
  )
  if (STRING.SCAN("&clk", "*", 1)==(STRING.LENGTH("&clk")-1))
  (
    &wild_tail=1
  )

  if ((&wild_head==1)&&(&wild_tail==1))
  (
    if (STRING.SCAN("camss_csi0pix_clk", STRING.MID("&clk", 1, &clk_input_length-2), 0)!=-1)
    ( 
      &match=1
    )
  )
  else if (&wild_head==1)
  (
    if (STRING.MID("camss_csi0pix_clk", &clk_itr_length-&clk_input_length+1, &clk_input_length-1)==STRING.CUT("&clk", 1))
    ( 
      &match=1
    )
  )
  else if (&wild_tail==1)
  (
    if (STRING.MID("camss_csi0pix_clk", 0, &clk_input_length-1)==STRING.CUT("&clk", -1))
    ( 
      &match=1
    )
  )
  else if ("camss_csi0pix_clk"=="&clk")
  (
    &match=1
  )
  
  if (&match==1)
  (
    &clk_test=&CLK_TEST_CAMSS_CSI0PIX_CLK
    &clk_reg=&HWIO_MMSS_CAMSS_CSI0PIX_CBCR_ADDR
    &clk_reg_name="MMSS_CAMSS_CSI0PIX_CBCR"
    &clk_name="camss_csi0pix_clk"
    &clk_reg_cbcr_type="sm_cbc"
    &clk_vote_bit=-1.
    &clk_multiplier=3.

    gosub Print_Clk_Info_Line
  )

  &match=0
  &wild_head=0
  &wild_tail=0
  &clk_input_length=STRING.LENGTH("&clk")
  &clk_itr_length=STRING.LENGTH("camss_csi0rdi_clk")

  if (STRING.SCAN("&clk", "*", 0)==0)
  (
    &wild_head=1
  )
  if (STRING.SCAN("&clk", "*", 1)==(STRING.LENGTH("&clk")-1))
  (
    &wild_tail=1
  )

  if ((&wild_head==1)&&(&wild_tail==1))
  (
    if (STRING.SCAN("camss_csi0rdi_clk", STRING.MID("&clk", 1, &clk_input_length-2), 0)!=-1)
    ( 
      &match=1
    )
  )
  else if (&wild_head==1)
  (
    if (STRING.MID("camss_csi0rdi_clk", &clk_itr_length-&clk_input_length+1, &clk_input_length-1)==STRING.CUT("&clk", 1))
    ( 
      &match=1
    )
  )
  else if (&wild_tail==1)
  (
    if (STRING.MID("camss_csi0rdi_clk", 0, &clk_input_length-1)==STRING.CUT("&clk", -1))
    ( 
      &match=1
    )
  )
  else if ("camss_csi0rdi_clk"=="&clk")
  (
    &match=1
  )
  
  if (&match==1)
  (
    &clk_test=&CLK_TEST_CAMSS_CSI0RDI_CLK
    &clk_reg=&HWIO_MMSS_CAMSS_CSI0RDI_CBCR_ADDR
    &clk_reg_name="MMSS_CAMSS_CSI0RDI_CBCR"
    &clk_name="camss_csi0rdi_clk"
    &clk_reg_cbcr_type="sm_cbc"
    &clk_vote_bit=-1.
    &clk_multiplier=3.

    gosub Print_Clk_Info_Line
  )

  &match=0
  &wild_head=0
  &wild_tail=0
  &clk_input_length=STRING.LENGTH("&clk")
  &clk_itr_length=STRING.LENGTH("mmss_spdm_csi0_clk")

  if (STRING.SCAN("&clk", "*", 0)==0)
  (
    &wild_head=1
  )
  if (STRING.SCAN("&clk", "*", 1)==(STRING.LENGTH("&clk")-1))
  (
    &wild_tail=1
  )

  if ((&wild_head==1)&&(&wild_tail==1))
  (
    if (STRING.SCAN("mmss_spdm_csi0_clk", STRING.MID("&clk", 1, &clk_input_length-2), 0)!=-1)
    ( 
      &match=1
    )
  )
  else if (&wild_head==1)
  (
    if (STRING.MID("mmss_spdm_csi0_clk", &clk_itr_length-&clk_input_length+1, &clk_input_length-1)==STRING.CUT("&clk", 1))
    ( 
      &match=1
    )
  )
  else if (&wild_tail==1)
  (
    if (STRING.MID("mmss_spdm_csi0_clk", 0, &clk_input_length-1)==STRING.CUT("&clk", -1))
    ( 
      &match=1
    )
  )
  else if ("mmss_spdm_csi0_clk"=="&clk")
  (
    &match=1
  )
  
  if (&match==1)
  (
    &clk_test=&CLK_TEST_MMSS_SPDM_CSI0_CLK
    &clk_reg=&HWIO_MMSS_MMSS_SPDM_CSI0_CBCR_ADDR
    &clk_reg_name="MMSS_MMSS_SPDM_CSI0_CBCR"
    &clk_name="mmss_spdm_csi0_clk"
    &clk_reg_cbcr_type="sm_cbc"
    &clk_vote_bit=-1.
    &clk_multiplier=3.

    gosub Print_Clk_Info_Line
  )

  &match=0
  &wild_head=0
  &wild_tail=0
  &clk_input_length=STRING.LENGTH("&clk")
  &clk_itr_length=STRING.LENGTH("camss_csi0phytimer_clk")

  if (STRING.SCAN("&clk", "*", 0)==0)
  (
    &wild_head=1
  )
  if (STRING.SCAN("&clk", "*", 1)==(STRING.LENGTH("&clk")-1))
  (
    &wild_tail=1
  )

  if ((&wild_head==1)&&(&wild_tail==1))
  (
    if (STRING.SCAN("camss_csi0phytimer_clk", STRING.MID("&clk", 1, &clk_input_length-2), 0)!=-1)
    ( 
      &match=1
    )
  )
  else if (&wild_head==1)
  (
    if (STRING.MID("camss_csi0phytimer_clk", &clk_itr_length-&clk_input_length+1, &clk_input_length-1)==STRING.CUT("&clk", 1))
    ( 
      &match=1
    )
  )
  else if (&wild_tail==1)
  (
    if (STRING.MID("camss_csi0phytimer_clk", 0, &clk_input_length-1)==STRING.CUT("&clk", -1))
    ( 
      &match=1
    )
  )
  else if ("camss_csi0phytimer_clk"=="&clk")
  (
    &match=1
  )
  
  if (&match==1)
  (
    &clk_test=&CLK_TEST_CAMSS_CSI0PHYTIMER_CLK
    &clk_reg=&HWIO_MMSS_CAMSS_CSI0PHYTIMER_CBCR_ADDR
    &clk_reg_name="MMSS_CAMSS_CSI0PHYTIMER_CBCR"
    &clk_name="camss_csi0phytimer_clk"
    &clk_reg_cbcr_type="sm_cbc"
    &clk_vote_bit=-1.
    &clk_multiplier=3.

    gosub Print_Clk_Info_Line
  )

  &match=0
  &wild_head=0
  &wild_tail=0
  &clk_input_length=STRING.LENGTH("&clk")
  &clk_itr_length=STRING.LENGTH("camss_csi1_clk")

  if (STRING.SCAN("&clk", "*", 0)==0)
  (
    &wild_head=1
  )
  if (STRING.SCAN("&clk", "*", 1)==(STRING.LENGTH("&clk")-1))
  (
    &wild_tail=1
  )

  if ((&wild_head==1)&&(&wild_tail==1))
  (
    if (STRING.SCAN("camss_csi1_clk", STRING.MID("&clk", 1, &clk_input_length-2), 0)!=-1)
    ( 
      &match=1
    )
  )
  else if (&wild_head==1)
  (
    if (STRING.MID("camss_csi1_clk", &clk_itr_length-&clk_input_length+1, &clk_input_length-1)==STRING.CUT("&clk", 1))
    ( 
      &match=1
    )
  )
  else if (&wild_tail==1)
  (
    if (STRING.MID("camss_csi1_clk", 0, &clk_input_length-1)==STRING.CUT("&clk", -1))
    ( 
      &match=1
    )
  )
  else if ("camss_csi1_clk"=="&clk")
  (
    &match=1
  )
  
  if (&match==1)
  (
    &clk_test=&CLK_TEST_CAMSS_CSI1_CLK
    &clk_reg=&HWIO_MMSS_CAMSS_CSI1_CBCR_ADDR
    &clk_reg_name="MMSS_CAMSS_CSI1_CBCR"
    &clk_name="camss_csi1_clk"
    &clk_reg_cbcr_type="sm_cbc"
    &clk_vote_bit=-1.
    &clk_multiplier=3.

    gosub Print_Clk_Info_Line
  )

  &match=0
  &wild_head=0
  &wild_tail=0
  &clk_input_length=STRING.LENGTH("&clk")
  &clk_itr_length=STRING.LENGTH("camss_csi1phy_clk")

  if (STRING.SCAN("&clk", "*", 0)==0)
  (
    &wild_head=1
  )
  if (STRING.SCAN("&clk", "*", 1)==(STRING.LENGTH("&clk")-1))
  (
    &wild_tail=1
  )

  if ((&wild_head==1)&&(&wild_tail==1))
  (
    if (STRING.SCAN("camss_csi1phy_clk", STRING.MID("&clk", 1, &clk_input_length-2), 0)!=-1)
    ( 
      &match=1
    )
  )
  else if (&wild_head==1)
  (
    if (STRING.MID("camss_csi1phy_clk", &clk_itr_length-&clk_input_length+1, &clk_input_length-1)==STRING.CUT("&clk", 1))
    ( 
      &match=1
    )
  )
  else if (&wild_tail==1)
  (
    if (STRING.MID("camss_csi1phy_clk", 0, &clk_input_length-1)==STRING.CUT("&clk", -1))
    ( 
      &match=1
    )
  )
  else if ("camss_csi1phy_clk"=="&clk")
  (
    &match=1
  )
  
  if (&match==1)
  (
    &clk_test=&CLK_TEST_CAMSS_CSI1PHY_CLK
    &clk_reg=&HWIO_MMSS_CAMSS_CSI1PHY_CBCR_ADDR
    &clk_reg_name="MMSS_CAMSS_CSI1PHY_CBCR"
    &clk_name="camss_csi1phy_clk"
    &clk_reg_cbcr_type="sm_cbc"
    &clk_vote_bit=-1.
    &clk_multiplier=3.

    gosub Print_Clk_Info_Line
  )

  &match=0
  &wild_head=0
  &wild_tail=0
  &clk_input_length=STRING.LENGTH("&clk")
  &clk_itr_length=STRING.LENGTH("camss_csi1pix_clk")

  if (STRING.SCAN("&clk", "*", 0)==0)
  (
    &wild_head=1
  )
  if (STRING.SCAN("&clk", "*", 1)==(STRING.LENGTH("&clk")-1))
  (
    &wild_tail=1
  )

  if ((&wild_head==1)&&(&wild_tail==1))
  (
    if (STRING.SCAN("camss_csi1pix_clk", STRING.MID("&clk", 1, &clk_input_length-2), 0)!=-1)
    ( 
      &match=1
    )
  )
  else if (&wild_head==1)
  (
    if (STRING.MID("camss_csi1pix_clk", &clk_itr_length-&clk_input_length+1, &clk_input_length-1)==STRING.CUT("&clk", 1))
    ( 
      &match=1
    )
  )
  else if (&wild_tail==1)
  (
    if (STRING.MID("camss_csi1pix_clk", 0, &clk_input_length-1)==STRING.CUT("&clk", -1))
    ( 
      &match=1
    )
  )
  else if ("camss_csi1pix_clk"=="&clk")
  (
    &match=1
  )
  
  if (&match==1)
  (
    &clk_test=&CLK_TEST_CAMSS_CSI1PIX_CLK
    &clk_reg=&HWIO_MMSS_CAMSS_CSI1PIX_CBCR_ADDR
    &clk_reg_name="MMSS_CAMSS_CSI1PIX_CBCR"
    &clk_name="camss_csi1pix_clk"
    &clk_reg_cbcr_type="sm_cbc"
    &clk_vote_bit=-1.
    &clk_multiplier=3.

    gosub Print_Clk_Info_Line
  )

  &match=0
  &wild_head=0
  &wild_tail=0
  &clk_input_length=STRING.LENGTH("&clk")
  &clk_itr_length=STRING.LENGTH("camss_csi1rdi_clk")

  if (STRING.SCAN("&clk", "*", 0)==0)
  (
    &wild_head=1
  )
  if (STRING.SCAN("&clk", "*", 1)==(STRING.LENGTH("&clk")-1))
  (
    &wild_tail=1
  )

  if ((&wild_head==1)&&(&wild_tail==1))
  (
    if (STRING.SCAN("camss_csi1rdi_clk", STRING.MID("&clk", 1, &clk_input_length-2), 0)!=-1)
    ( 
      &match=1
    )
  )
  else if (&wild_head==1)
  (
    if (STRING.MID("camss_csi1rdi_clk", &clk_itr_length-&clk_input_length+1, &clk_input_length-1)==STRING.CUT("&clk", 1))
    ( 
      &match=1
    )
  )
  else if (&wild_tail==1)
  (
    if (STRING.MID("camss_csi1rdi_clk", 0, &clk_input_length-1)==STRING.CUT("&clk", -1))
    ( 
      &match=1
    )
  )
  else if ("camss_csi1rdi_clk"=="&clk")
  (
    &match=1
  )
  
  if (&match==1)
  (
    &clk_test=&CLK_TEST_CAMSS_CSI1RDI_CLK
    &clk_reg=&HWIO_MMSS_CAMSS_CSI1RDI_CBCR_ADDR
    &clk_reg_name="MMSS_CAMSS_CSI1RDI_CBCR"
    &clk_name="camss_csi1rdi_clk"
    &clk_reg_cbcr_type="sm_cbc"
    &clk_vote_bit=-1.
    &clk_multiplier=3.

    gosub Print_Clk_Info_Line
  )

  &match=0
  &wild_head=0
  &wild_tail=0
  &clk_input_length=STRING.LENGTH("&clk")
  &clk_itr_length=STRING.LENGTH("camss_csi1phytimer_clk")

  if (STRING.SCAN("&clk", "*", 0)==0)
  (
    &wild_head=1
  )
  if (STRING.SCAN("&clk", "*", 1)==(STRING.LENGTH("&clk")-1))
  (
    &wild_tail=1
  )

  if ((&wild_head==1)&&(&wild_tail==1))
  (
    if (STRING.SCAN("camss_csi1phytimer_clk", STRING.MID("&clk", 1, &clk_input_length-2), 0)!=-1)
    ( 
      &match=1
    )
  )
  else if (&wild_head==1)
  (
    if (STRING.MID("camss_csi1phytimer_clk", &clk_itr_length-&clk_input_length+1, &clk_input_length-1)==STRING.CUT("&clk", 1))
    ( 
      &match=1
    )
  )
  else if (&wild_tail==1)
  (
    if (STRING.MID("camss_csi1phytimer_clk", 0, &clk_input_length-1)==STRING.CUT("&clk", -1))
    ( 
      &match=1
    )
  )
  else if ("camss_csi1phytimer_clk"=="&clk")
  (
    &match=1
  )
  
  if (&match==1)
  (
    &clk_test=&CLK_TEST_CAMSS_CSI1PHYTIMER_CLK
    &clk_reg=&HWIO_MMSS_CAMSS_CSI1PHYTIMER_CBCR_ADDR
    &clk_reg_name="MMSS_CAMSS_CSI1PHYTIMER_CBCR"
    &clk_name="camss_csi1phytimer_clk"
    &clk_reg_cbcr_type="sm_cbc"
    &clk_vote_bit=-1.
    &clk_multiplier=3.

    gosub Print_Clk_Info_Line
  )

  &match=0
  &wild_head=0
  &wild_tail=0
  &clk_input_length=STRING.LENGTH("&clk")
  &clk_itr_length=STRING.LENGTH("camss_csi2_clk")

  if (STRING.SCAN("&clk", "*", 0)==0)
  (
    &wild_head=1
  )
  if (STRING.SCAN("&clk", "*", 1)==(STRING.LENGTH("&clk")-1))
  (
    &wild_tail=1
  )

  if ((&wild_head==1)&&(&wild_tail==1))
  (
    if (STRING.SCAN("camss_csi2_clk", STRING.MID("&clk", 1, &clk_input_length-2), 0)!=-1)
    ( 
      &match=1
    )
  )
  else if (&wild_head==1)
  (
    if (STRING.MID("camss_csi2_clk", &clk_itr_length-&clk_input_length+1, &clk_input_length-1)==STRING.CUT("&clk", 1))
    ( 
      &match=1
    )
  )
  else if (&wild_tail==1)
  (
    if (STRING.MID("camss_csi2_clk", 0, &clk_input_length-1)==STRING.CUT("&clk", -1))
    ( 
      &match=1
    )
  )
  else if ("camss_csi2_clk"=="&clk")
  (
    &match=1
  )
  
  if (&match==1)
  (
    &clk_test=&CLK_TEST_CAMSS_CSI2_CLK
    &clk_reg=&HWIO_MMSS_CAMSS_CSI2_CBCR_ADDR
    &clk_reg_name="MMSS_CAMSS_CSI2_CBCR"
    &clk_name="camss_csi2_clk"
    &clk_reg_cbcr_type="sm_cbc"
    &clk_vote_bit=-1.
    &clk_multiplier=3.

    gosub Print_Clk_Info_Line
  )

  &match=0
  &wild_head=0
  &wild_tail=0
  &clk_input_length=STRING.LENGTH("&clk")
  &clk_itr_length=STRING.LENGTH("camss_csi2phy_clk")

  if (STRING.SCAN("&clk", "*", 0)==0)
  (
    &wild_head=1
  )
  if (STRING.SCAN("&clk", "*", 1)==(STRING.LENGTH("&clk")-1))
  (
    &wild_tail=1
  )

  if ((&wild_head==1)&&(&wild_tail==1))
  (
    if (STRING.SCAN("camss_csi2phy_clk", STRING.MID("&clk", 1, &clk_input_length-2), 0)!=-1)
    ( 
      &match=1
    )
  )
  else if (&wild_head==1)
  (
    if (STRING.MID("camss_csi2phy_clk", &clk_itr_length-&clk_input_length+1, &clk_input_length-1)==STRING.CUT("&clk", 1))
    ( 
      &match=1
    )
  )
  else if (&wild_tail==1)
  (
    if (STRING.MID("camss_csi2phy_clk", 0, &clk_input_length-1)==STRING.CUT("&clk", -1))
    ( 
      &match=1
    )
  )
  else if ("camss_csi2phy_clk"=="&clk")
  (
    &match=1
  )
  
  if (&match==1)
  (
    &clk_test=&CLK_TEST_CAMSS_CSI2PHY_CLK
    &clk_reg=&HWIO_MMSS_CAMSS_CSI2PHY_CBCR_ADDR
    &clk_reg_name="MMSS_CAMSS_CSI2PHY_CBCR"
    &clk_name="camss_csi2phy_clk"
    &clk_reg_cbcr_type="sm_cbc"
    &clk_vote_bit=-1.
    &clk_multiplier=3.

    gosub Print_Clk_Info_Line
  )

  &match=0
  &wild_head=0
  &wild_tail=0
  &clk_input_length=STRING.LENGTH("&clk")
  &clk_itr_length=STRING.LENGTH("camss_csi2pix_clk")

  if (STRING.SCAN("&clk", "*", 0)==0)
  (
    &wild_head=1
  )
  if (STRING.SCAN("&clk", "*", 1)==(STRING.LENGTH("&clk")-1))
  (
    &wild_tail=1
  )

  if ((&wild_head==1)&&(&wild_tail==1))
  (
    if (STRING.SCAN("camss_csi2pix_clk", STRING.MID("&clk", 1, &clk_input_length-2), 0)!=-1)
    ( 
      &match=1
    )
  )
  else if (&wild_head==1)
  (
    if (STRING.MID("camss_csi2pix_clk", &clk_itr_length-&clk_input_length+1, &clk_input_length-1)==STRING.CUT("&clk", 1))
    ( 
      &match=1
    )
  )
  else if (&wild_tail==1)
  (
    if (STRING.MID("camss_csi2pix_clk", 0, &clk_input_length-1)==STRING.CUT("&clk", -1))
    ( 
      &match=1
    )
  )
  else if ("camss_csi2pix_clk"=="&clk")
  (
    &match=1
  )
  
  if (&match==1)
  (
    &clk_test=&CLK_TEST_CAMSS_CSI2PIX_CLK
    &clk_reg=&HWIO_MMSS_CAMSS_CSI2PIX_CBCR_ADDR
    &clk_reg_name="MMSS_CAMSS_CSI2PIX_CBCR"
    &clk_name="camss_csi2pix_clk"
    &clk_reg_cbcr_type="sm_cbc"
    &clk_vote_bit=-1.
    &clk_multiplier=3.

    gosub Print_Clk_Info_Line
  )

  &match=0
  &wild_head=0
  &wild_tail=0
  &clk_input_length=STRING.LENGTH("&clk")
  &clk_itr_length=STRING.LENGTH("camss_csi2rdi_clk")

  if (STRING.SCAN("&clk", "*", 0)==0)
  (
    &wild_head=1
  )
  if (STRING.SCAN("&clk", "*", 1)==(STRING.LENGTH("&clk")-1))
  (
    &wild_tail=1
  )

  if ((&wild_head==1)&&(&wild_tail==1))
  (
    if (STRING.SCAN("camss_csi2rdi_clk", STRING.MID("&clk", 1, &clk_input_length-2), 0)!=-1)
    ( 
      &match=1
    )
  )
  else if (&wild_head==1)
  (
    if (STRING.MID("camss_csi2rdi_clk", &clk_itr_length-&clk_input_length+1, &clk_input_length-1)==STRING.CUT("&clk", 1))
    ( 
      &match=1
    )
  )
  else if (&wild_tail==1)
  (
    if (STRING.MID("camss_csi2rdi_clk", 0, &clk_input_length-1)==STRING.CUT("&clk", -1))
    ( 
      &match=1
    )
  )
  else if ("camss_csi2rdi_clk"=="&clk")
  (
    &match=1
  )
  
  if (&match==1)
  (
    &clk_test=&CLK_TEST_CAMSS_CSI2RDI_CLK
    &clk_reg=&HWIO_MMSS_CAMSS_CSI2RDI_CBCR_ADDR
    &clk_reg_name="MMSS_CAMSS_CSI2RDI_CBCR"
    &clk_name="camss_csi2rdi_clk"
    &clk_reg_cbcr_type="sm_cbc"
    &clk_vote_bit=-1.
    &clk_multiplier=3.

    gosub Print_Clk_Info_Line
  )

  &match=0
  &wild_head=0
  &wild_tail=0
  &clk_input_length=STRING.LENGTH("&clk")
  &clk_itr_length=STRING.LENGTH("camss_csi2phytimer_clk")

  if (STRING.SCAN("&clk", "*", 0)==0)
  (
    &wild_head=1
  )
  if (STRING.SCAN("&clk", "*", 1)==(STRING.LENGTH("&clk")-1))
  (
    &wild_tail=1
  )

  if ((&wild_head==1)&&(&wild_tail==1))
  (
    if (STRING.SCAN("camss_csi2phytimer_clk", STRING.MID("&clk", 1, &clk_input_length-2), 0)!=-1)
    ( 
      &match=1
    )
  )
  else if (&wild_head==1)
  (
    if (STRING.MID("camss_csi2phytimer_clk", &clk_itr_length-&clk_input_length+1, &clk_input_length-1)==STRING.CUT("&clk", 1))
    ( 
      &match=1
    )
  )
  else if (&wild_tail==1)
  (
    if (STRING.MID("camss_csi2phytimer_clk", 0, &clk_input_length-1)==STRING.CUT("&clk", -1))
    ( 
      &match=1
    )
  )
  else if ("camss_csi2phytimer_clk"=="&clk")
  (
    &match=1
  )
  
  if (&match==1)
  (
    &clk_test=&CLK_TEST_CAMSS_CSI2PHYTIMER_CLK
    &clk_reg=&HWIO_MMSS_CAMSS_CSI2PHYTIMER_CBCR_ADDR
    &clk_reg_name="MMSS_CAMSS_CSI2PHYTIMER_CBCR"
    &clk_name="camss_csi2phytimer_clk"
    &clk_reg_cbcr_type="sm_cbc"
    &clk_vote_bit=-1.
    &clk_multiplier=3.

    gosub Print_Clk_Info_Line
  )

  &match=0
  &wild_head=0
  &wild_tail=0
  &clk_input_length=STRING.LENGTH("&clk")
  &clk_itr_length=STRING.LENGTH("camss_csi3_clk")

  if (STRING.SCAN("&clk", "*", 0)==0)
  (
    &wild_head=1
  )
  if (STRING.SCAN("&clk", "*", 1)==(STRING.LENGTH("&clk")-1))
  (
    &wild_tail=1
  )

  if ((&wild_head==1)&&(&wild_tail==1))
  (
    if (STRING.SCAN("camss_csi3_clk", STRING.MID("&clk", 1, &clk_input_length-2), 0)!=-1)
    ( 
      &match=1
    )
  )
  else if (&wild_head==1)
  (
    if (STRING.MID("camss_csi3_clk", &clk_itr_length-&clk_input_length+1, &clk_input_length-1)==STRING.CUT("&clk", 1))
    ( 
      &match=1
    )
  )
  else if (&wild_tail==1)
  (
    if (STRING.MID("camss_csi3_clk", 0, &clk_input_length-1)==STRING.CUT("&clk", -1))
    ( 
      &match=1
    )
  )
  else if ("camss_csi3_clk"=="&clk")
  (
    &match=1
  )
  
  if (&match==1)
  (
    &clk_test=&CLK_TEST_CAMSS_CSI3_CLK
    &clk_reg=&HWIO_MMSS_CAMSS_CSI3_CBCR_ADDR
    &clk_reg_name="MMSS_CAMSS_CSI3_CBCR"
    &clk_name="camss_csi3_clk"
    &clk_reg_cbcr_type="sm_cbc"
    &clk_vote_bit=-1.
    &clk_multiplier=3.

    gosub Print_Clk_Info_Line
  )

  &match=0
  &wild_head=0
  &wild_tail=0
  &clk_input_length=STRING.LENGTH("&clk")
  &clk_itr_length=STRING.LENGTH("camss_csi3phy_clk")

  if (STRING.SCAN("&clk", "*", 0)==0)
  (
    &wild_head=1
  )
  if (STRING.SCAN("&clk", "*", 1)==(STRING.LENGTH("&clk")-1))
  (
    &wild_tail=1
  )

  if ((&wild_head==1)&&(&wild_tail==1))
  (
    if (STRING.SCAN("camss_csi3phy_clk", STRING.MID("&clk", 1, &clk_input_length-2), 0)!=-1)
    ( 
      &match=1
    )
  )
  else if (&wild_head==1)
  (
    if (STRING.MID("camss_csi3phy_clk", &clk_itr_length-&clk_input_length+1, &clk_input_length-1)==STRING.CUT("&clk", 1))
    ( 
      &match=1
    )
  )
  else if (&wild_tail==1)
  (
    if (STRING.MID("camss_csi3phy_clk", 0, &clk_input_length-1)==STRING.CUT("&clk", -1))
    ( 
      &match=1
    )
  )
  else if ("camss_csi3phy_clk"=="&clk")
  (
    &match=1
  )
  
  if (&match==1)
  (
    &clk_test=&CLK_TEST_CAMSS_CSI3PHY_CLK
    &clk_reg=&HWIO_MMSS_CAMSS_CSI3PHY_CBCR_ADDR
    &clk_reg_name="MMSS_CAMSS_CSI3PHY_CBCR"
    &clk_name="camss_csi3phy_clk"
    &clk_reg_cbcr_type="sm_cbc"
    &clk_vote_bit=-1.
    &clk_multiplier=3.

    gosub Print_Clk_Info_Line
  )

  &match=0
  &wild_head=0
  &wild_tail=0
  &clk_input_length=STRING.LENGTH("&clk")
  &clk_itr_length=STRING.LENGTH("camss_csi3pix_clk")

  if (STRING.SCAN("&clk", "*", 0)==0)
  (
    &wild_head=1
  )
  if (STRING.SCAN("&clk", "*", 1)==(STRING.LENGTH("&clk")-1))
  (
    &wild_tail=1
  )

  if ((&wild_head==1)&&(&wild_tail==1))
  (
    if (STRING.SCAN("camss_csi3pix_clk", STRING.MID("&clk", 1, &clk_input_length-2), 0)!=-1)
    ( 
      &match=1
    )
  )
  else if (&wild_head==1)
  (
    if (STRING.MID("camss_csi3pix_clk", &clk_itr_length-&clk_input_length+1, &clk_input_length-1)==STRING.CUT("&clk", 1))
    ( 
      &match=1
    )
  )
  else if (&wild_tail==1)
  (
    if (STRING.MID("camss_csi3pix_clk", 0, &clk_input_length-1)==STRING.CUT("&clk", -1))
    ( 
      &match=1
    )
  )
  else if ("camss_csi3pix_clk"=="&clk")
  (
    &match=1
  )
  
  if (&match==1)
  (
    &clk_test=&CLK_TEST_CAMSS_CSI3PIX_CLK
    &clk_reg=&HWIO_MMSS_CAMSS_CSI3PIX_CBCR_ADDR
    &clk_reg_name="MMSS_CAMSS_CSI3PIX_CBCR"
    &clk_name="camss_csi3pix_clk"
    &clk_reg_cbcr_type="sm_cbc"
    &clk_vote_bit=-1.
    &clk_multiplier=3.

    gosub Print_Clk_Info_Line
  )

  &match=0
  &wild_head=0
  &wild_tail=0
  &clk_input_length=STRING.LENGTH("&clk")
  &clk_itr_length=STRING.LENGTH("camss_csi3rdi_clk")

  if (STRING.SCAN("&clk", "*", 0)==0)
  (
    &wild_head=1
  )
  if (STRING.SCAN("&clk", "*", 1)==(STRING.LENGTH("&clk")-1))
  (
    &wild_tail=1
  )

  if ((&wild_head==1)&&(&wild_tail==1))
  (
    if (STRING.SCAN("camss_csi3rdi_clk", STRING.MID("&clk", 1, &clk_input_length-2), 0)!=-1)
    ( 
      &match=1
    )
  )
  else if (&wild_head==1)
  (
    if (STRING.MID("camss_csi3rdi_clk", &clk_itr_length-&clk_input_length+1, &clk_input_length-1)==STRING.CUT("&clk", 1))
    ( 
      &match=1
    )
  )
  else if (&wild_tail==1)
  (
    if (STRING.MID("camss_csi3rdi_clk", 0, &clk_input_length-1)==STRING.CUT("&clk", -1))
    ( 
      &match=1
    )
  )
  else if ("camss_csi3rdi_clk"=="&clk")
  (
    &match=1
  )
  
  if (&match==1)
  (
    &clk_test=&CLK_TEST_CAMSS_CSI3RDI_CLK
    &clk_reg=&HWIO_MMSS_CAMSS_CSI3RDI_CBCR_ADDR
    &clk_reg_name="MMSS_CAMSS_CSI3RDI_CBCR"
    &clk_name="camss_csi3rdi_clk"
    &clk_reg_cbcr_type="sm_cbc"
    &clk_vote_bit=-1.
    &clk_multiplier=3.

    gosub Print_Clk_Info_Line
  )

  &match=0
  &wild_head=0
  &wild_tail=0
  &clk_input_length=STRING.LENGTH("&clk")
  &clk_itr_length=STRING.LENGTH("camss_csiphy0_3p_clk")

  if (STRING.SCAN("&clk", "*", 0)==0)
  (
    &wild_head=1
  )
  if (STRING.SCAN("&clk", "*", 1)==(STRING.LENGTH("&clk")-1))
  (
    &wild_tail=1
  )

  if ((&wild_head==1)&&(&wild_tail==1))
  (
    if (STRING.SCAN("camss_csiphy0_3p_clk", STRING.MID("&clk", 1, &clk_input_length-2), 0)!=-1)
    ( 
      &match=1
    )
  )
  else if (&wild_head==1)
  (
    if (STRING.MID("camss_csiphy0_3p_clk", &clk_itr_length-&clk_input_length+1, &clk_input_length-1)==STRING.CUT("&clk", 1))
    ( 
      &match=1
    )
  )
  else if (&wild_tail==1)
  (
    if (STRING.MID("camss_csiphy0_3p_clk", 0, &clk_input_length-1)==STRING.CUT("&clk", -1))
    ( 
      &match=1
    )
  )
  else if ("camss_csiphy0_3p_clk"=="&clk")
  (
    &match=1
  )
  
  if (&match==1)
  (
    &clk_test=&CLK_TEST_CAMSS_CSIPHY0_3P_CLK
    &clk_reg=&HWIO_MMSS_CAMSS_CSIPHY0_3P_CBCR_ADDR
    &clk_reg_name="MMSS_CAMSS_CSIPHY0_3P_CBCR"
    &clk_name="camss_csiphy0_3p_clk"
    &clk_reg_cbcr_type="sm_cbc"
    &clk_vote_bit=-1.
    &clk_multiplier=3.

    gosub Print_Clk_Info_Line
  )

  &match=0
  &wild_head=0
  &wild_tail=0
  &clk_input_length=STRING.LENGTH("&clk")
  &clk_itr_length=STRING.LENGTH("camss_csiphy1_3p_clk")

  if (STRING.SCAN("&clk", "*", 0)==0)
  (
    &wild_head=1
  )
  if (STRING.SCAN("&clk", "*", 1)==(STRING.LENGTH("&clk")-1))
  (
    &wild_tail=1
  )

  if ((&wild_head==1)&&(&wild_tail==1))
  (
    if (STRING.SCAN("camss_csiphy1_3p_clk", STRING.MID("&clk", 1, &clk_input_length-2), 0)!=-1)
    ( 
      &match=1
    )
  )
  else if (&wild_head==1)
  (
    if (STRING.MID("camss_csiphy1_3p_clk", &clk_itr_length-&clk_input_length+1, &clk_input_length-1)==STRING.CUT("&clk", 1))
    ( 
      &match=1
    )
  )
  else if (&wild_tail==1)
  (
    if (STRING.MID("camss_csiphy1_3p_clk", 0, &clk_input_length-1)==STRING.CUT("&clk", -1))
    ( 
      &match=1
    )
  )
  else if ("camss_csiphy1_3p_clk"=="&clk")
  (
    &match=1
  )
  
  if (&match==1)
  (
    &clk_test=&CLK_TEST_CAMSS_CSIPHY1_3P_CLK
    &clk_reg=&HWIO_MMSS_CAMSS_CSIPHY1_3P_CBCR_ADDR
    &clk_reg_name="MMSS_CAMSS_CSIPHY1_3P_CBCR"
    &clk_name="camss_csiphy1_3p_clk"
    &clk_reg_cbcr_type="sm_cbc"
    &clk_vote_bit=-1.
    &clk_multiplier=3.

    gosub Print_Clk_Info_Line
  )

  &match=0
  &wild_head=0
  &wild_tail=0
  &clk_input_length=STRING.LENGTH("&clk")
  &clk_itr_length=STRING.LENGTH("camss_csiphy2_3p_clk")

  if (STRING.SCAN("&clk", "*", 0)==0)
  (
    &wild_head=1
  )
  if (STRING.SCAN("&clk", "*", 1)==(STRING.LENGTH("&clk")-1))
  (
    &wild_tail=1
  )

  if ((&wild_head==1)&&(&wild_tail==1))
  (
    if (STRING.SCAN("camss_csiphy2_3p_clk", STRING.MID("&clk", 1, &clk_input_length-2), 0)!=-1)
    ( 
      &match=1
    )
  )
  else if (&wild_head==1)
  (
    if (STRING.MID("camss_csiphy2_3p_clk", &clk_itr_length-&clk_input_length+1, &clk_input_length-1)==STRING.CUT("&clk", 1))
    ( 
      &match=1
    )
  )
  else if (&wild_tail==1)
  (
    if (STRING.MID("camss_csiphy2_3p_clk", 0, &clk_input_length-1)==STRING.CUT("&clk", -1))
    ( 
      &match=1
    )
  )
  else if ("camss_csiphy2_3p_clk"=="&clk")
  (
    &match=1
  )
  
  if (&match==1)
  (
    &clk_test=&CLK_TEST_CAMSS_CSIPHY2_3P_CLK
    &clk_reg=&HWIO_MMSS_CAMSS_CSIPHY2_3P_CBCR_ADDR
    &clk_reg_name="MMSS_CAMSS_CSIPHY2_3P_CBCR"
    &clk_name="camss_csiphy2_3p_clk"
    &clk_reg_cbcr_type="sm_cbc"
    &clk_vote_bit=-1.
    &clk_multiplier=3.

    gosub Print_Clk_Info_Line
  )

  &match=0
  &wild_head=0
  &wild_tail=0
  &clk_input_length=STRING.LENGTH("&clk")
  &clk_itr_length=STRING.LENGTH("dsa_core_clk")

  if (STRING.SCAN("&clk", "*", 0)==0)
  (
    &wild_head=1
  )
  if (STRING.SCAN("&clk", "*", 1)==(STRING.LENGTH("&clk")-1))
  (
    &wild_tail=1
  )

  if ((&wild_head==1)&&(&wild_tail==1))
  (
    if (STRING.SCAN("dsa_core_clk", STRING.MID("&clk", 1, &clk_input_length-2), 0)!=-1)
    ( 
      &match=1
    )
  )
  else if (&wild_head==1)
  (
    if (STRING.MID("dsa_core_clk", &clk_itr_length-&clk_input_length+1, &clk_input_length-1)==STRING.CUT("&clk", 1))
    ( 
      &match=1
    )
  )
  else if (&wild_tail==1)
  (
    if (STRING.MID("dsa_core_clk", 0, &clk_input_length-1)==STRING.CUT("&clk", -1))
    ( 
      &match=1
    )
  )
  else if ("dsa_core_clk"=="&clk")
  (
    &match=1
  )
  
  if (&match==1)
  (
    &clk_test=&CLK_TEST_DSA_CORE_CLK
    &clk_reg=&HWIO_MMSS_DSA_CORE_CBCR_ADDR
    &clk_reg_name="MMSS_DSA_CORE_CBCR"
    &clk_name="dsa_core_clk"
    &clk_reg_cbcr_type="sm_cbc"
    &clk_vote_bit=-1.
    &clk_multiplier=3.

    gosub Print_Clk_Info_Line
  )

  &match=0
  &wild_head=0
  &wild_tail=0
  &clk_input_length=STRING.LENGTH("&clk")
  &clk_itr_length=STRING.LENGTH("mdss_edpaux_clk")

  if (STRING.SCAN("&clk", "*", 0)==0)
  (
    &wild_head=1
  )
  if (STRING.SCAN("&clk", "*", 1)==(STRING.LENGTH("&clk")-1))
  (
    &wild_tail=1
  )

  if ((&wild_head==1)&&(&wild_tail==1))
  (
    if (STRING.SCAN("mdss_edpaux_clk", STRING.MID("&clk", 1, &clk_input_length-2), 0)!=-1)
    ( 
      &match=1
    )
  )
  else if (&wild_head==1)
  (
    if (STRING.MID("mdss_edpaux_clk", &clk_itr_length-&clk_input_length+1, &clk_input_length-1)==STRING.CUT("&clk", 1))
    ( 
      &match=1
    )
  )
  else if (&wild_tail==1)
  (
    if (STRING.MID("mdss_edpaux_clk", 0, &clk_input_length-1)==STRING.CUT("&clk", -1))
    ( 
      &match=1
    )
  )
  else if ("mdss_edpaux_clk"=="&clk")
  (
    &match=1
  )
  
  if (&match==1)
  (
    &clk_test=&CLK_TEST_MDSS_EDPAUX_CLK
    &clk_reg=&HWIO_MMSS_MDSS_EDPAUX_CBCR_ADDR
    &clk_reg_name="MMSS_MDSS_EDPAUX_CBCR"
    &clk_name="mdss_edpaux_clk"
    &clk_reg_cbcr_type="sm_cbc"
    &clk_vote_bit=-1.
    &clk_multiplier=3.

    gosub Print_Clk_Info_Line
  )

  &match=0
  &wild_head=0
  &wild_tail=0
  &clk_input_length=STRING.LENGTH("&clk")
  &clk_itr_length=STRING.LENGTH("mdss_edpgtc_clk")

  if (STRING.SCAN("&clk", "*", 0)==0)
  (
    &wild_head=1
  )
  if (STRING.SCAN("&clk", "*", 1)==(STRING.LENGTH("&clk")-1))
  (
    &wild_tail=1
  )

  if ((&wild_head==1)&&(&wild_tail==1))
  (
    if (STRING.SCAN("mdss_edpgtc_clk", STRING.MID("&clk", 1, &clk_input_length-2), 0)!=-1)
    ( 
      &match=1
    )
  )
  else if (&wild_head==1)
  (
    if (STRING.MID("mdss_edpgtc_clk", &clk_itr_length-&clk_input_length+1, &clk_input_length-1)==STRING.CUT("&clk", 1))
    ( 
      &match=1
    )
  )
  else if (&wild_tail==1)
  (
    if (STRING.MID("mdss_edpgtc_clk", 0, &clk_input_length-1)==STRING.CUT("&clk", -1))
    ( 
      &match=1
    )
  )
  else if ("mdss_edpgtc_clk"=="&clk")
  (
    &match=1
  )
  
  if (&match==1)
  (
    &clk_test=&CLK_TEST_MDSS_EDPGTC_CLK
    &clk_reg=&HWIO_MMSS_MDSS_EDPGTC_CBCR_ADDR
    &clk_reg_name="MMSS_MDSS_EDPGTC_CBCR"
    &clk_name="mdss_edpgtc_clk"
    &clk_reg_cbcr_type="sm_cbc"
    &clk_vote_bit=-1.
    &clk_multiplier=3.

    gosub Print_Clk_Info_Line
  )

  &match=0
  &wild_head=0
  &wild_tail=0
  &clk_input_length=STRING.LENGTH("&clk")
  &clk_itr_length=STRING.LENGTH("mdss_edplink_clk")

  if (STRING.SCAN("&clk", "*", 0)==0)
  (
    &wild_head=1
  )
  if (STRING.SCAN("&clk", "*", 1)==(STRING.LENGTH("&clk")-1))
  (
    &wild_tail=1
  )

  if ((&wild_head==1)&&(&wild_tail==1))
  (
    if (STRING.SCAN("mdss_edplink_clk", STRING.MID("&clk", 1, &clk_input_length-2), 0)!=-1)
    ( 
      &match=1
    )
  )
  else if (&wild_head==1)
  (
    if (STRING.MID("mdss_edplink_clk", &clk_itr_length-&clk_input_length+1, &clk_input_length-1)==STRING.CUT("&clk", 1))
    ( 
      &match=1
    )
  )
  else if (&wild_tail==1)
  (
    if (STRING.MID("mdss_edplink_clk", 0, &clk_input_length-1)==STRING.CUT("&clk", -1))
    ( 
      &match=1
    )
  )
  else if ("mdss_edplink_clk"=="&clk")
  (
    &match=1
  )
  
  if (&match==1)
  (
    &clk_test=&CLK_TEST_MDSS_EDPLINK_CLK
    &clk_reg=&HWIO_MMSS_MDSS_EDPLINK_CBCR_ADDR
    &clk_reg_name="MMSS_MDSS_EDPLINK_CBCR"
    &clk_name="mdss_edplink_clk"
    &clk_reg_cbcr_type="sm_cbc"
    &clk_vote_bit=-1.
    &clk_multiplier=3.

    gosub Print_Clk_Info_Line
  )

  &match=0
  &wild_head=0
  &wild_tail=0
  &clk_input_length=STRING.LENGTH("&clk")
  &clk_itr_length=STRING.LENGTH("mdss_edppixel_clk")

  if (STRING.SCAN("&clk", "*", 0)==0)
  (
    &wild_head=1
  )
  if (STRING.SCAN("&clk", "*", 1)==(STRING.LENGTH("&clk")-1))
  (
    &wild_tail=1
  )

  if ((&wild_head==1)&&(&wild_tail==1))
  (
    if (STRING.SCAN("mdss_edppixel_clk", STRING.MID("&clk", 1, &clk_input_length-2), 0)!=-1)
    ( 
      &match=1
    )
  )
  else if (&wild_head==1)
  (
    if (STRING.MID("mdss_edppixel_clk", &clk_itr_length-&clk_input_length+1, &clk_input_length-1)==STRING.CUT("&clk", 1))
    ( 
      &match=1
    )
  )
  else if (&wild_tail==1)
  (
    if (STRING.MID("mdss_edppixel_clk", 0, &clk_input_length-1)==STRING.CUT("&clk", -1))
    ( 
      &match=1
    )
  )
  else if ("mdss_edppixel_clk"=="&clk")
  (
    &match=1
  )
  
  if (&match==1)
  (
    &clk_test=&CLK_TEST_MDSS_EDPPIXEL_CLK
    &clk_reg=&HWIO_MMSS_MDSS_EDPPIXEL_CBCR_ADDR
    &clk_reg_name="MMSS_MDSS_EDPPIXEL_CBCR"
    &clk_name="mdss_edppixel_clk"
    &clk_reg_cbcr_type="sm_cbc"
    &clk_vote_bit=-1.
    &clk_multiplier=3.

    gosub Print_Clk_Info_Line
  )

  &match=0
  &wild_head=0
  &wild_tail=0
  &clk_input_length=STRING.LENGTH("&clk")
  &clk_itr_length=STRING.LENGTH("mdss_esc0_clk")

  if (STRING.SCAN("&clk", "*", 0)==0)
  (
    &wild_head=1
  )
  if (STRING.SCAN("&clk", "*", 1)==(STRING.LENGTH("&clk")-1))
  (
    &wild_tail=1
  )

  if ((&wild_head==1)&&(&wild_tail==1))
  (
    if (STRING.SCAN("mdss_esc0_clk", STRING.MID("&clk", 1, &clk_input_length-2), 0)!=-1)
    ( 
      &match=1
    )
  )
  else if (&wild_head==1)
  (
    if (STRING.MID("mdss_esc0_clk", &clk_itr_length-&clk_input_length+1, &clk_input_length-1)==STRING.CUT("&clk", 1))
    ( 
      &match=1
    )
  )
  else if (&wild_tail==1)
  (
    if (STRING.MID("mdss_esc0_clk", 0, &clk_input_length-1)==STRING.CUT("&clk", -1))
    ( 
      &match=1
    )
  )
  else if ("mdss_esc0_clk"=="&clk")
  (
    &match=1
  )
  
  if (&match==1)
  (
    &clk_test=&CLK_TEST_MDSS_ESC0_CLK
    &clk_reg=&HWIO_MMSS_MDSS_ESC0_CBCR_ADDR
    &clk_reg_name="MMSS_MDSS_ESC0_CBCR"
    &clk_name="mdss_esc0_clk"
    &clk_reg_cbcr_type="sm_cbc"
    &clk_vote_bit=-1.
    &clk_multiplier=3.

    gosub Print_Clk_Info_Line
  )

  &match=0
  &wild_head=0
  &wild_tail=0
  &clk_input_length=STRING.LENGTH("&clk")
  &clk_itr_length=STRING.LENGTH("mdss_esc1_clk")

  if (STRING.SCAN("&clk", "*", 0)==0)
  (
    &wild_head=1
  )
  if (STRING.SCAN("&clk", "*", 1)==(STRING.LENGTH("&clk")-1))
  (
    &wild_tail=1
  )

  if ((&wild_head==1)&&(&wild_tail==1))
  (
    if (STRING.SCAN("mdss_esc1_clk", STRING.MID("&clk", 1, &clk_input_length-2), 0)!=-1)
    ( 
      &match=1
    )
  )
  else if (&wild_head==1)
  (
    if (STRING.MID("mdss_esc1_clk", &clk_itr_length-&clk_input_length+1, &clk_input_length-1)==STRING.CUT("&clk", 1))
    ( 
      &match=1
    )
  )
  else if (&wild_tail==1)
  (
    if (STRING.MID("mdss_esc1_clk", 0, &clk_input_length-1)==STRING.CUT("&clk", -1))
    ( 
      &match=1
    )
  )
  else if ("mdss_esc1_clk"=="&clk")
  (
    &match=1
  )
  
  if (&match==1)
  (
    &clk_test=&CLK_TEST_MDSS_ESC1_CLK
    &clk_reg=&HWIO_MMSS_MDSS_ESC1_CBCR_ADDR
    &clk_reg_name="MMSS_MDSS_ESC1_CBCR"
    &clk_name="mdss_esc1_clk"
    &clk_reg_cbcr_type="sm_cbc"
    &clk_vote_bit=-1.
    &clk_multiplier=3.

    gosub Print_Clk_Info_Line
  )

  &match=0
  &wild_head=0
  &wild_tail=0
  &clk_input_length=STRING.LENGTH("&clk")
  &clk_itr_length=STRING.LENGTH("mdss_extpclk_clk")

  if (STRING.SCAN("&clk", "*", 0)==0)
  (
    &wild_head=1
  )
  if (STRING.SCAN("&clk", "*", 1)==(STRING.LENGTH("&clk")-1))
  (
    &wild_tail=1
  )

  if ((&wild_head==1)&&(&wild_tail==1))
  (
    if (STRING.SCAN("mdss_extpclk_clk", STRING.MID("&clk", 1, &clk_input_length-2), 0)!=-1)
    ( 
      &match=1
    )
  )
  else if (&wild_head==1)
  (
    if (STRING.MID("mdss_extpclk_clk", &clk_itr_length-&clk_input_length+1, &clk_input_length-1)==STRING.CUT("&clk", 1))
    ( 
      &match=1
    )
  )
  else if (&wild_tail==1)
  (
    if (STRING.MID("mdss_extpclk_clk", 0, &clk_input_length-1)==STRING.CUT("&clk", -1))
    ( 
      &match=1
    )
  )
  else if ("mdss_extpclk_clk"=="&clk")
  (
    &match=1
  )
  
  if (&match==1)
  (
    &clk_test=&CLK_TEST_MDSS_EXTPCLK_CLK
    &clk_reg=&HWIO_MMSS_MDSS_EXTPCLK_CBCR_ADDR
    &clk_reg_name="MMSS_MDSS_EXTPCLK_CBCR"
    &clk_name="mdss_extpclk_clk"
    &clk_reg_cbcr_type="sm_cbc"
    &clk_vote_bit=-1.
    &clk_multiplier=3.

    gosub Print_Clk_Info_Line
  )

  &match=0
  &wild_head=0
  &wild_tail=0
  &clk_input_length=STRING.LENGTH("&clk")
  &clk_itr_length=STRING.LENGTH("fd_core_clk")

  if (STRING.SCAN("&clk", "*", 0)==0)
  (
    &wild_head=1
  )
  if (STRING.SCAN("&clk", "*", 1)==(STRING.LENGTH("&clk")-1))
  (
    &wild_tail=1
  )

  if ((&wild_head==1)&&(&wild_tail==1))
  (
    if (STRING.SCAN("fd_core_clk", STRING.MID("&clk", 1, &clk_input_length-2), 0)!=-1)
    ( 
      &match=1
    )
  )
  else if (&wild_head==1)
  (
    if (STRING.MID("fd_core_clk", &clk_itr_length-&clk_input_length+1, &clk_input_length-1)==STRING.CUT("&clk", 1))
    ( 
      &match=1
    )
  )
  else if (&wild_tail==1)
  (
    if (STRING.MID("fd_core_clk", 0, &clk_input_length-1)==STRING.CUT("&clk", -1))
    ( 
      &match=1
    )
  )
  else if ("fd_core_clk"=="&clk")
  (
    &match=1
  )
  
  if (&match==1)
  (
    &clk_test=&CLK_TEST_FD_CORE_CLK
    &clk_reg=&HWIO_MMSS_FD_CORE_CBCR_ADDR
    &clk_reg_name="MMSS_FD_CORE_CBCR"
    &clk_name="fd_core_clk"
    &clk_reg_cbcr_type="sm_pscbc"
    &clk_vote_bit=-1.
    &clk_multiplier=3.

    gosub Print_Clk_Info_Line
  )

  &match=0
  &wild_head=0
  &wild_tail=0
  &clk_input_length=STRING.LENGTH("&clk")
  &clk_itr_length=STRING.LENGTH("fd_core_uar_clk")

  if (STRING.SCAN("&clk", "*", 0)==0)
  (
    &wild_head=1
  )
  if (STRING.SCAN("&clk", "*", 1)==(STRING.LENGTH("&clk")-1))
  (
    &wild_tail=1
  )

  if ((&wild_head==1)&&(&wild_tail==1))
  (
    if (STRING.SCAN("fd_core_uar_clk", STRING.MID("&clk", 1, &clk_input_length-2), 0)!=-1)
    ( 
      &match=1
    )
  )
  else if (&wild_head==1)
  (
    if (STRING.MID("fd_core_uar_clk", &clk_itr_length-&clk_input_length+1, &clk_input_length-1)==STRING.CUT("&clk", 1))
    ( 
      &match=1
    )
  )
  else if (&wild_tail==1)
  (
    if (STRING.MID("fd_core_uar_clk", 0, &clk_input_length-1)==STRING.CUT("&clk", -1))
    ( 
      &match=1
    )
  )
  else if ("fd_core_uar_clk"=="&clk")
  (
    &match=1
  )
  
  if (&match==1)
  (
    &clk_test=&CLK_TEST_FD_CORE_UAR_CLK
    &clk_reg=&HWIO_MMSS_FD_CORE_UAR_CBCR_ADDR
    &clk_reg_name="MMSS_FD_CORE_UAR_CBCR"
    &clk_name="fd_core_uar_clk"
    &clk_reg_cbcr_type="sm_pscbc"
    &clk_vote_bit=-1.
    &clk_multiplier=3.

    gosub Print_Clk_Info_Line
  )

  &match=0
  &wild_head=0
  &wild_tail=0
  &clk_input_length=STRING.LENGTH("&clk")
  &clk_itr_length=STRING.LENGTH("dsa_noc_cfg_ahb_clk")

  if (STRING.SCAN("&clk", "*", 0)==0)
  (
    &wild_head=1
  )
  if (STRING.SCAN("&clk", "*", 1)==(STRING.LENGTH("&clk")-1))
  (
    &wild_tail=1
  )

  if ((&wild_head==1)&&(&wild_tail==1))
  (
    if (STRING.SCAN("dsa_noc_cfg_ahb_clk", STRING.MID("&clk", 1, &clk_input_length-2), 0)!=-1)
    ( 
      &match=1
    )
  )
  else if (&wild_head==1)
  (
    if (STRING.MID("dsa_noc_cfg_ahb_clk", &clk_itr_length-&clk_input_length+1, &clk_input_length-1)==STRING.CUT("&clk", 1))
    ( 
      &match=1
    )
  )
  else if (&wild_tail==1)
  (
    if (STRING.MID("dsa_noc_cfg_ahb_clk", 0, &clk_input_length-1)==STRING.CUT("&clk", -1))
    ( 
      &match=1
    )
  )
  else if ("dsa_noc_cfg_ahb_clk"=="&clk")
  (
    &match=1
  )
  
  if (&match==1)
  (
    &clk_test=&CLK_TEST_DSA_NOC_CFG_AHB_CLK
    &clk_reg=&HWIO_MMSS_DSA_NOC_CFG_AHB_CBCR_ADDR
    &clk_reg_name="MMSS_DSA_NOC_CFG_AHB_CBCR"
    &clk_name="dsa_noc_cfg_ahb_clk"
    &clk_reg_cbcr_type="sm_cbc"
    &clk_vote_bit=-1.
    &clk_multiplier=3.

    gosub Print_Clk_Info_Line
  )

  &match=0
  &wild_head=0
  &wild_tail=0
  &clk_input_length=STRING.LENGTH("&clk")
  &clk_itr_length=STRING.LENGTH("mmagic_bimc_noc_cfg_ahb_clk")

  if (STRING.SCAN("&clk", "*", 0)==0)
  (
    &wild_head=1
  )
  if (STRING.SCAN("&clk", "*", 1)==(STRING.LENGTH("&clk")-1))
  (
    &wild_tail=1
  )

  if ((&wild_head==1)&&(&wild_tail==1))
  (
    if (STRING.SCAN("mmagic_bimc_noc_cfg_ahb_clk", STRING.MID("&clk", 1, &clk_input_length-2), 0)!=-1)
    ( 
      &match=1
    )
  )
  else if (&wild_head==1)
  (
    if (STRING.MID("mmagic_bimc_noc_cfg_ahb_clk", &clk_itr_length-&clk_input_length+1, &clk_input_length-1)==STRING.CUT("&clk", 1))
    ( 
      &match=1
    )
  )
  else if (&wild_tail==1)
  (
    if (STRING.MID("mmagic_bimc_noc_cfg_ahb_clk", 0, &clk_input_length-1)==STRING.CUT("&clk", -1))
    ( 
      &match=1
    )
  )
  else if ("mmagic_bimc_noc_cfg_ahb_clk"=="&clk")
  (
    &match=1
  )
  
  if (&match==1)
  (
    &clk_test=&CLK_TEST_MMAGIC_BIMC_NOC_CFG_AHB_CLK
    &clk_reg=&HWIO_MMSS_MMAGIC_BIMC_NOC_CFG_AHB_CBCR_ADDR
    &clk_reg_name="MMSS_MMAGIC_BIMC_NOC_CFG_AHB_CBCR"
    &clk_name="mmagic_bimc_noc_cfg_ahb_clk"
    &clk_reg_cbcr_type="sm_cbc"
    &clk_vote_bit=-1.
    &clk_multiplier=3.

    gosub Print_Clk_Info_Line
  )

  &match=0
  &wild_head=0
  &wild_tail=0
  &clk_input_length=STRING.LENGTH("&clk")
  &clk_itr_length=STRING.LENGTH("mmagic_camss_noc_cfg_ahb_clk")

  if (STRING.SCAN("&clk", "*", 0)==0)
  (
    &wild_head=1
  )
  if (STRING.SCAN("&clk", "*", 1)==(STRING.LENGTH("&clk")-1))
  (
    &wild_tail=1
  )

  if ((&wild_head==1)&&(&wild_tail==1))
  (
    if (STRING.SCAN("mmagic_camss_noc_cfg_ahb_clk", STRING.MID("&clk", 1, &clk_input_length-2), 0)!=-1)
    ( 
      &match=1
    )
  )
  else if (&wild_head==1)
  (
    if (STRING.MID("mmagic_camss_noc_cfg_ahb_clk", &clk_itr_length-&clk_input_length+1, &clk_input_length-1)==STRING.CUT("&clk", 1))
    ( 
      &match=1
    )
  )
  else if (&wild_tail==1)
  (
    if (STRING.MID("mmagic_camss_noc_cfg_ahb_clk", 0, &clk_input_length-1)==STRING.CUT("&clk", -1))
    ( 
      &match=1
    )
  )
  else if ("mmagic_camss_noc_cfg_ahb_clk"=="&clk")
  (
    &match=1
  )
  
  if (&match==1)
  (
    &clk_test=&CLK_TEST_MMAGIC_CAMSS_NOC_CFG_AHB_CLK
    &clk_reg=&HWIO_MMSS_MMAGIC_CAMSS_NOC_CFG_AHB_CBCR_ADDR
    &clk_reg_name="MMSS_MMAGIC_CAMSS_NOC_CFG_AHB_CBCR"
    &clk_name="mmagic_camss_noc_cfg_ahb_clk"
    &clk_reg_cbcr_type="sm_cbc"
    &clk_vote_bit=-1.
    &clk_multiplier=3.

    gosub Print_Clk_Info_Line
  )

  &match=0
  &wild_head=0
  &wild_tail=0
  &clk_input_length=STRING.LENGTH("&clk")
  &clk_itr_length=STRING.LENGTH("mmagic_mdss_noc_cfg_ahb_clk")

  if (STRING.SCAN("&clk", "*", 0)==0)
  (
    &wild_head=1
  )
  if (STRING.SCAN("&clk", "*", 1)==(STRING.LENGTH("&clk")-1))
  (
    &wild_tail=1
  )

  if ((&wild_head==1)&&(&wild_tail==1))
  (
    if (STRING.SCAN("mmagic_mdss_noc_cfg_ahb_clk", STRING.MID("&clk", 1, &clk_input_length-2), 0)!=-1)
    ( 
      &match=1
    )
  )
  else if (&wild_head==1)
  (
    if (STRING.MID("mmagic_mdss_noc_cfg_ahb_clk", &clk_itr_length-&clk_input_length+1, &clk_input_length-1)==STRING.CUT("&clk", 1))
    ( 
      &match=1
    )
  )
  else if (&wild_tail==1)
  (
    if (STRING.MID("mmagic_mdss_noc_cfg_ahb_clk", 0, &clk_input_length-1)==STRING.CUT("&clk", -1))
    ( 
      &match=1
    )
  )
  else if ("mmagic_mdss_noc_cfg_ahb_clk"=="&clk")
  (
    &match=1
  )
  
  if (&match==1)
  (
    &clk_test=&CLK_TEST_MMAGIC_MDSS_NOC_CFG_AHB_CLK
    &clk_reg=&HWIO_MMSS_MMAGIC_MDSS_NOC_CFG_AHB_CBCR_ADDR
    &clk_reg_name="MMSS_MMAGIC_MDSS_NOC_CFG_AHB_CBCR"
    &clk_name="mmagic_mdss_noc_cfg_ahb_clk"
    &clk_reg_cbcr_type="sm_cbc"
    &clk_vote_bit=-1.
    &clk_multiplier=3.

    gosub Print_Clk_Info_Line
  )

  &match=0
  &wild_head=0
  &wild_tail=0
  &clk_input_length=STRING.LENGTH("&clk")
  &clk_itr_length=STRING.LENGTH("mmagic_video_noc_cfg_ahb_clk")

  if (STRING.SCAN("&clk", "*", 0)==0)
  (
    &wild_head=1
  )
  if (STRING.SCAN("&clk", "*", 1)==(STRING.LENGTH("&clk")-1))
  (
    &wild_tail=1
  )

  if ((&wild_head==1)&&(&wild_tail==1))
  (
    if (STRING.SCAN("mmagic_video_noc_cfg_ahb_clk", STRING.MID("&clk", 1, &clk_input_length-2), 0)!=-1)
    ( 
      &match=1
    )
  )
  else if (&wild_head==1)
  (
    if (STRING.MID("mmagic_video_noc_cfg_ahb_clk", &clk_itr_length-&clk_input_length+1, &clk_input_length-1)==STRING.CUT("&clk", 1))
    ( 
      &match=1
    )
  )
  else if (&wild_tail==1)
  (
    if (STRING.MID("mmagic_video_noc_cfg_ahb_clk", 0, &clk_input_length-1)==STRING.CUT("&clk", -1))
    ( 
      &match=1
    )
  )
  else if ("mmagic_video_noc_cfg_ahb_clk"=="&clk")
  (
    &match=1
  )
  
  if (&match==1)
  (
    &clk_test=&CLK_TEST_MMAGIC_VIDEO_NOC_CFG_AHB_CLK
    &clk_reg=&HWIO_MMSS_MMAGIC_VIDEO_NOC_CFG_AHB_CBCR_ADDR
    &clk_reg_name="MMSS_MMAGIC_VIDEO_NOC_CFG_AHB_CBCR"
    &clk_name="mmagic_video_noc_cfg_ahb_clk"
    &clk_reg_cbcr_type="sm_cbc"
    &clk_vote_bit=-1.
    &clk_multiplier=3.

    gosub Print_Clk_Info_Line
  )

  &match=0
  &wild_head=0
  &wild_tail=0
  &clk_input_length=STRING.LENGTH("&clk")
  &clk_itr_length=STRING.LENGTH("gpu_gx_gfx3d_clk")

  if (STRING.SCAN("&clk", "*", 0)==0)
  (
    &wild_head=1
  )
  if (STRING.SCAN("&clk", "*", 1)==(STRING.LENGTH("&clk")-1))
  (
    &wild_tail=1
  )

  if ((&wild_head==1)&&(&wild_tail==1))
  (
    if (STRING.SCAN("gpu_gx_gfx3d_clk", STRING.MID("&clk", 1, &clk_input_length-2), 0)!=-1)
    ( 
      &match=1
    )
  )
  else if (&wild_head==1)
  (
    if (STRING.MID("gpu_gx_gfx3d_clk", &clk_itr_length-&clk_input_length+1, &clk_input_length-1)==STRING.CUT("&clk", 1))
    ( 
      &match=1
    )
  )
  else if (&wild_tail==1)
  (
    if (STRING.MID("gpu_gx_gfx3d_clk", 0, &clk_input_length-1)==STRING.CUT("&clk", -1))
    ( 
      &match=1
    )
  )
  else if ("gpu_gx_gfx3d_clk"=="&clk")
  (
    &match=1
  )
  
  if (&match==1)
  (
    &clk_test=&CLK_TEST_GPU_GX_GFX3D_CLK
    &clk_reg=&HWIO_MMSS_GPU_GX_GFX3D_CBCR_ADDR
    &clk_reg_name="MMSS_GPU_GX_GFX3D_CBCR"
    &clk_name="gpu_gx_gfx3d_clk"
    &clk_reg_cbcr_type="sm_pscbc"
    &clk_vote_bit=-1.
    &clk_multiplier=3.

    gosub Print_Clk_Info_Line
  )

  &match=0
  &wild_head=0
  &wild_tail=0
  &clk_input_length=STRING.LENGTH("&clk")
  &clk_itr_length=STRING.LENGTH("mmss_spdm_debug_clk")

  if (STRING.SCAN("&clk", "*", 0)==0)
  (
    &wild_head=1
  )
  if (STRING.SCAN("&clk", "*", 1)==(STRING.LENGTH("&clk")-1))
  (
    &wild_tail=1
  )

  if ((&wild_head==1)&&(&wild_tail==1))
  (
    if (STRING.SCAN("mmss_spdm_debug_clk", STRING.MID("&clk", 1, &clk_input_length-2), 0)!=-1)
    ( 
      &match=1
    )
  )
  else if (&wild_head==1)
  (
    if (STRING.MID("mmss_spdm_debug_clk", &clk_itr_length-&clk_input_length+1, &clk_input_length-1)==STRING.CUT("&clk", 1))
    ( 
      &match=1
    )
  )
  else if (&wild_tail==1)
  (
    if (STRING.MID("mmss_spdm_debug_clk", 0, &clk_input_length-1)==STRING.CUT("&clk", -1))
    ( 
      &match=1
    )
  )
  else if ("mmss_spdm_debug_clk"=="&clk")
  (
    &match=1
  )
  
  if (&match==1)
  (
    &clk_test=0
    &clk_reg=&HWIO_MMSS_MMSS_SPDM_DEBUG_CBCR_ADDR
    &clk_reg_name="MMSS_MMSS_SPDM_DEBUG_CBCR"
    &clk_name="mmss_spdm_debug_clk"
    &clk_reg_cbcr_type="sm_cbc"
    &clk_vote_bit=-1.
    &clk_multiplier=3.

    gosub Print_Clk_Info_Line
  )

  &match=0
  &wild_head=0
  &wild_tail=0
  &clk_input_length=STRING.LENGTH("&clk")
  &clk_itr_length=STRING.LENGTH("mmss_spdm_gfx3d_clk")

  if (STRING.SCAN("&clk", "*", 0)==0)
  (
    &wild_head=1
  )
  if (STRING.SCAN("&clk", "*", 1)==(STRING.LENGTH("&clk")-1))
  (
    &wild_tail=1
  )

  if ((&wild_head==1)&&(&wild_tail==1))
  (
    if (STRING.SCAN("mmss_spdm_gfx3d_clk", STRING.MID("&clk", 1, &clk_input_length-2), 0)!=-1)
    ( 
      &match=1
    )
  )
  else if (&wild_head==1)
  (
    if (STRING.MID("mmss_spdm_gfx3d_clk", &clk_itr_length-&clk_input_length+1, &clk_input_length-1)==STRING.CUT("&clk", 1))
    ( 
      &match=1
    )
  )
  else if (&wild_tail==1)
  (
    if (STRING.MID("mmss_spdm_gfx3d_clk", 0, &clk_input_length-1)==STRING.CUT("&clk", -1))
    ( 
      &match=1
    )
  )
  else if ("mmss_spdm_gfx3d_clk"=="&clk")
  (
    &match=1
  )
  
  if (&match==1)
  (
    &clk_test=&CLK_TEST_MMSS_SPDM_GFX3D_CLK
    &clk_reg=&HWIO_MMSS_MMSS_SPDM_GFX3D_CBCR_ADDR
    &clk_reg_name="MMSS_MMSS_SPDM_GFX3D_CBCR"
    &clk_name="mmss_spdm_gfx3d_clk"
    &clk_reg_cbcr_type="sm_cbc"
    &clk_vote_bit=-1.
    &clk_multiplier=3.

    gosub Print_Clk_Info_Line
  )

  &match=0
  &wild_head=0
  &wild_tail=0
  &clk_input_length=STRING.LENGTH("&clk")
  &clk_itr_length=STRING.LENGTH("mdss_hdmi_clk")

  if (STRING.SCAN("&clk", "*", 0)==0)
  (
    &wild_head=1
  )
  if (STRING.SCAN("&clk", "*", 1)==(STRING.LENGTH("&clk")-1))
  (
    &wild_tail=1
  )

  if ((&wild_head==1)&&(&wild_tail==1))
  (
    if (STRING.SCAN("mdss_hdmi_clk", STRING.MID("&clk", 1, &clk_input_length-2), 0)!=-1)
    ( 
      &match=1
    )
  )
  else if (&wild_head==1)
  (
    if (STRING.MID("mdss_hdmi_clk", &clk_itr_length-&clk_input_length+1, &clk_input_length-1)==STRING.CUT("&clk", 1))
    ( 
      &match=1
    )
  )
  else if (&wild_tail==1)
  (
    if (STRING.MID("mdss_hdmi_clk", 0, &clk_input_length-1)==STRING.CUT("&clk", -1))
    ( 
      &match=1
    )
  )
  else if ("mdss_hdmi_clk"=="&clk")
  (
    &match=1
  )
  
  if (&match==1)
  (
    &clk_test=&CLK_TEST_MDSS_HDMI_CLK
    &clk_reg=&HWIO_MMSS_MDSS_HDMI_CBCR_ADDR
    &clk_reg_name="MMSS_MDSS_HDMI_CBCR"
    &clk_name="mdss_hdmi_clk"
    &clk_reg_cbcr_type="sm_cbc"
    &clk_vote_bit=-1.
    &clk_multiplier=3.

    gosub Print_Clk_Info_Line
  )

  &match=0
  &wild_head=0
  &wild_tail=0
  &clk_input_length=STRING.LENGTH("&clk")
  &clk_itr_length=STRING.LENGTH("gpu_aon_isense_clk")

  if (STRING.SCAN("&clk", "*", 0)==0)
  (
    &wild_head=1
  )
  if (STRING.SCAN("&clk", "*", 1)==(STRING.LENGTH("&clk")-1))
  (
    &wild_tail=1
  )

  if ((&wild_head==1)&&(&wild_tail==1))
  (
    if (STRING.SCAN("gpu_aon_isense_clk", STRING.MID("&clk", 1, &clk_input_length-2), 0)!=-1)
    ( 
      &match=1
    )
  )
  else if (&wild_head==1)
  (
    if (STRING.MID("gpu_aon_isense_clk", &clk_itr_length-&clk_input_length+1, &clk_input_length-1)==STRING.CUT("&clk", 1))
    ( 
      &match=1
    )
  )
  else if (&wild_tail==1)
  (
    if (STRING.MID("gpu_aon_isense_clk", 0, &clk_input_length-1)==STRING.CUT("&clk", -1))
    ( 
      &match=1
    )
  )
  else if ("gpu_aon_isense_clk"=="&clk")
  (
    &match=1
  )
  
  if (&match==1)
  (
    &clk_test=&CLK_TEST_GPU_AON_ISENSE_CLK
    &clk_reg=&HWIO_MMSS_GPU_AON_ISENSE_CBCR_ADDR
    &clk_reg_name="MMSS_GPU_AON_ISENSE_CBCR"
    &clk_name="gpu_aon_isense_clk"
    &clk_reg_cbcr_type="sm_cbc"
    &clk_vote_bit=-1.
    &clk_multiplier=3.

    gosub Print_Clk_Info_Line
  )

  &match=0
  &wild_head=0
  &wild_tail=0
  &clk_input_length=STRING.LENGTH("&clk")
  &clk_itr_length=STRING.LENGTH("camss_jpeg0_clk")

  if (STRING.SCAN("&clk", "*", 0)==0)
  (
    &wild_head=1
  )
  if (STRING.SCAN("&clk", "*", 1)==(STRING.LENGTH("&clk")-1))
  (
    &wild_tail=1
  )

  if ((&wild_head==1)&&(&wild_tail==1))
  (
    if (STRING.SCAN("camss_jpeg0_clk", STRING.MID("&clk", 1, &clk_input_length-2), 0)!=-1)
    ( 
      &match=1
    )
  )
  else if (&wild_head==1)
  (
    if (STRING.MID("camss_jpeg0_clk", &clk_itr_length-&clk_input_length+1, &clk_input_length-1)==STRING.CUT("&clk", 1))
    ( 
      &match=1
    )
  )
  else if (&wild_tail==1)
  (
    if (STRING.MID("camss_jpeg0_clk", 0, &clk_input_length-1)==STRING.CUT("&clk", -1))
    ( 
      &match=1
    )
  )
  else if ("camss_jpeg0_clk"=="&clk")
  (
    &match=1
  )
  
  if (&match==1)
  (
    &clk_test=&CLK_TEST_CAMSS_JPEG0_CLK
    &clk_reg=&HWIO_MMSS_CAMSS_JPEG0_CBCR_ADDR
    &clk_reg_name="MMSS_CAMSS_JPEG0_CBCR"
    &clk_name="camss_jpeg0_clk"
    &clk_reg_cbcr_type="sm_pscbc"
    &clk_vote_bit=-1.
    &clk_multiplier=3.

    gosub Print_Clk_Info_Line
  )

  &match=0
  &wild_head=0
  &wild_tail=0
  &clk_input_length=STRING.LENGTH("&clk")
  &clk_itr_length=STRING.LENGTH("mmss_spdm_jpeg0_clk")

  if (STRING.SCAN("&clk", "*", 0)==0)
  (
    &wild_head=1
  )
  if (STRING.SCAN("&clk", "*", 1)==(STRING.LENGTH("&clk")-1))
  (
    &wild_tail=1
  )

  if ((&wild_head==1)&&(&wild_tail==1))
  (
    if (STRING.SCAN("mmss_spdm_jpeg0_clk", STRING.MID("&clk", 1, &clk_input_length-2), 0)!=-1)
    ( 
      &match=1
    )
  )
  else if (&wild_head==1)
  (
    if (STRING.MID("mmss_spdm_jpeg0_clk", &clk_itr_length-&clk_input_length+1, &clk_input_length-1)==STRING.CUT("&clk", 1))
    ( 
      &match=1
    )
  )
  else if (&wild_tail==1)
  (
    if (STRING.MID("mmss_spdm_jpeg0_clk", 0, &clk_input_length-1)==STRING.CUT("&clk", -1))
    ( 
      &match=1
    )
  )
  else if ("mmss_spdm_jpeg0_clk"=="&clk")
  (
    &match=1
  )
  
  if (&match==1)
  (
    &clk_test=&CLK_TEST_MMSS_SPDM_JPEG0_CLK
    &clk_reg=&HWIO_MMSS_MMSS_SPDM_JPEG0_CBCR_ADDR
    &clk_reg_name="MMSS_MMSS_SPDM_JPEG0_CBCR"
    &clk_name="mmss_spdm_jpeg0_clk"
    &clk_reg_cbcr_type="sm_cbc"
    &clk_vote_bit=-1.
    &clk_multiplier=3.

    gosub Print_Clk_Info_Line
  )

  &match=0
  &wild_head=0
  &wild_tail=0
  &clk_input_length=STRING.LENGTH("&clk")
  &clk_itr_length=STRING.LENGTH("camss_jpeg2_clk")

  if (STRING.SCAN("&clk", "*", 0)==0)
  (
    &wild_head=1
  )
  if (STRING.SCAN("&clk", "*", 1)==(STRING.LENGTH("&clk")-1))
  (
    &wild_tail=1
  )

  if ((&wild_head==1)&&(&wild_tail==1))
  (
    if (STRING.SCAN("camss_jpeg2_clk", STRING.MID("&clk", 1, &clk_input_length-2), 0)!=-1)
    ( 
      &match=1
    )
  )
  else if (&wild_head==1)
  (
    if (STRING.MID("camss_jpeg2_clk", &clk_itr_length-&clk_input_length+1, &clk_input_length-1)==STRING.CUT("&clk", 1))
    ( 
      &match=1
    )
  )
  else if (&wild_tail==1)
  (
    if (STRING.MID("camss_jpeg2_clk", 0, &clk_input_length-1)==STRING.CUT("&clk", -1))
    ( 
      &match=1
    )
  )
  else if ("camss_jpeg2_clk"=="&clk")
  (
    &match=1
  )
  
  if (&match==1)
  (
    &clk_test=&CLK_TEST_CAMSS_JPEG2_CLK
    &clk_reg=&HWIO_MMSS_CAMSS_JPEG2_CBCR_ADDR
    &clk_reg_name="MMSS_CAMSS_JPEG2_CBCR"
    &clk_name="camss_jpeg2_clk"
    &clk_reg_cbcr_type="sm_pscbc"
    &clk_vote_bit=-1.
    &clk_multiplier=3.

    gosub Print_Clk_Info_Line
  )

  &match=0
  &wild_head=0
  &wild_tail=0
  &clk_input_length=STRING.LENGTH("&clk")
  &clk_itr_length=STRING.LENGTH("mmss_spdm_jpeg2_clk")

  if (STRING.SCAN("&clk", "*", 0)==0)
  (
    &wild_head=1
  )
  if (STRING.SCAN("&clk", "*", 1)==(STRING.LENGTH("&clk")-1))
  (
    &wild_tail=1
  )

  if ((&wild_head==1)&&(&wild_tail==1))
  (
    if (STRING.SCAN("mmss_spdm_jpeg2_clk", STRING.MID("&clk", 1, &clk_input_length-2), 0)!=-1)
    ( 
      &match=1
    )
  )
  else if (&wild_head==1)
  (
    if (STRING.MID("mmss_spdm_jpeg2_clk", &clk_itr_length-&clk_input_length+1, &clk_input_length-1)==STRING.CUT("&clk", 1))
    ( 
      &match=1
    )
  )
  else if (&wild_tail==1)
  (
    if (STRING.MID("mmss_spdm_jpeg2_clk", 0, &clk_input_length-1)==STRING.CUT("&clk", -1))
    ( 
      &match=1
    )
  )
  else if ("mmss_spdm_jpeg2_clk"=="&clk")
  (
    &match=1
  )
  
  if (&match==1)
  (
    &clk_test=&CLK_TEST_MMSS_SPDM_JPEG2_CLK
    &clk_reg=&HWIO_MMSS_MMSS_SPDM_JPEG2_CBCR_ADDR
    &clk_reg_name="MMSS_MMSS_SPDM_JPEG2_CBCR"
    &clk_name="mmss_spdm_jpeg2_clk"
    &clk_reg_cbcr_type="sm_cbc"
    &clk_vote_bit=-1.
    &clk_multiplier=3.

    gosub Print_Clk_Info_Line
  )

  &match=0
  &wild_head=0
  &wild_tail=0
  &clk_input_length=STRING.LENGTH("&clk")
  &clk_itr_length=STRING.LENGTH("camss_jpeg_dma_clk")

  if (STRING.SCAN("&clk", "*", 0)==0)
  (
    &wild_head=1
  )
  if (STRING.SCAN("&clk", "*", 1)==(STRING.LENGTH("&clk")-1))
  (
    &wild_tail=1
  )

  if ((&wild_head==1)&&(&wild_tail==1))
  (
    if (STRING.SCAN("camss_jpeg_dma_clk", STRING.MID("&clk", 1, &clk_input_length-2), 0)!=-1)
    ( 
      &match=1
    )
  )
  else if (&wild_head==1)
  (
    if (STRING.MID("camss_jpeg_dma_clk", &clk_itr_length-&clk_input_length+1, &clk_input_length-1)==STRING.CUT("&clk", 1))
    ( 
      &match=1
    )
  )
  else if (&wild_tail==1)
  (
    if (STRING.MID("camss_jpeg_dma_clk", 0, &clk_input_length-1)==STRING.CUT("&clk", -1))
    ( 
      &match=1
    )
  )
  else if ("camss_jpeg_dma_clk"=="&clk")
  (
    &match=1
  )
  
  if (&match==1)
  (
    &clk_test=&CLK_TEST_CAMSS_JPEG_DMA_CLK
    &clk_reg=&HWIO_MMSS_CAMSS_JPEG_DMA_CBCR_ADDR
    &clk_reg_name="MMSS_CAMSS_JPEG_DMA_CBCR"
    &clk_name="camss_jpeg_dma_clk"
    &clk_reg_cbcr_type="sm_pscbc"
    &clk_vote_bit=-1.
    &clk_multiplier=3.

    gosub Print_Clk_Info_Line
  )

  &match=0
  &wild_head=0
  &wild_tail=0
  &clk_input_length=STRING.LENGTH("&clk")
  &clk_itr_length=STRING.LENGTH("mmss_spdm_jpeg_dma_clk")

  if (STRING.SCAN("&clk", "*", 0)==0)
  (
    &wild_head=1
  )
  if (STRING.SCAN("&clk", "*", 1)==(STRING.LENGTH("&clk")-1))
  (
    &wild_tail=1
  )

  if ((&wild_head==1)&&(&wild_tail==1))
  (
    if (STRING.SCAN("mmss_spdm_jpeg_dma_clk", STRING.MID("&clk", 1, &clk_input_length-2), 0)!=-1)
    ( 
      &match=1
    )
  )
  else if (&wild_head==1)
  (
    if (STRING.MID("mmss_spdm_jpeg_dma_clk", &clk_itr_length-&clk_input_length+1, &clk_input_length-1)==STRING.CUT("&clk", 1))
    ( 
      &match=1
    )
  )
  else if (&wild_tail==1)
  (
    if (STRING.MID("mmss_spdm_jpeg_dma_clk", 0, &clk_input_length-1)==STRING.CUT("&clk", -1))
    ( 
      &match=1
    )
  )
  else if ("mmss_spdm_jpeg_dma_clk"=="&clk")
  (
    &match=1
  )
  
  if (&match==1)
  (
    &clk_test=&CLK_TEST_MMSS_SPDM_JPEG_DMA_CLK
    &clk_reg=&HWIO_MMSS_MMSS_SPDM_JPEG_DMA_CBCR_ADDR
    &clk_reg_name="MMSS_MMSS_SPDM_JPEG_DMA_CBCR"
    &clk_name="mmss_spdm_jpeg_dma_clk"
    &clk_reg_cbcr_type="sm_cbc"
    &clk_vote_bit=-1.
    &clk_multiplier=3.

    gosub Print_Clk_Info_Line
  )

  &match=0
  &wild_head=0
  &wild_tail=0
  &clk_input_length=STRING.LENGTH("&clk")
  &clk_itr_length=STRING.LENGTH("mmss_mmagic_maxi_clk")

  if (STRING.SCAN("&clk", "*", 0)==0)
  (
    &wild_head=1
  )
  if (STRING.SCAN("&clk", "*", 1)==(STRING.LENGTH("&clk")-1))
  (
    &wild_tail=1
  )

  if ((&wild_head==1)&&(&wild_tail==1))
  (
    if (STRING.SCAN("mmss_mmagic_maxi_clk", STRING.MID("&clk", 1, &clk_input_length-2), 0)!=-1)
    ( 
      &match=1
    )
  )
  else if (&wild_head==1)
  (
    if (STRING.MID("mmss_mmagic_maxi_clk", &clk_itr_length-&clk_input_length+1, &clk_input_length-1)==STRING.CUT("&clk", 1))
    ( 
      &match=1
    )
  )
  else if (&wild_tail==1)
  (
    if (STRING.MID("mmss_mmagic_maxi_clk", 0, &clk_input_length-1)==STRING.CUT("&clk", -1))
    ( 
      &match=1
    )
  )
  else if ("mmss_mmagic_maxi_clk"=="&clk")
  (
    &match=1
  )
  
  if (&match==1)
  (
    &clk_test=&CLK_TEST_MMSS_MMAGIC_MAXI_CLK
    &clk_reg=&HWIO_MMSS_MMSS_MMAGIC_MAXI_CBCR_ADDR
    &clk_reg_name="MMSS_MMSS_MMAGIC_MAXI_CBCR"
    &clk_name="mmss_mmagic_maxi_clk"
    &clk_reg_cbcr_type="sm_cbc"
    &clk_vote_bit=-1.
    &clk_multiplier=3.

    gosub Print_Clk_Info_Line
  )

  &match=0
  &wild_head=0
  &wild_tail=0
  &clk_input_length=STRING.LENGTH("&clk")
  &clk_itr_length=STRING.LENGTH("mmss_spdm_rm_maxi_clk")

  if (STRING.SCAN("&clk", "*", 0)==0)
  (
    &wild_head=1
  )
  if (STRING.SCAN("&clk", "*", 1)==(STRING.LENGTH("&clk")-1))
  (
    &wild_tail=1
  )

  if ((&wild_head==1)&&(&wild_tail==1))
  (
    if (STRING.SCAN("mmss_spdm_rm_maxi_clk", STRING.MID("&clk", 1, &clk_input_length-2), 0)!=-1)
    ( 
      &match=1
    )
  )
  else if (&wild_head==1)
  (
    if (STRING.MID("mmss_spdm_rm_maxi_clk", &clk_itr_length-&clk_input_length+1, &clk_input_length-1)==STRING.CUT("&clk", 1))
    ( 
      &match=1
    )
  )
  else if (&wild_tail==1)
  (
    if (STRING.MID("mmss_spdm_rm_maxi_clk", 0, &clk_input_length-1)==STRING.CUT("&clk", -1))
    ( 
      &match=1
    )
  )
  else if ("mmss_spdm_rm_maxi_clk"=="&clk")
  (
    &match=1
  )
  
  if (&match==1)
  (
    &clk_test=&CLK_TEST_MMSS_SPDM_RM_MAXI_CLK
    &clk_reg=&HWIO_MMSS_MMSS_SPDM_RM_MAXI_CBCR_ADDR
    &clk_reg_name="MMSS_MMSS_SPDM_RM_MAXI_CBCR"
    &clk_name="mmss_spdm_rm_maxi_clk"
    &clk_reg_cbcr_type="sm_cbc"
    &clk_vote_bit=-1.
    &clk_multiplier=3.

    gosub Print_Clk_Info_Line
  )

  &match=0
  &wild_head=0
  &wild_tail=0
  &clk_input_length=STRING.LENGTH("&clk")
  &clk_itr_length=STRING.LENGTH("video_maxi_clk")

  if (STRING.SCAN("&clk", "*", 0)==0)
  (
    &wild_head=1
  )
  if (STRING.SCAN("&clk", "*", 1)==(STRING.LENGTH("&clk")-1))
  (
    &wild_tail=1
  )

  if ((&wild_head==1)&&(&wild_tail==1))
  (
    if (STRING.SCAN("video_maxi_clk", STRING.MID("&clk", 1, &clk_input_length-2), 0)!=-1)
    ( 
      &match=1
    )
  )
  else if (&wild_head==1)
  (
    if (STRING.MID("video_maxi_clk", &clk_itr_length-&clk_input_length+1, &clk_input_length-1)==STRING.CUT("&clk", 1))
    ( 
      &match=1
    )
  )
  else if (&wild_tail==1)
  (
    if (STRING.MID("video_maxi_clk", 0, &clk_input_length-1)==STRING.CUT("&clk", -1))
    ( 
      &match=1
    )
  )
  else if ("video_maxi_clk"=="&clk")
  (
    &match=1
  )
  
  if (&match==1)
  (
    &clk_test=&CLK_TEST_VIDEO_MAXI_CLK
    &clk_reg=&HWIO_MMSS_VIDEO_MAXI_CBCR_ADDR
    &clk_reg_name="MMSS_VIDEO_MAXI_CBCR"
    &clk_name="video_maxi_clk"
    &clk_reg_cbcr_type="sm_pscbc"
    &clk_vote_bit=-1.
    &clk_multiplier=3.

    gosub Print_Clk_Info_Line
  )

  &match=0
  &wild_head=0
  &wild_tail=0
  &clk_input_length=STRING.LENGTH("&clk")
  &clk_itr_length=STRING.LENGTH("vmem_maxi_clk")

  if (STRING.SCAN("&clk", "*", 0)==0)
  (
    &wild_head=1
  )
  if (STRING.SCAN("&clk", "*", 1)==(STRING.LENGTH("&clk")-1))
  (
    &wild_tail=1
  )

  if ((&wild_head==1)&&(&wild_tail==1))
  (
    if (STRING.SCAN("vmem_maxi_clk", STRING.MID("&clk", 1, &clk_input_length-2), 0)!=-1)
    ( 
      &match=1
    )
  )
  else if (&wild_head==1)
  (
    if (STRING.MID("vmem_maxi_clk", &clk_itr_length-&clk_input_length+1, &clk_input_length-1)==STRING.CUT("&clk", 1))
    ( 
      &match=1
    )
  )
  else if (&wild_tail==1)
  (
    if (STRING.MID("vmem_maxi_clk", 0, &clk_input_length-1)==STRING.CUT("&clk", -1))
    ( 
      &match=1
    )
  )
  else if ("vmem_maxi_clk"=="&clk")
  (
    &match=1
  )
  
  if (&match==1)
  (
    &clk_test=&CLK_TEST_VMEM_MAXI_CLK
    &clk_reg=&HWIO_MMSS_VMEM_MAXI_CBCR_ADDR
    &clk_reg_name="MMSS_VMEM_MAXI_CBCR"
    &clk_name="vmem_maxi_clk"
    &clk_reg_cbcr_type="sm_pscbc"
    &clk_vote_bit=-1.
    &clk_multiplier=3.

    gosub Print_Clk_Info_Line
  )

  &match=0
  &wild_head=0
  &wild_tail=0
  &clk_input_length=STRING.LENGTH("&clk")
  &clk_itr_length=STRING.LENGTH("camss_mclk0_clk")

  if (STRING.SCAN("&clk", "*", 0)==0)
  (
    &wild_head=1
  )
  if (STRING.SCAN("&clk", "*", 1)==(STRING.LENGTH("&clk")-1))
  (
    &wild_tail=1
  )

  if ((&wild_head==1)&&(&wild_tail==1))
  (
    if (STRING.SCAN("camss_mclk0_clk", STRING.MID("&clk", 1, &clk_input_length-2), 0)!=-1)
    ( 
      &match=1
    )
  )
  else if (&wild_head==1)
  (
    if (STRING.MID("camss_mclk0_clk", &clk_itr_length-&clk_input_length+1, &clk_input_length-1)==STRING.CUT("&clk", 1))
    ( 
      &match=1
    )
  )
  else if (&wild_tail==1)
  (
    if (STRING.MID("camss_mclk0_clk", 0, &clk_input_length-1)==STRING.CUT("&clk", -1))
    ( 
      &match=1
    )
  )
  else if ("camss_mclk0_clk"=="&clk")
  (
    &match=1
  )
  
  if (&match==1)
  (
    &clk_test=&CLK_TEST_CAMSS_MCLK0_CLK
    &clk_reg=&HWIO_MMSS_CAMSS_MCLK0_CBCR_ADDR
    &clk_reg_name="MMSS_CAMSS_MCLK0_CBCR"
    &clk_name="camss_mclk0_clk"
    &clk_reg_cbcr_type="sm_cbc"
    &clk_vote_bit=-1.
    &clk_multiplier=3.

    gosub Print_Clk_Info_Line
  )

  &match=0
  &wild_head=0
  &wild_tail=0
  &clk_input_length=STRING.LENGTH("&clk")
  &clk_itr_length=STRING.LENGTH("camss_mclk1_clk")

  if (STRING.SCAN("&clk", "*", 0)==0)
  (
    &wild_head=1
  )
  if (STRING.SCAN("&clk", "*", 1)==(STRING.LENGTH("&clk")-1))
  (
    &wild_tail=1
  )

  if ((&wild_head==1)&&(&wild_tail==1))
  (
    if (STRING.SCAN("camss_mclk1_clk", STRING.MID("&clk", 1, &clk_input_length-2), 0)!=-1)
    ( 
      &match=1
    )
  )
  else if (&wild_head==1)
  (
    if (STRING.MID("camss_mclk1_clk", &clk_itr_length-&clk_input_length+1, &clk_input_length-1)==STRING.CUT("&clk", 1))
    ( 
      &match=1
    )
  )
  else if (&wild_tail==1)
  (
    if (STRING.MID("camss_mclk1_clk", 0, &clk_input_length-1)==STRING.CUT("&clk", -1))
    ( 
      &match=1
    )
  )
  else if ("camss_mclk1_clk"=="&clk")
  (
    &match=1
  )
  
  if (&match==1)
  (
    &clk_test=&CLK_TEST_CAMSS_MCLK1_CLK
    &clk_reg=&HWIO_MMSS_CAMSS_MCLK1_CBCR_ADDR
    &clk_reg_name="MMSS_CAMSS_MCLK1_CBCR"
    &clk_name="camss_mclk1_clk"
    &clk_reg_cbcr_type="sm_cbc"
    &clk_vote_bit=-1.
    &clk_multiplier=3.

    gosub Print_Clk_Info_Line
  )

  &match=0
  &wild_head=0
  &wild_tail=0
  &clk_input_length=STRING.LENGTH("&clk")
  &clk_itr_length=STRING.LENGTH("camss_mclk2_clk")

  if (STRING.SCAN("&clk", "*", 0)==0)
  (
    &wild_head=1
  )
  if (STRING.SCAN("&clk", "*", 1)==(STRING.LENGTH("&clk")-1))
  (
    &wild_tail=1
  )

  if ((&wild_head==1)&&(&wild_tail==1))
  (
    if (STRING.SCAN("camss_mclk2_clk", STRING.MID("&clk", 1, &clk_input_length-2), 0)!=-1)
    ( 
      &match=1
    )
  )
  else if (&wild_head==1)
  (
    if (STRING.MID("camss_mclk2_clk", &clk_itr_length-&clk_input_length+1, &clk_input_length-1)==STRING.CUT("&clk", 1))
    ( 
      &match=1
    )
  )
  else if (&wild_tail==1)
  (
    if (STRING.MID("camss_mclk2_clk", 0, &clk_input_length-1)==STRING.CUT("&clk", -1))
    ( 
      &match=1
    )
  )
  else if ("camss_mclk2_clk"=="&clk")
  (
    &match=1
  )
  
  if (&match==1)
  (
    &clk_test=&CLK_TEST_CAMSS_MCLK2_CLK
    &clk_reg=&HWIO_MMSS_CAMSS_MCLK2_CBCR_ADDR
    &clk_reg_name="MMSS_CAMSS_MCLK2_CBCR"
    &clk_name="camss_mclk2_clk"
    &clk_reg_cbcr_type="sm_cbc"
    &clk_vote_bit=-1.
    &clk_multiplier=3.

    gosub Print_Clk_Info_Line
  )

  &match=0
  &wild_head=0
  &wild_tail=0
  &clk_input_length=STRING.LENGTH("&clk")
  &clk_itr_length=STRING.LENGTH("camss_mclk3_clk")

  if (STRING.SCAN("&clk", "*", 0)==0)
  (
    &wild_head=1
  )
  if (STRING.SCAN("&clk", "*", 1)==(STRING.LENGTH("&clk")-1))
  (
    &wild_tail=1
  )

  if ((&wild_head==1)&&(&wild_tail==1))
  (
    if (STRING.SCAN("camss_mclk3_clk", STRING.MID("&clk", 1, &clk_input_length-2), 0)!=-1)
    ( 
      &match=1
    )
  )
  else if (&wild_head==1)
  (
    if (STRING.MID("camss_mclk3_clk", &clk_itr_length-&clk_input_length+1, &clk_input_length-1)==STRING.CUT("&clk", 1))
    ( 
      &match=1
    )
  )
  else if (&wild_tail==1)
  (
    if (STRING.MID("camss_mclk3_clk", 0, &clk_input_length-1)==STRING.CUT("&clk", -1))
    ( 
      &match=1
    )
  )
  else if ("camss_mclk3_clk"=="&clk")
  (
    &match=1
  )
  
  if (&match==1)
  (
    &clk_test=&CLK_TEST_CAMSS_MCLK3_CLK
    &clk_reg=&HWIO_MMSS_CAMSS_MCLK3_CBCR_ADDR
    &clk_reg_name="MMSS_CAMSS_MCLK3_CBCR"
    &clk_name="camss_mclk3_clk"
    &clk_reg_cbcr_type="sm_cbc"
    &clk_vote_bit=-1.
    &clk_multiplier=3.

    gosub Print_Clk_Info_Line
  )

  &match=0
  &wild_head=0
  &wild_tail=0
  &clk_input_length=STRING.LENGTH("&clk")
  &clk_itr_length=STRING.LENGTH("mdss_mdp_clk")

  if (STRING.SCAN("&clk", "*", 0)==0)
  (
    &wild_head=1
  )
  if (STRING.SCAN("&clk", "*", 1)==(STRING.LENGTH("&clk")-1))
  (
    &wild_tail=1
  )

  if ((&wild_head==1)&&(&wild_tail==1))
  (
    if (STRING.SCAN("mdss_mdp_clk", STRING.MID("&clk", 1, &clk_input_length-2), 0)!=-1)
    ( 
      &match=1
    )
  )
  else if (&wild_head==1)
  (
    if (STRING.MID("mdss_mdp_clk", &clk_itr_length-&clk_input_length+1, &clk_input_length-1)==STRING.CUT("&clk", 1))
    ( 
      &match=1
    )
  )
  else if (&wild_tail==1)
  (
    if (STRING.MID("mdss_mdp_clk", 0, &clk_input_length-1)==STRING.CUT("&clk", -1))
    ( 
      &match=1
    )
  )
  else if ("mdss_mdp_clk"=="&clk")
  (
    &match=1
  )
  
  if (&match==1)
  (
    &clk_test=&CLK_TEST_MDSS_MDP_CLK
    &clk_reg=&HWIO_MMSS_MDSS_MDP_CBCR_ADDR
    &clk_reg_name="MMSS_MDSS_MDP_CBCR"
    &clk_name="mdss_mdp_clk"
    &clk_reg_cbcr_type="sm_pscbc"
    &clk_vote_bit=-1.
    &clk_multiplier=3.

    gosub Print_Clk_Info_Line
  )

  &match=0
  &wild_head=0
  &wild_tail=0
  &clk_input_length=STRING.LENGTH("&clk")
  &clk_itr_length=STRING.LENGTH("mmss_spdm_mdp_clk")

  if (STRING.SCAN("&clk", "*", 0)==0)
  (
    &wild_head=1
  )
  if (STRING.SCAN("&clk", "*", 1)==(STRING.LENGTH("&clk")-1))
  (
    &wild_tail=1
  )

  if ((&wild_head==1)&&(&wild_tail==1))
  (
    if (STRING.SCAN("mmss_spdm_mdp_clk", STRING.MID("&clk", 1, &clk_input_length-2), 0)!=-1)
    ( 
      &match=1
    )
  )
  else if (&wild_head==1)
  (
    if (STRING.MID("mmss_spdm_mdp_clk", &clk_itr_length-&clk_input_length+1, &clk_input_length-1)==STRING.CUT("&clk", 1))
    ( 
      &match=1
    )
  )
  else if (&wild_tail==1)
  (
    if (STRING.MID("mmss_spdm_mdp_clk", 0, &clk_input_length-1)==STRING.CUT("&clk", -1))
    ( 
      &match=1
    )
  )
  else if ("mmss_spdm_mdp_clk"=="&clk")
  (
    &match=1
  )
  
  if (&match==1)
  (
    &clk_test=&CLK_TEST_MMSS_SPDM_MDP_CLK
    &clk_reg=&HWIO_MMSS_MMSS_SPDM_MDP_CBCR_ADDR
    &clk_reg_name="MMSS_MMSS_SPDM_MDP_CBCR"
    &clk_name="mmss_spdm_mdp_clk"
    &clk_reg_cbcr_type="sm_cbc"
    &clk_vote_bit=-1.
    &clk_multiplier=3.

    gosub Print_Clk_Info_Line
  )

  &match=0
  &wild_head=0
  &wild_tail=0
  &clk_input_length=STRING.LENGTH("&clk")
  &clk_itr_length=STRING.LENGTH("mdss_pclk0_clk")

  if (STRING.SCAN("&clk", "*", 0)==0)
  (
    &wild_head=1
  )
  if (STRING.SCAN("&clk", "*", 1)==(STRING.LENGTH("&clk")-1))
  (
    &wild_tail=1
  )

  if ((&wild_head==1)&&(&wild_tail==1))
  (
    if (STRING.SCAN("mdss_pclk0_clk", STRING.MID("&clk", 1, &clk_input_length-2), 0)!=-1)
    ( 
      &match=1
    )
  )
  else if (&wild_head==1)
  (
    if (STRING.MID("mdss_pclk0_clk", &clk_itr_length-&clk_input_length+1, &clk_input_length-1)==STRING.CUT("&clk", 1))
    ( 
      &match=1
    )
  )
  else if (&wild_tail==1)
  (
    if (STRING.MID("mdss_pclk0_clk", 0, &clk_input_length-1)==STRING.CUT("&clk", -1))
    ( 
      &match=1
    )
  )
  else if ("mdss_pclk0_clk"=="&clk")
  (
    &match=1
  )
  
  if (&match==1)
  (
    &clk_test=&CLK_TEST_MDSS_PCLK0_CLK
    &clk_reg=&HWIO_MMSS_MDSS_PCLK0_CBCR_ADDR
    &clk_reg_name="MMSS_MDSS_PCLK0_CBCR"
    &clk_name="mdss_pclk0_clk"
    &clk_reg_cbcr_type="sm_cbc"
    &clk_vote_bit=-1.
    &clk_multiplier=3.

    gosub Print_Clk_Info_Line
  )

  &match=0
  &wild_head=0
  &wild_tail=0
  &clk_input_length=STRING.LENGTH("&clk")
  &clk_itr_length=STRING.LENGTH("mmss_spdm_pclk0_clk")

  if (STRING.SCAN("&clk", "*", 0)==0)
  (
    &wild_head=1
  )
  if (STRING.SCAN("&clk", "*", 1)==(STRING.LENGTH("&clk")-1))
  (
    &wild_tail=1
  )

  if ((&wild_head==1)&&(&wild_tail==1))
  (
    if (STRING.SCAN("mmss_spdm_pclk0_clk", STRING.MID("&clk", 1, &clk_input_length-2), 0)!=-1)
    ( 
      &match=1
    )
  )
  else if (&wild_head==1)
  (
    if (STRING.MID("mmss_spdm_pclk0_clk", &clk_itr_length-&clk_input_length+1, &clk_input_length-1)==STRING.CUT("&clk", 1))
    ( 
      &match=1
    )
  )
  else if (&wild_tail==1)
  (
    if (STRING.MID("mmss_spdm_pclk0_clk", 0, &clk_input_length-1)==STRING.CUT("&clk", -1))
    ( 
      &match=1
    )
  )
  else if ("mmss_spdm_pclk0_clk"=="&clk")
  (
    &match=1
  )
  
  if (&match==1)
  (
    &clk_test=&CLK_TEST_MMSS_SPDM_PCLK0_CLK
    &clk_reg=&HWIO_MMSS_MMSS_SPDM_PCLK0_CBCR_ADDR
    &clk_reg_name="MMSS_MMSS_SPDM_PCLK0_CBCR"
    &clk_name="mmss_spdm_pclk0_clk"
    &clk_reg_cbcr_type="sm_cbc"
    &clk_vote_bit=-1.
    &clk_multiplier=3.

    gosub Print_Clk_Info_Line
  )

  &match=0
  &wild_head=0
  &wild_tail=0
  &clk_input_length=STRING.LENGTH("&clk")
  &clk_itr_length=STRING.LENGTH("mdss_pclk1_clk")

  if (STRING.SCAN("&clk", "*", 0)==0)
  (
    &wild_head=1
  )
  if (STRING.SCAN("&clk", "*", 1)==(STRING.LENGTH("&clk")-1))
  (
    &wild_tail=1
  )

  if ((&wild_head==1)&&(&wild_tail==1))
  (
    if (STRING.SCAN("mdss_pclk1_clk", STRING.MID("&clk", 1, &clk_input_length-2), 0)!=-1)
    ( 
      &match=1
    )
  )
  else if (&wild_head==1)
  (
    if (STRING.MID("mdss_pclk1_clk", &clk_itr_length-&clk_input_length+1, &clk_input_length-1)==STRING.CUT("&clk", 1))
    ( 
      &match=1
    )
  )
  else if (&wild_tail==1)
  (
    if (STRING.MID("mdss_pclk1_clk", 0, &clk_input_length-1)==STRING.CUT("&clk", -1))
    ( 
      &match=1
    )
  )
  else if ("mdss_pclk1_clk"=="&clk")
  (
    &match=1
  )
  
  if (&match==1)
  (
    &clk_test=&CLK_TEST_MDSS_PCLK1_CLK
    &clk_reg=&HWIO_MMSS_MDSS_PCLK1_CBCR_ADDR
    &clk_reg_name="MMSS_MDSS_PCLK1_CBCR"
    &clk_name="mdss_pclk1_clk"
    &clk_reg_cbcr_type="sm_cbc"
    &clk_vote_bit=-1.
    &clk_multiplier=3.

    gosub Print_Clk_Info_Line
  )

  &match=0
  &wild_head=0
  &wild_tail=0
  &clk_input_length=STRING.LENGTH("&clk")
  &clk_itr_length=STRING.LENGTH("mmss_spdm_pclk1_clk")

  if (STRING.SCAN("&clk", "*", 0)==0)
  (
    &wild_head=1
  )
  if (STRING.SCAN("&clk", "*", 1)==(STRING.LENGTH("&clk")-1))
  (
    &wild_tail=1
  )

  if ((&wild_head==1)&&(&wild_tail==1))
  (
    if (STRING.SCAN("mmss_spdm_pclk1_clk", STRING.MID("&clk", 1, &clk_input_length-2), 0)!=-1)
    ( 
      &match=1
    )
  )
  else if (&wild_head==1)
  (
    if (STRING.MID("mmss_spdm_pclk1_clk", &clk_itr_length-&clk_input_length+1, &clk_input_length-1)==STRING.CUT("&clk", 1))
    ( 
      &match=1
    )
  )
  else if (&wild_tail==1)
  (
    if (STRING.MID("mmss_spdm_pclk1_clk", 0, &clk_input_length-1)==STRING.CUT("&clk", -1))
    ( 
      &match=1
    )
  )
  else if ("mmss_spdm_pclk1_clk"=="&clk")
  (
    &match=1
  )
  
  if (&match==1)
  (
    &clk_test=&CLK_TEST_MMSS_SPDM_PCLK1_CLK
    &clk_reg=&HWIO_MMSS_MMSS_SPDM_PCLK1_CBCR_ADDR
    &clk_reg_name="MMSS_MMSS_SPDM_PCLK1_CBCR"
    &clk_name="mmss_spdm_pclk1_clk"
    &clk_reg_cbcr_type="sm_cbc"
    &clk_vote_bit=-1.
    &clk_multiplier=3.

    gosub Print_Clk_Info_Line
  )

  &match=0
  &wild_head=0
  &wild_tail=0
  &clk_input_length=STRING.LENGTH("&clk")
  &clk_itr_length=STRING.LENGTH("gpu_gx_rbbmtimer_clk")

  if (STRING.SCAN("&clk", "*", 0)==0)
  (
    &wild_head=1
  )
  if (STRING.SCAN("&clk", "*", 1)==(STRING.LENGTH("&clk")-1))
  (
    &wild_tail=1
  )

  if ((&wild_head==1)&&(&wild_tail==1))
  (
    if (STRING.SCAN("gpu_gx_rbbmtimer_clk", STRING.MID("&clk", 1, &clk_input_length-2), 0)!=-1)
    ( 
      &match=1
    )
  )
  else if (&wild_head==1)
  (
    if (STRING.MID("gpu_gx_rbbmtimer_clk", &clk_itr_length-&clk_input_length+1, &clk_input_length-1)==STRING.CUT("&clk", 1))
    ( 
      &match=1
    )
  )
  else if (&wild_tail==1)
  (
    if (STRING.MID("gpu_gx_rbbmtimer_clk", 0, &clk_input_length-1)==STRING.CUT("&clk", -1))
    ( 
      &match=1
    )
  )
  else if ("gpu_gx_rbbmtimer_clk"=="&clk")
  (
    &match=1
  )
  
  if (&match==1)
  (
    &clk_test=&CLK_TEST_GPU_GX_RBBMTIMER_CLK
    &clk_reg=&HWIO_MMSS_GPU_GX_RBBMTIMER_CBCR_ADDR
    &clk_reg_name="MMSS_GPU_GX_RBBMTIMER_CBCR"
    &clk_name="gpu_gx_rbbmtimer_clk"
    &clk_reg_cbcr_type="sm_cbc"
    &clk_vote_bit=-1.
    &clk_multiplier=3.

    gosub Print_Clk_Info_Line
  )

  &match=0
  &wild_head=0
  &wild_tail=0
  &clk_input_length=STRING.LENGTH("&clk")
  &clk_itr_length=STRING.LENGTH("mmss_rbcpr_clk")

  if (STRING.SCAN("&clk", "*", 0)==0)
  (
    &wild_head=1
  )
  if (STRING.SCAN("&clk", "*", 1)==(STRING.LENGTH("&clk")-1))
  (
    &wild_tail=1
  )

  if ((&wild_head==1)&&(&wild_tail==1))
  (
    if (STRING.SCAN("mmss_rbcpr_clk", STRING.MID("&clk", 1, &clk_input_length-2), 0)!=-1)
    ( 
      &match=1
    )
  )
  else if (&wild_head==1)
  (
    if (STRING.MID("mmss_rbcpr_clk", &clk_itr_length-&clk_input_length+1, &clk_input_length-1)==STRING.CUT("&clk", 1))
    ( 
      &match=1
    )
  )
  else if (&wild_tail==1)
  (
    if (STRING.MID("mmss_rbcpr_clk", 0, &clk_input_length-1)==STRING.CUT("&clk", -1))
    ( 
      &match=1
    )
  )
  else if ("mmss_rbcpr_clk"=="&clk")
  (
    &match=1
  )
  
  if (&match==1)
  (
    &clk_test=&CLK_TEST_MMSS_RBCPR_CLK
    &clk_reg=&HWIO_MMSS_MMSS_RBCPR_CBCR_ADDR
    &clk_reg_name="MMSS_MMSS_RBCPR_CBCR"
    &clk_name="mmss_rbcpr_clk"
    &clk_reg_cbcr_type="sm_cbc"
    &clk_vote_bit=-1.
    &clk_multiplier=3.

    gosub Print_Clk_Info_Line
  )

  &match=0
  &wild_head=0
  &wild_tail=0
  &clk_input_length=STRING.LENGTH("&clk")
  &clk_itr_length=STRING.LENGTH("camss_csi_vfe0_clk")

  if (STRING.SCAN("&clk", "*", 0)==0)
  (
    &wild_head=1
  )
  if (STRING.SCAN("&clk", "*", 1)==(STRING.LENGTH("&clk")-1))
  (
    &wild_tail=1
  )

  if ((&wild_head==1)&&(&wild_tail==1))
  (
    if (STRING.SCAN("camss_csi_vfe0_clk", STRING.MID("&clk", 1, &clk_input_length-2), 0)!=-1)
    ( 
      &match=1
    )
  )
  else if (&wild_head==1)
  (
    if (STRING.MID("camss_csi_vfe0_clk", &clk_itr_length-&clk_input_length+1, &clk_input_length-1)==STRING.CUT("&clk", 1))
    ( 
      &match=1
    )
  )
  else if (&wild_tail==1)
  (
    if (STRING.MID("camss_csi_vfe0_clk", 0, &clk_input_length-1)==STRING.CUT("&clk", -1))
    ( 
      &match=1
    )
  )
  else if ("camss_csi_vfe0_clk"=="&clk")
  (
    &match=1
  )
  
  if (&match==1)
  (
    &clk_test=&CLK_TEST_CAMSS_CSI_VFE0_CLK
    &clk_reg=&HWIO_MMSS_CAMSS_CSI_VFE0_CBCR_ADDR
    &clk_reg_name="MMSS_CAMSS_CSI_VFE0_CBCR"
    &clk_name="camss_csi_vfe0_clk"
    &clk_reg_cbcr_type="sm_pscbc"
    &clk_vote_bit=-1.
    &clk_multiplier=3.

    gosub Print_Clk_Info_Line
  )

  &match=0
  &wild_head=0
  &wild_tail=0
  &clk_input_length=STRING.LENGTH("&clk")
  &clk_itr_length=STRING.LENGTH("camss_vfe0_clk")

  if (STRING.SCAN("&clk", "*", 0)==0)
  (
    &wild_head=1
  )
  if (STRING.SCAN("&clk", "*", 1)==(STRING.LENGTH("&clk")-1))
  (
    &wild_tail=1
  )

  if ((&wild_head==1)&&(&wild_tail==1))
  (
    if (STRING.SCAN("camss_vfe0_clk", STRING.MID("&clk", 1, &clk_input_length-2), 0)!=-1)
    ( 
      &match=1
    )
  )
  else if (&wild_head==1)
  (
    if (STRING.MID("camss_vfe0_clk", &clk_itr_length-&clk_input_length+1, &clk_input_length-1)==STRING.CUT("&clk", 1))
    ( 
      &match=1
    )
  )
  else if (&wild_tail==1)
  (
    if (STRING.MID("camss_vfe0_clk", 0, &clk_input_length-1)==STRING.CUT("&clk", -1))
    ( 
      &match=1
    )
  )
  else if ("camss_vfe0_clk"=="&clk")
  (
    &match=1
  )
  
  if (&match==1)
  (
    &clk_test=&CLK_TEST_CAMSS_VFE0_CLK
    &clk_reg=&HWIO_MMSS_CAMSS_VFE0_CBCR_ADDR
    &clk_reg_name="MMSS_CAMSS_VFE0_CBCR"
    &clk_name="camss_vfe0_clk"
    &clk_reg_cbcr_type="sm_pscbc"
    &clk_vote_bit=-1.
    &clk_multiplier=3.

    gosub Print_Clk_Info_Line
  )

  &match=0
  &wild_head=0
  &wild_tail=0
  &clk_input_length=STRING.LENGTH("&clk")
  &clk_itr_length=STRING.LENGTH("camss_vfe0_stream_clk")

  if (STRING.SCAN("&clk", "*", 0)==0)
  (
    &wild_head=1
  )
  if (STRING.SCAN("&clk", "*", 1)==(STRING.LENGTH("&clk")-1))
  (
    &wild_tail=1
  )

  if ((&wild_head==1)&&(&wild_tail==1))
  (
    if (STRING.SCAN("camss_vfe0_stream_clk", STRING.MID("&clk", 1, &clk_input_length-2), 0)!=-1)
    ( 
      &match=1
    )
  )
  else if (&wild_head==1)
  (
    if (STRING.MID("camss_vfe0_stream_clk", &clk_itr_length-&clk_input_length+1, &clk_input_length-1)==STRING.CUT("&clk", 1))
    ( 
      &match=1
    )
  )
  else if (&wild_tail==1)
  (
    if (STRING.MID("camss_vfe0_stream_clk", 0, &clk_input_length-1)==STRING.CUT("&clk", -1))
    ( 
      &match=1
    )
  )
  else if ("camss_vfe0_stream_clk"=="&clk")
  (
    &match=1
  )
  
  if (&match==1)
  (
    &clk_test=&CLK_TEST_CAMSS_VFE0_STREAM_CLK
    &clk_reg=&HWIO_MMSS_CAMSS_VFE0_STREAM_CBCR_ADDR
    &clk_reg_name="MMSS_CAMSS_VFE0_STREAM_CBCR"
    &clk_name="camss_vfe0_stream_clk"
    &clk_reg_cbcr_type="sm_cbc"
    &clk_vote_bit=-1.
    &clk_multiplier=3.

    gosub Print_Clk_Info_Line
  )

  &match=0
  &wild_head=0
  &wild_tail=0
  &clk_input_length=STRING.LENGTH("&clk")
  &clk_itr_length=STRING.LENGTH("mmss_spdm_vfe0_clk")

  if (STRING.SCAN("&clk", "*", 0)==0)
  (
    &wild_head=1
  )
  if (STRING.SCAN("&clk", "*", 1)==(STRING.LENGTH("&clk")-1))
  (
    &wild_tail=1
  )

  if ((&wild_head==1)&&(&wild_tail==1))
  (
    if (STRING.SCAN("mmss_spdm_vfe0_clk", STRING.MID("&clk", 1, &clk_input_length-2), 0)!=-1)
    ( 
      &match=1
    )
  )
  else if (&wild_head==1)
  (
    if (STRING.MID("mmss_spdm_vfe0_clk", &clk_itr_length-&clk_input_length+1, &clk_input_length-1)==STRING.CUT("&clk", 1))
    ( 
      &match=1
    )
  )
  else if (&wild_tail==1)
  (
    if (STRING.MID("mmss_spdm_vfe0_clk", 0, &clk_input_length-1)==STRING.CUT("&clk", -1))
    ( 
      &match=1
    )
  )
  else if ("mmss_spdm_vfe0_clk"=="&clk")
  (
    &match=1
  )
  
  if (&match==1)
  (
    &clk_test=&CLK_TEST_MMSS_SPDM_VFE0_CLK
    &clk_reg=&HWIO_MMSS_MMSS_SPDM_VFE0_CBCR_ADDR
    &clk_reg_name="MMSS_MMSS_SPDM_VFE0_CBCR"
    &clk_name="mmss_spdm_vfe0_clk"
    &clk_reg_cbcr_type="sm_cbc"
    &clk_vote_bit=-1.
    &clk_multiplier=3.

    gosub Print_Clk_Info_Line
  )

  &match=0
  &wild_head=0
  &wild_tail=0
  &clk_input_length=STRING.LENGTH("&clk")
  &clk_itr_length=STRING.LENGTH("camss_csi_vfe1_clk")

  if (STRING.SCAN("&clk", "*", 0)==0)
  (
    &wild_head=1
  )
  if (STRING.SCAN("&clk", "*", 1)==(STRING.LENGTH("&clk")-1))
  (
    &wild_tail=1
  )

  if ((&wild_head==1)&&(&wild_tail==1))
  (
    if (STRING.SCAN("camss_csi_vfe1_clk", STRING.MID("&clk", 1, &clk_input_length-2), 0)!=-1)
    ( 
      &match=1
    )
  )
  else if (&wild_head==1)
  (
    if (STRING.MID("camss_csi_vfe1_clk", &clk_itr_length-&clk_input_length+1, &clk_input_length-1)==STRING.CUT("&clk", 1))
    ( 
      &match=1
    )
  )
  else if (&wild_tail==1)
  (
    if (STRING.MID("camss_csi_vfe1_clk", 0, &clk_input_length-1)==STRING.CUT("&clk", -1))
    ( 
      &match=1
    )
  )
  else if ("camss_csi_vfe1_clk"=="&clk")
  (
    &match=1
  )
  
  if (&match==1)
  (
    &clk_test=&CLK_TEST_CAMSS_CSI_VFE1_CLK
    &clk_reg=&HWIO_MMSS_CAMSS_CSI_VFE1_CBCR_ADDR
    &clk_reg_name="MMSS_CAMSS_CSI_VFE1_CBCR"
    &clk_name="camss_csi_vfe1_clk"
    &clk_reg_cbcr_type="sm_pscbc"
    &clk_vote_bit=-1.
    &clk_multiplier=3.

    gosub Print_Clk_Info_Line
  )

  &match=0
  &wild_head=0
  &wild_tail=0
  &clk_input_length=STRING.LENGTH("&clk")
  &clk_itr_length=STRING.LENGTH("camss_vfe1_clk")

  if (STRING.SCAN("&clk", "*", 0)==0)
  (
    &wild_head=1
  )
  if (STRING.SCAN("&clk", "*", 1)==(STRING.LENGTH("&clk")-1))
  (
    &wild_tail=1
  )

  if ((&wild_head==1)&&(&wild_tail==1))
  (
    if (STRING.SCAN("camss_vfe1_clk", STRING.MID("&clk", 1, &clk_input_length-2), 0)!=-1)
    ( 
      &match=1
    )
  )
  else if (&wild_head==1)
  (
    if (STRING.MID("camss_vfe1_clk", &clk_itr_length-&clk_input_length+1, &clk_input_length-1)==STRING.CUT("&clk", 1))
    ( 
      &match=1
    )
  )
  else if (&wild_tail==1)
  (
    if (STRING.MID("camss_vfe1_clk", 0, &clk_input_length-1)==STRING.CUT("&clk", -1))
    ( 
      &match=1
    )
  )
  else if ("camss_vfe1_clk"=="&clk")
  (
    &match=1
  )
  
  if (&match==1)
  (
    &clk_test=&CLK_TEST_CAMSS_VFE1_CLK
    &clk_reg=&HWIO_MMSS_CAMSS_VFE1_CBCR_ADDR
    &clk_reg_name="MMSS_CAMSS_VFE1_CBCR"
    &clk_name="camss_vfe1_clk"
    &clk_reg_cbcr_type="sm_pscbc"
    &clk_vote_bit=-1.
    &clk_multiplier=3.

    gosub Print_Clk_Info_Line
  )

  &match=0
  &wild_head=0
  &wild_tail=0
  &clk_input_length=STRING.LENGTH("&clk")
  &clk_itr_length=STRING.LENGTH("camss_vfe1_stream_clk")

  if (STRING.SCAN("&clk", "*", 0)==0)
  (
    &wild_head=1
  )
  if (STRING.SCAN("&clk", "*", 1)==(STRING.LENGTH("&clk")-1))
  (
    &wild_tail=1
  )

  if ((&wild_head==1)&&(&wild_tail==1))
  (
    if (STRING.SCAN("camss_vfe1_stream_clk", STRING.MID("&clk", 1, &clk_input_length-2), 0)!=-1)
    ( 
      &match=1
    )
  )
  else if (&wild_head==1)
  (
    if (STRING.MID("camss_vfe1_stream_clk", &clk_itr_length-&clk_input_length+1, &clk_input_length-1)==STRING.CUT("&clk", 1))
    ( 
      &match=1
    )
  )
  else if (&wild_tail==1)
  (
    if (STRING.MID("camss_vfe1_stream_clk", 0, &clk_input_length-1)==STRING.CUT("&clk", -1))
    ( 
      &match=1
    )
  )
  else if ("camss_vfe1_stream_clk"=="&clk")
  (
    &match=1
  )
  
  if (&match==1)
  (
    &clk_test=&CLK_TEST_CAMSS_VFE1_STREAM_CLK
    &clk_reg=&HWIO_MMSS_CAMSS_VFE1_STREAM_CBCR_ADDR
    &clk_reg_name="MMSS_CAMSS_VFE1_STREAM_CBCR"
    &clk_name="camss_vfe1_stream_clk"
    &clk_reg_cbcr_type="sm_cbc"
    &clk_vote_bit=-1.
    &clk_multiplier=3.

    gosub Print_Clk_Info_Line
  )

  &match=0
  &wild_head=0
  &wild_tail=0
  &clk_input_length=STRING.LENGTH("&clk")
  &clk_itr_length=STRING.LENGTH("mmss_spdm_vfe1_clk")

  if (STRING.SCAN("&clk", "*", 0)==0)
  (
    &wild_head=1
  )
  if (STRING.SCAN("&clk", "*", 1)==(STRING.LENGTH("&clk")-1))
  (
    &wild_tail=1
  )

  if ((&wild_head==1)&&(&wild_tail==1))
  (
    if (STRING.SCAN("mmss_spdm_vfe1_clk", STRING.MID("&clk", 1, &clk_input_length-2), 0)!=-1)
    ( 
      &match=1
    )
  )
  else if (&wild_head==1)
  (
    if (STRING.MID("mmss_spdm_vfe1_clk", &clk_itr_length-&clk_input_length+1, &clk_input_length-1)==STRING.CUT("&clk", 1))
    ( 
      &match=1
    )
  )
  else if (&wild_tail==1)
  (
    if (STRING.MID("mmss_spdm_vfe1_clk", 0, &clk_input_length-1)==STRING.CUT("&clk", -1))
    ( 
      &match=1
    )
  )
  else if ("mmss_spdm_vfe1_clk"=="&clk")
  (
    &match=1
  )
  
  if (&match==1)
  (
    &clk_test=&CLK_TEST_MMSS_SPDM_VFE1_CLK
    &clk_reg=&HWIO_MMSS_MMSS_SPDM_VFE1_CBCR_ADDR
    &clk_reg_name="MMSS_MMSS_SPDM_VFE1_CBCR"
    &clk_name="mmss_spdm_vfe1_clk"
    &clk_reg_cbcr_type="sm_cbc"
    &clk_vote_bit=-1.
    &clk_multiplier=3.

    gosub Print_Clk_Info_Line
  )

  &match=0
  &wild_head=0
  &wild_tail=0
  &clk_input_length=STRING.LENGTH("&clk")
  &clk_itr_length=STRING.LENGTH("mmss_spdm_video_core_clk")

  if (STRING.SCAN("&clk", "*", 0)==0)
  (
    &wild_head=1
  )
  if (STRING.SCAN("&clk", "*", 1)==(STRING.LENGTH("&clk")-1))
  (
    &wild_tail=1
  )

  if ((&wild_head==1)&&(&wild_tail==1))
  (
    if (STRING.SCAN("mmss_spdm_video_core_clk", STRING.MID("&clk", 1, &clk_input_length-2), 0)!=-1)
    ( 
      &match=1
    )
  )
  else if (&wild_head==1)
  (
    if (STRING.MID("mmss_spdm_video_core_clk", &clk_itr_length-&clk_input_length+1, &clk_input_length-1)==STRING.CUT("&clk", 1))
    ( 
      &match=1
    )
  )
  else if (&wild_tail==1)
  (
    if (STRING.MID("mmss_spdm_video_core_clk", 0, &clk_input_length-1)==STRING.CUT("&clk", -1))
    ( 
      &match=1
    )
  )
  else if ("mmss_spdm_video_core_clk"=="&clk")
  (
    &match=1
  )
  
  if (&match==1)
  (
    &clk_test=&CLK_TEST_MMSS_SPDM_VIDEO_CORE_CLK
    &clk_reg=&HWIO_MMSS_MMSS_SPDM_VIDEO_CORE_CBCR_ADDR
    &clk_reg_name="MMSS_MMSS_SPDM_VIDEO_CORE_CBCR"
    &clk_name="mmss_spdm_video_core_clk"
    &clk_reg_cbcr_type="sm_cbc"
    &clk_vote_bit=-1.
    &clk_multiplier=3.

    gosub Print_Clk_Info_Line
  )

  &match=0
  &wild_head=0
  &wild_tail=0
  &clk_input_length=STRING.LENGTH("&clk")
  &clk_itr_length=STRING.LENGTH("video_core_clk")

  if (STRING.SCAN("&clk", "*", 0)==0)
  (
    &wild_head=1
  )
  if (STRING.SCAN("&clk", "*", 1)==(STRING.LENGTH("&clk")-1))
  (
    &wild_tail=1
  )

  if ((&wild_head==1)&&(&wild_tail==1))
  (
    if (STRING.SCAN("video_core_clk", STRING.MID("&clk", 1, &clk_input_length-2), 0)!=-1)
    ( 
      &match=1
    )
  )
  else if (&wild_head==1)
  (
    if (STRING.MID("video_core_clk", &clk_itr_length-&clk_input_length+1, &clk_input_length-1)==STRING.CUT("&clk", 1))
    ( 
      &match=1
    )
  )
  else if (&wild_tail==1)
  (
    if (STRING.MID("video_core_clk", 0, &clk_input_length-1)==STRING.CUT("&clk", -1))
    ( 
      &match=1
    )
  )
  else if ("video_core_clk"=="&clk")
  (
    &match=1
  )
  
  if (&match==1)
  (
    &clk_test=&CLK_TEST_VIDEO_CORE_CLK
    &clk_reg=&HWIO_MMSS_VIDEO_CORE_CBCR_ADDR
    &clk_reg_name="MMSS_VIDEO_CORE_CBCR"
    &clk_name="video_core_clk"
    &clk_reg_cbcr_type="sm_pscbc"
    &clk_vote_bit=-1.
    &clk_multiplier=3.

    gosub Print_Clk_Info_Line
  )

  &match=0
  &wild_head=0
  &wild_tail=0
  &clk_input_length=STRING.LENGTH("&clk")
  &clk_itr_length=STRING.LENGTH("video_subcore0_clk")

  if (STRING.SCAN("&clk", "*", 0)==0)
  (
    &wild_head=1
  )
  if (STRING.SCAN("&clk", "*", 1)==(STRING.LENGTH("&clk")-1))
  (
    &wild_tail=1
  )

  if ((&wild_head==1)&&(&wild_tail==1))
  (
    if (STRING.SCAN("video_subcore0_clk", STRING.MID("&clk", 1, &clk_input_length-2), 0)!=-1)
    ( 
      &match=1
    )
  )
  else if (&wild_head==1)
  (
    if (STRING.MID("video_subcore0_clk", &clk_itr_length-&clk_input_length+1, &clk_input_length-1)==STRING.CUT("&clk", 1))
    ( 
      &match=1
    )
  )
  else if (&wild_tail==1)
  (
    if (STRING.MID("video_subcore0_clk", 0, &clk_input_length-1)==STRING.CUT("&clk", -1))
    ( 
      &match=1
    )
  )
  else if ("video_subcore0_clk"=="&clk")
  (
    &match=1
  )
  
  if (&match==1)
  (
    &clk_test=&CLK_TEST_VIDEO_SUBCORE0_CLK
    &clk_reg=&HWIO_MMSS_VIDEO_SUBCORE0_CBCR_ADDR
    &clk_reg_name="MMSS_VIDEO_SUBCORE0_CBCR"
    &clk_name="video_subcore0_clk"
    &clk_reg_cbcr_type="sm_pscbc"
    &clk_vote_bit=-1.
    &clk_multiplier=3.

    gosub Print_Clk_Info_Line
  )

  &match=0
  &wild_head=0
  &wild_tail=0
  &clk_input_length=STRING.LENGTH("&clk")
  &clk_itr_length=STRING.LENGTH("video_subcore1_clk")

  if (STRING.SCAN("&clk", "*", 0)==0)
  (
    &wild_head=1
  )
  if (STRING.SCAN("&clk", "*", 1)==(STRING.LENGTH("&clk")-1))
  (
    &wild_tail=1
  )

  if ((&wild_head==1)&&(&wild_tail==1))
  (
    if (STRING.SCAN("video_subcore1_clk", STRING.MID("&clk", 1, &clk_input_length-2), 0)!=-1)
    ( 
      &match=1
    )
  )
  else if (&wild_head==1)
  (
    if (STRING.MID("video_subcore1_clk", &clk_itr_length-&clk_input_length+1, &clk_input_length-1)==STRING.CUT("&clk", 1))
    ( 
      &match=1
    )
  )
  else if (&wild_tail==1)
  (
    if (STRING.MID("video_subcore1_clk", 0, &clk_input_length-1)==STRING.CUT("&clk", -1))
    ( 
      &match=1
    )
  )
  else if ("video_subcore1_clk"=="&clk")
  (
    &match=1
  )
  
  if (&match==1)
  (
    &clk_test=&CLK_TEST_VIDEO_SUBCORE1_CLK
    &clk_reg=&HWIO_MMSS_VIDEO_SUBCORE1_CBCR_ADDR
    &clk_reg_name="MMSS_VIDEO_SUBCORE1_CBCR"
    &clk_name="video_subcore1_clk"
    &clk_reg_cbcr_type="sm_pscbc"
    &clk_vote_bit=-1.
    &clk_multiplier=3.

    gosub Print_Clk_Info_Line
  )

  &match=0
  &wild_head=0
  &wild_tail=0
  &clk_input_length=STRING.LENGTH("&clk")
  &clk_itr_length=STRING.LENGTH("mdss_vsync_clk")

  if (STRING.SCAN("&clk", "*", 0)==0)
  (
    &wild_head=1
  )
  if (STRING.SCAN("&clk", "*", 1)==(STRING.LENGTH("&clk")-1))
  (
    &wild_tail=1
  )

  if ((&wild_head==1)&&(&wild_tail==1))
  (
    if (STRING.SCAN("mdss_vsync_clk", STRING.MID("&clk", 1, &clk_input_length-2), 0)!=-1)
    ( 
      &match=1
    )
  )
  else if (&wild_head==1)
  (
    if (STRING.MID("mdss_vsync_clk", &clk_itr_length-&clk_input_length+1, &clk_input_length-1)==STRING.CUT("&clk", 1))
    ( 
      &match=1
    )
  )
  else if (&wild_tail==1)
  (
    if (STRING.MID("mdss_vsync_clk", 0, &clk_input_length-1)==STRING.CUT("&clk", -1))
    ( 
      &match=1
    )
  )
  else if ("mdss_vsync_clk"=="&clk")
  (
    &match=1
  )
  
  if (&match==1)
  (
    &clk_test=&CLK_TEST_MDSS_VSYNC_CLK
    &clk_reg=&HWIO_MMSS_MDSS_VSYNC_CBCR_ADDR
    &clk_reg_name="MMSS_MDSS_VSYNC_CBCR"
    &clk_name="mdss_vsync_clk"
    &clk_reg_cbcr_type="sm_cbc"
    &clk_vote_bit=-1.
    &clk_multiplier=3.

    gosub Print_Clk_Info_Line
  )

  &match=0
  &wild_head=0
  &wild_tail=0
  &clk_input_length=STRING.LENGTH("&clk")
  &clk_itr_length=STRING.LENGTH("mmss_cxo_clk")

  if (STRING.SCAN("&clk", "*", 0)==0)
  (
    &wild_head=1
  )
  if (STRING.SCAN("&clk", "*", 1)==(STRING.LENGTH("&clk")-1))
  (
    &wild_tail=1
  )

  if ((&wild_head==1)&&(&wild_tail==1))
  (
    if (STRING.SCAN("mmss_cxo_clk", STRING.MID("&clk", 1, &clk_input_length-2), 0)!=-1)
    ( 
      &match=1
    )
  )
  else if (&wild_head==1)
  (
    if (STRING.MID("mmss_cxo_clk", &clk_itr_length-&clk_input_length+1, &clk_input_length-1)==STRING.CUT("&clk", 1))
    ( 
      &match=1
    )
  )
  else if (&wild_tail==1)
  (
    if (STRING.MID("mmss_cxo_clk", 0, &clk_input_length-1)==STRING.CUT("&clk", -1))
    ( 
      &match=1
    )
  )
  else if ("mmss_cxo_clk"=="&clk")
  (
    &match=1
  )
  
  if (&match==1)
  (
    &clk_test=0
    &clk_reg=&HWIO_MMSS_MMSS_CXO_CBCR_ADDR
    &clk_reg_name="MMSS_MMSS_CXO_CBCR"
    &clk_name="mmss_cxo_clk"
    &clk_reg_cbcr_type="sm_cbc"
    &clk_vote_bit=-1.
    &clk_multiplier=3.

    gosub Print_Clk_Info_Line
  )

  &match=0
  &wild_head=0
  &wild_tail=0
  &clk_input_length=STRING.LENGTH("&clk")
  &clk_itr_length=STRING.LENGTH("mmss_misc_cxo_clk")

  if (STRING.SCAN("&clk", "*", 0)==0)
  (
    &wild_head=1
  )
  if (STRING.SCAN("&clk", "*", 1)==(STRING.LENGTH("&clk")-1))
  (
    &wild_tail=1
  )

  if ((&wild_head==1)&&(&wild_tail==1))
  (
    if (STRING.SCAN("mmss_misc_cxo_clk", STRING.MID("&clk", 1, &clk_input_length-2), 0)!=-1)
    ( 
      &match=1
    )
  )
  else if (&wild_head==1)
  (
    if (STRING.MID("mmss_misc_cxo_clk", &clk_itr_length-&clk_input_length+1, &clk_input_length-1)==STRING.CUT("&clk", 1))
    ( 
      &match=1
    )
  )
  else if (&wild_tail==1)
  (
    if (STRING.MID("mmss_misc_cxo_clk", 0, &clk_input_length-1)==STRING.CUT("&clk", -1))
    ( 
      &match=1
    )
  )
  else if ("mmss_misc_cxo_clk"=="&clk")
  (
    &match=1
  )
  
  if (&match==1)
  (
    &clk_test=&CLK_TEST_MMSS_MISC_CXO_CLK
    &clk_reg=&HWIO_MMSS_MMSS_MISC_CXO_CBCR_ADDR
    &clk_reg_name="MMSS_MMSS_MISC_CXO_CBCR"
    &clk_name="mmss_misc_cxo_clk"
    &clk_reg_cbcr_type="sm_cbc"
    &clk_vote_bit=-1.
    &clk_multiplier=3.

    gosub Print_Clk_Info_Line
  )

  &match=0
  &wild_head=0
  &wild_tail=0
  &clk_input_length=STRING.LENGTH("&clk")
  &clk_itr_length=STRING.LENGTH("throttle_camss_cxo_clk")

  if (STRING.SCAN("&clk", "*", 0)==0)
  (
    &wild_head=1
  )
  if (STRING.SCAN("&clk", "*", 1)==(STRING.LENGTH("&clk")-1))
  (
    &wild_tail=1
  )

  if ((&wild_head==1)&&(&wild_tail==1))
  (
    if (STRING.SCAN("throttle_camss_cxo_clk", STRING.MID("&clk", 1, &clk_input_length-2), 0)!=-1)
    ( 
      &match=1
    )
  )
  else if (&wild_head==1)
  (
    if (STRING.MID("throttle_camss_cxo_clk", &clk_itr_length-&clk_input_length+1, &clk_input_length-1)==STRING.CUT("&clk", 1))
    ( 
      &match=1
    )
  )
  else if (&wild_tail==1)
  (
    if (STRING.MID("throttle_camss_cxo_clk", 0, &clk_input_length-1)==STRING.CUT("&clk", -1))
    ( 
      &match=1
    )
  )
  else if ("throttle_camss_cxo_clk"=="&clk")
  (
    &match=1
  )
  
  if (&match==1)
  (
    &clk_test=&CLK_TEST_THROTTLE_CAMSS_CXO_CLK
    &clk_reg=&HWIO_MMSS_THROTTLE_CAMSS_CXO_CBCR_ADDR
    &clk_reg_name="MMSS_THROTTLE_CAMSS_CXO_CBCR"
    &clk_name="throttle_camss_cxo_clk"
    &clk_reg_cbcr_type="sm_cbc"
    &clk_vote_bit=-1.
    &clk_multiplier=3.

    gosub Print_Clk_Info_Line
  )

  &match=0
  &wild_head=0
  &wild_tail=0
  &clk_input_length=STRING.LENGTH("&clk")
  &clk_itr_length=STRING.LENGTH("throttle_mdss_cxo_clk")

  if (STRING.SCAN("&clk", "*", 0)==0)
  (
    &wild_head=1
  )
  if (STRING.SCAN("&clk", "*", 1)==(STRING.LENGTH("&clk")-1))
  (
    &wild_tail=1
  )

  if ((&wild_head==1)&&(&wild_tail==1))
  (
    if (STRING.SCAN("throttle_mdss_cxo_clk", STRING.MID("&clk", 1, &clk_input_length-2), 0)!=-1)
    ( 
      &match=1
    )
  )
  else if (&wild_head==1)
  (
    if (STRING.MID("throttle_mdss_cxo_clk", &clk_itr_length-&clk_input_length+1, &clk_input_length-1)==STRING.CUT("&clk", 1))
    ( 
      &match=1
    )
  )
  else if (&wild_tail==1)
  (
    if (STRING.MID("throttle_mdss_cxo_clk", 0, &clk_input_length-1)==STRING.CUT("&clk", -1))
    ( 
      &match=1
    )
  )
  else if ("throttle_mdss_cxo_clk"=="&clk")
  (
    &match=1
  )
  
  if (&match==1)
  (
    &clk_test=&CLK_TEST_THROTTLE_MDSS_CXO_CLK
    &clk_reg=&HWIO_MMSS_THROTTLE_MDSS_CXO_CBCR_ADDR
    &clk_reg_name="MMSS_THROTTLE_MDSS_CXO_CBCR"
    &clk_name="throttle_mdss_cxo_clk"
    &clk_reg_cbcr_type="sm_cbc"
    &clk_vote_bit=-1.
    &clk_multiplier=3.

    gosub Print_Clk_Info_Line
  )

  &match=0
  &wild_head=0
  &wild_tail=0
  &clk_input_length=STRING.LENGTH("&clk")
  &clk_itr_length=STRING.LENGTH("throttle_video_cxo_clk")

  if (STRING.SCAN("&clk", "*", 0)==0)
  (
    &wild_head=1
  )
  if (STRING.SCAN("&clk", "*", 1)==(STRING.LENGTH("&clk")-1))
  (
    &wild_tail=1
  )

  if ((&wild_head==1)&&(&wild_tail==1))
  (
    if (STRING.SCAN("throttle_video_cxo_clk", STRING.MID("&clk", 1, &clk_input_length-2), 0)!=-1)
    ( 
      &match=1
    )
  )
  else if (&wild_head==1)
  (
    if (STRING.MID("throttle_video_cxo_clk", &clk_itr_length-&clk_input_length+1, &clk_input_length-1)==STRING.CUT("&clk", 1))
    ( 
      &match=1
    )
  )
  else if (&wild_tail==1)
  (
    if (STRING.MID("throttle_video_cxo_clk", 0, &clk_input_length-1)==STRING.CUT("&clk", -1))
    ( 
      &match=1
    )
  )
  else if ("throttle_video_cxo_clk"=="&clk")
  (
    &match=1
  )
  
  if (&match==1)
  (
    &clk_test=&CLK_TEST_THROTTLE_VIDEO_CXO_CLK
    &clk_reg=&HWIO_MMSS_THROTTLE_VIDEO_CXO_CBCR_ADDR
    &clk_reg_name="MMSS_THROTTLE_VIDEO_CXO_CBCR"
    &clk_name="throttle_video_cxo_clk"
    &clk_reg_cbcr_type="sm_cbc"
    &clk_vote_bit=-1.
    &clk_multiplier=3.

    gosub Print_Clk_Info_Line
  )

  &match=0
  &wild_head=0
  &wild_tail=0
  &clk_input_length=STRING.LENGTH("&clk")
  &clk_itr_length=STRING.LENGTH("mmpll0_dtest")

  if (STRING.SCAN("&clk", "*", 0)==0)
  (
    &wild_head=1
  )
  if (STRING.SCAN("&clk", "*", 1)==(STRING.LENGTH("&clk")-1))
  (
    &wild_tail=1
  )

  if ((&wild_head==1)&&(&wild_tail==1))
  (
    if (STRING.SCAN("mmpll0_dtest", STRING.MID("&clk", 1, &clk_input_length-2), 0)!=-1)
    ( 
      &match=1
    )
  )
  else if (&wild_head==1)
  (
    if (STRING.MID("mmpll0_dtest", &clk_itr_length-&clk_input_length+1, &clk_input_length-1)==STRING.CUT("&clk", 1))
    ( 
      &match=1
    )
  )
  else if (&wild_tail==1)
  (
    if (STRING.MID("mmpll0_dtest", 0, &clk_input_length-1)==STRING.CUT("&clk", -1))
    ( 
      &match=1
    )
  )
  else if ("mmpll0_dtest"=="&clk")
  (
    &match=1
  )
  
  if (&match==1)
  (
    &clk_test=&CLK_TEST_MMPLL0_DTEST
    &clk_reg=0
    &clk_reg_name="No CBCR"
    &clk_name="mmpll0_dtest"
    &clk_reg_cbcr_type=""
    &clk_vote_bit=-1.
    &clk_multiplier=3.

    gosub Print_Clk_Info_Line
  )

  &match=0
  &wild_head=0
  &wild_tail=0
  &clk_input_length=STRING.LENGTH("&clk")
  &clk_itr_length=STRING.LENGTH("mmpll0_enable_status")

  if (STRING.SCAN("&clk", "*", 0)==0)
  (
    &wild_head=1
  )
  if (STRING.SCAN("&clk", "*", 1)==(STRING.LENGTH("&clk")-1))
  (
    &wild_tail=1
  )

  if ((&wild_head==1)&&(&wild_tail==1))
  (
    if (STRING.SCAN("mmpll0_enable_status", STRING.MID("&clk", 1, &clk_input_length-2), 0)!=-1)
    ( 
      &match=1
    )
  )
  else if (&wild_head==1)
  (
    if (STRING.MID("mmpll0_enable_status", &clk_itr_length-&clk_input_length+1, &clk_input_length-1)==STRING.CUT("&clk", 1))
    ( 
      &match=1
    )
  )
  else if (&wild_tail==1)
  (
    if (STRING.MID("mmpll0_enable_status", 0, &clk_input_length-1)==STRING.CUT("&clk", -1))
    ( 
      &match=1
    )
  )
  else if ("mmpll0_enable_status"=="&clk")
  (
    &match=1
  )
  
  if (&match==1)
  (
    &clk_test=&CLK_TEST_MMPLL0_ENABLE_STATUS
    &clk_reg=0
    &clk_reg_name="No CBCR"
    &clk_name="mmpll0_enable_status"
    &clk_reg_cbcr_type=""
    &clk_vote_bit=-1.
    &clk_multiplier=3.

    gosub Print_Clk_Info_Line
  )

  &match=0
  &wild_head=0
  &wild_tail=0
  &clk_input_length=STRING.LENGTH("&clk")
  &clk_itr_length=STRING.LENGTH("mmpll0_lock_det")

  if (STRING.SCAN("&clk", "*", 0)==0)
  (
    &wild_head=1
  )
  if (STRING.SCAN("&clk", "*", 1)==(STRING.LENGTH("&clk")-1))
  (
    &wild_tail=1
  )

  if ((&wild_head==1)&&(&wild_tail==1))
  (
    if (STRING.SCAN("mmpll0_lock_det", STRING.MID("&clk", 1, &clk_input_length-2), 0)!=-1)
    ( 
      &match=1
    )
  )
  else if (&wild_head==1)
  (
    if (STRING.MID("mmpll0_lock_det", &clk_itr_length-&clk_input_length+1, &clk_input_length-1)==STRING.CUT("&clk", 1))
    ( 
      &match=1
    )
  )
  else if (&wild_tail==1)
  (
    if (STRING.MID("mmpll0_lock_det", 0, &clk_input_length-1)==STRING.CUT("&clk", -1))
    ( 
      &match=1
    )
  )
  else if ("mmpll0_lock_det"=="&clk")
  (
    &match=1
  )
  
  if (&match==1)
  (
    &clk_test=&CLK_TEST_MMPLL0_LOCK_DET
    &clk_reg=0
    &clk_reg_name="No CBCR"
    &clk_name="mmpll0_lock_det"
    &clk_reg_cbcr_type=""
    &clk_vote_bit=-1.
    &clk_multiplier=3.

    gosub Print_Clk_Info_Line
  )

  &match=0
  &wild_head=0
  &wild_tail=0
  &clk_input_length=STRING.LENGTH("&clk")
  &clk_itr_length=STRING.LENGTH("mmpll1_dtest")

  if (STRING.SCAN("&clk", "*", 0)==0)
  (
    &wild_head=1
  )
  if (STRING.SCAN("&clk", "*", 1)==(STRING.LENGTH("&clk")-1))
  (
    &wild_tail=1
  )

  if ((&wild_head==1)&&(&wild_tail==1))
  (
    if (STRING.SCAN("mmpll1_dtest", STRING.MID("&clk", 1, &clk_input_length-2), 0)!=-1)
    ( 
      &match=1
    )
  )
  else if (&wild_head==1)
  (
    if (STRING.MID("mmpll1_dtest", &clk_itr_length-&clk_input_length+1, &clk_input_length-1)==STRING.CUT("&clk", 1))
    ( 
      &match=1
    )
  )
  else if (&wild_tail==1)
  (
    if (STRING.MID("mmpll1_dtest", 0, &clk_input_length-1)==STRING.CUT("&clk", -1))
    ( 
      &match=1
    )
  )
  else if ("mmpll1_dtest"=="&clk")
  (
    &match=1
  )
  
  if (&match==1)
  (
    &clk_test=&CLK_TEST_MMPLL1_DTEST
    &clk_reg=0
    &clk_reg_name="No CBCR"
    &clk_name="mmpll1_dtest"
    &clk_reg_cbcr_type=""
    &clk_vote_bit=-1.
    &clk_multiplier=3.

    gosub Print_Clk_Info_Line
  )

  &match=0
  &wild_head=0
  &wild_tail=0
  &clk_input_length=STRING.LENGTH("&clk")
  &clk_itr_length=STRING.LENGTH("mmpll1_enable_status")

  if (STRING.SCAN("&clk", "*", 0)==0)
  (
    &wild_head=1
  )
  if (STRING.SCAN("&clk", "*", 1)==(STRING.LENGTH("&clk")-1))
  (
    &wild_tail=1
  )

  if ((&wild_head==1)&&(&wild_tail==1))
  (
    if (STRING.SCAN("mmpll1_enable_status", STRING.MID("&clk", 1, &clk_input_length-2), 0)!=-1)
    ( 
      &match=1
    )
  )
  else if (&wild_head==1)
  (
    if (STRING.MID("mmpll1_enable_status", &clk_itr_length-&clk_input_length+1, &clk_input_length-1)==STRING.CUT("&clk", 1))
    ( 
      &match=1
    )
  )
  else if (&wild_tail==1)
  (
    if (STRING.MID("mmpll1_enable_status", 0, &clk_input_length-1)==STRING.CUT("&clk", -1))
    ( 
      &match=1
    )
  )
  else if ("mmpll1_enable_status"=="&clk")
  (
    &match=1
  )
  
  if (&match==1)
  (
    &clk_test=&CLK_TEST_MMPLL1_ENABLE_STATUS
    &clk_reg=0
    &clk_reg_name="No CBCR"
    &clk_name="mmpll1_enable_status"
    &clk_reg_cbcr_type=""
    &clk_vote_bit=-1.
    &clk_multiplier=3.

    gosub Print_Clk_Info_Line
  )

  &match=0
  &wild_head=0
  &wild_tail=0
  &clk_input_length=STRING.LENGTH("&clk")
  &clk_itr_length=STRING.LENGTH("mmpll1_lock_det")

  if (STRING.SCAN("&clk", "*", 0)==0)
  (
    &wild_head=1
  )
  if (STRING.SCAN("&clk", "*", 1)==(STRING.LENGTH("&clk")-1))
  (
    &wild_tail=1
  )

  if ((&wild_head==1)&&(&wild_tail==1))
  (
    if (STRING.SCAN("mmpll1_lock_det", STRING.MID("&clk", 1, &clk_input_length-2), 0)!=-1)
    ( 
      &match=1
    )
  )
  else if (&wild_head==1)
  (
    if (STRING.MID("mmpll1_lock_det", &clk_itr_length-&clk_input_length+1, &clk_input_length-1)==STRING.CUT("&clk", 1))
    ( 
      &match=1
    )
  )
  else if (&wild_tail==1)
  (
    if (STRING.MID("mmpll1_lock_det", 0, &clk_input_length-1)==STRING.CUT("&clk", -1))
    ( 
      &match=1
    )
  )
  else if ("mmpll1_lock_det"=="&clk")
  (
    &match=1
  )
  
  if (&match==1)
  (
    &clk_test=&CLK_TEST_MMPLL1_LOCK_DET
    &clk_reg=0
    &clk_reg_name="No CBCR"
    &clk_name="mmpll1_lock_det"
    &clk_reg_cbcr_type=""
    &clk_vote_bit=-1.
    &clk_multiplier=3.

    gosub Print_Clk_Info_Line
  )

  &match=0
  &wild_head=0
  &wild_tail=0
  &clk_input_length=STRING.LENGTH("&clk")
  &clk_itr_length=STRING.LENGTH("mmpll2_dtest")

  if (STRING.SCAN("&clk", "*", 0)==0)
  (
    &wild_head=1
  )
  if (STRING.SCAN("&clk", "*", 1)==(STRING.LENGTH("&clk")-1))
  (
    &wild_tail=1
  )

  if ((&wild_head==1)&&(&wild_tail==1))
  (
    if (STRING.SCAN("mmpll2_dtest", STRING.MID("&clk", 1, &clk_input_length-2), 0)!=-1)
    ( 
      &match=1
    )
  )
  else if (&wild_head==1)
  (
    if (STRING.MID("mmpll2_dtest", &clk_itr_length-&clk_input_length+1, &clk_input_length-1)==STRING.CUT("&clk", 1))
    ( 
      &match=1
    )
  )
  else if (&wild_tail==1)
  (
    if (STRING.MID("mmpll2_dtest", 0, &clk_input_length-1)==STRING.CUT("&clk", -1))
    ( 
      &match=1
    )
  )
  else if ("mmpll2_dtest"=="&clk")
  (
    &match=1
  )
  
  if (&match==1)
  (
    &clk_test=&CLK_TEST_MMPLL2_DTEST
    &clk_reg=0
    &clk_reg_name="No CBCR"
    &clk_name="mmpll2_dtest"
    &clk_reg_cbcr_type=""
    &clk_vote_bit=-1.
    &clk_multiplier=3.

    gosub Print_Clk_Info_Line
  )

  &match=0
  &wild_head=0
  &wild_tail=0
  &clk_input_length=STRING.LENGTH("&clk")
  &clk_itr_length=STRING.LENGTH("mmpll2_enable_status")

  if (STRING.SCAN("&clk", "*", 0)==0)
  (
    &wild_head=1
  )
  if (STRING.SCAN("&clk", "*", 1)==(STRING.LENGTH("&clk")-1))
  (
    &wild_tail=1
  )

  if ((&wild_head==1)&&(&wild_tail==1))
  (
    if (STRING.SCAN("mmpll2_enable_status", STRING.MID("&clk", 1, &clk_input_length-2), 0)!=-1)
    ( 
      &match=1
    )
  )
  else if (&wild_head==1)
  (
    if (STRING.MID("mmpll2_enable_status", &clk_itr_length-&clk_input_length+1, &clk_input_length-1)==STRING.CUT("&clk", 1))
    ( 
      &match=1
    )
  )
  else if (&wild_tail==1)
  (
    if (STRING.MID("mmpll2_enable_status", 0, &clk_input_length-1)==STRING.CUT("&clk", -1))
    ( 
      &match=1
    )
  )
  else if ("mmpll2_enable_status"=="&clk")
  (
    &match=1
  )
  
  if (&match==1)
  (
    &clk_test=&CLK_TEST_MMPLL2_ENABLE_STATUS
    &clk_reg=0
    &clk_reg_name="No CBCR"
    &clk_name="mmpll2_enable_status"
    &clk_reg_cbcr_type=""
    &clk_vote_bit=-1.
    &clk_multiplier=3.

    gosub Print_Clk_Info_Line
  )

  &match=0
  &wild_head=0
  &wild_tail=0
  &clk_input_length=STRING.LENGTH("&clk")
  &clk_itr_length=STRING.LENGTH("mmpll2_lock_det")

  if (STRING.SCAN("&clk", "*", 0)==0)
  (
    &wild_head=1
  )
  if (STRING.SCAN("&clk", "*", 1)==(STRING.LENGTH("&clk")-1))
  (
    &wild_tail=1
  )

  if ((&wild_head==1)&&(&wild_tail==1))
  (
    if (STRING.SCAN("mmpll2_lock_det", STRING.MID("&clk", 1, &clk_input_length-2), 0)!=-1)
    ( 
      &match=1
    )
  )
  else if (&wild_head==1)
  (
    if (STRING.MID("mmpll2_lock_det", &clk_itr_length-&clk_input_length+1, &clk_input_length-1)==STRING.CUT("&clk", 1))
    ( 
      &match=1
    )
  )
  else if (&wild_tail==1)
  (
    if (STRING.MID("mmpll2_lock_det", 0, &clk_input_length-1)==STRING.CUT("&clk", -1))
    ( 
      &match=1
    )
  )
  else if ("mmpll2_lock_det"=="&clk")
  (
    &match=1
  )
  
  if (&match==1)
  (
    &clk_test=&CLK_TEST_MMPLL2_LOCK_DET
    &clk_reg=0
    &clk_reg_name="No CBCR"
    &clk_name="mmpll2_lock_det"
    &clk_reg_cbcr_type=""
    &clk_vote_bit=-1.
    &clk_multiplier=3.

    gosub Print_Clk_Info_Line
  )

  &match=0
  &wild_head=0
  &wild_tail=0
  &clk_input_length=STRING.LENGTH("&clk")
  &clk_itr_length=STRING.LENGTH("mmpll3_dtest")

  if (STRING.SCAN("&clk", "*", 0)==0)
  (
    &wild_head=1
  )
  if (STRING.SCAN("&clk", "*", 1)==(STRING.LENGTH("&clk")-1))
  (
    &wild_tail=1
  )

  if ((&wild_head==1)&&(&wild_tail==1))
  (
    if (STRING.SCAN("mmpll3_dtest", STRING.MID("&clk", 1, &clk_input_length-2), 0)!=-1)
    ( 
      &match=1
    )
  )
  else if (&wild_head==1)
  (
    if (STRING.MID("mmpll3_dtest", &clk_itr_length-&clk_input_length+1, &clk_input_length-1)==STRING.CUT("&clk", 1))
    ( 
      &match=1
    )
  )
  else if (&wild_tail==1)
  (
    if (STRING.MID("mmpll3_dtest", 0, &clk_input_length-1)==STRING.CUT("&clk", -1))
    ( 
      &match=1
    )
  )
  else if ("mmpll3_dtest"=="&clk")
  (
    &match=1
  )
  
  if (&match==1)
  (
    &clk_test=&CLK_TEST_MMPLL3_DTEST
    &clk_reg=0
    &clk_reg_name="No CBCR"
    &clk_name="mmpll3_dtest"
    &clk_reg_cbcr_type=""
    &clk_vote_bit=-1.
    &clk_multiplier=3.

    gosub Print_Clk_Info_Line
  )

  &match=0
  &wild_head=0
  &wild_tail=0
  &clk_input_length=STRING.LENGTH("&clk")
  &clk_itr_length=STRING.LENGTH("mmpll3_enable_status")

  if (STRING.SCAN("&clk", "*", 0)==0)
  (
    &wild_head=1
  )
  if (STRING.SCAN("&clk", "*", 1)==(STRING.LENGTH("&clk")-1))
  (
    &wild_tail=1
  )

  if ((&wild_head==1)&&(&wild_tail==1))
  (
    if (STRING.SCAN("mmpll3_enable_status", STRING.MID("&clk", 1, &clk_input_length-2), 0)!=-1)
    ( 
      &match=1
    )
  )
  else if (&wild_head==1)
  (
    if (STRING.MID("mmpll3_enable_status", &clk_itr_length-&clk_input_length+1, &clk_input_length-1)==STRING.CUT("&clk", 1))
    ( 
      &match=1
    )
  )
  else if (&wild_tail==1)
  (
    if (STRING.MID("mmpll3_enable_status", 0, &clk_input_length-1)==STRING.CUT("&clk", -1))
    ( 
      &match=1
    )
  )
  else if ("mmpll3_enable_status"=="&clk")
  (
    &match=1
  )
  
  if (&match==1)
  (
    &clk_test=&CLK_TEST_MMPLL3_ENABLE_STATUS
    &clk_reg=0
    &clk_reg_name="No CBCR"
    &clk_name="mmpll3_enable_status"
    &clk_reg_cbcr_type=""
    &clk_vote_bit=-1.
    &clk_multiplier=3.

    gosub Print_Clk_Info_Line
  )

  &match=0
  &wild_head=0
  &wild_tail=0
  &clk_input_length=STRING.LENGTH("&clk")
  &clk_itr_length=STRING.LENGTH("mmpll3_lock_det")

  if (STRING.SCAN("&clk", "*", 0)==0)
  (
    &wild_head=1
  )
  if (STRING.SCAN("&clk", "*", 1)==(STRING.LENGTH("&clk")-1))
  (
    &wild_tail=1
  )

  if ((&wild_head==1)&&(&wild_tail==1))
  (
    if (STRING.SCAN("mmpll3_lock_det", STRING.MID("&clk", 1, &clk_input_length-2), 0)!=-1)
    ( 
      &match=1
    )
  )
  else if (&wild_head==1)
  (
    if (STRING.MID("mmpll3_lock_det", &clk_itr_length-&clk_input_length+1, &clk_input_length-1)==STRING.CUT("&clk", 1))
    ( 
      &match=1
    )
  )
  else if (&wild_tail==1)
  (
    if (STRING.MID("mmpll3_lock_det", 0, &clk_input_length-1)==STRING.CUT("&clk", -1))
    ( 
      &match=1
    )
  )
  else if ("mmpll3_lock_det"=="&clk")
  (
    &match=1
  )
  
  if (&match==1)
  (
    &clk_test=&CLK_TEST_MMPLL3_LOCK_DET
    &clk_reg=0
    &clk_reg_name="No CBCR"
    &clk_name="mmpll3_lock_det"
    &clk_reg_cbcr_type=""
    &clk_vote_bit=-1.
    &clk_multiplier=3.

    gosub Print_Clk_Info_Line
  )

  &match=0
  &wild_head=0
  &wild_tail=0
  &clk_input_length=STRING.LENGTH("&clk")
  &clk_itr_length=STRING.LENGTH("mmpll4_dtest")

  if (STRING.SCAN("&clk", "*", 0)==0)
  (
    &wild_head=1
  )
  if (STRING.SCAN("&clk", "*", 1)==(STRING.LENGTH("&clk")-1))
  (
    &wild_tail=1
  )

  if ((&wild_head==1)&&(&wild_tail==1))
  (
    if (STRING.SCAN("mmpll4_dtest", STRING.MID("&clk", 1, &clk_input_length-2), 0)!=-1)
    ( 
      &match=1
    )
  )
  else if (&wild_head==1)
  (
    if (STRING.MID("mmpll4_dtest", &clk_itr_length-&clk_input_length+1, &clk_input_length-1)==STRING.CUT("&clk", 1))
    ( 
      &match=1
    )
  )
  else if (&wild_tail==1)
  (
    if (STRING.MID("mmpll4_dtest", 0, &clk_input_length-1)==STRING.CUT("&clk", -1))
    ( 
      &match=1
    )
  )
  else if ("mmpll4_dtest"=="&clk")
  (
    &match=1
  )
  
  if (&match==1)
  (
    &clk_test=&CLK_TEST_MMPLL4_DTEST
    &clk_reg=0
    &clk_reg_name="No CBCR"
    &clk_name="mmpll4_dtest"
    &clk_reg_cbcr_type=""
    &clk_vote_bit=-1.
    &clk_multiplier=3.

    gosub Print_Clk_Info_Line
  )

  &match=0
  &wild_head=0
  &wild_tail=0
  &clk_input_length=STRING.LENGTH("&clk")
  &clk_itr_length=STRING.LENGTH("mmpll4_enable_status")

  if (STRING.SCAN("&clk", "*", 0)==0)
  (
    &wild_head=1
  )
  if (STRING.SCAN("&clk", "*", 1)==(STRING.LENGTH("&clk")-1))
  (
    &wild_tail=1
  )

  if ((&wild_head==1)&&(&wild_tail==1))
  (
    if (STRING.SCAN("mmpll4_enable_status", STRING.MID("&clk", 1, &clk_input_length-2), 0)!=-1)
    ( 
      &match=1
    )
  )
  else if (&wild_head==1)
  (
    if (STRING.MID("mmpll4_enable_status", &clk_itr_length-&clk_input_length+1, &clk_input_length-1)==STRING.CUT("&clk", 1))
    ( 
      &match=1
    )
  )
  else if (&wild_tail==1)
  (
    if (STRING.MID("mmpll4_enable_status", 0, &clk_input_length-1)==STRING.CUT("&clk", -1))
    ( 
      &match=1
    )
  )
  else if ("mmpll4_enable_status"=="&clk")
  (
    &match=1
  )
  
  if (&match==1)
  (
    &clk_test=&CLK_TEST_MMPLL4_ENABLE_STATUS
    &clk_reg=0
    &clk_reg_name="No CBCR"
    &clk_name="mmpll4_enable_status"
    &clk_reg_cbcr_type=""
    &clk_vote_bit=-1.
    &clk_multiplier=3.

    gosub Print_Clk_Info_Line
  )

  &match=0
  &wild_head=0
  &wild_tail=0
  &clk_input_length=STRING.LENGTH("&clk")
  &clk_itr_length=STRING.LENGTH("mmpll4_lock_det")

  if (STRING.SCAN("&clk", "*", 0)==0)
  (
    &wild_head=1
  )
  if (STRING.SCAN("&clk", "*", 1)==(STRING.LENGTH("&clk")-1))
  (
    &wild_tail=1
  )

  if ((&wild_head==1)&&(&wild_tail==1))
  (
    if (STRING.SCAN("mmpll4_lock_det", STRING.MID("&clk", 1, &clk_input_length-2), 0)!=-1)
    ( 
      &match=1
    )
  )
  else if (&wild_head==1)
  (
    if (STRING.MID("mmpll4_lock_det", &clk_itr_length-&clk_input_length+1, &clk_input_length-1)==STRING.CUT("&clk", 1))
    ( 
      &match=1
    )
  )
  else if (&wild_tail==1)
  (
    if (STRING.MID("mmpll4_lock_det", 0, &clk_input_length-1)==STRING.CUT("&clk", -1))
    ( 
      &match=1
    )
  )
  else if ("mmpll4_lock_det"=="&clk")
  (
    &match=1
  )
  
  if (&match==1)
  (
    &clk_test=&CLK_TEST_MMPLL4_LOCK_DET
    &clk_reg=0
    &clk_reg_name="No CBCR"
    &clk_name="mmpll4_lock_det"
    &clk_reg_cbcr_type=""
    &clk_vote_bit=-1.
    &clk_multiplier=3.

    gosub Print_Clk_Info_Line
  )

  &match=0
  &wild_head=0
  &wild_tail=0
  &clk_input_length=STRING.LENGTH("&clk")
  &clk_itr_length=STRING.LENGTH("mmpll5_dtest")

  if (STRING.SCAN("&clk", "*", 0)==0)
  (
    &wild_head=1
  )
  if (STRING.SCAN("&clk", "*", 1)==(STRING.LENGTH("&clk")-1))
  (
    &wild_tail=1
  )

  if ((&wild_head==1)&&(&wild_tail==1))
  (
    if (STRING.SCAN("mmpll5_dtest", STRING.MID("&clk", 1, &clk_input_length-2), 0)!=-1)
    ( 
      &match=1
    )
  )
  else if (&wild_head==1)
  (
    if (STRING.MID("mmpll5_dtest", &clk_itr_length-&clk_input_length+1, &clk_input_length-1)==STRING.CUT("&clk", 1))
    ( 
      &match=1
    )
  )
  else if (&wild_tail==1)
  (
    if (STRING.MID("mmpll5_dtest", 0, &clk_input_length-1)==STRING.CUT("&clk", -1))
    ( 
      &match=1
    )
  )
  else if ("mmpll5_dtest"=="&clk")
  (
    &match=1
  )
  
  if (&match==1)
  (
    &clk_test=&CLK_TEST_MMPLL5_DTEST
    &clk_reg=0
    &clk_reg_name="No CBCR"
    &clk_name="mmpll5_dtest"
    &clk_reg_cbcr_type=""
    &clk_vote_bit=-1.
    &clk_multiplier=3.

    gosub Print_Clk_Info_Line
  )

  &match=0
  &wild_head=0
  &wild_tail=0
  &clk_input_length=STRING.LENGTH("&clk")
  &clk_itr_length=STRING.LENGTH("mmpll5_enable_status")

  if (STRING.SCAN("&clk", "*", 0)==0)
  (
    &wild_head=1
  )
  if (STRING.SCAN("&clk", "*", 1)==(STRING.LENGTH("&clk")-1))
  (
    &wild_tail=1
  )

  if ((&wild_head==1)&&(&wild_tail==1))
  (
    if (STRING.SCAN("mmpll5_enable_status", STRING.MID("&clk", 1, &clk_input_length-2), 0)!=-1)
    ( 
      &match=1
    )
  )
  else if (&wild_head==1)
  (
    if (STRING.MID("mmpll5_enable_status", &clk_itr_length-&clk_input_length+1, &clk_input_length-1)==STRING.CUT("&clk", 1))
    ( 
      &match=1
    )
  )
  else if (&wild_tail==1)
  (
    if (STRING.MID("mmpll5_enable_status", 0, &clk_input_length-1)==STRING.CUT("&clk", -1))
    ( 
      &match=1
    )
  )
  else if ("mmpll5_enable_status"=="&clk")
  (
    &match=1
  )
  
  if (&match==1)
  (
    &clk_test=&CLK_TEST_MMPLL5_ENABLE_STATUS
    &clk_reg=0
    &clk_reg_name="No CBCR"
    &clk_name="mmpll5_enable_status"
    &clk_reg_cbcr_type=""
    &clk_vote_bit=-1.
    &clk_multiplier=3.

    gosub Print_Clk_Info_Line
  )

  &match=0
  &wild_head=0
  &wild_tail=0
  &clk_input_length=STRING.LENGTH("&clk")
  &clk_itr_length=STRING.LENGTH("mmpll5_lock_det")

  if (STRING.SCAN("&clk", "*", 0)==0)
  (
    &wild_head=1
  )
  if (STRING.SCAN("&clk", "*", 1)==(STRING.LENGTH("&clk")-1))
  (
    &wild_tail=1
  )

  if ((&wild_head==1)&&(&wild_tail==1))
  (
    if (STRING.SCAN("mmpll5_lock_det", STRING.MID("&clk", 1, &clk_input_length-2), 0)!=-1)
    ( 
      &match=1
    )
  )
  else if (&wild_head==1)
  (
    if (STRING.MID("mmpll5_lock_det", &clk_itr_length-&clk_input_length+1, &clk_input_length-1)==STRING.CUT("&clk", 1))
    ( 
      &match=1
    )
  )
  else if (&wild_tail==1)
  (
    if (STRING.MID("mmpll5_lock_det", 0, &clk_input_length-1)==STRING.CUT("&clk", -1))
    ( 
      &match=1
    )
  )
  else if ("mmpll5_lock_det"=="&clk")
  (
    &match=1
  )
  
  if (&match==1)
  (
    &clk_test=&CLK_TEST_MMPLL5_LOCK_DET
    &clk_reg=0
    &clk_reg_name="No CBCR"
    &clk_name="mmpll5_lock_det"
    &clk_reg_cbcr_type=""
    &clk_vote_bit=-1.
    &clk_multiplier=3.

    gosub Print_Clk_Info_Line
  )

  &match=0
  &wild_head=0
  &wild_tail=0
  &clk_input_length=STRING.LENGTH("&clk")
  &clk_itr_length=STRING.LENGTH("mmpll8_dtest")

  if (STRING.SCAN("&clk", "*", 0)==0)
  (
    &wild_head=1
  )
  if (STRING.SCAN("&clk", "*", 1)==(STRING.LENGTH("&clk")-1))
  (
    &wild_tail=1
  )

  if ((&wild_head==1)&&(&wild_tail==1))
  (
    if (STRING.SCAN("mmpll8_dtest", STRING.MID("&clk", 1, &clk_input_length-2), 0)!=-1)
    ( 
      &match=1
    )
  )
  else if (&wild_head==1)
  (
    if (STRING.MID("mmpll8_dtest", &clk_itr_length-&clk_input_length+1, &clk_input_length-1)==STRING.CUT("&clk", 1))
    ( 
      &match=1
    )
  )
  else if (&wild_tail==1)
  (
    if (STRING.MID("mmpll8_dtest", 0, &clk_input_length-1)==STRING.CUT("&clk", -1))
    ( 
      &match=1
    )
  )
  else if ("mmpll8_dtest"=="&clk")
  (
    &match=1
  )
  
  if (&match==1)
  (
    &clk_test=&CLK_TEST_MMPLL8_DTEST
    &clk_reg=0
    &clk_reg_name="No CBCR"
    &clk_name="mmpll8_dtest"
    &clk_reg_cbcr_type=""
    &clk_vote_bit=-1.
    &clk_multiplier=3.

    gosub Print_Clk_Info_Line
  )

  &match=0
  &wild_head=0
  &wild_tail=0
  &clk_input_length=STRING.LENGTH("&clk")
  &clk_itr_length=STRING.LENGTH("mmpll8_enable_status")

  if (STRING.SCAN("&clk", "*", 0)==0)
  (
    &wild_head=1
  )
  if (STRING.SCAN("&clk", "*", 1)==(STRING.LENGTH("&clk")-1))
  (
    &wild_tail=1
  )

  if ((&wild_head==1)&&(&wild_tail==1))
  (
    if (STRING.SCAN("mmpll8_enable_status", STRING.MID("&clk", 1, &clk_input_length-2), 0)!=-1)
    ( 
      &match=1
    )
  )
  else if (&wild_head==1)
  (
    if (STRING.MID("mmpll8_enable_status", &clk_itr_length-&clk_input_length+1, &clk_input_length-1)==STRING.CUT("&clk", 1))
    ( 
      &match=1
    )
  )
  else if (&wild_tail==1)
  (
    if (STRING.MID("mmpll8_enable_status", 0, &clk_input_length-1)==STRING.CUT("&clk", -1))
    ( 
      &match=1
    )
  )
  else if ("mmpll8_enable_status"=="&clk")
  (
    &match=1
  )
  
  if (&match==1)
  (
    &clk_test=&CLK_TEST_MMPLL8_ENABLE_STATUS
    &clk_reg=0
    &clk_reg_name="No CBCR"
    &clk_name="mmpll8_enable_status"
    &clk_reg_cbcr_type=""
    &clk_vote_bit=-1.
    &clk_multiplier=3.

    gosub Print_Clk_Info_Line
  )

  &match=0
  &wild_head=0
  &wild_tail=0
  &clk_input_length=STRING.LENGTH("&clk")
  &clk_itr_length=STRING.LENGTH("mmpll8_lock_det")

  if (STRING.SCAN("&clk", "*", 0)==0)
  (
    &wild_head=1
  )
  if (STRING.SCAN("&clk", "*", 1)==(STRING.LENGTH("&clk")-1))
  (
    &wild_tail=1
  )

  if ((&wild_head==1)&&(&wild_tail==1))
  (
    if (STRING.SCAN("mmpll8_lock_det", STRING.MID("&clk", 1, &clk_input_length-2), 0)!=-1)
    ( 
      &match=1
    )
  )
  else if (&wild_head==1)
  (
    if (STRING.MID("mmpll8_lock_det", &clk_itr_length-&clk_input_length+1, &clk_input_length-1)==STRING.CUT("&clk", 1))
    ( 
      &match=1
    )
  )
  else if (&wild_tail==1)
  (
    if (STRING.MID("mmpll8_lock_det", 0, &clk_input_length-1)==STRING.CUT("&clk", -1))
    ( 
      &match=1
    )
  )
  else if ("mmpll8_lock_det"=="&clk")
  (
    &match=1
  )
  
  if (&match==1)
  (
    &clk_test=&CLK_TEST_MMPLL8_LOCK_DET
    &clk_reg=0
    &clk_reg_name="No CBCR"
    &clk_name="mmpll8_lock_det"
    &clk_reg_cbcr_type=""
    &clk_vote_bit=-1.
    &clk_multiplier=3.

    gosub Print_Clk_Info_Line
  )

  &match=0
  &wild_head=0
  &wild_tail=0
  &clk_input_length=STRING.LENGTH("&clk")
  &clk_itr_length=STRING.LENGTH("mmpll9_dtest")

  if (STRING.SCAN("&clk", "*", 0)==0)
  (
    &wild_head=1
  )
  if (STRING.SCAN("&clk", "*", 1)==(STRING.LENGTH("&clk")-1))
  (
    &wild_tail=1
  )

  if ((&wild_head==1)&&(&wild_tail==1))
  (
    if (STRING.SCAN("mmpll9_dtest", STRING.MID("&clk", 1, &clk_input_length-2), 0)!=-1)
    ( 
      &match=1
    )
  )
  else if (&wild_head==1)
  (
    if (STRING.MID("mmpll9_dtest", &clk_itr_length-&clk_input_length+1, &clk_input_length-1)==STRING.CUT("&clk", 1))
    ( 
      &match=1
    )
  )
  else if (&wild_tail==1)
  (
    if (STRING.MID("mmpll9_dtest", 0, &clk_input_length-1)==STRING.CUT("&clk", -1))
    ( 
      &match=1
    )
  )
  else if ("mmpll9_dtest"=="&clk")
  (
    &match=1
  )
  
  if (&match==1)
  (
    &clk_test=&CLK_TEST_MMPLL9_DTEST
    &clk_reg=0
    &clk_reg_name="No CBCR"
    &clk_name="mmpll9_dtest"
    &clk_reg_cbcr_type=""
    &clk_vote_bit=-1.
    &clk_multiplier=3.

    gosub Print_Clk_Info_Line
  )

  &match=0
  &wild_head=0
  &wild_tail=0
  &clk_input_length=STRING.LENGTH("&clk")
  &clk_itr_length=STRING.LENGTH("mmpll9_enable_status")

  if (STRING.SCAN("&clk", "*", 0)==0)
  (
    &wild_head=1
  )
  if (STRING.SCAN("&clk", "*", 1)==(STRING.LENGTH("&clk")-1))
  (
    &wild_tail=1
  )

  if ((&wild_head==1)&&(&wild_tail==1))
  (
    if (STRING.SCAN("mmpll9_enable_status", STRING.MID("&clk", 1, &clk_input_length-2), 0)!=-1)
    ( 
      &match=1
    )
  )
  else if (&wild_head==1)
  (
    if (STRING.MID("mmpll9_enable_status", &clk_itr_length-&clk_input_length+1, &clk_input_length-1)==STRING.CUT("&clk", 1))
    ( 
      &match=1
    )
  )
  else if (&wild_tail==1)
  (
    if (STRING.MID("mmpll9_enable_status", 0, &clk_input_length-1)==STRING.CUT("&clk", -1))
    ( 
      &match=1
    )
  )
  else if ("mmpll9_enable_status"=="&clk")
  (
    &match=1
  )
  
  if (&match==1)
  (
    &clk_test=&CLK_TEST_MMPLL9_ENABLE_STATUS
    &clk_reg=0
    &clk_reg_name="No CBCR"
    &clk_name="mmpll9_enable_status"
    &clk_reg_cbcr_type=""
    &clk_vote_bit=-1.
    &clk_multiplier=3.

    gosub Print_Clk_Info_Line
  )

  &match=0
  &wild_head=0
  &wild_tail=0
  &clk_input_length=STRING.LENGTH("&clk")
  &clk_itr_length=STRING.LENGTH("mmpll9_lock_det")

  if (STRING.SCAN("&clk", "*", 0)==0)
  (
    &wild_head=1
  )
  if (STRING.SCAN("&clk", "*", 1)==(STRING.LENGTH("&clk")-1))
  (
    &wild_tail=1
  )

  if ((&wild_head==1)&&(&wild_tail==1))
  (
    if (STRING.SCAN("mmpll9_lock_det", STRING.MID("&clk", 1, &clk_input_length-2), 0)!=-1)
    ( 
      &match=1
    )
  )
  else if (&wild_head==1)
  (
    if (STRING.MID("mmpll9_lock_det", &clk_itr_length-&clk_input_length+1, &clk_input_length-1)==STRING.CUT("&clk", 1))
    ( 
      &match=1
    )
  )
  else if (&wild_tail==1)
  (
    if (STRING.MID("mmpll9_lock_det", 0, &clk_input_length-1)==STRING.CUT("&clk", -1))
    ( 
      &match=1
    )
  )
  else if ("mmpll9_lock_det"=="&clk")
  (
    &match=1
  )
  
  if (&match==1)
  (
    &clk_test=&CLK_TEST_MMPLL9_LOCK_DET
    &clk_reg=0
    &clk_reg_name="No CBCR"
    &clk_name="mmpll9_lock_det"
    &clk_reg_cbcr_type=""
    &clk_vote_bit=-1.
    &clk_multiplier=3.

    gosub Print_Clk_Info_Line
  )


  ; Set appropriate access mode for MSS registers 
  &clk_access_mode="&mss_access_mode"

  &match=0
  &wild_head=0
  &wild_tail=0
  &clk_input_length=STRING.LENGTH("&clk")
  &clk_itr_length=STRING.LENGTH("clk_src_bit_coxm_mnd")

  if (STRING.SCAN("&clk", "*", 0)==0)
  (
    &wild_head=1
  )
  if (STRING.SCAN("&clk", "*", 1)==(STRING.LENGTH("&clk")-1))
  (
    &wild_tail=1
  )

  if ((&wild_head==1)&&(&wild_tail==1))
  (
    if (STRING.SCAN("clk_src_bit_coxm_mnd", STRING.MID("&clk", 1, &clk_input_length-2), 0)!=-1)
    ( 
      &match=1
    )
  )
  else if (&wild_head==1)
  (
    if (STRING.MID("clk_src_bit_coxm_mnd", &clk_itr_length-&clk_input_length+1, &clk_input_length-1)==STRING.CUT("&clk", 1))
    ( 
      &match=1
    )
  )
  else if (&wild_tail==1)
  (
    if (STRING.MID("clk_src_bit_coxm_mnd", 0, &clk_input_length-1)==STRING.CUT("&clk", -1))
    ( 
      &match=1
    )
  )
  else if ("clk_src_bit_coxm_mnd"=="&clk")
  (
    &match=1
  )
  
  if (&match==1)
  (
    &clk_test=&CLK_TEST_CLK_SRC_BIT_COXM_MND
    &clk_reg=0
    &clk_reg_name="No CBCR"
    &clk_name="clk_src_bit_coxm_mnd"
    &clk_reg_cbcr_type=""
    &clk_vote_bit=-1.
    &clk_multiplier=1.

    gosub Print_Clk_Info_Line
  )

  &match=0
  &wild_head=0
  &wild_tail=0
  &clk_input_length=STRING.LENGTH("&clk")
  &clk_itr_length=STRING.LENGTH("clk_bit_coxm")

  if (STRING.SCAN("&clk", "*", 0)==0)
  (
    &wild_head=1
  )
  if (STRING.SCAN("&clk", "*", 1)==(STRING.LENGTH("&clk")-1))
  (
    &wild_tail=1
  )

  if ((&wild_head==1)&&(&wild_tail==1))
  (
    if (STRING.SCAN("clk_bit_coxm", STRING.MID("&clk", 1, &clk_input_length-2), 0)!=-1)
    ( 
      &match=1
    )
  )
  else if (&wild_head==1)
  (
    if (STRING.MID("clk_bit_coxm", &clk_itr_length-&clk_input_length+1, &clk_input_length-1)==STRING.CUT("&clk", 1))
    ( 
      &match=1
    )
  )
  else if (&wild_tail==1)
  (
    if (STRING.MID("clk_bit_coxm", 0, &clk_input_length-1)==STRING.CUT("&clk", -1))
    ( 
      &match=1
    )
  )
  else if ("clk_bit_coxm"=="&clk")
  (
    &match=1
  )
  
  if (&match==1)
  (
    &clk_test=&CLK_TEST_CLK_BIT_COXM
    &clk_reg=&HWIO_MSS_BIT_COXM_CBCR_ADDR
    &clk_reg_name="MSS_BIT_COXM_CBCR"
    &clk_name="clk_bit_coxm"
    &clk_reg_cbcr_type="sm_cbc"
    &clk_vote_bit=-1.
    &clk_multiplier=1.

    gosub Print_Clk_Info_Line
  )

  &match=0
  &wild_head=0
  &wild_tail=0
  &clk_input_length=STRING.LENGTH("&clk")
  &clk_itr_length=STRING.LENGTH("clk_src_bus_mss_config")

  if (STRING.SCAN("&clk", "*", 0)==0)
  (
    &wild_head=1
  )
  if (STRING.SCAN("&clk", "*", 1)==(STRING.LENGTH("&clk")-1))
  (
    &wild_tail=1
  )

  if ((&wild_head==1)&&(&wild_tail==1))
  (
    if (STRING.SCAN("clk_src_bus_mss_config", STRING.MID("&clk", 1, &clk_input_length-2), 0)!=-1)
    ( 
      &match=1
    )
  )
  else if (&wild_head==1)
  (
    if (STRING.MID("clk_src_bus_mss_config", &clk_itr_length-&clk_input_length+1, &clk_input_length-1)==STRING.CUT("&clk", 1))
    ( 
      &match=1
    )
  )
  else if (&wild_tail==1)
  (
    if (STRING.MID("clk_src_bus_mss_config", 0, &clk_input_length-1)==STRING.CUT("&clk", -1))
    ( 
      &match=1
    )
  )
  else if ("clk_src_bus_mss_config"=="&clk")
  (
    &match=1
  )
  
  if (&match==1)
  (
    &clk_test=&CLK_TEST_CLK_SRC_BUS_MSS_CONFIG
    &clk_reg=0
    &clk_reg_name="No CBCR"
    &clk_name="clk_src_bus_mss_config"
    &clk_reg_cbcr_type=""
    &clk_vote_bit=-1.
    &clk_multiplier=1.

    gosub Print_Clk_Info_Line
  )

  &match=0
  &wild_head=0
  &wild_tail=0
  &clk_input_length=STRING.LENGTH("&clk")
  &clk_itr_length=STRING.LENGTH("clk_bus_config")

  if (STRING.SCAN("&clk", "*", 0)==0)
  (
    &wild_head=1
  )
  if (STRING.SCAN("&clk", "*", 1)==(STRING.LENGTH("&clk")-1))
  (
    &wild_tail=1
  )

  if ((&wild_head==1)&&(&wild_tail==1))
  (
    if (STRING.SCAN("clk_bus_config", STRING.MID("&clk", 1, &clk_input_length-2), 0)!=-1)
    ( 
      &match=1
    )
  )
  else if (&wild_head==1)
  (
    if (STRING.MID("clk_bus_config", &clk_itr_length-&clk_input_length+1, &clk_input_length-1)==STRING.CUT("&clk", 1))
    ( 
      &match=1
    )
  )
  else if (&wild_tail==1)
  (
    if (STRING.MID("clk_bus_config", 0, &clk_input_length-1)==STRING.CUT("&clk", -1))
    ( 
      &match=1
    )
  )
  else if ("clk_bus_config"=="&clk")
  (
    &match=1
  )
  
  if (&match==1)
  (
    &clk_test=&CLK_TEST_CLK_BUS_CONFIG
    &clk_reg=0
    &clk_reg_name="No CBCR"
    &clk_name="clk_bus_config"
    &clk_reg_cbcr_type=""
    &clk_vote_bit=-1.
    &clk_multiplier=1.

    gosub Print_Clk_Info_Line
  )

  &match=0
  &wild_head=0
  &wild_tail=0
  &clk_input_length=STRING.LENGTH("&clk")
  &clk_itr_length=STRING.LENGTH("clk_bus_coxm")

  if (STRING.SCAN("&clk", "*", 0)==0)
  (
    &wild_head=1
  )
  if (STRING.SCAN("&clk", "*", 1)==(STRING.LENGTH("&clk")-1))
  (
    &wild_tail=1
  )

  if ((&wild_head==1)&&(&wild_tail==1))
  (
    if (STRING.SCAN("clk_bus_coxm", STRING.MID("&clk", 1, &clk_input_length-2), 0)!=-1)
    ( 
      &match=1
    )
  )
  else if (&wild_head==1)
  (
    if (STRING.MID("clk_bus_coxm", &clk_itr_length-&clk_input_length+1, &clk_input_length-1)==STRING.CUT("&clk", 1))
    ( 
      &match=1
    )
  )
  else if (&wild_tail==1)
  (
    if (STRING.MID("clk_bus_coxm", 0, &clk_input_length-1)==STRING.CUT("&clk", -1))
    ( 
      &match=1
    )
  )
  else if ("clk_bus_coxm"=="&clk")
  (
    &match=1
  )
  
  if (&match==1)
  (
    &clk_test=&CLK_TEST_CLK_BUS_COXM
    &clk_reg=&HWIO_MSS_BUS_COXM_CBCR_ADDR
    &clk_reg_name="MSS_BUS_COXM_CBCR"
    &clk_name="clk_bus_coxm"
    &clk_reg_cbcr_type="sm_cbc"
    &clk_vote_bit=-1.
    &clk_multiplier=1.

    gosub Print_Clk_Info_Line
  )

  &match=0
  &wild_head=0
  &wild_tail=0
  &clk_input_length=STRING.LENGTH("&clk")
  &clk_itr_length=STRING.LENGTH("clk_bus_crypto")

  if (STRING.SCAN("&clk", "*", 0)==0)
  (
    &wild_head=1
  )
  if (STRING.SCAN("&clk", "*", 1)==(STRING.LENGTH("&clk")-1))
  (
    &wild_tail=1
  )

  if ((&wild_head==1)&&(&wild_tail==1))
  (
    if (STRING.SCAN("clk_bus_crypto", STRING.MID("&clk", 1, &clk_input_length-2), 0)!=-1)
    ( 
      &match=1
    )
  )
  else if (&wild_head==1)
  (
    if (STRING.MID("clk_bus_crypto", &clk_itr_length-&clk_input_length+1, &clk_input_length-1)==STRING.CUT("&clk", 1))
    ( 
      &match=1
    )
  )
  else if (&wild_tail==1)
  (
    if (STRING.MID("clk_bus_crypto", 0, &clk_input_length-1)==STRING.CUT("&clk", -1))
    ( 
      &match=1
    )
  )
  else if ("clk_bus_crypto"=="&clk")
  (
    &match=1
  )
  
  if (&match==1)
  (
    &clk_test=&CLK_TEST_CLK_BUS_CRYPTO
    &clk_reg=&HWIO_MSS_BUS_CRYPTO_CBCR_ADDR
    &clk_reg_name="MSS_BUS_CRYPTO_CBCR"
    &clk_name="clk_bus_crypto"
    &clk_reg_cbcr_type="sm_cbc"
    &clk_vote_bit=-1.
    &clk_multiplier=1.

    gosub Print_Clk_Info_Line
  )

  &match=0
  &wild_head=0
  &wild_tail=0
  &clk_input_length=STRING.LENGTH("&clk")
  &clk_itr_length=STRING.LENGTH("clk_bus_mgpi")

  if (STRING.SCAN("&clk", "*", 0)==0)
  (
    &wild_head=1
  )
  if (STRING.SCAN("&clk", "*", 1)==(STRING.LENGTH("&clk")-1))
  (
    &wild_tail=1
  )

  if ((&wild_head==1)&&(&wild_tail==1))
  (
    if (STRING.SCAN("clk_bus_mgpi", STRING.MID("&clk", 1, &clk_input_length-2), 0)!=-1)
    ( 
      &match=1
    )
  )
  else if (&wild_head==1)
  (
    if (STRING.MID("clk_bus_mgpi", &clk_itr_length-&clk_input_length+1, &clk_input_length-1)==STRING.CUT("&clk", 1))
    ( 
      &match=1
    )
  )
  else if (&wild_tail==1)
  (
    if (STRING.MID("clk_bus_mgpi", 0, &clk_input_length-1)==STRING.CUT("&clk", -1))
    ( 
      &match=1
    )
  )
  else if ("clk_bus_mgpi"=="&clk")
  (
    &match=1
  )
  
  if (&match==1)
  (
    &clk_test=&CLK_TEST_CLK_BUS_MGPI
    &clk_reg=&HWIO_MSS_BUS_MGPI_CBCR_ADDR
    &clk_reg_name="MSS_BUS_MGPI_CBCR"
    &clk_name="clk_bus_mgpi"
    &clk_reg_cbcr_type="sm_cbc"
    &clk_vote_bit=-1.
    &clk_multiplier=1.

    gosub Print_Clk_Info_Line
  )

  &match=0
  &wild_head=0
  &wild_tail=0
  &clk_input_length=STRING.LENGTH("&clk")
  &clk_itr_length=STRING.LENGTH("clk_bus_mvc")

  if (STRING.SCAN("&clk", "*", 0)==0)
  (
    &wild_head=1
  )
  if (STRING.SCAN("&clk", "*", 1)==(STRING.LENGTH("&clk")-1))
  (
    &wild_tail=1
  )

  if ((&wild_head==1)&&(&wild_tail==1))
  (
    if (STRING.SCAN("clk_bus_mvc", STRING.MID("&clk", 1, &clk_input_length-2), 0)!=-1)
    ( 
      &match=1
    )
  )
  else if (&wild_head==1)
  (
    if (STRING.MID("clk_bus_mvc", &clk_itr_length-&clk_input_length+1, &clk_input_length-1)==STRING.CUT("&clk", 1))
    ( 
      &match=1
    )
  )
  else if (&wild_tail==1)
  (
    if (STRING.MID("clk_bus_mvc", 0, &clk_input_length-1)==STRING.CUT("&clk", -1))
    ( 
      &match=1
    )
  )
  else if ("clk_bus_mvc"=="&clk")
  (
    &match=1
  )
  
  if (&match==1)
  (
    &clk_test=&CLK_TEST_CLK_BUS_MVC
    &clk_reg=&HWIO_MSS_BUS_MVC_CBCR_ADDR
    &clk_reg_name="MSS_BUS_MVC_CBCR"
    &clk_name="clk_bus_mvc"
    &clk_reg_cbcr_type="sm_cbc"
    &clk_vote_bit=-1.
    &clk_multiplier=1.

    gosub Print_Clk_Info_Line
  )

  &match=0
  &wild_head=0
  &wild_tail=0
  &clk_input_length=STRING.LENGTH("&clk")
  &clk_itr_length=STRING.LENGTH("clk_bus_nav")

  if (STRING.SCAN("&clk", "*", 0)==0)
  (
    &wild_head=1
  )
  if (STRING.SCAN("&clk", "*", 1)==(STRING.LENGTH("&clk")-1))
  (
    &wild_tail=1
  )

  if ((&wild_head==1)&&(&wild_tail==1))
  (
    if (STRING.SCAN("clk_bus_nav", STRING.MID("&clk", 1, &clk_input_length-2), 0)!=-1)
    ( 
      &match=1
    )
  )
  else if (&wild_head==1)
  (
    if (STRING.MID("clk_bus_nav", &clk_itr_length-&clk_input_length+1, &clk_input_length-1)==STRING.CUT("&clk", 1))
    ( 
      &match=1
    )
  )
  else if (&wild_tail==1)
  (
    if (STRING.MID("clk_bus_nav", 0, &clk_input_length-1)==STRING.CUT("&clk", -1))
    ( 
      &match=1
    )
  )
  else if ("clk_bus_nav"=="&clk")
  (
    &match=1
  )
  
  if (&match==1)
  (
    &clk_test=&CLK_TEST_CLK_BUS_NAV
    &clk_reg=&HWIO_MSS_BUS_NAV_CBCR_ADDR
    &clk_reg_name="MSS_BUS_NAV_CBCR"
    &clk_name="clk_bus_nav"
    &clk_reg_cbcr_type="sm_cbc"
    &clk_vote_bit=-1.
    &clk_multiplier=1.

    gosub Print_Clk_Info_Line
  )

  &match=0
  &wild_head=0
  &wild_tail=0
  &clk_input_length=STRING.LENGTH("&clk")
  &clk_itr_length=STRING.LENGTH("clk_bus_pll_outctrl")

  if (STRING.SCAN("&clk", "*", 0)==0)
  (
    &wild_head=1
  )
  if (STRING.SCAN("&clk", "*", 1)==(STRING.LENGTH("&clk")-1))
  (
    &wild_tail=1
  )

  if ((&wild_head==1)&&(&wild_tail==1))
  (
    if (STRING.SCAN("clk_bus_pll_outctrl", STRING.MID("&clk", 1, &clk_input_length-2), 0)!=-1)
    ( 
      &match=1
    )
  )
  else if (&wild_head==1)
  (
    if (STRING.MID("clk_bus_pll_outctrl", &clk_itr_length-&clk_input_length+1, &clk_input_length-1)==STRING.CUT("&clk", 1))
    ( 
      &match=1
    )
  )
  else if (&wild_tail==1)
  (
    if (STRING.MID("clk_bus_pll_outctrl", 0, &clk_input_length-1)==STRING.CUT("&clk", -1))
    ( 
      &match=1
    )
  )
  else if ("clk_bus_pll_outctrl"=="&clk")
  (
    &match=1
  )
  
  if (&match==1)
  (
    &clk_test=&CLK_TEST_CLK_BUS_PLL_OUTCTRL
    &clk_reg=0
    &clk_reg_name="No CBCR"
    &clk_name="clk_bus_pll_outctrl"
    &clk_reg_cbcr_type=""
    &clk_vote_bit=-1.
    &clk_multiplier=1.

    gosub Print_Clk_Info_Line
  )

  &match=0
  &wild_head=0
  &wild_tail=0
  &clk_input_length=STRING.LENGTH("&clk")
  &clk_itr_length=STRING.LENGTH("clk_bus_q6")

  if (STRING.SCAN("&clk", "*", 0)==0)
  (
    &wild_head=1
  )
  if (STRING.SCAN("&clk", "*", 1)==(STRING.LENGTH("&clk")-1))
  (
    &wild_tail=1
  )

  if ((&wild_head==1)&&(&wild_tail==1))
  (
    if (STRING.SCAN("clk_bus_q6", STRING.MID("&clk", 1, &clk_input_length-2), 0)!=-1)
    ( 
      &match=1
    )
  )
  else if (&wild_head==1)
  (
    if (STRING.MID("clk_bus_q6", &clk_itr_length-&clk_input_length+1, &clk_input_length-1)==STRING.CUT("&clk", 1))
    ( 
      &match=1
    )
  )
  else if (&wild_tail==1)
  (
    if (STRING.MID("clk_bus_q6", 0, &clk_input_length-1)==STRING.CUT("&clk", -1))
    ( 
      &match=1
    )
  )
  else if ("clk_bus_q6"=="&clk")
  (
    &match=1
  )
  
  if (&match==1)
  (
    &clk_test=&CLK_TEST_CLK_BUS_Q6
    &clk_reg=&HWIO_MSS_BUS_Q6SS_CBCR_ADDR
    &clk_reg_name="MSS_BUS_Q6SS_CBCR"
    &clk_name="clk_bus_q6"
    &clk_reg_cbcr_type="sm_cbc"
    &clk_vote_bit=-1.
    &clk_multiplier=1.

    gosub Print_Clk_Info_Line
  )

  &match=0
  &wild_head=0
  &wild_tail=0
  &clk_input_length=STRING.LENGTH("&clk")
  &clk_itr_length=STRING.LENGTH("clk_bus_rbcpr")

  if (STRING.SCAN("&clk", "*", 0)==0)
  (
    &wild_head=1
  )
  if (STRING.SCAN("&clk", "*", 1)==(STRING.LENGTH("&clk")-1))
  (
    &wild_tail=1
  )

  if ((&wild_head==1)&&(&wild_tail==1))
  (
    if (STRING.SCAN("clk_bus_rbcpr", STRING.MID("&clk", 1, &clk_input_length-2), 0)!=-1)
    ( 
      &match=1
    )
  )
  else if (&wild_head==1)
  (
    if (STRING.MID("clk_bus_rbcpr", &clk_itr_length-&clk_input_length+1, &clk_input_length-1)==STRING.CUT("&clk", 1))
    ( 
      &match=1
    )
  )
  else if (&wild_tail==1)
  (
    if (STRING.MID("clk_bus_rbcpr", 0, &clk_input_length-1)==STRING.CUT("&clk", -1))
    ( 
      &match=1
    )
  )
  else if ("clk_bus_rbcpr"=="&clk")
  (
    &match=1
  )
  
  if (&match==1)
  (
    &clk_test=&CLK_TEST_CLK_BUS_RBCPR
    &clk_reg=&HWIO_MSS_BUS_RBCPR_CBCR_ADDR
    &clk_reg_name="MSS_BUS_RBCPR_CBCR"
    &clk_name="clk_bus_rbcpr"
    &clk_reg_cbcr_type="sm_cbc"
    &clk_vote_bit=-1.
    &clk_multiplier=1.

    gosub Print_Clk_Info_Line
  )

  &match=0
  &wild_head=0
  &wild_tail=0
  &clk_input_length=STRING.LENGTH("&clk")
  &clk_itr_length=STRING.LENGTH("clk_bus_rfc")

  if (STRING.SCAN("&clk", "*", 0)==0)
  (
    &wild_head=1
  )
  if (STRING.SCAN("&clk", "*", 1)==(STRING.LENGTH("&clk")-1))
  (
    &wild_tail=1
  )

  if ((&wild_head==1)&&(&wild_tail==1))
  (
    if (STRING.SCAN("clk_bus_rfc", STRING.MID("&clk", 1, &clk_input_length-2), 0)!=-1)
    ( 
      &match=1
    )
  )
  else if (&wild_head==1)
  (
    if (STRING.MID("clk_bus_rfc", &clk_itr_length-&clk_input_length+1, &clk_input_length-1)==STRING.CUT("&clk", 1))
    ( 
      &match=1
    )
  )
  else if (&wild_tail==1)
  (
    if (STRING.MID("clk_bus_rfc", 0, &clk_input_length-1)==STRING.CUT("&clk", -1))
    ( 
      &match=1
    )
  )
  else if ("clk_bus_rfc"=="&clk")
  (
    &match=1
  )
  
  if (&match==1)
  (
    &clk_test=&CLK_TEST_CLK_BUS_RFC
    &clk_reg=&HWIO_MSS_BUS_RFC_CBCR_ADDR
    &clk_reg_name="MSS_BUS_RFC_CBCR"
    &clk_name="clk_bus_rfc"
    &clk_reg_cbcr_type="sm_cbc"
    &clk_vote_bit=-1.
    &clk_multiplier=1.

    gosub Print_Clk_Info_Line
  )

  &match=0
  &wild_head=0
  &wild_tail=0
  &clk_input_length=STRING.LENGTH("&clk")
  &clk_itr_length=STRING.LENGTH("clk_bus_slave_timeout")

  if (STRING.SCAN("&clk", "*", 0)==0)
  (
    &wild_head=1
  )
  if (STRING.SCAN("&clk", "*", 1)==(STRING.LENGTH("&clk")-1))
  (
    &wild_tail=1
  )

  if ((&wild_head==1)&&(&wild_tail==1))
  (
    if (STRING.SCAN("clk_bus_slave_timeout", STRING.MID("&clk", 1, &clk_input_length-2), 0)!=-1)
    ( 
      &match=1
    )
  )
  else if (&wild_head==1)
  (
    if (STRING.MID("clk_bus_slave_timeout", &clk_itr_length-&clk_input_length+1, &clk_input_length-1)==STRING.CUT("&clk", 1))
    ( 
      &match=1
    )
  )
  else if (&wild_tail==1)
  (
    if (STRING.MID("clk_bus_slave_timeout", 0, &clk_input_length-1)==STRING.CUT("&clk", -1))
    ( 
      &match=1
    )
  )
  else if ("clk_bus_slave_timeout"=="&clk")
  (
    &match=1
  )
  
  if (&match==1)
  (
    &clk_test=&CLK_TEST_CLK_BUS_SLAVE_TIMEOUT
    &clk_reg=&HWIO_MSS_BUS_SLAVE_TIMEOUT_CBCR_ADDR
    &clk_reg_name="MSS_BUS_SLAVE_TIMEOUT_CBCR"
    &clk_name="clk_bus_slave_timeout"
    &clk_reg_cbcr_type="sm_cbc"
    &clk_vote_bit=-1.
    &clk_multiplier=1.

    gosub Print_Clk_Info_Line
  )

  &match=0
  &wild_head=0
  &wild_tail=0
  &clk_input_length=STRING.LENGTH("&clk")
  &clk_itr_length=STRING.LENGTH("clk_bus_stmr")

  if (STRING.SCAN("&clk", "*", 0)==0)
  (
    &wild_head=1
  )
  if (STRING.SCAN("&clk", "*", 1)==(STRING.LENGTH("&clk")-1))
  (
    &wild_tail=1
  )

  if ((&wild_head==1)&&(&wild_tail==1))
  (
    if (STRING.SCAN("clk_bus_stmr", STRING.MID("&clk", 1, &clk_input_length-2), 0)!=-1)
    ( 
      &match=1
    )
  )
  else if (&wild_head==1)
  (
    if (STRING.MID("clk_bus_stmr", &clk_itr_length-&clk_input_length+1, &clk_input_length-1)==STRING.CUT("&clk", 1))
    ( 
      &match=1
    )
  )
  else if (&wild_tail==1)
  (
    if (STRING.MID("clk_bus_stmr", 0, &clk_input_length-1)==STRING.CUT("&clk", -1))
    ( 
      &match=1
    )
  )
  else if ("clk_bus_stmr"=="&clk")
  (
    &match=1
  )
  
  if (&match==1)
  (
    &clk_test=&CLK_TEST_CLK_BUS_STMR
    &clk_reg=&HWIO_MSS_BUS_STMR_CBCR_ADDR
    &clk_reg_name="MSS_BUS_STMR_CBCR"
    &clk_name="clk_bus_stmr"
    &clk_reg_cbcr_type="sm_cbc"
    &clk_vote_bit=-1.
    &clk_multiplier=1.

    gosub Print_Clk_Info_Line
  )

  &match=0
  &wild_head=0
  &wild_tail=0
  &clk_input_length=STRING.LENGTH("&clk")
  &clk_itr_length=STRING.LENGTH("clk_bus_uim0")

  if (STRING.SCAN("&clk", "*", 0)==0)
  (
    &wild_head=1
  )
  if (STRING.SCAN("&clk", "*", 1)==(STRING.LENGTH("&clk")-1))
  (
    &wild_tail=1
  )

  if ((&wild_head==1)&&(&wild_tail==1))
  (
    if (STRING.SCAN("clk_bus_uim0", STRING.MID("&clk", 1, &clk_input_length-2), 0)!=-1)
    ( 
      &match=1
    )
  )
  else if (&wild_head==1)
  (
    if (STRING.MID("clk_bus_uim0", &clk_itr_length-&clk_input_length+1, &clk_input_length-1)==STRING.CUT("&clk", 1))
    ( 
      &match=1
    )
  )
  else if (&wild_tail==1)
  (
    if (STRING.MID("clk_bus_uim0", 0, &clk_input_length-1)==STRING.CUT("&clk", -1))
    ( 
      &match=1
    )
  )
  else if ("clk_bus_uim0"=="&clk")
  (
    &match=1
  )
  
  if (&match==1)
  (
    &clk_test=&CLK_TEST_CLK_BUS_UIM0
    &clk_reg=&HWIO_MSS_BUS_UIM0_CBCR_ADDR
    &clk_reg_name="MSS_BUS_UIM0_CBCR"
    &clk_name="clk_bus_uim0"
    &clk_reg_cbcr_type="sm_cbc"
    &clk_vote_bit=-1.
    &clk_multiplier=1.

    gosub Print_Clk_Info_Line
  )

  &match=0
  &wild_head=0
  &wild_tail=0
  &clk_input_length=STRING.LENGTH("&clk")
  &clk_itr_length=STRING.LENGTH("clk_bus_uim1")

  if (STRING.SCAN("&clk", "*", 0)==0)
  (
    &wild_head=1
  )
  if (STRING.SCAN("&clk", "*", 1)==(STRING.LENGTH("&clk")-1))
  (
    &wild_tail=1
  )

  if ((&wild_head==1)&&(&wild_tail==1))
  (
    if (STRING.SCAN("clk_bus_uim1", STRING.MID("&clk", 1, &clk_input_length-2), 0)!=-1)
    ( 
      &match=1
    )
  )
  else if (&wild_head==1)
  (
    if (STRING.MID("clk_bus_uim1", &clk_itr_length-&clk_input_length+1, &clk_input_length-1)==STRING.CUT("&clk", 1))
    ( 
      &match=1
    )
  )
  else if (&wild_tail==1)
  (
    if (STRING.MID("clk_bus_uim1", 0, &clk_input_length-1)==STRING.CUT("&clk", -1))
    ( 
      &match=1
    )
  )
  else if ("clk_bus_uim1"=="&clk")
  (
    &match=1
  )
  
  if (&match==1)
  (
    &clk_test=&CLK_TEST_CLK_BUS_UIM1
    &clk_reg=&HWIO_MSS_BUS_UIM1_CBCR_ADDR
    &clk_reg_name="MSS_BUS_UIM1_CBCR"
    &clk_name="clk_bus_uim1"
    &clk_reg_cbcr_type="sm_cbc"
    &clk_vote_bit=-1.
    &clk_multiplier=1.

    gosub Print_Clk_Info_Line
  )

  &match=0
  &wild_head=0
  &wild_tail=0
  &clk_input_length=STRING.LENGTH("&clk")
  &clk_itr_length=STRING.LENGTH("clk_bus_uim2")

  if (STRING.SCAN("&clk", "*", 0)==0)
  (
    &wild_head=1
  )
  if (STRING.SCAN("&clk", "*", 1)==(STRING.LENGTH("&clk")-1))
  (
    &wild_tail=1
  )

  if ((&wild_head==1)&&(&wild_tail==1))
  (
    if (STRING.SCAN("clk_bus_uim2", STRING.MID("&clk", 1, &clk_input_length-2), 0)!=-1)
    ( 
      &match=1
    )
  )
  else if (&wild_head==1)
  (
    if (STRING.MID("clk_bus_uim2", &clk_itr_length-&clk_input_length+1, &clk_input_length-1)==STRING.CUT("&clk", 1))
    ( 
      &match=1
    )
  )
  else if (&wild_tail==1)
  (
    if (STRING.MID("clk_bus_uim2", 0, &clk_input_length-1)==STRING.CUT("&clk", -1))
    ( 
      &match=1
    )
  )
  else if ("clk_bus_uim2"=="&clk")
  (
    &match=1
  )
  
  if (&match==1)
  (
    &clk_test=&CLK_TEST_CLK_BUS_UIM2
    &clk_reg=&HWIO_MSS_BUS_UIM2_CBCR_ADDR
    &clk_reg_name="MSS_BUS_UIM2_CBCR"
    &clk_name="clk_bus_uim2"
    &clk_reg_cbcr_type="sm_cbc"
    &clk_vote_bit=-1.
    &clk_multiplier=1.

    gosub Print_Clk_Info_Line
  )

  &match=0
  &wild_head=0
  &wild_tail=0
  &clk_input_length=STRING.LENGTH("&clk")
  &clk_itr_length=STRING.LENGTH("clk_bus_uim3")

  if (STRING.SCAN("&clk", "*", 0)==0)
  (
    &wild_head=1
  )
  if (STRING.SCAN("&clk", "*", 1)==(STRING.LENGTH("&clk")-1))
  (
    &wild_tail=1
  )

  if ((&wild_head==1)&&(&wild_tail==1))
  (
    if (STRING.SCAN("clk_bus_uim3", STRING.MID("&clk", 1, &clk_input_length-2), 0)!=-1)
    ( 
      &match=1
    )
  )
  else if (&wild_head==1)
  (
    if (STRING.MID("clk_bus_uim3", &clk_itr_length-&clk_input_length+1, &clk_input_length-1)==STRING.CUT("&clk", 1))
    ( 
      &match=1
    )
  )
  else if (&wild_tail==1)
  (
    if (STRING.MID("clk_bus_uim3", 0, &clk_input_length-1)==STRING.CUT("&clk", -1))
    ( 
      &match=1
    )
  )
  else if ("clk_bus_uim3"=="&clk")
  (
    &match=1
  )
  
  if (&match==1)
  (
    &clk_test=&CLK_TEST_CLK_BUS_UIM3
    &clk_reg=&HWIO_MSS_BUS_UIM3_CBCR_ADDR
    &clk_reg_name="MSS_BUS_UIM3_CBCR"
    &clk_name="clk_bus_uim3"
    &clk_reg_cbcr_type="sm_cbc"
    &clk_vote_bit=-1.
    &clk_multiplier=1.

    gosub Print_Clk_Info_Line
  )

  &match=0
  &wild_head=0
  &wild_tail=0
  &clk_input_length=STRING.LENGTH("&clk")
  &clk_itr_length=STRING.LENGTH("mss_dgr_ahb_clk")

  if (STRING.SCAN("&clk", "*", 0)==0)
  (
    &wild_head=1
  )
  if (STRING.SCAN("&clk", "*", 1)==(STRING.LENGTH("&clk")-1))
  (
    &wild_tail=1
  )

  if ((&wild_head==1)&&(&wild_tail==1))
  (
    if (STRING.SCAN("mss_dgr_ahb_clk", STRING.MID("&clk", 1, &clk_input_length-2), 0)!=-1)
    ( 
      &match=1
    )
  )
  else if (&wild_head==1)
  (
    if (STRING.MID("mss_dgr_ahb_clk", &clk_itr_length-&clk_input_length+1, &clk_input_length-1)==STRING.CUT("&clk", 1))
    ( 
      &match=1
    )
  )
  else if (&wild_tail==1)
  (
    if (STRING.MID("mss_dgr_ahb_clk", 0, &clk_input_length-1)==STRING.CUT("&clk", -1))
    ( 
      &match=1
    )
  )
  else if ("mss_dgr_ahb_clk"=="&clk")
  (
    &match=1
  )
  
  if (&match==1)
  (
    &clk_test=&CLK_TEST_MSS_DGR_AHB_CLK
    &clk_reg=&HWIO_MSS_DGR_AHB_CBCR_ADDR
    &clk_reg_name="MSS_DGR_AHB_CBCR"
    &clk_name="mss_dgr_ahb_clk"
    &clk_reg_cbcr_type="sm_cbc"
    &clk_vote_bit=-1.
    &clk_multiplier=1.

    gosub Print_Clk_Info_Line
  )

  &match=0
  &wild_head=0
  &wild_tail=0
  &clk_input_length=STRING.LENGTH("&clk")
  &clk_itr_length=STRING.LENGTH("mss_dgr_freerun_ahb_clk")

  if (STRING.SCAN("&clk", "*", 0)==0)
  (
    &wild_head=1
  )
  if (STRING.SCAN("&clk", "*", 1)==(STRING.LENGTH("&clk")-1))
  (
    &wild_tail=1
  )

  if ((&wild_head==1)&&(&wild_tail==1))
  (
    if (STRING.SCAN("mss_dgr_freerun_ahb_clk", STRING.MID("&clk", 1, &clk_input_length-2), 0)!=-1)
    ( 
      &match=1
    )
  )
  else if (&wild_head==1)
  (
    if (STRING.MID("mss_dgr_freerun_ahb_clk", &clk_itr_length-&clk_input_length+1, &clk_input_length-1)==STRING.CUT("&clk", 1))
    ( 
      &match=1
    )
  )
  else if (&wild_tail==1)
  (
    if (STRING.MID("mss_dgr_freerun_ahb_clk", 0, &clk_input_length-1)==STRING.CUT("&clk", -1))
    ( 
      &match=1
    )
  )
  else if ("mss_dgr_freerun_ahb_clk"=="&clk")
  (
    &match=1
  )
  
  if (&match==1)
  (
    &clk_test=0
    &clk_reg=0
    &clk_reg_name="No CBCR"
    &clk_name="mss_dgr_freerun_ahb_clk"
    &clk_reg_cbcr_type=""
    &clk_vote_bit=-1.
    &clk_multiplier=1.

    gosub Print_Clk_Info_Line
  )

  &match=0
  &wild_head=0
  &wild_tail=0
  &clk_input_length=STRING.LENGTH("&clk")
  &clk_itr_length=STRING.LENGTH("clk_xo")

  if (STRING.SCAN("&clk", "*", 0)==0)
  (
    &wild_head=1
  )
  if (STRING.SCAN("&clk", "*", 1)==(STRING.LENGTH("&clk")-1))
  (
    &wild_tail=1
  )

  if ((&wild_head==1)&&(&wild_tail==1))
  (
    if (STRING.SCAN("clk_xo", STRING.MID("&clk", 1, &clk_input_length-2), 0)!=-1)
    ( 
      &match=1
    )
  )
  else if (&wild_head==1)
  (
    if (STRING.MID("clk_xo", &clk_itr_length-&clk_input_length+1, &clk_input_length-1)==STRING.CUT("&clk", 1))
    ( 
      &match=1
    )
  )
  else if (&wild_tail==1)
  (
    if (STRING.MID("clk_xo", 0, &clk_input_length-1)==STRING.CUT("&clk", -1))
    ( 
      &match=1
    )
  )
  else if ("clk_xo"=="&clk")
  (
    &match=1
  )
  
  if (&match==1)
  (
    &clk_test=&CLK_TEST_CLK_XO
    &clk_reg=0
    &clk_reg_name="No CBCR"
    &clk_name="clk_xo"
    &clk_reg_cbcr_type=""
    &clk_vote_bit=-1.
    &clk_multiplier=1.

    gosub Print_Clk_Info_Line
  )

  &match=0
  &wild_head=0
  &wild_tail=0
  &clk_input_length=STRING.LENGTH("&clk")
  &clk_itr_length=STRING.LENGTH("clk_xo_mdm")

  if (STRING.SCAN("&clk", "*", 0)==0)
  (
    &wild_head=1
  )
  if (STRING.SCAN("&clk", "*", 1)==(STRING.LENGTH("&clk")-1))
  (
    &wild_tail=1
  )

  if ((&wild_head==1)&&(&wild_tail==1))
  (
    if (STRING.SCAN("clk_xo_mdm", STRING.MID("&clk", 1, &clk_input_length-2), 0)!=-1)
    ( 
      &match=1
    )
  )
  else if (&wild_head==1)
  (
    if (STRING.MID("clk_xo_mdm", &clk_itr_length-&clk_input_length+1, &clk_input_length-1)==STRING.CUT("&clk", 1))
    ( 
      &match=1
    )
  )
  else if (&wild_tail==1)
  (
    if (STRING.MID("clk_xo_mdm", 0, &clk_input_length-1)==STRING.CUT("&clk", -1))
    ( 
      &match=1
    )
  )
  else if ("clk_xo_mdm"=="&clk")
  (
    &match=1
  )
  
  if (&match==1)
  (
    &clk_test=&CLK_TEST_CLK_XO_MDM
    &clk_reg=&HWIO_MSS_XO_MDM_CBCR_ADDR
    &clk_reg_name="MSS_XO_MDM_CBCR"
    &clk_name="clk_xo_mdm"
    &clk_reg_cbcr_type="sm_cbc"
    &clk_vote_bit=-1.
    &clk_multiplier=1.

    gosub Print_Clk_Info_Line
  )

  &match=0
  &wild_head=0
  &wild_tail=0
  &clk_input_length=STRING.LENGTH("&clk")
  &clk_itr_length=STRING.LENGTH("clk_xo_nav")

  if (STRING.SCAN("&clk", "*", 0)==0)
  (
    &wild_head=1
  )
  if (STRING.SCAN("&clk", "*", 1)==(STRING.LENGTH("&clk")-1))
  (
    &wild_tail=1
  )

  if ((&wild_head==1)&&(&wild_tail==1))
  (
    if (STRING.SCAN("clk_xo_nav", STRING.MID("&clk", 1, &clk_input_length-2), 0)!=-1)
    ( 
      &match=1
    )
  )
  else if (&wild_head==1)
  (
    if (STRING.MID("clk_xo_nav", &clk_itr_length-&clk_input_length+1, &clk_input_length-1)==STRING.CUT("&clk", 1))
    ( 
      &match=1
    )
  )
  else if (&wild_tail==1)
  (
    if (STRING.MID("clk_xo_nav", 0, &clk_input_length-1)==STRING.CUT("&clk", -1))
    ( 
      &match=1
    )
  )
  else if ("clk_xo_nav"=="&clk")
  (
    &match=1
  )
  
  if (&match==1)
  (
    &clk_test=&CLK_TEST_CLK_XO_NAV
    &clk_reg=&HWIO_MSS_XO_NAV_CBCR_ADDR
    &clk_reg_name="MSS_XO_NAV_CBCR"
    &clk_name="clk_xo_nav"
    &clk_reg_cbcr_type="sm_cbc"
    &clk_vote_bit=-1.
    &clk_multiplier=1.

    gosub Print_Clk_Info_Line
  )

  &match=0
  &wild_head=0
  &wild_tail=0
  &clk_input_length=STRING.LENGTH("&clk")
  &clk_itr_length=STRING.LENGTH("clk_src_rbcpr_ref")

  if (STRING.SCAN("&clk", "*", 0)==0)
  (
    &wild_head=1
  )
  if (STRING.SCAN("&clk", "*", 1)==(STRING.LENGTH("&clk")-1))
  (
    &wild_tail=1
  )

  if ((&wild_head==1)&&(&wild_tail==1))
  (
    if (STRING.SCAN("clk_src_rbcpr_ref", STRING.MID("&clk", 1, &clk_input_length-2), 0)!=-1)
    ( 
      &match=1
    )
  )
  else if (&wild_head==1)
  (
    if (STRING.MID("clk_src_rbcpr_ref", &clk_itr_length-&clk_input_length+1, &clk_input_length-1)==STRING.CUT("&clk", 1))
    ( 
      &match=1
    )
  )
  else if (&wild_tail==1)
  (
    if (STRING.MID("clk_src_rbcpr_ref", 0, &clk_input_length-1)==STRING.CUT("&clk", -1))
    ( 
      &match=1
    )
  )
  else if ("clk_src_rbcpr_ref"=="&clk")
  (
    &match=1
  )
  
  if (&match==1)
  (
    &clk_test=&CLK_TEST_CLK_SRC_RBCPR_REF
    &clk_reg=0
    &clk_reg_name="No CBCR"
    &clk_name="clk_src_rbcpr_ref"
    &clk_reg_cbcr_type=""
    &clk_vote_bit=-1.
    &clk_multiplier=1.

    gosub Print_Clk_Info_Line
  )

  &match=0
  &wild_head=0
  &wild_tail=0
  &clk_input_length=STRING.LENGTH("&clk")
  &clk_itr_length=STRING.LENGTH("clk_rbcpr_ref")

  if (STRING.SCAN("&clk", "*", 0)==0)
  (
    &wild_head=1
  )
  if (STRING.SCAN("&clk", "*", 1)==(STRING.LENGTH("&clk")-1))
  (
    &wild_tail=1
  )

  if ((&wild_head==1)&&(&wild_tail==1))
  (
    if (STRING.SCAN("clk_rbcpr_ref", STRING.MID("&clk", 1, &clk_input_length-2), 0)!=-1)
    ( 
      &match=1
    )
  )
  else if (&wild_head==1)
  (
    if (STRING.MID("clk_rbcpr_ref", &clk_itr_length-&clk_input_length+1, &clk_input_length-1)==STRING.CUT("&clk", 1))
    ( 
      &match=1
    )
  )
  else if (&wild_tail==1)
  (
    if (STRING.MID("clk_rbcpr_ref", 0, &clk_input_length-1)==STRING.CUT("&clk", -1))
    ( 
      &match=1
    )
  )
  else if ("clk_rbcpr_ref"=="&clk")
  (
    &match=1
  )
  
  if (&match==1)
  (
    &clk_test=&CLK_TEST_CLK_RBCPR_REF
    &clk_reg=&HWIO_MSS_RBCPR_REF_CBCR_ADDR
    &clk_reg_name="MSS_RBCPR_REF_CBCR"
    &clk_name="clk_rbcpr_ref"
    &clk_reg_cbcr_type="sm_cbc"
    &clk_vote_bit=-1.
    &clk_multiplier=1.

    gosub Print_Clk_Info_Line
  )

  &match=0
  &wild_head=0
  &wild_tail=0
  &clk_input_length=STRING.LENGTH("&clk")
  &clk_itr_length=STRING.LENGTH("clk_src_uim")

  if (STRING.SCAN("&clk", "*", 0)==0)
  (
    &wild_head=1
  )
  if (STRING.SCAN("&clk", "*", 1)==(STRING.LENGTH("&clk")-1))
  (
    &wild_tail=1
  )

  if ((&wild_head==1)&&(&wild_tail==1))
  (
    if (STRING.SCAN("clk_src_uim", STRING.MID("&clk", 1, &clk_input_length-2), 0)!=-1)
    ( 
      &match=1
    )
  )
  else if (&wild_head==1)
  (
    if (STRING.MID("clk_src_uim", &clk_itr_length-&clk_input_length+1, &clk_input_length-1)==STRING.CUT("&clk", 1))
    ( 
      &match=1
    )
  )
  else if (&wild_tail==1)
  (
    if (STRING.MID("clk_src_uim", 0, &clk_input_length-1)==STRING.CUT("&clk", -1))
    ( 
      &match=1
    )
  )
  else if ("clk_src_uim"=="&clk")
  (
    &match=1
  )
  
  if (&match==1)
  (
    &clk_test=&CLK_TEST_CLK_SRC_UIM
    &clk_reg=0
    &clk_reg_name="No CBCR"
    &clk_name="clk_src_uim"
    &clk_reg_cbcr_type=""
    &clk_vote_bit=-1.
    &clk_multiplier=1.

    gosub Print_Clk_Info_Line
  )

  &match=0
  &wild_head=0
  &wild_tail=0
  &clk_input_length=STRING.LENGTH("&clk")
  &clk_itr_length=STRING.LENGTH("clk_card_src_uim0")

  if (STRING.SCAN("&clk", "*", 0)==0)
  (
    &wild_head=1
  )
  if (STRING.SCAN("&clk", "*", 1)==(STRING.LENGTH("&clk")-1))
  (
    &wild_tail=1
  )

  if ((&wild_head==1)&&(&wild_tail==1))
  (
    if (STRING.SCAN("clk_card_src_uim0", STRING.MID("&clk", 1, &clk_input_length-2), 0)!=-1)
    ( 
      &match=1
    )
  )
  else if (&wild_head==1)
  (
    if (STRING.MID("clk_card_src_uim0", &clk_itr_length-&clk_input_length+1, &clk_input_length-1)==STRING.CUT("&clk", 1))
    ( 
      &match=1
    )
  )
  else if (&wild_tail==1)
  (
    if (STRING.MID("clk_card_src_uim0", 0, &clk_input_length-1)==STRING.CUT("&clk", -1))
    ( 
      &match=1
    )
  )
  else if ("clk_card_src_uim0"=="&clk")
  (
    &match=1
  )
  
  if (&match==1)
  (
    &clk_test=&CLK_TEST_CLK_CARD_SRC_UIM0
    &clk_reg=&HWIO_MSS_CARD_SRC_UIM0_CBCR_ADDR
    &clk_reg_name="MSS_CARD_SRC_UIM0_CBCR"
    &clk_name="clk_card_src_uim0"
    &clk_reg_cbcr_type="sm_cbc"
    &clk_vote_bit=-1.
    &clk_multiplier=1.

    gosub Print_Clk_Info_Line
  )

  &match=0
  &wild_head=0
  &wild_tail=0
  &clk_input_length=STRING.LENGTH("&clk")
  &clk_itr_length=STRING.LENGTH("clk_card_src_uim1")

  if (STRING.SCAN("&clk", "*", 0)==0)
  (
    &wild_head=1
  )
  if (STRING.SCAN("&clk", "*", 1)==(STRING.LENGTH("&clk")-1))
  (
    &wild_tail=1
  )

  if ((&wild_head==1)&&(&wild_tail==1))
  (
    if (STRING.SCAN("clk_card_src_uim1", STRING.MID("&clk", 1, &clk_input_length-2), 0)!=-1)
    ( 
      &match=1
    )
  )
  else if (&wild_head==1)
  (
    if (STRING.MID("clk_card_src_uim1", &clk_itr_length-&clk_input_length+1, &clk_input_length-1)==STRING.CUT("&clk", 1))
    ( 
      &match=1
    )
  )
  else if (&wild_tail==1)
  (
    if (STRING.MID("clk_card_src_uim1", 0, &clk_input_length-1)==STRING.CUT("&clk", -1))
    ( 
      &match=1
    )
  )
  else if ("clk_card_src_uim1"=="&clk")
  (
    &match=1
  )
  
  if (&match==1)
  (
    &clk_test=&CLK_TEST_CLK_CARD_SRC_UIM1
    &clk_reg=&HWIO_MSS_CARD_SRC_UIM1_CBCR_ADDR
    &clk_reg_name="MSS_CARD_SRC_UIM1_CBCR"
    &clk_name="clk_card_src_uim1"
    &clk_reg_cbcr_type="sm_cbc"
    &clk_vote_bit=-1.
    &clk_multiplier=1.

    gosub Print_Clk_Info_Line
  )

  &match=0
  &wild_head=0
  &wild_tail=0
  &clk_input_length=STRING.LENGTH("&clk")
  &clk_itr_length=STRING.LENGTH("clk_card_src_uim2")

  if (STRING.SCAN("&clk", "*", 0)==0)
  (
    &wild_head=1
  )
  if (STRING.SCAN("&clk", "*", 1)==(STRING.LENGTH("&clk")-1))
  (
    &wild_tail=1
  )

  if ((&wild_head==1)&&(&wild_tail==1))
  (
    if (STRING.SCAN("clk_card_src_uim2", STRING.MID("&clk", 1, &clk_input_length-2), 0)!=-1)
    ( 
      &match=1
    )
  )
  else if (&wild_head==1)
  (
    if (STRING.MID("clk_card_src_uim2", &clk_itr_length-&clk_input_length+1, &clk_input_length-1)==STRING.CUT("&clk", 1))
    ( 
      &match=1
    )
  )
  else if (&wild_tail==1)
  (
    if (STRING.MID("clk_card_src_uim2", 0, &clk_input_length-1)==STRING.CUT("&clk", -1))
    ( 
      &match=1
    )
  )
  else if ("clk_card_src_uim2"=="&clk")
  (
    &match=1
  )
  
  if (&match==1)
  (
    &clk_test=&CLK_TEST_CLK_CARD_SRC_UIM2
    &clk_reg=&HWIO_MSS_CARD_SRC_UIM2_CBCR_ADDR
    &clk_reg_name="MSS_CARD_SRC_UIM2_CBCR"
    &clk_name="clk_card_src_uim2"
    &clk_reg_cbcr_type="sm_cbc"
    &clk_vote_bit=-1.
    &clk_multiplier=1.

    gosub Print_Clk_Info_Line
  )

  &match=0
  &wild_head=0
  &wild_tail=0
  &clk_input_length=STRING.LENGTH("&clk")
  &clk_itr_length=STRING.LENGTH("clk_card_src_uim3")

  if (STRING.SCAN("&clk", "*", 0)==0)
  (
    &wild_head=1
  )
  if (STRING.SCAN("&clk", "*", 1)==(STRING.LENGTH("&clk")-1))
  (
    &wild_tail=1
  )

  if ((&wild_head==1)&&(&wild_tail==1))
  (
    if (STRING.SCAN("clk_card_src_uim3", STRING.MID("&clk", 1, &clk_input_length-2), 0)!=-1)
    ( 
      &match=1
    )
  )
  else if (&wild_head==1)
  (
    if (STRING.MID("clk_card_src_uim3", &clk_itr_length-&clk_input_length+1, &clk_input_length-1)==STRING.CUT("&clk", 1))
    ( 
      &match=1
    )
  )
  else if (&wild_tail==1)
  (
    if (STRING.MID("clk_card_src_uim3", 0, &clk_input_length-1)==STRING.CUT("&clk", -1))
    ( 
      &match=1
    )
  )
  else if ("clk_card_src_uim3"=="&clk")
  (
    &match=1
  )
  
  if (&match==1)
  (
    &clk_test=&CLK_TEST_CLK_CARD_SRC_UIM3
    &clk_reg=&HWIO_MSS_CARD_SRC_UIM3_CBCR_ADDR
    &clk_reg_name="MSS_CARD_SRC_UIM3_CBCR"
    &clk_name="clk_card_src_uim3"
    &clk_reg_cbcr_type="sm_cbc"
    &clk_vote_bit=-1.
    &clk_multiplier=1.

    gosub Print_Clk_Info_Line
  )

  &match=0
  &wild_head=0
  &wild_tail=0
  &clk_input_length=STRING.LENGTH("&clk")
  &clk_itr_length=STRING.LENGTH("clk_src_uim0_mnd")

  if (STRING.SCAN("&clk", "*", 0)==0)
  (
    &wild_head=1
  )
  if (STRING.SCAN("&clk", "*", 1)==(STRING.LENGTH("&clk")-1))
  (
    &wild_tail=1
  )

  if ((&wild_head==1)&&(&wild_tail==1))
  (
    if (STRING.SCAN("clk_src_uim0_mnd", STRING.MID("&clk", 1, &clk_input_length-2), 0)!=-1)
    ( 
      &match=1
    )
  )
  else if (&wild_head==1)
  (
    if (STRING.MID("clk_src_uim0_mnd", &clk_itr_length-&clk_input_length+1, &clk_input_length-1)==STRING.CUT("&clk", 1))
    ( 
      &match=1
    )
  )
  else if (&wild_tail==1)
  (
    if (STRING.MID("clk_src_uim0_mnd", 0, &clk_input_length-1)==STRING.CUT("&clk", -1))
    ( 
      &match=1
    )
  )
  else if ("clk_src_uim0_mnd"=="&clk")
  (
    &match=1
  )
  
  if (&match==1)
  (
    &clk_test=&CLK_TEST_CLK_SRC_UIM0_MND
    &clk_reg=0
    &clk_reg_name="No CBCR"
    &clk_name="clk_src_uim0_mnd"
    &clk_reg_cbcr_type=""
    &clk_vote_bit=-1.
    &clk_multiplier=1.

    gosub Print_Clk_Info_Line
  )

  &match=0
  &wild_head=0
  &wild_tail=0
  &clk_input_length=STRING.LENGTH("&clk")
  &clk_itr_length=STRING.LENGTH("clk_uart_bit_uim0")

  if (STRING.SCAN("&clk", "*", 0)==0)
  (
    &wild_head=1
  )
  if (STRING.SCAN("&clk", "*", 1)==(STRING.LENGTH("&clk")-1))
  (
    &wild_tail=1
  )

  if ((&wild_head==1)&&(&wild_tail==1))
  (
    if (STRING.SCAN("clk_uart_bit_uim0", STRING.MID("&clk", 1, &clk_input_length-2), 0)!=-1)
    ( 
      &match=1
    )
  )
  else if (&wild_head==1)
  (
    if (STRING.MID("clk_uart_bit_uim0", &clk_itr_length-&clk_input_length+1, &clk_input_length-1)==STRING.CUT("&clk", 1))
    ( 
      &match=1
    )
  )
  else if (&wild_tail==1)
  (
    if (STRING.MID("clk_uart_bit_uim0", 0, &clk_input_length-1)==STRING.CUT("&clk", -1))
    ( 
      &match=1
    )
  )
  else if ("clk_uart_bit_uim0"=="&clk")
  (
    &match=1
  )
  
  if (&match==1)
  (
    &clk_test=&CLK_TEST_CLK_UART_BIT_UIM0
    &clk_reg=&HWIO_MSS_UART_BIT_UIM0_CBCR_ADDR
    &clk_reg_name="MSS_UART_BIT_UIM0_CBCR"
    &clk_name="clk_uart_bit_uim0"
    &clk_reg_cbcr_type="sm_cbc"
    &clk_vote_bit=-1.
    &clk_multiplier=1.

    gosub Print_Clk_Info_Line
  )

  &match=0
  &wild_head=0
  &wild_tail=0
  &clk_input_length=STRING.LENGTH("&clk")
  &clk_itr_length=STRING.LENGTH("clk_src_uim1_mnd")

  if (STRING.SCAN("&clk", "*", 0)==0)
  (
    &wild_head=1
  )
  if (STRING.SCAN("&clk", "*", 1)==(STRING.LENGTH("&clk")-1))
  (
    &wild_tail=1
  )

  if ((&wild_head==1)&&(&wild_tail==1))
  (
    if (STRING.SCAN("clk_src_uim1_mnd", STRING.MID("&clk", 1, &clk_input_length-2), 0)!=-1)
    ( 
      &match=1
    )
  )
  else if (&wild_head==1)
  (
    if (STRING.MID("clk_src_uim1_mnd", &clk_itr_length-&clk_input_length+1, &clk_input_length-1)==STRING.CUT("&clk", 1))
    ( 
      &match=1
    )
  )
  else if (&wild_tail==1)
  (
    if (STRING.MID("clk_src_uim1_mnd", 0, &clk_input_length-1)==STRING.CUT("&clk", -1))
    ( 
      &match=1
    )
  )
  else if ("clk_src_uim1_mnd"=="&clk")
  (
    &match=1
  )
  
  if (&match==1)
  (
    &clk_test=&CLK_TEST_CLK_SRC_UIM1_MND
    &clk_reg=0
    &clk_reg_name="No CBCR"
    &clk_name="clk_src_uim1_mnd"
    &clk_reg_cbcr_type=""
    &clk_vote_bit=-1.
    &clk_multiplier=1.

    gosub Print_Clk_Info_Line
  )

  &match=0
  &wild_head=0
  &wild_tail=0
  &clk_input_length=STRING.LENGTH("&clk")
  &clk_itr_length=STRING.LENGTH("clk_uart_bit_uim1")

  if (STRING.SCAN("&clk", "*", 0)==0)
  (
    &wild_head=1
  )
  if (STRING.SCAN("&clk", "*", 1)==(STRING.LENGTH("&clk")-1))
  (
    &wild_tail=1
  )

  if ((&wild_head==1)&&(&wild_tail==1))
  (
    if (STRING.SCAN("clk_uart_bit_uim1", STRING.MID("&clk", 1, &clk_input_length-2), 0)!=-1)
    ( 
      &match=1
    )
  )
  else if (&wild_head==1)
  (
    if (STRING.MID("clk_uart_bit_uim1", &clk_itr_length-&clk_input_length+1, &clk_input_length-1)==STRING.CUT("&clk", 1))
    ( 
      &match=1
    )
  )
  else if (&wild_tail==1)
  (
    if (STRING.MID("clk_uart_bit_uim1", 0, &clk_input_length-1)==STRING.CUT("&clk", -1))
    ( 
      &match=1
    )
  )
  else if ("clk_uart_bit_uim1"=="&clk")
  (
    &match=1
  )
  
  if (&match==1)
  (
    &clk_test=&CLK_TEST_CLK_UART_BIT_UIM1
    &clk_reg=&HWIO_MSS_UART_BIT_UIM1_CBCR_ADDR
    &clk_reg_name="MSS_UART_BIT_UIM1_CBCR"
    &clk_name="clk_uart_bit_uim1"
    &clk_reg_cbcr_type="sm_cbc"
    &clk_vote_bit=-1.
    &clk_multiplier=1.

    gosub Print_Clk_Info_Line
  )

  &match=0
  &wild_head=0
  &wild_tail=0
  &clk_input_length=STRING.LENGTH("&clk")
  &clk_itr_length=STRING.LENGTH("clk_src_uim2_mnd")

  if (STRING.SCAN("&clk", "*", 0)==0)
  (
    &wild_head=1
  )
  if (STRING.SCAN("&clk", "*", 1)==(STRING.LENGTH("&clk")-1))
  (
    &wild_tail=1
  )

  if ((&wild_head==1)&&(&wild_tail==1))
  (
    if (STRING.SCAN("clk_src_uim2_mnd", STRING.MID("&clk", 1, &clk_input_length-2), 0)!=-1)
    ( 
      &match=1
    )
  )
  else if (&wild_head==1)
  (
    if (STRING.MID("clk_src_uim2_mnd", &clk_itr_length-&clk_input_length+1, &clk_input_length-1)==STRING.CUT("&clk", 1))
    ( 
      &match=1
    )
  )
  else if (&wild_tail==1)
  (
    if (STRING.MID("clk_src_uim2_mnd", 0, &clk_input_length-1)==STRING.CUT("&clk", -1))
    ( 
      &match=1
    )
  )
  else if ("clk_src_uim2_mnd"=="&clk")
  (
    &match=1
  )
  
  if (&match==1)
  (
    &clk_test=&CLK_TEST_CLK_SRC_UIM2_MND
    &clk_reg=0
    &clk_reg_name="No CBCR"
    &clk_name="clk_src_uim2_mnd"
    &clk_reg_cbcr_type=""
    &clk_vote_bit=-1.
    &clk_multiplier=1.

    gosub Print_Clk_Info_Line
  )

  &match=0
  &wild_head=0
  &wild_tail=0
  &clk_input_length=STRING.LENGTH("&clk")
  &clk_itr_length=STRING.LENGTH("clk_uart_bit_uim2")

  if (STRING.SCAN("&clk", "*", 0)==0)
  (
    &wild_head=1
  )
  if (STRING.SCAN("&clk", "*", 1)==(STRING.LENGTH("&clk")-1))
  (
    &wild_tail=1
  )

  if ((&wild_head==1)&&(&wild_tail==1))
  (
    if (STRING.SCAN("clk_uart_bit_uim2", STRING.MID("&clk", 1, &clk_input_length-2), 0)!=-1)
    ( 
      &match=1
    )
  )
  else if (&wild_head==1)
  (
    if (STRING.MID("clk_uart_bit_uim2", &clk_itr_length-&clk_input_length+1, &clk_input_length-1)==STRING.CUT("&clk", 1))
    ( 
      &match=1
    )
  )
  else if (&wild_tail==1)
  (
    if (STRING.MID("clk_uart_bit_uim2", 0, &clk_input_length-1)==STRING.CUT("&clk", -1))
    ( 
      &match=1
    )
  )
  else if ("clk_uart_bit_uim2"=="&clk")
  (
    &match=1
  )
  
  if (&match==1)
  (
    &clk_test=&CLK_TEST_CLK_UART_BIT_UIM2
    &clk_reg=&HWIO_MSS_UART_BIT_UIM2_CBCR_ADDR
    &clk_reg_name="MSS_UART_BIT_UIM2_CBCR"
    &clk_name="clk_uart_bit_uim2"
    &clk_reg_cbcr_type="sm_cbc"
    &clk_vote_bit=-1.
    &clk_multiplier=1.

    gosub Print_Clk_Info_Line
  )

  &match=0
  &wild_head=0
  &wild_tail=0
  &clk_input_length=STRING.LENGTH("&clk")
  &clk_itr_length=STRING.LENGTH("clk_src_uim3_mnd")

  if (STRING.SCAN("&clk", "*", 0)==0)
  (
    &wild_head=1
  )
  if (STRING.SCAN("&clk", "*", 1)==(STRING.LENGTH("&clk")-1))
  (
    &wild_tail=1
  )

  if ((&wild_head==1)&&(&wild_tail==1))
  (
    if (STRING.SCAN("clk_src_uim3_mnd", STRING.MID("&clk", 1, &clk_input_length-2), 0)!=-1)
    ( 
      &match=1
    )
  )
  else if (&wild_head==1)
  (
    if (STRING.MID("clk_src_uim3_mnd", &clk_itr_length-&clk_input_length+1, &clk_input_length-1)==STRING.CUT("&clk", 1))
    ( 
      &match=1
    )
  )
  else if (&wild_tail==1)
  (
    if (STRING.MID("clk_src_uim3_mnd", 0, &clk_input_length-1)==STRING.CUT("&clk", -1))
    ( 
      &match=1
    )
  )
  else if ("clk_src_uim3_mnd"=="&clk")
  (
    &match=1
  )
  
  if (&match==1)
  (
    &clk_test=&CLK_TEST_CLK_SRC_UIM3_MND
    &clk_reg=0
    &clk_reg_name="No CBCR"
    &clk_name="clk_src_uim3_mnd"
    &clk_reg_cbcr_type=""
    &clk_vote_bit=-1.
    &clk_multiplier=1.

    gosub Print_Clk_Info_Line
  )

  &match=0
  &wild_head=0
  &wild_tail=0
  &clk_input_length=STRING.LENGTH("&clk")
  &clk_itr_length=STRING.LENGTH("clk_uart_bit_uim3")

  if (STRING.SCAN("&clk", "*", 0)==0)
  (
    &wild_head=1
  )
  if (STRING.SCAN("&clk", "*", 1)==(STRING.LENGTH("&clk")-1))
  (
    &wild_tail=1
  )

  if ((&wild_head==1)&&(&wild_tail==1))
  (
    if (STRING.SCAN("clk_uart_bit_uim3", STRING.MID("&clk", 1, &clk_input_length-2), 0)!=-1)
    ( 
      &match=1
    )
  )
  else if (&wild_head==1)
  (
    if (STRING.MID("clk_uart_bit_uim3", &clk_itr_length-&clk_input_length+1, &clk_input_length-1)==STRING.CUT("&clk", 1))
    ( 
      &match=1
    )
  )
  else if (&wild_tail==1)
  (
    if (STRING.MID("clk_uart_bit_uim3", 0, &clk_input_length-1)==STRING.CUT("&clk", -1))
    ( 
      &match=1
    )
  )
  else if ("clk_uart_bit_uim3"=="&clk")
  (
    &match=1
  )
  
  if (&match==1)
  (
    &clk_test=&CLK_TEST_CLK_UART_BIT_UIM3
    &clk_reg=&HWIO_MSS_UART_BIT_UIM3_CBCR_ADDR
    &clk_reg_name="MSS_UART_BIT_UIM3_CBCR"
    &clk_name="clk_uart_bit_uim3"
    &clk_reg_cbcr_type="sm_cbc"
    &clk_vote_bit=-1.
    &clk_multiplier=1.

    gosub Print_Clk_Info_Line
  )

  &match=0
  &wild_head=0
  &wild_tail=0
  &clk_input_length=STRING.LENGTH("&clk")
  &clk_itr_length=STRING.LENGTH("clk_mdm")

  if (STRING.SCAN("&clk", "*", 0)==0)
  (
    &wild_head=1
  )
  if (STRING.SCAN("&clk", "*", 1)==(STRING.LENGTH("&clk")-1))
  (
    &wild_tail=1
  )

  if ((&wild_head==1)&&(&wild_tail==1))
  (
    if (STRING.SCAN("clk_mdm", STRING.MID("&clk", 1, &clk_input_length-2), 0)!=-1)
    ( 
      &match=1
    )
  )
  else if (&wild_head==1)
  (
    if (STRING.MID("clk_mdm", &clk_itr_length-&clk_input_length+1, &clk_input_length-1)==STRING.CUT("&clk", 1))
    ( 
      &match=1
    )
  )
  else if (&wild_tail==1)
  (
    if (STRING.MID("clk_mdm", 0, &clk_input_length-1)==STRING.CUT("&clk", -1))
    ( 
      &match=1
    )
  )
  else if ("clk_mdm"=="&clk")
  (
    &match=1
  )
  
  if (&match==1)
  (
    &clk_test=&CLK_TEST_CLK_MDM
    &clk_reg=0
    &clk_reg_name="No CBCR"
    &clk_name="clk_mdm"
    &clk_reg_cbcr_type=""
    &clk_vote_bit=-1.
    &clk_multiplier=1.

    gosub Print_Clk_Info_Line
  )

  &match=0
  &wild_head=0
  &wild_tail=0
  &clk_input_length=STRING.LENGTH("&clk")
  &clk_itr_length=STRING.LENGTH("clk_nav_main")

  if (STRING.SCAN("&clk", "*", 0)==0)
  (
    &wild_head=1
  )
  if (STRING.SCAN("&clk", "*", 1)==(STRING.LENGTH("&clk")-1))
  (
    &wild_tail=1
  )

  if ((&wild_head==1)&&(&wild_tail==1))
  (
    if (STRING.SCAN("clk_nav_main", STRING.MID("&clk", 1, &clk_input_length-2), 0)!=-1)
    ( 
      &match=1
    )
  )
  else if (&wild_head==1)
  (
    if (STRING.MID("clk_nav_main", &clk_itr_length-&clk_input_length+1, &clk_input_length-1)==STRING.CUT("&clk", 1))
    ( 
      &match=1
    )
  )
  else if (&wild_tail==1)
  (
    if (STRING.MID("clk_nav_main", 0, &clk_input_length-1)==STRING.CUT("&clk", -1))
    ( 
      &match=1
    )
  )
  else if ("clk_nav_main"=="&clk")
  (
    &match=1
  )
  
  if (&match==1)
  (
    &clk_test=&CLK_TEST_CLK_NAV_MAIN
    &clk_reg=0
    &clk_reg_name="No CBCR"
    &clk_name="clk_nav_main"
    &clk_reg_cbcr_type=""
    &clk_vote_bit=-1.
    &clk_multiplier=1.

    gosub Print_Clk_Info_Line
  )

  &match=0
  &wild_head=0
  &wild_tail=0
  &clk_input_length=STRING.LENGTH("&clk")
  &clk_itr_length=STRING.LENGTH("clk_nav_adc1")

  if (STRING.SCAN("&clk", "*", 0)==0)
  (
    &wild_head=1
  )
  if (STRING.SCAN("&clk", "*", 1)==(STRING.LENGTH("&clk")-1))
  (
    &wild_tail=1
  )

  if ((&wild_head==1)&&(&wild_tail==1))
  (
    if (STRING.SCAN("clk_nav_adc1", STRING.MID("&clk", 1, &clk_input_length-2), 0)!=-1)
    ( 
      &match=1
    )
  )
  else if (&wild_head==1)
  (
    if (STRING.MID("clk_nav_adc1", &clk_itr_length-&clk_input_length+1, &clk_input_length-1)==STRING.CUT("&clk", 1))
    ( 
      &match=1
    )
  )
  else if (&wild_tail==1)
  (
    if (STRING.MID("clk_nav_adc1", 0, &clk_input_length-1)==STRING.CUT("&clk", -1))
    ( 
      &match=1
    )
  )
  else if ("clk_nav_adc1"=="&clk")
  (
    &match=1
  )
  
  if (&match==1)
  (
    &clk_test=&CLK_TEST_CLK_NAV_ADC1
    &clk_reg=0
    &clk_reg_name="No CBCR"
    &clk_name="clk_nav_adc1"
    &clk_reg_cbcr_type=""
    &clk_vote_bit=-1.
    &clk_multiplier=1.

    gosub Print_Clk_Info_Line
  )

  &match=0
  &wild_head=0
  &wild_tail=0
  &clk_input_length=STRING.LENGTH("&clk")
  &clk_itr_length=STRING.LENGTH("clk_nav_xo")

  if (STRING.SCAN("&clk", "*", 0)==0)
  (
    &wild_head=1
  )
  if (STRING.SCAN("&clk", "*", 1)==(STRING.LENGTH("&clk")-1))
  (
    &wild_tail=1
  )

  if ((&wild_head==1)&&(&wild_tail==1))
  (
    if (STRING.SCAN("clk_nav_xo", STRING.MID("&clk", 1, &clk_input_length-2), 0)!=-1)
    ( 
      &match=1
    )
  )
  else if (&wild_head==1)
  (
    if (STRING.MID("clk_nav_xo", &clk_itr_length-&clk_input_length+1, &clk_input_length-1)==STRING.CUT("&clk", 1))
    ( 
      &match=1
    )
  )
  else if (&wild_tail==1)
  (
    if (STRING.MID("clk_nav_xo", 0, &clk_input_length-1)==STRING.CUT("&clk", -1))
    ( 
      &match=1
    )
  )
  else if ("clk_nav_xo"=="&clk")
  (
    &match=1
  )
  
  if (&match==1)
  (
    &clk_test=&CLK_TEST_CLK_NAV_XO
    &clk_reg=0
    &clk_reg_name="No CBCR"
    &clk_name="clk_nav_xo"
    &clk_reg_cbcr_type=""
    &clk_vote_bit=-1.
    &clk_multiplier=1.

    gosub Print_Clk_Info_Line
  )

  &match=0
  &wild_head=0
  &wild_tail=0
  &clk_input_length=STRING.LENGTH("&clk")
  &clk_itr_length=STRING.LENGTH("mss_qdsp6ss_q6_core_clk")

  if (STRING.SCAN("&clk", "*", 0)==0)
  (
    &wild_head=1
  )
  if (STRING.SCAN("&clk", "*", 1)==(STRING.LENGTH("&clk")-1))
  (
    &wild_tail=1
  )

  if ((&wild_head==1)&&(&wild_tail==1))
  (
    if (STRING.SCAN("mss_qdsp6ss_q6_core_clk", STRING.MID("&clk", 1, &clk_input_length-2), 0)!=-1)
    ( 
      &match=1
    )
  )
  else if (&wild_head==1)
  (
    if (STRING.MID("mss_qdsp6ss_q6_core_clk", &clk_itr_length-&clk_input_length+1, &clk_input_length-1)==STRING.CUT("&clk", 1))
    ( 
      &match=1
    )
  )
  else if (&wild_tail==1)
  (
    if (STRING.MID("mss_qdsp6ss_q6_core_clk", 0, &clk_input_length-1)==STRING.CUT("&clk", -1))
    ( 
      &match=1
    )
  )
  else if ("mss_qdsp6ss_q6_core_clk"=="&clk")||("cpus"=="&clk")
  (
    &match=1
  )
  
  if (&match==1)
  (
    &clk_test=&CLK_TEST_MSS_QDSP6SS_Q6_CORE_CLK
    &clk_reg=0
    &clk_reg_name="No CBCR"
    &clk_name="mss_qdsp6ss_q6_core_clk"
    &clk_reg_cbcr_type=""
    &clk_vote_bit=-1.
    &clk_multiplier=1.

    gosub Print_Clk_Info_Line
  )

  &match=0
  &wild_head=0
  &wild_tail=0
  &clk_input_length=STRING.LENGTH("&clk")
  &clk_itr_length=STRING.LENGTH("mss_qdsp6ss_axi_m_clk")

  if (STRING.SCAN("&clk", "*", 0)==0)
  (
    &wild_head=1
  )
  if (STRING.SCAN("&clk", "*", 1)==(STRING.LENGTH("&clk")-1))
  (
    &wild_tail=1
  )

  if ((&wild_head==1)&&(&wild_tail==1))
  (
    if (STRING.SCAN("mss_qdsp6ss_axi_m_clk", STRING.MID("&clk", 1, &clk_input_length-2), 0)!=-1)
    ( 
      &match=1
    )
  )
  else if (&wild_head==1)
  (
    if (STRING.MID("mss_qdsp6ss_axi_m_clk", &clk_itr_length-&clk_input_length+1, &clk_input_length-1)==STRING.CUT("&clk", 1))
    ( 
      &match=1
    )
  )
  else if (&wild_tail==1)
  (
    if (STRING.MID("mss_qdsp6ss_axi_m_clk", 0, &clk_input_length-1)==STRING.CUT("&clk", -1))
    ( 
      &match=1
    )
  )
  else if ("mss_qdsp6ss_axi_m_clk"=="&clk")
  (
    &match=1
  )
  
  if (&match==1)
  (
    &clk_test=&CLK_TEST_MSS_QDSP6SS_AXI_M_CLK
    &clk_reg=0
    &clk_reg_name="No CBCR"
    &clk_name="mss_qdsp6ss_axi_m_clk"
    &clk_reg_cbcr_type=""
    &clk_vote_bit=-1.
    &clk_multiplier=1.

    gosub Print_Clk_Info_Line
  )

  &match=0
  &wild_head=0
  &wild_tail=0
  &clk_input_length=STRING.LENGTH("&clk")
  &clk_itr_length=STRING.LENGTH("mss_qdsp6ss_ldo_nmo_out")

  if (STRING.SCAN("&clk", "*", 0)==0)
  (
    &wild_head=1
  )
  if (STRING.SCAN("&clk", "*", 1)==(STRING.LENGTH("&clk")-1))
  (
    &wild_tail=1
  )

  if ((&wild_head==1)&&(&wild_tail==1))
  (
    if (STRING.SCAN("mss_qdsp6ss_ldo_nmo_out", STRING.MID("&clk", 1, &clk_input_length-2), 0)!=-1)
    ( 
      &match=1
    )
  )
  else if (&wild_head==1)
  (
    if (STRING.MID("mss_qdsp6ss_ldo_nmo_out", &clk_itr_length-&clk_input_length+1, &clk_input_length-1)==STRING.CUT("&clk", 1))
    ( 
      &match=1
    )
  )
  else if (&wild_tail==1)
  (
    if (STRING.MID("mss_qdsp6ss_ldo_nmo_out", 0, &clk_input_length-1)==STRING.CUT("&clk", -1))
    ( 
      &match=1
    )
  )
  else if ("mss_qdsp6ss_ldo_nmo_out"=="&clk")
  (
    &match=1
  )
  
  if (&match==1)
  (
    &clk_test=&CLK_TEST_MSS_QDSP6SS_LDO_NMO_OUT
    &clk_reg=0
    &clk_reg_name="No CBCR"
    &clk_name="mss_qdsp6ss_ldo_nmo_out"
    &clk_reg_cbcr_type=""
    &clk_vote_bit=-1.
    &clk_multiplier=1.

    gosub Print_Clk_Info_Line
  )

  &match=0
  &wild_head=0
  &wild_tail=0
  &clk_input_length=STRING.LENGTH("&clk")
  &clk_itr_length=STRING.LENGTH("mss_qdsp6ss_ahb_m_clk")

  if (STRING.SCAN("&clk", "*", 0)==0)
  (
    &wild_head=1
  )
  if (STRING.SCAN("&clk", "*", 1)==(STRING.LENGTH("&clk")-1))
  (
    &wild_tail=1
  )

  if ((&wild_head==1)&&(&wild_tail==1))
  (
    if (STRING.SCAN("mss_qdsp6ss_ahb_m_clk", STRING.MID("&clk", 1, &clk_input_length-2), 0)!=-1)
    ( 
      &match=1
    )
  )
  else if (&wild_head==1)
  (
    if (STRING.MID("mss_qdsp6ss_ahb_m_clk", &clk_itr_length-&clk_input_length+1, &clk_input_length-1)==STRING.CUT("&clk", 1))
    ( 
      &match=1
    )
  )
  else if (&wild_tail==1)
  (
    if (STRING.MID("mss_qdsp6ss_ahb_m_clk", 0, &clk_input_length-1)==STRING.CUT("&clk", -1))
    ( 
      &match=1
    )
  )
  else if ("mss_qdsp6ss_ahb_m_clk"=="&clk")
  (
    &match=1
  )
  
  if (&match==1)
  (
    &clk_test=&CLK_TEST_MSS_QDSP6SS_AHB_M_CLK
    &clk_reg=0
    &clk_reg_name="No CBCR"
    &clk_name="mss_qdsp6ss_ahb_m_clk"
    &clk_reg_cbcr_type=""
    &clk_vote_bit=-1.
    &clk_multiplier=1.

    gosub Print_Clk_Info_Line
  )

  &match=0
  &wild_head=0
  &wild_tail=0
  &clk_input_length=STRING.LENGTH("&clk")
  &clk_itr_length=STRING.LENGTH("mss_qdsp6ss_ahb_s_clk")

  if (STRING.SCAN("&clk", "*", 0)==0)
  (
    &wild_head=1
  )
  if (STRING.SCAN("&clk", "*", 1)==(STRING.LENGTH("&clk")-1))
  (
    &wild_tail=1
  )

  if ((&wild_head==1)&&(&wild_tail==1))
  (
    if (STRING.SCAN("mss_qdsp6ss_ahb_s_clk", STRING.MID("&clk", 1, &clk_input_length-2), 0)!=-1)
    ( 
      &match=1
    )
  )
  else if (&wild_head==1)
  (
    if (STRING.MID("mss_qdsp6ss_ahb_s_clk", &clk_itr_length-&clk_input_length+1, &clk_input_length-1)==STRING.CUT("&clk", 1))
    ( 
      &match=1
    )
  )
  else if (&wild_tail==1)
  (
    if (STRING.MID("mss_qdsp6ss_ahb_s_clk", 0, &clk_input_length-1)==STRING.CUT("&clk", -1))
    ( 
      &match=1
    )
  )
  else if ("mss_qdsp6ss_ahb_s_clk"=="&clk")
  (
    &match=1
  )
  
  if (&match==1)
  (
    &clk_test=&CLK_TEST_MSS_QDSP6SS_AHB_S_CLK
    &clk_reg=0
    &clk_reg_name="No CBCR"
    &clk_name="mss_qdsp6ss_ahb_s_clk"
    &clk_reg_cbcr_type=""
    &clk_vote_bit=-1.
    &clk_multiplier=1.

    gosub Print_Clk_Info_Line
  )

  &match=0
  &wild_head=0
  &wild_tail=0
  &clk_input_length=STRING.LENGTH("&clk")
  &clk_itr_length=STRING.LENGTH("mss_qdsp6ss_xo_clk")

  if (STRING.SCAN("&clk", "*", 0)==0)
  (
    &wild_head=1
  )
  if (STRING.SCAN("&clk", "*", 1)==(STRING.LENGTH("&clk")-1))
  (
    &wild_tail=1
  )

  if ((&wild_head==1)&&(&wild_tail==1))
  (
    if (STRING.SCAN("mss_qdsp6ss_xo_clk", STRING.MID("&clk", 1, &clk_input_length-2), 0)!=-1)
    ( 
      &match=1
    )
  )
  else if (&wild_head==1)
  (
    if (STRING.MID("mss_qdsp6ss_xo_clk", &clk_itr_length-&clk_input_length+1, &clk_input_length-1)==STRING.CUT("&clk", 1))
    ( 
      &match=1
    )
  )
  else if (&wild_tail==1)
  (
    if (STRING.MID("mss_qdsp6ss_xo_clk", 0, &clk_input_length-1)==STRING.CUT("&clk", -1))
    ( 
      &match=1
    )
  )
  else if ("mss_qdsp6ss_xo_clk"=="&clk")
  (
    &match=1
  )
  
  if (&match==1)
  (
    &clk_test=&CLK_TEST_MSS_QDSP6SS_XO_CLK
    &clk_reg=0
    &clk_reg_name="No CBCR"
    &clk_name="mss_qdsp6ss_xo_clk"
    &clk_reg_cbcr_type=""
    &clk_vote_bit=-1.
    &clk_multiplier=1.

    gosub Print_Clk_Info_Line
  )

  &match=0
  &wild_head=0
  &wild_tail=0
  &clk_input_length=STRING.LENGTH("&clk")
  &clk_itr_length=STRING.LENGTH("mss_qdsp6ss_sleep_clk")

  if (STRING.SCAN("&clk", "*", 0)==0)
  (
    &wild_head=1
  )
  if (STRING.SCAN("&clk", "*", 1)==(STRING.LENGTH("&clk")-1))
  (
    &wild_tail=1
  )

  if ((&wild_head==1)&&(&wild_tail==1))
  (
    if (STRING.SCAN("mss_qdsp6ss_sleep_clk", STRING.MID("&clk", 1, &clk_input_length-2), 0)!=-1)
    ( 
      &match=1
    )
  )
  else if (&wild_head==1)
  (
    if (STRING.MID("mss_qdsp6ss_sleep_clk", &clk_itr_length-&clk_input_length+1, &clk_input_length-1)==STRING.CUT("&clk", 1))
    ( 
      &match=1
    )
  )
  else if (&wild_tail==1)
  (
    if (STRING.MID("mss_qdsp6ss_sleep_clk", 0, &clk_input_length-1)==STRING.CUT("&clk", -1))
    ( 
      &match=1
    )
  )
  else if ("mss_qdsp6ss_sleep_clk"=="&clk")
  (
    &match=1
  )
  
  if (&match==1)
  (
    &clk_test=&CLK_TEST_MSS_QDSP6SS_SLEEP_CLK
    &clk_reg=0
    &clk_reg_name="No CBCR"
    &clk_name="mss_qdsp6ss_sleep_clk"
    &clk_reg_cbcr_type=""
    &clk_vote_bit=-1.
    &clk_multiplier=1.

    gosub Print_Clk_Info_Line
  )

  &match=0
  &wild_head=0
  &wild_tail=0
  &clk_input_length=STRING.LENGTH("&clk")
  &clk_itr_length=STRING.LENGTH("mss_qdsp6ss_jtag_tck")

  if (STRING.SCAN("&clk", "*", 0)==0)
  (
    &wild_head=1
  )
  if (STRING.SCAN("&clk", "*", 1)==(STRING.LENGTH("&clk")-1))
  (
    &wild_tail=1
  )

  if ((&wild_head==1)&&(&wild_tail==1))
  (
    if (STRING.SCAN("mss_qdsp6ss_jtag_tck", STRING.MID("&clk", 1, &clk_input_length-2), 0)!=-1)
    ( 
      &match=1
    )
  )
  else if (&wild_head==1)
  (
    if (STRING.MID("mss_qdsp6ss_jtag_tck", &clk_itr_length-&clk_input_length+1, &clk_input_length-1)==STRING.CUT("&clk", 1))
    ( 
      &match=1
    )
  )
  else if (&wild_tail==1)
  (
    if (STRING.MID("mss_qdsp6ss_jtag_tck", 0, &clk_input_length-1)==STRING.CUT("&clk", -1))
    ( 
      &match=1
    )
  )
  else if ("mss_qdsp6ss_jtag_tck"=="&clk")
  (
    &match=1
  )
  
  if (&match==1)
  (
    &clk_test=&CLK_TEST_MSS_QDSP6SS_JTAG_TCK
    &clk_reg=0
    &clk_reg_name="No CBCR"
    &clk_name="mss_qdsp6ss_jtag_tck"
    &clk_reg_cbcr_type=""
    &clk_vote_bit=-1.
    &clk_multiplier=1.

    gosub Print_Clk_Info_Line
  )

  &match=0
  &wild_head=0
  &wild_tail=0
  &clk_input_length=STRING.LENGTH("&clk")
  &clk_itr_length=STRING.LENGTH("mss_qdsp6ss_atb_clk")

  if (STRING.SCAN("&clk", "*", 0)==0)
  (
    &wild_head=1
  )
  if (STRING.SCAN("&clk", "*", 1)==(STRING.LENGTH("&clk")-1))
  (
    &wild_tail=1
  )

  if ((&wild_head==1)&&(&wild_tail==1))
  (
    if (STRING.SCAN("mss_qdsp6ss_atb_clk", STRING.MID("&clk", 1, &clk_input_length-2), 0)!=-1)
    ( 
      &match=1
    )
  )
  else if (&wild_head==1)
  (
    if (STRING.MID("mss_qdsp6ss_atb_clk", &clk_itr_length-&clk_input_length+1, &clk_input_length-1)==STRING.CUT("&clk", 1))
    ( 
      &match=1
    )
  )
  else if (&wild_tail==1)
  (
    if (STRING.MID("mss_qdsp6ss_atb_clk", 0, &clk_input_length-1)==STRING.CUT("&clk", -1))
    ( 
      &match=1
    )
  )
  else if ("mss_qdsp6ss_atb_clk"=="&clk")
  (
    &match=1
  )
  
  if (&match==1)
  (
    &clk_test=&CLK_TEST_MSS_QDSP6SS_ATB_CLK
    &clk_reg=0
    &clk_reg_name="No CBCR"
    &clk_name="mss_qdsp6ss_atb_clk"
    &clk_reg_cbcr_type=""
    &clk_vote_bit=-1.
    &clk_multiplier=1.

    gosub Print_Clk_Info_Line
  )

  &match=0
  &wild_head=0
  &wild_tail=0
  &clk_input_length=STRING.LENGTH("&clk")
  &clk_itr_length=STRING.LENGTH("mss_qdsp6ss_apb_clk")

  if (STRING.SCAN("&clk", "*", 0)==0)
  (
    &wild_head=1
  )
  if (STRING.SCAN("&clk", "*", 1)==(STRING.LENGTH("&clk")-1))
  (
    &wild_tail=1
  )

  if ((&wild_head==1)&&(&wild_tail==1))
  (
    if (STRING.SCAN("mss_qdsp6ss_apb_clk", STRING.MID("&clk", 1, &clk_input_length-2), 0)!=-1)
    ( 
      &match=1
    )
  )
  else if (&wild_head==1)
  (
    if (STRING.MID("mss_qdsp6ss_apb_clk", &clk_itr_length-&clk_input_length+1, &clk_input_length-1)==STRING.CUT("&clk", 1))
    ( 
      &match=1
    )
  )
  else if (&wild_tail==1)
  (
    if (STRING.MID("mss_qdsp6ss_apb_clk", 0, &clk_input_length-1)==STRING.CUT("&clk", -1))
    ( 
      &match=1
    )
  )
  else if ("mss_qdsp6ss_apb_clk"=="&clk")
  (
    &match=1
  )
  
  if (&match==1)
  (
    &clk_test=&CLK_TEST_MSS_QDSP6SS_APB_CLK
    &clk_reg=0
    &clk_reg_name="No CBCR"
    &clk_name="mss_qdsp6ss_apb_clk"
    &clk_reg_cbcr_type=""
    &clk_vote_bit=-1.
    &clk_multiplier=1.

    gosub Print_Clk_Info_Line
  )

  &match=0
  &wild_head=0
  &wild_tail=0
  &clk_input_length=STRING.LENGTH("&clk")
  &clk_itr_length=STRING.LENGTH("mss_qdsp6ss_timestamp_clk")

  if (STRING.SCAN("&clk", "*", 0)==0)
  (
    &wild_head=1
  )
  if (STRING.SCAN("&clk", "*", 1)==(STRING.LENGTH("&clk")-1))
  (
    &wild_tail=1
  )

  if ((&wild_head==1)&&(&wild_tail==1))
  (
    if (STRING.SCAN("mss_qdsp6ss_timestamp_clk", STRING.MID("&clk", 1, &clk_input_length-2), 0)!=-1)
    ( 
      &match=1
    )
  )
  else if (&wild_head==1)
  (
    if (STRING.MID("mss_qdsp6ss_timestamp_clk", &clk_itr_length-&clk_input_length+1, &clk_input_length-1)==STRING.CUT("&clk", 1))
    ( 
      &match=1
    )
  )
  else if (&wild_tail==1)
  (
    if (STRING.MID("mss_qdsp6ss_timestamp_clk", 0, &clk_input_length-1)==STRING.CUT("&clk", -1))
    ( 
      &match=1
    )
  )
  else if ("mss_qdsp6ss_timestamp_clk"=="&clk")
  (
    &match=1
  )
  
  if (&match==1)
  (
    &clk_test=&CLK_TEST_MSS_QDSP6SS_TIMESTAMP_CLK
    &clk_reg=0
    &clk_reg_name="No CBCR"
    &clk_name="mss_qdsp6ss_timestamp_clk"
    &clk_reg_cbcr_type=""
    &clk_vote_bit=-1.
    &clk_multiplier=1.

    gosub Print_Clk_Info_Line
  )

  &match=0
  &wild_head=0
  &wild_tail=0
  &clk_input_length=STRING.LENGTH("&clk")
  &clk_itr_length=STRING.LENGTH("clk_axi_crypto")

  if (STRING.SCAN("&clk", "*", 0)==0)
  (
    &wild_head=1
  )
  if (STRING.SCAN("&clk", "*", 1)==(STRING.LENGTH("&clk")-1))
  (
    &wild_tail=1
  )

  if ((&wild_head==1)&&(&wild_tail==1))
  (
    if (STRING.SCAN("clk_axi_crypto", STRING.MID("&clk", 1, &clk_input_length-2), 0)!=-1)
    ( 
      &match=1
    )
  )
  else if (&wild_head==1)
  (
    if (STRING.MID("clk_axi_crypto", &clk_itr_length-&clk_input_length+1, &clk_input_length-1)==STRING.CUT("&clk", 1))
    ( 
      &match=1
    )
  )
  else if (&wild_tail==1)
  (
    if (STRING.MID("clk_axi_crypto", 0, &clk_input_length-1)==STRING.CUT("&clk", -1))
    ( 
      &match=1
    )
  )
  else if ("clk_axi_crypto"=="&clk")
  (
    &match=1
  )
  
  if (&match==1)
  (
    &clk_test=&CLK_TEST_CLK_AXI_CRYPTO
    &clk_reg=0
    &clk_reg_name="No CBCR"
    &clk_name="clk_axi_crypto"
    &clk_reg_cbcr_type=""
    &clk_vote_bit=-1.
    &clk_multiplier=1.

    gosub Print_Clk_Info_Line
  )

  &match=0
  &wild_head=0
  &wild_tail=0
  &clk_input_length=STRING.LENGTH("&clk")
  &clk_itr_length=STRING.LENGTH("clk_bus_pseudo_hm_rcg")

  if (STRING.SCAN("&clk", "*", 0)==0)
  (
    &wild_head=1
  )
  if (STRING.SCAN("&clk", "*", 1)==(STRING.LENGTH("&clk")-1))
  (
    &wild_tail=1
  )

  if ((&wild_head==1)&&(&wild_tail==1))
  (
    if (STRING.SCAN("clk_bus_pseudo_hm_rcg", STRING.MID("&clk", 1, &clk_input_length-2), 0)!=-1)
    ( 
      &match=1
    )
  )
  else if (&wild_head==1)
  (
    if (STRING.MID("clk_bus_pseudo_hm_rcg", &clk_itr_length-&clk_input_length+1, &clk_input_length-1)==STRING.CUT("&clk", 1))
    ( 
      &match=1
    )
  )
  else if (&wild_tail==1)
  (
    if (STRING.MID("clk_bus_pseudo_hm_rcg", 0, &clk_input_length-1)==STRING.CUT("&clk", -1))
    ( 
      &match=1
    )
  )
  else if ("clk_bus_pseudo_hm_rcg"=="&clk")
  (
    &match=1
  )
  
  if (&match==1)
  (
    &clk_test=&CLK_TEST_CLK_BUS_PSEUDO_HM_RCG
    &clk_reg=0
    &clk_reg_name="No CBCR"
    &clk_name="clk_bus_pseudo_hm_rcg"
    &clk_reg_cbcr_type=""
    &clk_vote_bit=-1.
    &clk_multiplier=1.

    gosub Print_Clk_Info_Line
  )

  &match=0
  &wild_head=0
  &wild_tail=0
  &clk_input_length=STRING.LENGTH("&clk")
  &clk_itr_length=STRING.LENGTH("clk_xo_cx")

  if (STRING.SCAN("&clk", "*", 0)==0)
  (
    &wild_head=1
  )
  if (STRING.SCAN("&clk", "*", 1)==(STRING.LENGTH("&clk")-1))
  (
    &wild_tail=1
  )

  if ((&wild_head==1)&&(&wild_tail==1))
  (
    if (STRING.SCAN("clk_xo_cx", STRING.MID("&clk", 1, &clk_input_length-2), 0)!=-1)
    ( 
      &match=1
    )
  )
  else if (&wild_head==1)
  (
    if (STRING.MID("clk_xo_cx", &clk_itr_length-&clk_input_length+1, &clk_input_length-1)==STRING.CUT("&clk", 1))
    ( 
      &match=1
    )
  )
  else if (&wild_tail==1)
  (
    if (STRING.MID("clk_xo_cx", 0, &clk_input_length-1)==STRING.CUT("&clk", -1))
    ( 
      &match=1
    )
  )
  else if ("clk_xo_cx"=="&clk")
  (
    &match=1
  )
  
  if (&match==1)
  (
    &clk_test=&CLK_TEST_CLK_XO_CX
    &clk_reg=0
    &clk_reg_name="No CBCR"
    &clk_name="clk_xo_cx"
    &clk_reg_cbcr_type=""
    &clk_vote_bit=-1.
    &clk_multiplier=1.

    gosub Print_Clk_Info_Line
  )

  &match=0
  &wild_head=0
  &wild_tail=0
  &clk_input_length=STRING.LENGTH("&clk")
  &clk_itr_length=STRING.LENGTH("dbg_dtr_clksig")

  if (STRING.SCAN("&clk", "*", 0)==0)
  (
    &wild_head=1
  )
  if (STRING.SCAN("&clk", "*", 1)==(STRING.LENGTH("&clk")-1))
  (
    &wild_tail=1
  )

  if ((&wild_head==1)&&(&wild_tail==1))
  (
    if (STRING.SCAN("dbg_dtr_clksig", STRING.MID("&clk", 1, &clk_input_length-2), 0)!=-1)
    ( 
      &match=1
    )
  )
  else if (&wild_head==1)
  (
    if (STRING.MID("dbg_dtr_clksig", &clk_itr_length-&clk_input_length+1, &clk_input_length-1)==STRING.CUT("&clk", 1))
    ( 
      &match=1
    )
  )
  else if (&wild_tail==1)
  (
    if (STRING.MID("dbg_dtr_clksig", 0, &clk_input_length-1)==STRING.CUT("&clk", -1))
    ( 
      &match=1
    )
  )
  else if ("dbg_dtr_clksig"=="&clk")
  (
    &match=1
  )
  
  if (&match==1)
  (
    &clk_test=&CLK_TEST_DBG_DTR_CLKSIG
    &clk_reg=0
    &clk_reg_name="No CBCR"
    &clk_name="dbg_dtr_clksig"
    &clk_reg_cbcr_type=""
    &clk_vote_bit=-1.
    &clk_multiplier=1.

    gosub Print_Clk_Info_Line
  )

  &match=0
  &wild_head=0
  &wild_tail=0
  &clk_input_length=STRING.LENGTH("&clk")
  &clk_itr_length=STRING.LENGTH("dbg_modem_clksig")

  if (STRING.SCAN("&clk", "*", 0)==0)
  (
    &wild_head=1
  )
  if (STRING.SCAN("&clk", "*", 1)==(STRING.LENGTH("&clk")-1))
  (
    &wild_tail=1
  )

  if ((&wild_head==1)&&(&wild_tail==1))
  (
    if (STRING.SCAN("dbg_modem_clksig", STRING.MID("&clk", 1, &clk_input_length-2), 0)!=-1)
    ( 
      &match=1
    )
  )
  else if (&wild_head==1)
  (
    if (STRING.MID("dbg_modem_clksig", &clk_itr_length-&clk_input_length+1, &clk_input_length-1)==STRING.CUT("&clk", 1))
    ( 
      &match=1
    )
  )
  else if (&wild_tail==1)
  (
    if (STRING.MID("dbg_modem_clksig", 0, &clk_input_length-1)==STRING.CUT("&clk", -1))
    ( 
      &match=1
    )
  )
  else if ("dbg_modem_clksig"=="&clk")
  (
    &match=1
  )
  
  if (&match==1)
  (
    &clk_test=&CLK_TEST_DBG_MODEM_CLKSIG
    &clk_reg=0
    &clk_reg_name="No CBCR"
    &clk_name="dbg_modem_clksig"
    &clk_reg_cbcr_type=""
    &clk_vote_bit=-1.
    &clk_multiplier=1.

    gosub Print_Clk_Info_Line
  )

  &match=0
  &wild_head=0
  &wild_tail=0
  &clk_input_length=STRING.LENGTH("&clk")
  &clk_itr_length=STRING.LENGTH("dbg_nav_clksig")

  if (STRING.SCAN("&clk", "*", 0)==0)
  (
    &wild_head=1
  )
  if (STRING.SCAN("&clk", "*", 1)==(STRING.LENGTH("&clk")-1))
  (
    &wild_tail=1
  )

  if ((&wild_head==1)&&(&wild_tail==1))
  (
    if (STRING.SCAN("dbg_nav_clksig", STRING.MID("&clk", 1, &clk_input_length-2), 0)!=-1)
    ( 
      &match=1
    )
  )
  else if (&wild_head==1)
  (
    if (STRING.MID("dbg_nav_clksig", &clk_itr_length-&clk_input_length+1, &clk_input_length-1)==STRING.CUT("&clk", 1))
    ( 
      &match=1
    )
  )
  else if (&wild_tail==1)
  (
    if (STRING.MID("dbg_nav_clksig", 0, &clk_input_length-1)==STRING.CUT("&clk", -1))
    ( 
      &match=1
    )
  )
  else if ("dbg_nav_clksig"=="&clk")
  (
    &match=1
  )
  
  if (&match==1)
  (
    &clk_test=&CLK_TEST_DBG_NAV_CLKSIG
    &clk_reg=0
    &clk_reg_name="No CBCR"
    &clk_name="dbg_nav_clksig"
    &clk_reg_cbcr_type=""
    &clk_vote_bit=-1.
    &clk_multiplier=1.

    gosub Print_Clk_Info_Line
  )

  &match=0
  &wild_head=0
  &wild_tail=0
  &clk_input_length=STRING.LENGTH("&clk")
  &clk_itr_length=STRING.LENGTH("dbg_q6_clksig")

  if (STRING.SCAN("&clk", "*", 0)==0)
  (
    &wild_head=1
  )
  if (STRING.SCAN("&clk", "*", 1)==(STRING.LENGTH("&clk")-1))
  (
    &wild_tail=1
  )

  if ((&wild_head==1)&&(&wild_tail==1))
  (
    if (STRING.SCAN("dbg_q6_clksig", STRING.MID("&clk", 1, &clk_input_length-2), 0)!=-1)
    ( 
      &match=1
    )
  )
  else if (&wild_head==1)
  (
    if (STRING.MID("dbg_q6_clksig", &clk_itr_length-&clk_input_length+1, &clk_input_length-1)==STRING.CUT("&clk", 1))
    ( 
      &match=1
    )
  )
  else if (&wild_tail==1)
  (
    if (STRING.MID("dbg_q6_clksig", 0, &clk_input_length-1)==STRING.CUT("&clk", -1))
    ( 
      &match=1
    )
  )
  else if ("dbg_q6_clksig"=="&clk")
  (
    &match=1
  )
  
  if (&match==1)
  (
    &clk_test=&CLK_TEST_DBG_Q6_CLKSIG
    &clk_reg=0
    &clk_reg_name="No CBCR"
    &clk_name="dbg_q6_clksig"
    &clk_reg_cbcr_type=""
    &clk_vote_bit=-1.
    &clk_multiplier=1.

    gosub Print_Clk_Info_Line
  )

  &match=0
  &wild_head=0
  &wild_tail=0
  &clk_input_length=STRING.LENGTH("&clk")
  &clk_itr_length=STRING.LENGTH("dtr1_pll_dtest")

  if (STRING.SCAN("&clk", "*", 0)==0)
  (
    &wild_head=1
  )
  if (STRING.SCAN("&clk", "*", 1)==(STRING.LENGTH("&clk")-1))
  (
    &wild_tail=1
  )

  if ((&wild_head==1)&&(&wild_tail==1))
  (
    if (STRING.SCAN("dtr1_pll_dtest", STRING.MID("&clk", 1, &clk_input_length-2), 0)!=-1)
    ( 
      &match=1
    )
  )
  else if (&wild_head==1)
  (
    if (STRING.MID("dtr1_pll_dtest", &clk_itr_length-&clk_input_length+1, &clk_input_length-1)==STRING.CUT("&clk", 1))
    ( 
      &match=1
    )
  )
  else if (&wild_tail==1)
  (
    if (STRING.MID("dtr1_pll_dtest", 0, &clk_input_length-1)==STRING.CUT("&clk", -1))
    ( 
      &match=1
    )
  )
  else if ("dtr1_pll_dtest"=="&clk")
  (
    &match=1
  )
  
  if (&match==1)
  (
    &clk_test=&CLK_TEST_DTR1_PLL_DTEST
    &clk_reg=0
    &clk_reg_name="No CBCR"
    &clk_name="dtr1_pll_dtest"
    &clk_reg_cbcr_type=""
    &clk_vote_bit=-1.
    &clk_multiplier=1.

    gosub Print_Clk_Info_Line
  )

  &match=0
  &wild_head=0
  &wild_tail=0
  &clk_input_length=STRING.LENGTH("&clk")
  &clk_itr_length=STRING.LENGTH("dtr1_pll_lock_det")

  if (STRING.SCAN("&clk", "*", 0)==0)
  (
    &wild_head=1
  )
  if (STRING.SCAN("&clk", "*", 1)==(STRING.LENGTH("&clk")-1))
  (
    &wild_tail=1
  )

  if ((&wild_head==1)&&(&wild_tail==1))
  (
    if (STRING.SCAN("dtr1_pll_lock_det", STRING.MID("&clk", 1, &clk_input_length-2), 0)!=-1)
    ( 
      &match=1
    )
  )
  else if (&wild_head==1)
  (
    if (STRING.MID("dtr1_pll_lock_det", &clk_itr_length-&clk_input_length+1, &clk_input_length-1)==STRING.CUT("&clk", 1))
    ( 
      &match=1
    )
  )
  else if (&wild_tail==1)
  (
    if (STRING.MID("dtr1_pll_lock_det", 0, &clk_input_length-1)==STRING.CUT("&clk", -1))
    ( 
      &match=1
    )
  )
  else if ("dtr1_pll_lock_det"=="&clk")
  (
    &match=1
  )
  
  if (&match==1)
  (
    &clk_test=&CLK_TEST_DTR1_PLL_LOCK_DET
    &clk_reg=0
    &clk_reg_name="No CBCR"
    &clk_name="dtr1_pll_lock_det"
    &clk_reg_cbcr_type=""
    &clk_vote_bit=-1.
    &clk_multiplier=1.

    gosub Print_Clk_Info_Line
  )

  &match=0
  &wild_head=0
  &wild_tail=0
  &clk_input_length=STRING.LENGTH("&clk")
  &clk_itr_length=STRING.LENGTH("dtr2_pll_dtest")

  if (STRING.SCAN("&clk", "*", 0)==0)
  (
    &wild_head=1
  )
  if (STRING.SCAN("&clk", "*", 1)==(STRING.LENGTH("&clk")-1))
  (
    &wild_tail=1
  )

  if ((&wild_head==1)&&(&wild_tail==1))
  (
    if (STRING.SCAN("dtr2_pll_dtest", STRING.MID("&clk", 1, &clk_input_length-2), 0)!=-1)
    ( 
      &match=1
    )
  )
  else if (&wild_head==1)
  (
    if (STRING.MID("dtr2_pll_dtest", &clk_itr_length-&clk_input_length+1, &clk_input_length-1)==STRING.CUT("&clk", 1))
    ( 
      &match=1
    )
  )
  else if (&wild_tail==1)
  (
    if (STRING.MID("dtr2_pll_dtest", 0, &clk_input_length-1)==STRING.CUT("&clk", -1))
    ( 
      &match=1
    )
  )
  else if ("dtr2_pll_dtest"=="&clk")
  (
    &match=1
  )
  
  if (&match==1)
  (
    &clk_test=&CLK_TEST_DTR2_PLL_DTEST
    &clk_reg=0
    &clk_reg_name="No CBCR"
    &clk_name="dtr2_pll_dtest"
    &clk_reg_cbcr_type=""
    &clk_vote_bit=-1.
    &clk_multiplier=1.

    gosub Print_Clk_Info_Line
  )

  &match=0
  &wild_head=0
  &wild_tail=0
  &clk_input_length=STRING.LENGTH("&clk")
  &clk_itr_length=STRING.LENGTH("dtr2_pll_lock_det")

  if (STRING.SCAN("&clk", "*", 0)==0)
  (
    &wild_head=1
  )
  if (STRING.SCAN("&clk", "*", 1)==(STRING.LENGTH("&clk")-1))
  (
    &wild_tail=1
  )

  if ((&wild_head==1)&&(&wild_tail==1))
  (
    if (STRING.SCAN("dtr2_pll_lock_det", STRING.MID("&clk", 1, &clk_input_length-2), 0)!=-1)
    ( 
      &match=1
    )
  )
  else if (&wild_head==1)
  (
    if (STRING.MID("dtr2_pll_lock_det", &clk_itr_length-&clk_input_length+1, &clk_input_length-1)==STRING.CUT("&clk", 1))
    ( 
      &match=1
    )
  )
  else if (&wild_tail==1)
  (
    if (STRING.MID("dtr2_pll_lock_det", 0, &clk_input_length-1)==STRING.CUT("&clk", -1))
    ( 
      &match=1
    )
  )
  else if ("dtr2_pll_lock_det"=="&clk")
  (
    &match=1
  )
  
  if (&match==1)
  (
    &clk_test=&CLK_TEST_DTR2_PLL_LOCK_DET
    &clk_reg=0
    &clk_reg_name="No CBCR"
    &clk_name="dtr2_pll_lock_det"
    &clk_reg_cbcr_type=""
    &clk_vote_bit=-1.
    &clk_multiplier=1.

    gosub Print_Clk_Info_Line
  )

  &match=0
  &wild_head=0
  &wild_tail=0
  &clk_input_length=STRING.LENGTH("&clk")
  &clk_itr_length=STRING.LENGTH("modem_offline_pll_dtest")

  if (STRING.SCAN("&clk", "*", 0)==0)
  (
    &wild_head=1
  )
  if (STRING.SCAN("&clk", "*", 1)==(STRING.LENGTH("&clk")-1))
  (
    &wild_tail=1
  )

  if ((&wild_head==1)&&(&wild_tail==1))
  (
    if (STRING.SCAN("modem_offline_pll_dtest", STRING.MID("&clk", 1, &clk_input_length-2), 0)!=-1)
    ( 
      &match=1
    )
  )
  else if (&wild_head==1)
  (
    if (STRING.MID("modem_offline_pll_dtest", &clk_itr_length-&clk_input_length+1, &clk_input_length-1)==STRING.CUT("&clk", 1))
    ( 
      &match=1
    )
  )
  else if (&wild_tail==1)
  (
    if (STRING.MID("modem_offline_pll_dtest", 0, &clk_input_length-1)==STRING.CUT("&clk", -1))
    ( 
      &match=1
    )
  )
  else if ("modem_offline_pll_dtest"=="&clk")
  (
    &match=1
  )
  
  if (&match==1)
  (
    &clk_test=&CLK_TEST_MODEM_OFFLINE_PLL_DTEST
    &clk_reg=0
    &clk_reg_name="No CBCR"
    &clk_name="modem_offline_pll_dtest"
    &clk_reg_cbcr_type=""
    &clk_vote_bit=-1.
    &clk_multiplier=1.

    gosub Print_Clk_Info_Line
  )

  &match=0
  &wild_head=0
  &wild_tail=0
  &clk_input_length=STRING.LENGTH("&clk")
  &clk_itr_length=STRING.LENGTH("mss_dgr_axi_clk")

  if (STRING.SCAN("&clk", "*", 0)==0)
  (
    &wild_head=1
  )
  if (STRING.SCAN("&clk", "*", 1)==(STRING.LENGTH("&clk")-1))
  (
    &wild_tail=1
  )

  if ((&wild_head==1)&&(&wild_tail==1))
  (
    if (STRING.SCAN("mss_dgr_axi_clk", STRING.MID("&clk", 1, &clk_input_length-2), 0)!=-1)
    ( 
      &match=1
    )
  )
  else if (&wild_head==1)
  (
    if (STRING.MID("mss_dgr_axi_clk", &clk_itr_length-&clk_input_length+1, &clk_input_length-1)==STRING.CUT("&clk", 1))
    ( 
      &match=1
    )
  )
  else if (&wild_tail==1)
  (
    if (STRING.MID("mss_dgr_axi_clk", 0, &clk_input_length-1)==STRING.CUT("&clk", -1))
    ( 
      &match=1
    )
  )
  else if ("mss_dgr_axi_clk"=="&clk")
  (
    &match=1
  )
  
  if (&match==1)
  (
    &clk_test=&CLK_TEST_MSS_DGR_AXI_CLK
    &clk_reg=0
    &clk_reg_name="No CBCR"
    &clk_name="mss_dgr_axi_clk"
    &clk_reg_cbcr_type=""
    &clk_vote_bit=-1.
    &clk_multiplier=1.

    gosub Print_Clk_Info_Line
  )

  &match=0
  &wild_head=0
  &wild_tail=0
  &clk_input_length=STRING.LENGTH("&clk")
  &clk_itr_length=STRING.LENGTH("mss_offline_pll_lock_det")

  if (STRING.SCAN("&clk", "*", 0)==0)
  (
    &wild_head=1
  )
  if (STRING.SCAN("&clk", "*", 1)==(STRING.LENGTH("&clk")-1))
  (
    &wild_tail=1
  )

  if ((&wild_head==1)&&(&wild_tail==1))
  (
    if (STRING.SCAN("mss_offline_pll_lock_det", STRING.MID("&clk", 1, &clk_input_length-2), 0)!=-1)
    ( 
      &match=1
    )
  )
  else if (&wild_head==1)
  (
    if (STRING.MID("mss_offline_pll_lock_det", &clk_itr_length-&clk_input_length+1, &clk_input_length-1)==STRING.CUT("&clk", 1))
    ( 
      &match=1
    )
  )
  else if (&wild_tail==1)
  (
    if (STRING.MID("mss_offline_pll_lock_det", 0, &clk_input_length-1)==STRING.CUT("&clk", -1))
    ( 
      &match=1
    )
  )
  else if ("mss_offline_pll_lock_det"=="&clk")
  (
    &match=1
  )
  
  if (&match==1)
  (
    &clk_test=&CLK_TEST_MSS_OFFLINE_PLL_LOCK_DET
    &clk_reg=0
    &clk_reg_name="No CBCR"
    &clk_name="mss_offline_pll_lock_det"
    &clk_reg_cbcr_type=""
    &clk_vote_bit=-1.
    &clk_multiplier=1.

    gosub Print_Clk_Info_Line
  )

  &match=0
  &wild_head=0
  &wild_tail=0
  &clk_input_length=STRING.LENGTH("&clk")
  &clk_itr_length=STRING.LENGTH("nav_pll_dtest")

  if (STRING.SCAN("&clk", "*", 0)==0)
  (
    &wild_head=1
  )
  if (STRING.SCAN("&clk", "*", 1)==(STRING.LENGTH("&clk")-1))
  (
    &wild_tail=1
  )

  if ((&wild_head==1)&&(&wild_tail==1))
  (
    if (STRING.SCAN("nav_pll_dtest", STRING.MID("&clk", 1, &clk_input_length-2), 0)!=-1)
    ( 
      &match=1
    )
  )
  else if (&wild_head==1)
  (
    if (STRING.MID("nav_pll_dtest", &clk_itr_length-&clk_input_length+1, &clk_input_length-1)==STRING.CUT("&clk", 1))
    ( 
      &match=1
    )
  )
  else if (&wild_tail==1)
  (
    if (STRING.MID("nav_pll_dtest", 0, &clk_input_length-1)==STRING.CUT("&clk", -1))
    ( 
      &match=1
    )
  )
  else if ("nav_pll_dtest"=="&clk")
  (
    &match=1
  )
  
  if (&match==1)
  (
    &clk_test=&CLK_TEST_NAV_PLL_DTEST
    &clk_reg=0
    &clk_reg_name="No CBCR"
    &clk_name="nav_pll_dtest"
    &clk_reg_cbcr_type=""
    &clk_vote_bit=-1.
    &clk_multiplier=1.

    gosub Print_Clk_Info_Line
  )

  &match=0
  &wild_head=0
  &wild_tail=0
  &clk_input_length=STRING.LENGTH("&clk")
  &clk_itr_length=STRING.LENGTH("nav_pll_lock_det")

  if (STRING.SCAN("&clk", "*", 0)==0)
  (
    &wild_head=1
  )
  if (STRING.SCAN("&clk", "*", 1)==(STRING.LENGTH("&clk")-1))
  (
    &wild_tail=1
  )

  if ((&wild_head==1)&&(&wild_tail==1))
  (
    if (STRING.SCAN("nav_pll_lock_det", STRING.MID("&clk", 1, &clk_input_length-2), 0)!=-1)
    ( 
      &match=1
    )
  )
  else if (&wild_head==1)
  (
    if (STRING.MID("nav_pll_lock_det", &clk_itr_length-&clk_input_length+1, &clk_input_length-1)==STRING.CUT("&clk", 1))
    ( 
      &match=1
    )
  )
  else if (&wild_tail==1)
  (
    if (STRING.MID("nav_pll_lock_det", 0, &clk_input_length-1)==STRING.CUT("&clk", -1))
    ( 
      &match=1
    )
  )
  else if ("nav_pll_lock_det"=="&clk")
  (
    &match=1
  )
  
  if (&match==1)
  (
    &clk_test=&CLK_TEST_NAV_PLL_LOCK_DET
    &clk_reg=0
    &clk_reg_name="No CBCR"
    &clk_name="nav_pll_lock_det"
    &clk_reg_cbcr_type=""
    &clk_vote_bit=-1.
    &clk_multiplier=1.

    gosub Print_Clk_Info_Line
  )

  &match=0
  &wild_head=0
  &wild_tail=0
  &clk_input_length=STRING.LENGTH("&clk")
  &clk_itr_length=STRING.LENGTH("q6_pll_dtest")

  if (STRING.SCAN("&clk", "*", 0)==0)
  (
    &wild_head=1
  )
  if (STRING.SCAN("&clk", "*", 1)==(STRING.LENGTH("&clk")-1))
  (
    &wild_tail=1
  )

  if ((&wild_head==1)&&(&wild_tail==1))
  (
    if (STRING.SCAN("q6_pll_dtest", STRING.MID("&clk", 1, &clk_input_length-2), 0)!=-1)
    ( 
      &match=1
    )
  )
  else if (&wild_head==1)
  (
    if (STRING.MID("q6_pll_dtest", &clk_itr_length-&clk_input_length+1, &clk_input_length-1)==STRING.CUT("&clk", 1))
    ( 
      &match=1
    )
  )
  else if (&wild_tail==1)
  (
    if (STRING.MID("q6_pll_dtest", 0, &clk_input_length-1)==STRING.CUT("&clk", -1))
    ( 
      &match=1
    )
  )
  else if ("q6_pll_dtest"=="&clk")
  (
    &match=1
  )
  
  if (&match==1)
  (
    &clk_test=&CLK_TEST_Q6_PLL_DTEST
    &clk_reg=0
    &clk_reg_name="No CBCR"
    &clk_name="q6_pll_dtest"
    &clk_reg_cbcr_type=""
    &clk_vote_bit=-1.
    &clk_multiplier=1.

    gosub Print_Clk_Info_Line
  )

  &match=0
  &wild_head=0
  &wild_tail=0
  &clk_input_length=STRING.LENGTH("&clk")
  &clk_itr_length=STRING.LENGTH("q6_pll_lock_det")

  if (STRING.SCAN("&clk", "*", 0)==0)
  (
    &wild_head=1
  )
  if (STRING.SCAN("&clk", "*", 1)==(STRING.LENGTH("&clk")-1))
  (
    &wild_tail=1
  )

  if ((&wild_head==1)&&(&wild_tail==1))
  (
    if (STRING.SCAN("q6_pll_lock_det", STRING.MID("&clk", 1, &clk_input_length-2), 0)!=-1)
    ( 
      &match=1
    )
  )
  else if (&wild_head==1)
  (
    if (STRING.MID("q6_pll_lock_det", &clk_itr_length-&clk_input_length+1, &clk_input_length-1)==STRING.CUT("&clk", 1))
    ( 
      &match=1
    )
  )
  else if (&wild_tail==1)
  (
    if (STRING.MID("q6_pll_lock_det", 0, &clk_input_length-1)==STRING.CUT("&clk", -1))
    ( 
      &match=1
    )
  )
  else if ("q6_pll_lock_det"=="&clk")
  (
    &match=1
  )
  
  if (&match==1)
  (
    &clk_test=&CLK_TEST_Q6_PLL_LOCK_DET
    &clk_reg=0
    &clk_reg_name="No CBCR"
    &clk_name="q6_pll_lock_det"
    &clk_reg_cbcr_type=""
    &clk_vote_bit=-1.
    &clk_multiplier=1.

    gosub Print_Clk_Info_Line
  )


  ; Set appropriate access mode for SSC registers 
  &clk_access_mode="&ssc_access_mode"

  &match=0
  &wild_head=0
  &wild_tail=0
  &clk_input_length=STRING.LENGTH("&clk")
  &clk_itr_length=STRING.LENGTH("scc_ahb_timeout_clk")

  if (STRING.SCAN("&clk", "*", 0)==0)
  (
    &wild_head=1
  )
  if (STRING.SCAN("&clk", "*", 1)==(STRING.LENGTH("&clk")-1))
  (
    &wild_tail=1
  )

  if ((&wild_head==1)&&(&wild_tail==1))
  (
    if (STRING.SCAN("scc_ahb_timeout_clk", STRING.MID("&clk", 1, &clk_input_length-2), 0)!=-1)
    ( 
      &match=1
    )
  )
  else if (&wild_head==1)
  (
    if (STRING.MID("scc_ahb_timeout_clk", &clk_itr_length-&clk_input_length+1, &clk_input_length-1)==STRING.CUT("&clk", 1))
    ( 
      &match=1
    )
  )
  else if (&wild_tail==1)
  (
    if (STRING.MID("scc_ahb_timeout_clk", 0, &clk_input_length-1)==STRING.CUT("&clk", -1))
    ( 
      &match=1
    )
  )
  else if ("scc_ahb_timeout_clk"=="&clk")
  (
    &match=1
  )
  
  if (&match==1)
  (
    &clk_test=&CLK_TEST_SCC_AHB_TIMEOUT_CLK
    &clk_reg=&HWIO_SSC_SCC_SCC_AHB_TIMEOUT_CBCR_ADDR
    &clk_reg_name="SSC_SCC_SCC_AHB_TIMEOUT_CBCR"
    &clk_name="scc_ahb_timeout_clk"
    &clk_reg_cbcr_type="sm_cbc"
    &clk_vote_bit=-1.
    &clk_multiplier=1.

    gosub Print_Clk_Info_Line
  )

  &match=0
  &wild_head=0
  &wild_tail=0
  &clk_input_length=STRING.LENGTH("&clk")
  &clk_itr_length=STRING.LENGTH("scc_at_clk")

  if (STRING.SCAN("&clk", "*", 0)==0)
  (
    &wild_head=1
  )
  if (STRING.SCAN("&clk", "*", 1)==(STRING.LENGTH("&clk")-1))
  (
    &wild_tail=1
  )

  if ((&wild_head==1)&&(&wild_tail==1))
  (
    if (STRING.SCAN("scc_at_clk", STRING.MID("&clk", 1, &clk_input_length-2), 0)!=-1)
    ( 
      &match=1
    )
  )
  else if (&wild_head==1)
  (
    if (STRING.MID("scc_at_clk", &clk_itr_length-&clk_input_length+1, &clk_input_length-1)==STRING.CUT("&clk", 1))
    ( 
      &match=1
    )
  )
  else if (&wild_tail==1)
  (
    if (STRING.MID("scc_at_clk", 0, &clk_input_length-1)==STRING.CUT("&clk", -1))
    ( 
      &match=1
    )
  )
  else if ("scc_at_clk"=="&clk")
  (
    &match=1
  )
  
  if (&match==1)
  (
    &clk_test=&CLK_TEST_SCC_AT_CLK
    &clk_reg=&HWIO_SSC_SCC_SCC_AT_CBCR_ADDR
    &clk_reg_name="SSC_SCC_SCC_AT_CBCR"
    &clk_name="scc_at_clk"
    &clk_reg_cbcr_type="sm_pscbc"
    &clk_vote_bit=-1.
    &clk_multiplier=1.

    gosub Print_Clk_Info_Line
  )

  &match=0
  &wild_head=0
  &wild_tail=0
  &clk_input_length=STRING.LENGTH("&clk")
  &clk_itr_length=STRING.LENGTH("scc_blsp_h_clk")

  if (STRING.SCAN("&clk", "*", 0)==0)
  (
    &wild_head=1
  )
  if (STRING.SCAN("&clk", "*", 1)==(STRING.LENGTH("&clk")-1))
  (
    &wild_tail=1
  )

  if ((&wild_head==1)&&(&wild_tail==1))
  (
    if (STRING.SCAN("scc_blsp_h_clk", STRING.MID("&clk", 1, &clk_input_length-2), 0)!=-1)
    ( 
      &match=1
    )
  )
  else if (&wild_head==1)
  (
    if (STRING.MID("scc_blsp_h_clk", &clk_itr_length-&clk_input_length+1, &clk_input_length-1)==STRING.CUT("&clk", 1))
    ( 
      &match=1
    )
  )
  else if (&wild_tail==1)
  (
    if (STRING.MID("scc_blsp_h_clk", 0, &clk_input_length-1)==STRING.CUT("&clk", -1))
    ( 
      &match=1
    )
  )
  else if ("scc_blsp_h_clk"=="&clk")
  (
    &match=1
  )
  
  if (&match==1)
  (
    &clk_test=&CLK_TEST_SCC_BLSP_H_CLK
    &clk_reg=&HWIO_SSC_SCC_SCC_BLSP_H_CBCR_ADDR
    &clk_reg_name="SSC_SCC_SCC_BLSP_H_CBCR"
    &clk_name="scc_blsp_h_clk"
    &clk_reg_cbcr_type="sm_pscbc"
    &clk_vote_bit=-1.
    &clk_multiplier=1.

    gosub Print_Clk_Info_Line
  )

  &match=0
  &wild_head=0
  &wild_tail=0
  &clk_input_length=STRING.LENGTH("&clk")
  &clk_itr_length=STRING.LENGTH("scc_cfg_ahb_clk")

  if (STRING.SCAN("&clk", "*", 0)==0)
  (
    &wild_head=1
  )
  if (STRING.SCAN("&clk", "*", 1)==(STRING.LENGTH("&clk")-1))
  (
    &wild_tail=1
  )

  if ((&wild_head==1)&&(&wild_tail==1))
  (
    if (STRING.SCAN("scc_cfg_ahb_clk", STRING.MID("&clk", 1, &clk_input_length-2), 0)!=-1)
    ( 
      &match=1
    )
  )
  else if (&wild_head==1)
  (
    if (STRING.MID("scc_cfg_ahb_clk", &clk_itr_length-&clk_input_length+1, &clk_input_length-1)==STRING.CUT("&clk", 1))
    ( 
      &match=1
    )
  )
  else if (&wild_tail==1)
  (
    if (STRING.MID("scc_cfg_ahb_clk", 0, &clk_input_length-1)==STRING.CUT("&clk", -1))
    ( 
      &match=1
    )
  )
  else if ("scc_cfg_ahb_clk"=="&clk")
  (
    &match=1
  )
  
  if (&match==1)
  (
    &clk_test=&CLK_TEST_SCC_CFG_AHB_CLK
    &clk_reg=&HWIO_SSC_SCC_SCC_CFG_AHB_CBCR_ADDR
    &clk_reg_name="SSC_SCC_SCC_CFG_AHB_CBCR"
    &clk_name="scc_cfg_ahb_clk"
    &clk_reg_cbcr_type="sm_cbc"
    &clk_vote_bit=-1.
    &clk_multiplier=1.

    gosub Print_Clk_Info_Line
  )

  &match=0
  &wild_head=0
  &wild_tail=0
  &clk_input_length=STRING.LENGTH("&clk")
  &clk_itr_length=STRING.LENGTH("scc_crif_clk")

  if (STRING.SCAN("&clk", "*", 0)==0)
  (
    &wild_head=1
  )
  if (STRING.SCAN("&clk", "*", 1)==(STRING.LENGTH("&clk")-1))
  (
    &wild_tail=1
  )

  if ((&wild_head==1)&&(&wild_tail==1))
  (
    if (STRING.SCAN("scc_crif_clk", STRING.MID("&clk", 1, &clk_input_length-2), 0)!=-1)
    ( 
      &match=1
    )
  )
  else if (&wild_head==1)
  (
    if (STRING.MID("scc_crif_clk", &clk_itr_length-&clk_input_length+1, &clk_input_length-1)==STRING.CUT("&clk", 1))
    ( 
      &match=1
    )
  )
  else if (&wild_tail==1)
  (
    if (STRING.MID("scc_crif_clk", 0, &clk_input_length-1)==STRING.CUT("&clk", -1))
    ( 
      &match=1
    )
  )
  else if ("scc_crif_clk"=="&clk")
  (
    &match=1
  )
  
  if (&match==1)
  (
    &clk_test=&CLK_TEST_SCC_CRIF_CLK
    &clk_reg=&HWIO_SSC_SCC_SCC_CRIF_CBCR_ADDR
    &clk_reg_name="SSC_SCC_SCC_CRIF_CBCR"
    &clk_name="scc_crif_clk"
    &clk_reg_cbcr_type="sm_cbc"
    &clk_vote_bit=-1.
    &clk_multiplier=1.

    gosub Print_Clk_Info_Line
  )

  &match=0
  &wild_head=0
  &wild_tail=0
  &clk_input_length=STRING.LENGTH("&clk")
  &clk_itr_length=STRING.LENGTH("scc_csr_h_clk")

  if (STRING.SCAN("&clk", "*", 0)==0)
  (
    &wild_head=1
  )
  if (STRING.SCAN("&clk", "*", 1)==(STRING.LENGTH("&clk")-1))
  (
    &wild_tail=1
  )

  if ((&wild_head==1)&&(&wild_tail==1))
  (
    if (STRING.SCAN("scc_csr_h_clk", STRING.MID("&clk", 1, &clk_input_length-2), 0)!=-1)
    ( 
      &match=1
    )
  )
  else if (&wild_head==1)
  (
    if (STRING.MID("scc_csr_h_clk", &clk_itr_length-&clk_input_length+1, &clk_input_length-1)==STRING.CUT("&clk", 1))
    ( 
      &match=1
    )
  )
  else if (&wild_tail==1)
  (
    if (STRING.MID("scc_csr_h_clk", 0, &clk_input_length-1)==STRING.CUT("&clk", -1))
    ( 
      &match=1
    )
  )
  else if ("scc_csr_h_clk"=="&clk")
  (
    &match=1
  )
  
  if (&match==1)
  (
    &clk_test=&CLK_TEST_SCC_CSR_H_CLK
    &clk_reg=&HWIO_SSC_SCC_SCC_CSR_H_CBCR_ADDR
    &clk_reg_name="SSC_SCC_SCC_CSR_H_CBCR"
    &clk_name="scc_csr_h_clk"
    &clk_reg_cbcr_type="sm_cbc"
    &clk_vote_bit=-1.
    &clk_multiplier=1.

    gosub Print_Clk_Info_Line
  )

  &match=0
  &wild_head=0
  &wild_tail=0
  &clk_input_length=STRING.LENGTH("&clk")
  &clk_itr_length=STRING.LENGTH("scc_data_h_clk")

  if (STRING.SCAN("&clk", "*", 0)==0)
  (
    &wild_head=1
  )
  if (STRING.SCAN("&clk", "*", 1)==(STRING.LENGTH("&clk")-1))
  (
    &wild_tail=1
  )

  if ((&wild_head==1)&&(&wild_tail==1))
  (
    if (STRING.SCAN("scc_data_h_clk", STRING.MID("&clk", 1, &clk_input_length-2), 0)!=-1)
    ( 
      &match=1
    )
  )
  else if (&wild_head==1)
  (
    if (STRING.MID("scc_data_h_clk", &clk_itr_length-&clk_input_length+1, &clk_input_length-1)==STRING.CUT("&clk", 1))
    ( 
      &match=1
    )
  )
  else if (&wild_tail==1)
  (
    if (STRING.MID("scc_data_h_clk", 0, &clk_input_length-1)==STRING.CUT("&clk", -1))
    ( 
      &match=1
    )
  )
  else if ("scc_data_h_clk"=="&clk")
  (
    &match=1
  )
  
  if (&match==1)
  (
    &clk_test=&CLK_TEST_SCC_DATA_H_CLK
    &clk_reg=&HWIO_SSC_SCC_SCC_DATA_H_CBCR_ADDR
    &clk_reg_name="SSC_SCC_SCC_DATA_H_CBCR"
    &clk_name="scc_data_h_clk"
    &clk_reg_cbcr_type="sm_cbc"
    &clk_vote_bit=-1.
    &clk_multiplier=1.

    gosub Print_Clk_Info_Line
  )

  &match=0
  &wild_head=0
  &wild_tail=0
  &clk_input_length=STRING.LENGTH("&clk")
  &clk_itr_length=STRING.LENGTH("scc_dbg_tsctr_clk")

  if (STRING.SCAN("&clk", "*", 0)==0)
  (
    &wild_head=1
  )
  if (STRING.SCAN("&clk", "*", 1)==(STRING.LENGTH("&clk")-1))
  (
    &wild_tail=1
  )

  if ((&wild_head==1)&&(&wild_tail==1))
  (
    if (STRING.SCAN("scc_dbg_tsctr_clk", STRING.MID("&clk", 1, &clk_input_length-2), 0)!=-1)
    ( 
      &match=1
    )
  )
  else if (&wild_head==1)
  (
    if (STRING.MID("scc_dbg_tsctr_clk", &clk_itr_length-&clk_input_length+1, &clk_input_length-1)==STRING.CUT("&clk", 1))
    ( 
      &match=1
    )
  )
  else if (&wild_tail==1)
  (
    if (STRING.MID("scc_dbg_tsctr_clk", 0, &clk_input_length-1)==STRING.CUT("&clk", -1))
    ( 
      &match=1
    )
  )
  else if ("scc_dbg_tsctr_clk"=="&clk")
  (
    &match=1
  )
  
  if (&match==1)
  (
    &clk_test=&CLK_TEST_SCC_DBG_TSCTR_CLK
    &clk_reg=&HWIO_SSC_SCC_SCC_DBG_TSCTR_CBCR_ADDR
    &clk_reg_name="SSC_SCC_SCC_DBG_TSCTR_CBCR"
    &clk_name="scc_dbg_tsctr_clk"
    &clk_reg_cbcr_type="sm_cbc"
    &clk_vote_bit=-1.
    &clk_multiplier=1.

    gosub Print_Clk_Info_Line
  )

  &match=0
  &wild_head=0
  &wild_tail=0
  &clk_input_length=STRING.LENGTH("&clk")
  &clk_itr_length=STRING.LENGTH("scc_pclkdbg_clk")

  if (STRING.SCAN("&clk", "*", 0)==0)
  (
    &wild_head=1
  )
  if (STRING.SCAN("&clk", "*", 1)==(STRING.LENGTH("&clk")-1))
  (
    &wild_tail=1
  )

  if ((&wild_head==1)&&(&wild_tail==1))
  (
    if (STRING.SCAN("scc_pclkdbg_clk", STRING.MID("&clk", 1, &clk_input_length-2), 0)!=-1)
    ( 
      &match=1
    )
  )
  else if (&wild_head==1)
  (
    if (STRING.MID("scc_pclkdbg_clk", &clk_itr_length-&clk_input_length+1, &clk_input_length-1)==STRING.CUT("&clk", 1))
    ( 
      &match=1
    )
  )
  else if (&wild_tail==1)
  (
    if (STRING.MID("scc_pclkdbg_clk", 0, &clk_input_length-1)==STRING.CUT("&clk", -1))
    ( 
      &match=1
    )
  )
  else if ("scc_pclkdbg_clk"=="&clk")
  (
    &match=1
  )
  
  if (&match==1)
  (
    &clk_test=&CLK_TEST_SCC_PCLKDBG_CLK
    &clk_reg=&HWIO_SSC_SCC_SCC_PCLKDBG_CBCR_ADDR
    &clk_reg_name="SSC_SCC_SCC_PCLKDBG_CBCR"
    &clk_name="scc_pclkdbg_clk"
    &clk_reg_cbcr_type="sm_cbc"
    &clk_vote_bit=-1.
    &clk_multiplier=1.

    gosub Print_Clk_Info_Line
  )

  &match=0
  &wild_head=0
  &wild_tail=0
  &clk_input_length=STRING.LENGTH("&clk")
  &clk_itr_length=STRING.LENGTH("scc_q6_ahbm_clk")

  if (STRING.SCAN("&clk", "*", 0)==0)
  (
    &wild_head=1
  )
  if (STRING.SCAN("&clk", "*", 1)==(STRING.LENGTH("&clk")-1))
  (
    &wild_tail=1
  )

  if ((&wild_head==1)&&(&wild_tail==1))
  (
    if (STRING.SCAN("scc_q6_ahbm_clk", STRING.MID("&clk", 1, &clk_input_length-2), 0)!=-1)
    ( 
      &match=1
    )
  )
  else if (&wild_head==1)
  (
    if (STRING.MID("scc_q6_ahbm_clk", &clk_itr_length-&clk_input_length+1, &clk_input_length-1)==STRING.CUT("&clk", 1))
    ( 
      &match=1
    )
  )
  else if (&wild_tail==1)
  (
    if (STRING.MID("scc_q6_ahbm_clk", 0, &clk_input_length-1)==STRING.CUT("&clk", -1))
    ( 
      &match=1
    )
  )
  else if ("scc_q6_ahbm_clk"=="&clk")
  (
    &match=1
  )
  
  if (&match==1)
  (
    &clk_test=&CLK_TEST_SCC_Q6_AHBM_CLK
    &clk_reg=&HWIO_SSC_SCC_SCC_Q6_AHBM_CBCR_ADDR
    &clk_reg_name="SSC_SCC_SCC_Q6_AHBM_CBCR"
    &clk_name="scc_q6_ahbm_clk"
    &clk_reg_cbcr_type="sm_cbc"
    &clk_vote_bit=-1.
    &clk_multiplier=1.

    gosub Print_Clk_Info_Line
  )

  &match=0
  &wild_head=0
  &wild_tail=0
  &clk_input_length=STRING.LENGTH("&clk")
  &clk_itr_length=STRING.LENGTH("scc_q6_ahbs_clk")

  if (STRING.SCAN("&clk", "*", 0)==0)
  (
    &wild_head=1
  )
  if (STRING.SCAN("&clk", "*", 1)==(STRING.LENGTH("&clk")-1))
  (
    &wild_tail=1
  )

  if ((&wild_head==1)&&(&wild_tail==1))
  (
    if (STRING.SCAN("scc_q6_ahbs_clk", STRING.MID("&clk", 1, &clk_input_length-2), 0)!=-1)
    ( 
      &match=1
    )
  )
  else if (&wild_head==1)
  (
    if (STRING.MID("scc_q6_ahbs_clk", &clk_itr_length-&clk_input_length+1, &clk_input_length-1)==STRING.CUT("&clk", 1))
    ( 
      &match=1
    )
  )
  else if (&wild_tail==1)
  (
    if (STRING.MID("scc_q6_ahbs_clk", 0, &clk_input_length-1)==STRING.CUT("&clk", -1))
    ( 
      &match=1
    )
  )
  else if ("scc_q6_ahbs_clk"=="&clk")
  (
    &match=1
  )
  
  if (&match==1)
  (
    &clk_test=&CLK_TEST_SCC_Q6_AHBS_CLK
    &clk_reg=&HWIO_SSC_SCC_SCC_Q6_AHBS_CBCR_ADDR
    &clk_reg_name="SSC_SCC_SCC_Q6_AHBS_CBCR"
    &clk_name="scc_q6_ahbs_clk"
    &clk_reg_cbcr_type="sm_cbc"
    &clk_vote_bit=-1.
    &clk_multiplier=1.

    gosub Print_Clk_Info_Line
  )

  &match=0
  &wild_head=0
  &wild_tail=0
  &clk_input_length=STRING.LENGTH("&clk")
  &clk_itr_length=STRING.LENGTH("scc_q6_atbm_clk")

  if (STRING.SCAN("&clk", "*", 0)==0)
  (
    &wild_head=1
  )
  if (STRING.SCAN("&clk", "*", 1)==(STRING.LENGTH("&clk")-1))
  (
    &wild_tail=1
  )

  if ((&wild_head==1)&&(&wild_tail==1))
  (
    if (STRING.SCAN("scc_q6_atbm_clk", STRING.MID("&clk", 1, &clk_input_length-2), 0)!=-1)
    ( 
      &match=1
    )
  )
  else if (&wild_head==1)
  (
    if (STRING.MID("scc_q6_atbm_clk", &clk_itr_length-&clk_input_length+1, &clk_input_length-1)==STRING.CUT("&clk", 1))
    ( 
      &match=1
    )
  )
  else if (&wild_tail==1)
  (
    if (STRING.MID("scc_q6_atbm_clk", 0, &clk_input_length-1)==STRING.CUT("&clk", -1))
    ( 
      &match=1
    )
  )
  else if ("scc_q6_atbm_clk"=="&clk")
  (
    &match=1
  )
  
  if (&match==1)
  (
    &clk_test=&CLK_TEST_SCC_Q6_ATBM_CLK
    &clk_reg=&HWIO_SSC_SCC_SCC_Q6_ATBM_CBCR_ADDR
    &clk_reg_name="SSC_SCC_SCC_Q6_ATBM_CBCR"
    &clk_name="scc_q6_atbm_clk"
    &clk_reg_cbcr_type="sm_cbc"
    &clk_vote_bit=-1.
    &clk_multiplier=1.

    gosub Print_Clk_Info_Line
  )

  &match=0
  &wild_head=0
  &wild_tail=0
  &clk_input_length=STRING.LENGTH("&clk")
  &clk_itr_length=STRING.LENGTH("scc_q6_spm_clk")

  if (STRING.SCAN("&clk", "*", 0)==0)
  (
    &wild_head=1
  )
  if (STRING.SCAN("&clk", "*", 1)==(STRING.LENGTH("&clk")-1))
  (
    &wild_tail=1
  )

  if ((&wild_head==1)&&(&wild_tail==1))
  (
    if (STRING.SCAN("scc_q6_spm_clk", STRING.MID("&clk", 1, &clk_input_length-2), 0)!=-1)
    ( 
      &match=1
    )
  )
  else if (&wild_head==1)
  (
    if (STRING.MID("scc_q6_spm_clk", &clk_itr_length-&clk_input_length+1, &clk_input_length-1)==STRING.CUT("&clk", 1))
    ( 
      &match=1
    )
  )
  else if (&wild_tail==1)
  (
    if (STRING.MID("scc_q6_spm_clk", 0, &clk_input_length-1)==STRING.CUT("&clk", -1))
    ( 
      &match=1
    )
  )
  else if ("scc_q6_spm_clk"=="&clk")
  (
    &match=1
  )
  
  if (&match==1)
  (
    &clk_test=&CLK_TEST_SCC_Q6_SPM_CLK
    &clk_reg=&HWIO_SSC_SCC_SCC_Q6_SPM_CBCR_ADDR
    &clk_reg_name="SSC_SCC_SCC_Q6_SPM_CBCR"
    &clk_name="scc_q6_spm_clk"
    &clk_reg_cbcr_type="sm_cbc"
    &clk_vote_bit=-1.
    &clk_multiplier=1.

    gosub Print_Clk_Info_Line
  )

  &match=0
  &wild_head=0
  &wild_tail=0
  &clk_input_length=STRING.LENGTH("&clk")
  &clk_itr_length=STRING.LENGTH("scc_q6_xpu2_client_clk")

  if (STRING.SCAN("&clk", "*", 0)==0)
  (
    &wild_head=1
  )
  if (STRING.SCAN("&clk", "*", 1)==(STRING.LENGTH("&clk")-1))
  (
    &wild_tail=1
  )

  if ((&wild_head==1)&&(&wild_tail==1))
  (
    if (STRING.SCAN("scc_q6_xpu2_client_clk", STRING.MID("&clk", 1, &clk_input_length-2), 0)!=-1)
    ( 
      &match=1
    )
  )
  else if (&wild_head==1)
  (
    if (STRING.MID("scc_q6_xpu2_client_clk", &clk_itr_length-&clk_input_length+1, &clk_input_length-1)==STRING.CUT("&clk", 1))
    ( 
      &match=1
    )
  )
  else if (&wild_tail==1)
  (
    if (STRING.MID("scc_q6_xpu2_client_clk", 0, &clk_input_length-1)==STRING.CUT("&clk", -1))
    ( 
      &match=1
    )
  )
  else if ("scc_q6_xpu2_client_clk"=="&clk")
  (
    &match=1
  )
  
  if (&match==1)
  (
    &clk_test=&CLK_TEST_SCC_Q6_XPU2_CLIENT_CLK
    &clk_reg=&HWIO_SSC_SCC_SCC_Q6_XPU2_CLIENT_CBCR_ADDR
    &clk_reg_name="SSC_SCC_SCC_Q6_XPU2_CLIENT_CBCR"
    &clk_name="scc_q6_xpu2_client_clk"
    &clk_reg_cbcr_type="sm_cbc"
    &clk_vote_bit=-1.
    &clk_multiplier=1.

    gosub Print_Clk_Info_Line
  )

  &match=0
  &wild_head=0
  &wild_tail=0
  &clk_input_length=STRING.LENGTH("&clk")
  &clk_itr_length=STRING.LENGTH("scc_q6_xpu2_config_clk")

  if (STRING.SCAN("&clk", "*", 0)==0)
  (
    &wild_head=1
  )
  if (STRING.SCAN("&clk", "*", 1)==(STRING.LENGTH("&clk")-1))
  (
    &wild_tail=1
  )

  if ((&wild_head==1)&&(&wild_tail==1))
  (
    if (STRING.SCAN("scc_q6_xpu2_config_clk", STRING.MID("&clk", 1, &clk_input_length-2), 0)!=-1)
    ( 
      &match=1
    )
  )
  else if (&wild_head==1)
  (
    if (STRING.MID("scc_q6_xpu2_config_clk", &clk_itr_length-&clk_input_length+1, &clk_input_length-1)==STRING.CUT("&clk", 1))
    ( 
      &match=1
    )
  )
  else if (&wild_tail==1)
  (
    if (STRING.MID("scc_q6_xpu2_config_clk", 0, &clk_input_length-1)==STRING.CUT("&clk", -1))
    ( 
      &match=1
    )
  )
  else if ("scc_q6_xpu2_config_clk"=="&clk")
  (
    &match=1
  )
  
  if (&match==1)
  (
    &clk_test=&CLK_TEST_SCC_Q6_XPU2_CONFIG_CLK
    &clk_reg=&HWIO_SSC_SCC_SCC_Q6_XPU2_CONFIG_CBCR_ADDR
    &clk_reg_name="SSC_SCC_SCC_Q6_XPU2_CONFIG_CBCR"
    &clk_name="scc_q6_xpu2_config_clk"
    &clk_reg_cbcr_type="sm_cbc"
    &clk_vote_bit=-1.
    &clk_multiplier=1.

    gosub Print_Clk_Info_Line
  )

  &match=0
  &wild_head=0
  &wild_tail=0
  &clk_input_length=STRING.LENGTH("&clk")
  &clk_itr_length=STRING.LENGTH("scc_qup_i2c1_clk")

  if (STRING.SCAN("&clk", "*", 0)==0)
  (
    &wild_head=1
  )
  if (STRING.SCAN("&clk", "*", 1)==(STRING.LENGTH("&clk")-1))
  (
    &wild_tail=1
  )

  if ((&wild_head==1)&&(&wild_tail==1))
  (
    if (STRING.SCAN("scc_qup_i2c1_clk", STRING.MID("&clk", 1, &clk_input_length-2), 0)!=-1)
    ( 
      &match=1
    )
  )
  else if (&wild_head==1)
  (
    if (STRING.MID("scc_qup_i2c1_clk", &clk_itr_length-&clk_input_length+1, &clk_input_length-1)==STRING.CUT("&clk", 1))
    ( 
      &match=1
    )
  )
  else if (&wild_tail==1)
  (
    if (STRING.MID("scc_qup_i2c1_clk", 0, &clk_input_length-1)==STRING.CUT("&clk", -1))
    ( 
      &match=1
    )
  )
  else if ("scc_qup_i2c1_clk"=="&clk")
  (
    &match=1
  )
  
  if (&match==1)
  (
    &clk_test=&CLK_TEST_SCC_QUP_I2C1_CLK
    &clk_reg=&HWIO_SSC_SCC_SCC_QUP_I2C1_CBCR_ADDR
    &clk_reg_name="SSC_SCC_SCC_QUP_I2C1_CBCR"
    &clk_name="scc_qup_i2c1_clk"
    &clk_reg_cbcr_type="sm_cbc"
    &clk_vote_bit=-1.
    &clk_multiplier=1.

    gosub Print_Clk_Info_Line
  )

  &match=0
  &wild_head=0
  &wild_tail=0
  &clk_input_length=STRING.LENGTH("&clk")
  &clk_itr_length=STRING.LENGTH("scc_qup_i2c2_clk")

  if (STRING.SCAN("&clk", "*", 0)==0)
  (
    &wild_head=1
  )
  if (STRING.SCAN("&clk", "*", 1)==(STRING.LENGTH("&clk")-1))
  (
    &wild_tail=1
  )

  if ((&wild_head==1)&&(&wild_tail==1))
  (
    if (STRING.SCAN("scc_qup_i2c2_clk", STRING.MID("&clk", 1, &clk_input_length-2), 0)!=-1)
    ( 
      &match=1
    )
  )
  else if (&wild_head==1)
  (
    if (STRING.MID("scc_qup_i2c2_clk", &clk_itr_length-&clk_input_length+1, &clk_input_length-1)==STRING.CUT("&clk", 1))
    ( 
      &match=1
    )
  )
  else if (&wild_tail==1)
  (
    if (STRING.MID("scc_qup_i2c2_clk", 0, &clk_input_length-1)==STRING.CUT("&clk", -1))
    ( 
      &match=1
    )
  )
  else if ("scc_qup_i2c2_clk"=="&clk")
  (
    &match=1
  )
  
  if (&match==1)
  (
    &clk_test=&CLK_TEST_SCC_QUP_I2C2_CLK
    &clk_reg=&HWIO_SSC_SCC_SCC_QUP_I2C2_CBCR_ADDR
    &clk_reg_name="SSC_SCC_SCC_QUP_I2C2_CBCR"
    &clk_name="scc_qup_i2c2_clk"
    &clk_reg_cbcr_type="sm_cbc"
    &clk_vote_bit=-1.
    &clk_multiplier=1.

    gosub Print_Clk_Info_Line
  )

  &match=0
  &wild_head=0
  &wild_tail=0
  &clk_input_length=STRING.LENGTH("&clk")
  &clk_itr_length=STRING.LENGTH("scc_qup_i2c3_clk")

  if (STRING.SCAN("&clk", "*", 0)==0)
  (
    &wild_head=1
  )
  if (STRING.SCAN("&clk", "*", 1)==(STRING.LENGTH("&clk")-1))
  (
    &wild_tail=1
  )

  if ((&wild_head==1)&&(&wild_tail==1))
  (
    if (STRING.SCAN("scc_qup_i2c3_clk", STRING.MID("&clk", 1, &clk_input_length-2), 0)!=-1)
    ( 
      &match=1
    )
  )
  else if (&wild_head==1)
  (
    if (STRING.MID("scc_qup_i2c3_clk", &clk_itr_length-&clk_input_length+1, &clk_input_length-1)==STRING.CUT("&clk", 1))
    ( 
      &match=1
    )
  )
  else if (&wild_tail==1)
  (
    if (STRING.MID("scc_qup_i2c3_clk", 0, &clk_input_length-1)==STRING.CUT("&clk", -1))
    ( 
      &match=1
    )
  )
  else if ("scc_qup_i2c3_clk"=="&clk")
  (
    &match=1
  )
  
  if (&match==1)
  (
    &clk_test=&CLK_TEST_SCC_QUP_I2C3_CLK
    &clk_reg=&HWIO_SSC_SCC_SCC_QUP_I2C3_CBCR_ADDR
    &clk_reg_name="SSC_SCC_SCC_QUP_I2C3_CBCR"
    &clk_name="scc_qup_i2c3_clk"
    &clk_reg_cbcr_type="sm_cbc"
    &clk_vote_bit=-1.
    &clk_multiplier=1.

    gosub Print_Clk_Info_Line
  )

  &match=0
  &wild_head=0
  &wild_tail=0
  &clk_input_length=STRING.LENGTH("&clk")
  &clk_itr_length=STRING.LENGTH("scc_qup_spi1_clk")

  if (STRING.SCAN("&clk", "*", 0)==0)
  (
    &wild_head=1
  )
  if (STRING.SCAN("&clk", "*", 1)==(STRING.LENGTH("&clk")-1))
  (
    &wild_tail=1
  )

  if ((&wild_head==1)&&(&wild_tail==1))
  (
    if (STRING.SCAN("scc_qup_spi1_clk", STRING.MID("&clk", 1, &clk_input_length-2), 0)!=-1)
    ( 
      &match=1
    )
  )
  else if (&wild_head==1)
  (
    if (STRING.MID("scc_qup_spi1_clk", &clk_itr_length-&clk_input_length+1, &clk_input_length-1)==STRING.CUT("&clk", 1))
    ( 
      &match=1
    )
  )
  else if (&wild_tail==1)
  (
    if (STRING.MID("scc_qup_spi1_clk", 0, &clk_input_length-1)==STRING.CUT("&clk", -1))
    ( 
      &match=1
    )
  )
  else if ("scc_qup_spi1_clk"=="&clk")
  (
    &match=1
  )
  
  if (&match==1)
  (
    &clk_test=&CLK_TEST_SCC_QUP_SPI1_CLK
    &clk_reg=&HWIO_SSC_SCC_SCC_QUP_SPI1_CBCR_ADDR
    &clk_reg_name="SSC_SCC_SCC_QUP_SPI1_CBCR"
    &clk_name="scc_qup_spi1_clk"
    &clk_reg_cbcr_type="sm_cbc"
    &clk_vote_bit=-1.
    &clk_multiplier=1.

    gosub Print_Clk_Info_Line
  )

  &match=0
  &wild_head=0
  &wild_tail=0
  &clk_input_length=STRING.LENGTH("&clk")
  &clk_itr_length=STRING.LENGTH("scc_qup_spi2_clk")

  if (STRING.SCAN("&clk", "*", 0)==0)
  (
    &wild_head=1
  )
  if (STRING.SCAN("&clk", "*", 1)==(STRING.LENGTH("&clk")-1))
  (
    &wild_tail=1
  )

  if ((&wild_head==1)&&(&wild_tail==1))
  (
    if (STRING.SCAN("scc_qup_spi2_clk", STRING.MID("&clk", 1, &clk_input_length-2), 0)!=-1)
    ( 
      &match=1
    )
  )
  else if (&wild_head==1)
  (
    if (STRING.MID("scc_qup_spi2_clk", &clk_itr_length-&clk_input_length+1, &clk_input_length-1)==STRING.CUT("&clk", 1))
    ( 
      &match=1
    )
  )
  else if (&wild_tail==1)
  (
    if (STRING.MID("scc_qup_spi2_clk", 0, &clk_input_length-1)==STRING.CUT("&clk", -1))
    ( 
      &match=1
    )
  )
  else if ("scc_qup_spi2_clk"=="&clk")
  (
    &match=1
  )
  
  if (&match==1)
  (
    &clk_test=&CLK_TEST_SCC_QUP_SPI2_CLK
    &clk_reg=&HWIO_SSC_SCC_SCC_QUP_SPI2_CBCR_ADDR
    &clk_reg_name="SSC_SCC_SCC_QUP_SPI2_CBCR"
    &clk_name="scc_qup_spi2_clk"
    &clk_reg_cbcr_type="sm_cbc"
    &clk_vote_bit=-1.
    &clk_multiplier=1.

    gosub Print_Clk_Info_Line
  )

  &match=0
  &wild_head=0
  &wild_tail=0
  &clk_input_length=STRING.LENGTH("&clk")
  &clk_itr_length=STRING.LENGTH("scc_qup_spi3_clk")

  if (STRING.SCAN("&clk", "*", 0)==0)
  (
    &wild_head=1
  )
  if (STRING.SCAN("&clk", "*", 1)==(STRING.LENGTH("&clk")-1))
  (
    &wild_tail=1
  )

  if ((&wild_head==1)&&(&wild_tail==1))
  (
    if (STRING.SCAN("scc_qup_spi3_clk", STRING.MID("&clk", 1, &clk_input_length-2), 0)!=-1)
    ( 
      &match=1
    )
  )
  else if (&wild_head==1)
  (
    if (STRING.MID("scc_qup_spi3_clk", &clk_itr_length-&clk_input_length+1, &clk_input_length-1)==STRING.CUT("&clk", 1))
    ( 
      &match=1
    )
  )
  else if (&wild_tail==1)
  (
    if (STRING.MID("scc_qup_spi3_clk", 0, &clk_input_length-1)==STRING.CUT("&clk", -1))
    ( 
      &match=1
    )
  )
  else if ("scc_qup_spi3_clk"=="&clk")
  (
    &match=1
  )
  
  if (&match==1)
  (
    &clk_test=&CLK_TEST_SCC_QUP_SPI3_CLK
    &clk_reg=&HWIO_SSC_SCC_SCC_QUP_SPI3_CBCR_ADDR
    &clk_reg_name="SSC_SCC_SCC_QUP_SPI3_CBCR"
    &clk_name="scc_qup_spi3_clk"
    &clk_reg_cbcr_type="sm_cbc"
    &clk_vote_bit=-1.
    &clk_multiplier=1.

    gosub Print_Clk_Info_Line
  )

  &match=0
  &wild_head=0
  &wild_tail=0
  &clk_input_length=STRING.LENGTH("&clk")
  &clk_itr_length=STRING.LENGTH("scc_smem_clk")

  if (STRING.SCAN("&clk", "*", 0)==0)
  (
    &wild_head=1
  )
  if (STRING.SCAN("&clk", "*", 1)==(STRING.LENGTH("&clk")-1))
  (
    &wild_tail=1
  )

  if ((&wild_head==1)&&(&wild_tail==1))
  (
    if (STRING.SCAN("scc_smem_clk", STRING.MID("&clk", 1, &clk_input_length-2), 0)!=-1)
    ( 
      &match=1
    )
  )
  else if (&wild_head==1)
  (
    if (STRING.MID("scc_smem_clk", &clk_itr_length-&clk_input_length+1, &clk_input_length-1)==STRING.CUT("&clk", 1))
    ( 
      &match=1
    )
  )
  else if (&wild_tail==1)
  (
    if (STRING.MID("scc_smem_clk", 0, &clk_input_length-1)==STRING.CUT("&clk", -1))
    ( 
      &match=1
    )
  )
  else if ("scc_smem_clk"=="&clk")
  (
    &match=1
  )
  
  if (&match==1)
  (
    &clk_test=&CLK_TEST_SCC_SMEM_CLK
    &clk_reg=&HWIO_SSC_SCC_SCC_SMEM_CBCR_ADDR
    &clk_reg_name="SSC_SCC_SCC_SMEM_CBCR"
    &clk_name="scc_smem_clk"
    &clk_reg_cbcr_type="sm_pscbc"
    &clk_vote_bit=-1.
    &clk_multiplier=1.

    gosub Print_Clk_Info_Line
  )

  &match=0
  &wild_head=0
  &wild_tail=0
  &clk_input_length=STRING.LENGTH("&clk")
  &clk_itr_length=STRING.LENGTH("scc_uart_dm_uart1_clk")

  if (STRING.SCAN("&clk", "*", 0)==0)
  (
    &wild_head=1
  )
  if (STRING.SCAN("&clk", "*", 1)==(STRING.LENGTH("&clk")-1))
  (
    &wild_tail=1
  )

  if ((&wild_head==1)&&(&wild_tail==1))
  (
    if (STRING.SCAN("scc_uart_dm_uart1_clk", STRING.MID("&clk", 1, &clk_input_length-2), 0)!=-1)
    ( 
      &match=1
    )
  )
  else if (&wild_head==1)
  (
    if (STRING.MID("scc_uart_dm_uart1_clk", &clk_itr_length-&clk_input_length+1, &clk_input_length-1)==STRING.CUT("&clk", 1))
    ( 
      &match=1
    )
  )
  else if (&wild_tail==1)
  (
    if (STRING.MID("scc_uart_dm_uart1_clk", 0, &clk_input_length-1)==STRING.CUT("&clk", -1))
    ( 
      &match=1
    )
  )
  else if ("scc_uart_dm_uart1_clk"=="&clk")
  (
    &match=1
  )
  
  if (&match==1)
  (
    &clk_test=&CLK_TEST_SCC_UART_DM_UART1_CLK
    &clk_reg=&HWIO_SSC_SCC_SCC_UART_DM_UART1_CBCR_ADDR
    &clk_reg_name="SSC_SCC_SCC_UART_DM_UART1_CBCR"
    &clk_name="scc_uart_dm_uart1_clk"
    &clk_reg_cbcr_type="sm_cbc"
    &clk_vote_bit=-1.
    &clk_multiplier=1.

    gosub Print_Clk_Info_Line
  )

  &match=0
  &wild_head=0
  &wild_tail=0
  &clk_input_length=STRING.LENGTH("&clk")
  &clk_itr_length=STRING.LENGTH("scc_uart_dm_uart2_clk")

  if (STRING.SCAN("&clk", "*", 0)==0)
  (
    &wild_head=1
  )
  if (STRING.SCAN("&clk", "*", 1)==(STRING.LENGTH("&clk")-1))
  (
    &wild_tail=1
  )

  if ((&wild_head==1)&&(&wild_tail==1))
  (
    if (STRING.SCAN("scc_uart_dm_uart2_clk", STRING.MID("&clk", 1, &clk_input_length-2), 0)!=-1)
    ( 
      &match=1
    )
  )
  else if (&wild_head==1)
  (
    if (STRING.MID("scc_uart_dm_uart2_clk", &clk_itr_length-&clk_input_length+1, &clk_input_length-1)==STRING.CUT("&clk", 1))
    ( 
      &match=1
    )
  )
  else if (&wild_tail==1)
  (
    if (STRING.MID("scc_uart_dm_uart2_clk", 0, &clk_input_length-1)==STRING.CUT("&clk", -1))
    ( 
      &match=1
    )
  )
  else if ("scc_uart_dm_uart2_clk"=="&clk")
  (
    &match=1
  )
  
  if (&match==1)
  (
    &clk_test=&CLK_TEST_SCC_UART_DM_UART2_CLK
    &clk_reg=&HWIO_SSC_SCC_SCC_UART_DM_UART2_CBCR_ADDR
    &clk_reg_name="SSC_SCC_SCC_UART_DM_UART2_CBCR"
    &clk_name="scc_uart_dm_uart2_clk"
    &clk_reg_cbcr_type="sm_cbc"
    &clk_vote_bit=-1.
    &clk_multiplier=1.

    gosub Print_Clk_Info_Line
  )

  &match=0
  &wild_head=0
  &wild_tail=0
  &clk_input_length=STRING.LENGTH("&clk")
  &clk_itr_length=STRING.LENGTH("scc_uart_dm_uart3_clk")

  if (STRING.SCAN("&clk", "*", 0)==0)
  (
    &wild_head=1
  )
  if (STRING.SCAN("&clk", "*", 1)==(STRING.LENGTH("&clk")-1))
  (
    &wild_tail=1
  )

  if ((&wild_head==1)&&(&wild_tail==1))
  (
    if (STRING.SCAN("scc_uart_dm_uart3_clk", STRING.MID("&clk", 1, &clk_input_length-2), 0)!=-1)
    ( 
      &match=1
    )
  )
  else if (&wild_head==1)
  (
    if (STRING.MID("scc_uart_dm_uart3_clk", &clk_itr_length-&clk_input_length+1, &clk_input_length-1)==STRING.CUT("&clk", 1))
    ( 
      &match=1
    )
  )
  else if (&wild_tail==1)
  (
    if (STRING.MID("scc_uart_dm_uart3_clk", 0, &clk_input_length-1)==STRING.CUT("&clk", -1))
    ( 
      &match=1
    )
  )
  else if ("scc_uart_dm_uart3_clk"=="&clk")
  (
    &match=1
  )
  
  if (&match==1)
  (
    &clk_test=&CLK_TEST_SCC_UART_DM_UART3_CLK
    &clk_reg=&HWIO_SSC_SCC_SCC_UART_DM_UART3_CBCR_ADDR
    &clk_reg_name="SSC_SCC_SCC_UART_DM_UART3_CBCR"
    &clk_name="scc_uart_dm_uart3_clk"
    &clk_reg_cbcr_type="sm_cbc"
    &clk_vote_bit=-1.
    &clk_multiplier=1.

    gosub Print_Clk_Info_Line
  )

  &match=0
  &wild_head=0
  &wild_tail=0
  &clk_input_length=STRING.LENGTH("&clk")
  &clk_itr_length=STRING.LENGTH("scc_vs_vddcx_clk")

  if (STRING.SCAN("&clk", "*", 0)==0)
  (
    &wild_head=1
  )
  if (STRING.SCAN("&clk", "*", 1)==(STRING.LENGTH("&clk")-1))
  (
    &wild_tail=1
  )

  if ((&wild_head==1)&&(&wild_tail==1))
  (
    if (STRING.SCAN("scc_vs_vddcx_clk", STRING.MID("&clk", 1, &clk_input_length-2), 0)!=-1)
    ( 
      &match=1
    )
  )
  else if (&wild_head==1)
  (
    if (STRING.MID("scc_vs_vddcx_clk", &clk_itr_length-&clk_input_length+1, &clk_input_length-1)==STRING.CUT("&clk", 1))
    ( 
      &match=1
    )
  )
  else if (&wild_tail==1)
  (
    if (STRING.MID("scc_vs_vddcx_clk", 0, &clk_input_length-1)==STRING.CUT("&clk", -1))
    ( 
      &match=1
    )
  )
  else if ("scc_vs_vddcx_clk"=="&clk")
  (
    &match=1
  )
  
  if (&match==1)
  (
    &clk_test=&CLK_TEST_SCC_VS_VDDCX_CLK
    &clk_reg=&HWIO_SSC_SCC_SCC_VS_VDDCX_CBCR_ADDR
    &clk_reg_name="SSC_SCC_SCC_VS_VDDCX_CBCR"
    &clk_name="scc_vs_vddcx_clk"
    &clk_reg_cbcr_type="sm_cbc"
    &clk_vote_bit=-1.
    &clk_multiplier=1.

    gosub Print_Clk_Info_Line
  )

  &match=0
  &wild_head=0
  &wild_tail=0
  &clk_input_length=STRING.LENGTH("&clk")
  &clk_itr_length=STRING.LENGTH("scc_vs_vddmx_clk")

  if (STRING.SCAN("&clk", "*", 0)==0)
  (
    &wild_head=1
  )
  if (STRING.SCAN("&clk", "*", 1)==(STRING.LENGTH("&clk")-1))
  (
    &wild_tail=1
  )

  if ((&wild_head==1)&&(&wild_tail==1))
  (
    if (STRING.SCAN("scc_vs_vddmx_clk", STRING.MID("&clk", 1, &clk_input_length-2), 0)!=-1)
    ( 
      &match=1
    )
  )
  else if (&wild_head==1)
  (
    if (STRING.MID("scc_vs_vddmx_clk", &clk_itr_length-&clk_input_length+1, &clk_input_length-1)==STRING.CUT("&clk", 1))
    ( 
      &match=1
    )
  )
  else if (&wild_tail==1)
  (
    if (STRING.MID("scc_vs_vddmx_clk", 0, &clk_input_length-1)==STRING.CUT("&clk", -1))
    ( 
      &match=1
    )
  )
  else if ("scc_vs_vddmx_clk"=="&clk")
  (
    &match=1
  )
  
  if (&match==1)
  (
    &clk_test=&CLK_TEST_SCC_VS_VDDMX_CLK
    &clk_reg=&HWIO_SSC_SCC_SCC_VS_VDDMX_CBCR_ADDR
    &clk_reg_name="SSC_SCC_SCC_VS_VDDMX_CBCR"
    &clk_name="scc_vs_vddmx_clk"
    &clk_reg_cbcr_type="sm_cbc"
    &clk_vote_bit=-1.
    &clk_multiplier=1.

    gosub Print_Clk_Info_Line
  )

  &match=0
  &wild_head=0
  &wild_tail=0
  &clk_input_length=STRING.LENGTH("&clk")
  &clk_itr_length=STRING.LENGTH("ssc_debug_clk")

  if (STRING.SCAN("&clk", "*", 0)==0)
  (
    &wild_head=1
  )
  if (STRING.SCAN("&clk", "*", 1)==(STRING.LENGTH("&clk")-1))
  (
    &wild_tail=1
  )

  if ((&wild_head==1)&&(&wild_tail==1))
  (
    if (STRING.SCAN("ssc_debug_clk", STRING.MID("&clk", 1, &clk_input_length-2), 0)!=-1)
    ( 
      &match=1
    )
  )
  else if (&wild_head==1)
  (
    if (STRING.MID("ssc_debug_clk", &clk_itr_length-&clk_input_length+1, &clk_input_length-1)==STRING.CUT("&clk", 1))
    ( 
      &match=1
    )
  )
  else if (&wild_tail==1)
  (
    if (STRING.MID("ssc_debug_clk", 0, &clk_input_length-1)==STRING.CUT("&clk", -1))
    ( 
      &match=1
    )
  )
  else if ("ssc_debug_clk"=="&clk")
  (
    &match=1
  )
  
  if (&match==1)
  (
    &clk_test=0
    &clk_reg=0
    &clk_reg_name="No CBCR"
    &clk_name="ssc_debug_clk"
    &clk_reg_cbcr_type=""
    &clk_vote_bit=-1.
    &clk_multiplier=1.

    gosub Print_Clk_Info_Line
  )

  &match=0
  &wild_head=0
  &wild_tail=0
  &clk_input_length=STRING.LENGTH("&clk")
  &clk_itr_length=STRING.LENGTH("ssc_pll_lv_test")

  if (STRING.SCAN("&clk", "*", 0)==0)
  (
    &wild_head=1
  )
  if (STRING.SCAN("&clk", "*", 1)==(STRING.LENGTH("&clk")-1))
  (
    &wild_tail=1
  )

  if ((&wild_head==1)&&(&wild_tail==1))
  (
    if (STRING.SCAN("ssc_pll_lv_test", STRING.MID("&clk", 1, &clk_input_length-2), 0)!=-1)
    ( 
      &match=1
    )
  )
  else if (&wild_head==1)
  (
    if (STRING.MID("ssc_pll_lv_test", &clk_itr_length-&clk_input_length+1, &clk_input_length-1)==STRING.CUT("&clk", 1))
    ( 
      &match=1
    )
  )
  else if (&wild_tail==1)
  (
    if (STRING.MID("ssc_pll_lv_test", 0, &clk_input_length-1)==STRING.CUT("&clk", -1))
    ( 
      &match=1
    )
  )
  else if ("ssc_pll_lv_test"=="&clk")
  (
    &match=1
  )
  
  if (&match==1)
  (
    &clk_test=0
    &clk_reg=0
    &clk_reg_name="No CBCR"
    &clk_name="ssc_pll_lv_test"
    &clk_reg_cbcr_type=""
    &clk_vote_bit=-1.
    &clk_multiplier=1.

    gosub Print_Clk_Info_Line
  )

  &match=0
  &wild_head=0
  &wild_tail=0
  &clk_input_length=STRING.LENGTH("&clk")
  &clk_itr_length=STRING.LENGTH("ssc_qdsp6ss_q6_core_clk")

  if (STRING.SCAN("&clk", "*", 0)==0)
  (
    &wild_head=1
  )
  if (STRING.SCAN("&clk", "*", 1)==(STRING.LENGTH("&clk")-1))
  (
    &wild_tail=1
  )

  if ((&wild_head==1)&&(&wild_tail==1))
  (
    if (STRING.SCAN("ssc_qdsp6ss_q6_core_clk", STRING.MID("&clk", 1, &clk_input_length-2), 0)!=-1)
    ( 
      &match=1
    )
  )
  else if (&wild_head==1)
  (
    if (STRING.MID("ssc_qdsp6ss_q6_core_clk", &clk_itr_length-&clk_input_length+1, &clk_input_length-1)==STRING.CUT("&clk", 1))
    ( 
      &match=1
    )
  )
  else if (&wild_tail==1)
  (
    if (STRING.MID("ssc_qdsp6ss_q6_core_clk", 0, &clk_input_length-1)==STRING.CUT("&clk", -1))
    ( 
      &match=1
    )
  )
  else if ("ssc_qdsp6ss_q6_core_clk"=="&clk")||("cpus"=="&clk")
  (
    &match=1
  )
  
  if (&match==1)
  (
    &clk_test=&CLK_TEST_SSC_QDSP6SS_Q6_CORE_CLK
    &clk_reg=0
    &clk_reg_name="No CBCR"
    &clk_name="ssc_qdsp6ss_q6_core_clk"
    &clk_reg_cbcr_type=""
    &clk_vote_bit=-1.
    &clk_multiplier=1.

    gosub Print_Clk_Info_Line
  )

  &match=0
  &wild_head=0
  &wild_tail=0
  &clk_input_length=STRING.LENGTH("&clk")
  &clk_itr_length=STRING.LENGTH("ssc_qdsp6ss_axi_m_clk")

  if (STRING.SCAN("&clk", "*", 0)==0)
  (
    &wild_head=1
  )
  if (STRING.SCAN("&clk", "*", 1)==(STRING.LENGTH("&clk")-1))
  (
    &wild_tail=1
  )

  if ((&wild_head==1)&&(&wild_tail==1))
  (
    if (STRING.SCAN("ssc_qdsp6ss_axi_m_clk", STRING.MID("&clk", 1, &clk_input_length-2), 0)!=-1)
    ( 
      &match=1
    )
  )
  else if (&wild_head==1)
  (
    if (STRING.MID("ssc_qdsp6ss_axi_m_clk", &clk_itr_length-&clk_input_length+1, &clk_input_length-1)==STRING.CUT("&clk", 1))
    ( 
      &match=1
    )
  )
  else if (&wild_tail==1)
  (
    if (STRING.MID("ssc_qdsp6ss_axi_m_clk", 0, &clk_input_length-1)==STRING.CUT("&clk", -1))
    ( 
      &match=1
    )
  )
  else if ("ssc_qdsp6ss_axi_m_clk"=="&clk")
  (
    &match=1
  )
  
  if (&match==1)
  (
    &clk_test=&CLK_TEST_SSC_QDSP6SS_AXI_M_CLK
    &clk_reg=0
    &clk_reg_name="No CBCR"
    &clk_name="ssc_qdsp6ss_axi_m_clk"
    &clk_reg_cbcr_type=""
    &clk_vote_bit=-1.
    &clk_multiplier=1.

    gosub Print_Clk_Info_Line
  )

  &match=0
  &wild_head=0
  &wild_tail=0
  &clk_input_length=STRING.LENGTH("&clk")
  &clk_itr_length=STRING.LENGTH("ssc_qdsp6ss_ldo_nmo_out")

  if (STRING.SCAN("&clk", "*", 0)==0)
  (
    &wild_head=1
  )
  if (STRING.SCAN("&clk", "*", 1)==(STRING.LENGTH("&clk")-1))
  (
    &wild_tail=1
  )

  if ((&wild_head==1)&&(&wild_tail==1))
  (
    if (STRING.SCAN("ssc_qdsp6ss_ldo_nmo_out", STRING.MID("&clk", 1, &clk_input_length-2), 0)!=-1)
    ( 
      &match=1
    )
  )
  else if (&wild_head==1)
  (
    if (STRING.MID("ssc_qdsp6ss_ldo_nmo_out", &clk_itr_length-&clk_input_length+1, &clk_input_length-1)==STRING.CUT("&clk", 1))
    ( 
      &match=1
    )
  )
  else if (&wild_tail==1)
  (
    if (STRING.MID("ssc_qdsp6ss_ldo_nmo_out", 0, &clk_input_length-1)==STRING.CUT("&clk", -1))
    ( 
      &match=1
    )
  )
  else if ("ssc_qdsp6ss_ldo_nmo_out"=="&clk")
  (
    &match=1
  )
  
  if (&match==1)
  (
    &clk_test=&CLK_TEST_SSC_QDSP6SS_LDO_NMO_OUT
    &clk_reg=0
    &clk_reg_name="No CBCR"
    &clk_name="ssc_qdsp6ss_ldo_nmo_out"
    &clk_reg_cbcr_type=""
    &clk_vote_bit=-1.
    &clk_multiplier=1.

    gosub Print_Clk_Info_Line
  )

  &match=0
  &wild_head=0
  &wild_tail=0
  &clk_input_length=STRING.LENGTH("&clk")
  &clk_itr_length=STRING.LENGTH("ssc_qdsp6ss_ahb_m_clk")

  if (STRING.SCAN("&clk", "*", 0)==0)
  (
    &wild_head=1
  )
  if (STRING.SCAN("&clk", "*", 1)==(STRING.LENGTH("&clk")-1))
  (
    &wild_tail=1
  )

  if ((&wild_head==1)&&(&wild_tail==1))
  (
    if (STRING.SCAN("ssc_qdsp6ss_ahb_m_clk", STRING.MID("&clk", 1, &clk_input_length-2), 0)!=-1)
    ( 
      &match=1
    )
  )
  else if (&wild_head==1)
  (
    if (STRING.MID("ssc_qdsp6ss_ahb_m_clk", &clk_itr_length-&clk_input_length+1, &clk_input_length-1)==STRING.CUT("&clk", 1))
    ( 
      &match=1
    )
  )
  else if (&wild_tail==1)
  (
    if (STRING.MID("ssc_qdsp6ss_ahb_m_clk", 0, &clk_input_length-1)==STRING.CUT("&clk", -1))
    ( 
      &match=1
    )
  )
  else if ("ssc_qdsp6ss_ahb_m_clk"=="&clk")
  (
    &match=1
  )
  
  if (&match==1)
  (
    &clk_test=&CLK_TEST_SSC_QDSP6SS_AHB_M_CLK
    &clk_reg=0
    &clk_reg_name="No CBCR"
    &clk_name="ssc_qdsp6ss_ahb_m_clk"
    &clk_reg_cbcr_type=""
    &clk_vote_bit=-1.
    &clk_multiplier=1.

    gosub Print_Clk_Info_Line
  )

  &match=0
  &wild_head=0
  &wild_tail=0
  &clk_input_length=STRING.LENGTH("&clk")
  &clk_itr_length=STRING.LENGTH("ssc_qdsp6ss_ahb_s_clk")

  if (STRING.SCAN("&clk", "*", 0)==0)
  (
    &wild_head=1
  )
  if (STRING.SCAN("&clk", "*", 1)==(STRING.LENGTH("&clk")-1))
  (
    &wild_tail=1
  )

  if ((&wild_head==1)&&(&wild_tail==1))
  (
    if (STRING.SCAN("ssc_qdsp6ss_ahb_s_clk", STRING.MID("&clk", 1, &clk_input_length-2), 0)!=-1)
    ( 
      &match=1
    )
  )
  else if (&wild_head==1)
  (
    if (STRING.MID("ssc_qdsp6ss_ahb_s_clk", &clk_itr_length-&clk_input_length+1, &clk_input_length-1)==STRING.CUT("&clk", 1))
    ( 
      &match=1
    )
  )
  else if (&wild_tail==1)
  (
    if (STRING.MID("ssc_qdsp6ss_ahb_s_clk", 0, &clk_input_length-1)==STRING.CUT("&clk", -1))
    ( 
      &match=1
    )
  )
  else if ("ssc_qdsp6ss_ahb_s_clk"=="&clk")
  (
    &match=1
  )
  
  if (&match==1)
  (
    &clk_test=&CLK_TEST_SSC_QDSP6SS_AHB_S_CLK
    &clk_reg=0
    &clk_reg_name="No CBCR"
    &clk_name="ssc_qdsp6ss_ahb_s_clk"
    &clk_reg_cbcr_type=""
    &clk_vote_bit=-1.
    &clk_multiplier=1.

    gosub Print_Clk_Info_Line
  )

  &match=0
  &wild_head=0
  &wild_tail=0
  &clk_input_length=STRING.LENGTH("&clk")
  &clk_itr_length=STRING.LENGTH("ssc_qdsp6ss_xo_clk")

  if (STRING.SCAN("&clk", "*", 0)==0)
  (
    &wild_head=1
  )
  if (STRING.SCAN("&clk", "*", 1)==(STRING.LENGTH("&clk")-1))
  (
    &wild_tail=1
  )

  if ((&wild_head==1)&&(&wild_tail==1))
  (
    if (STRING.SCAN("ssc_qdsp6ss_xo_clk", STRING.MID("&clk", 1, &clk_input_length-2), 0)!=-1)
    ( 
      &match=1
    )
  )
  else if (&wild_head==1)
  (
    if (STRING.MID("ssc_qdsp6ss_xo_clk", &clk_itr_length-&clk_input_length+1, &clk_input_length-1)==STRING.CUT("&clk", 1))
    ( 
      &match=1
    )
  )
  else if (&wild_tail==1)
  (
    if (STRING.MID("ssc_qdsp6ss_xo_clk", 0, &clk_input_length-1)==STRING.CUT("&clk", -1))
    ( 
      &match=1
    )
  )
  else if ("ssc_qdsp6ss_xo_clk"=="&clk")
  (
    &match=1
  )
  
  if (&match==1)
  (
    &clk_test=&CLK_TEST_SSC_QDSP6SS_XO_CLK
    &clk_reg=0
    &clk_reg_name="No CBCR"
    &clk_name="ssc_qdsp6ss_xo_clk"
    &clk_reg_cbcr_type=""
    &clk_vote_bit=-1.
    &clk_multiplier=1.

    gosub Print_Clk_Info_Line
  )

  &match=0
  &wild_head=0
  &wild_tail=0
  &clk_input_length=STRING.LENGTH("&clk")
  &clk_itr_length=STRING.LENGTH("ssc_qdsp6ss_sleep_clk")

  if (STRING.SCAN("&clk", "*", 0)==0)
  (
    &wild_head=1
  )
  if (STRING.SCAN("&clk", "*", 1)==(STRING.LENGTH("&clk")-1))
  (
    &wild_tail=1
  )

  if ((&wild_head==1)&&(&wild_tail==1))
  (
    if (STRING.SCAN("ssc_qdsp6ss_sleep_clk", STRING.MID("&clk", 1, &clk_input_length-2), 0)!=-1)
    ( 
      &match=1
    )
  )
  else if (&wild_head==1)
  (
    if (STRING.MID("ssc_qdsp6ss_sleep_clk", &clk_itr_length-&clk_input_length+1, &clk_input_length-1)==STRING.CUT("&clk", 1))
    ( 
      &match=1
    )
  )
  else if (&wild_tail==1)
  (
    if (STRING.MID("ssc_qdsp6ss_sleep_clk", 0, &clk_input_length-1)==STRING.CUT("&clk", -1))
    ( 
      &match=1
    )
  )
  else if ("ssc_qdsp6ss_sleep_clk"=="&clk")
  (
    &match=1
  )
  
  if (&match==1)
  (
    &clk_test=&CLK_TEST_SSC_QDSP6SS_SLEEP_CLK
    &clk_reg=0
    &clk_reg_name="No CBCR"
    &clk_name="ssc_qdsp6ss_sleep_clk"
    &clk_reg_cbcr_type=""
    &clk_vote_bit=-1.
    &clk_multiplier=1.

    gosub Print_Clk_Info_Line
  )

  &match=0
  &wild_head=0
  &wild_tail=0
  &clk_input_length=STRING.LENGTH("&clk")
  &clk_itr_length=STRING.LENGTH("ssc_qdsp6ss_jtag_tck")

  if (STRING.SCAN("&clk", "*", 0)==0)
  (
    &wild_head=1
  )
  if (STRING.SCAN("&clk", "*", 1)==(STRING.LENGTH("&clk")-1))
  (
    &wild_tail=1
  )

  if ((&wild_head==1)&&(&wild_tail==1))
  (
    if (STRING.SCAN("ssc_qdsp6ss_jtag_tck", STRING.MID("&clk", 1, &clk_input_length-2), 0)!=-1)
    ( 
      &match=1
    )
  )
  else if (&wild_head==1)
  (
    if (STRING.MID("ssc_qdsp6ss_jtag_tck", &clk_itr_length-&clk_input_length+1, &clk_input_length-1)==STRING.CUT("&clk", 1))
    ( 
      &match=1
    )
  )
  else if (&wild_tail==1)
  (
    if (STRING.MID("ssc_qdsp6ss_jtag_tck", 0, &clk_input_length-1)==STRING.CUT("&clk", -1))
    ( 
      &match=1
    )
  )
  else if ("ssc_qdsp6ss_jtag_tck"=="&clk")
  (
    &match=1
  )
  
  if (&match==1)
  (
    &clk_test=&CLK_TEST_SSC_QDSP6SS_JTAG_TCK
    &clk_reg=0
    &clk_reg_name="No CBCR"
    &clk_name="ssc_qdsp6ss_jtag_tck"
    &clk_reg_cbcr_type=""
    &clk_vote_bit=-1.
    &clk_multiplier=1.

    gosub Print_Clk_Info_Line
  )

  &match=0
  &wild_head=0
  &wild_tail=0
  &clk_input_length=STRING.LENGTH("&clk")
  &clk_itr_length=STRING.LENGTH("ssc_qdsp6ss_atb_clk")

  if (STRING.SCAN("&clk", "*", 0)==0)
  (
    &wild_head=1
  )
  if (STRING.SCAN("&clk", "*", 1)==(STRING.LENGTH("&clk")-1))
  (
    &wild_tail=1
  )

  if ((&wild_head==1)&&(&wild_tail==1))
  (
    if (STRING.SCAN("ssc_qdsp6ss_atb_clk", STRING.MID("&clk", 1, &clk_input_length-2), 0)!=-1)
    ( 
      &match=1
    )
  )
  else if (&wild_head==1)
  (
    if (STRING.MID("ssc_qdsp6ss_atb_clk", &clk_itr_length-&clk_input_length+1, &clk_input_length-1)==STRING.CUT("&clk", 1))
    ( 
      &match=1
    )
  )
  else if (&wild_tail==1)
  (
    if (STRING.MID("ssc_qdsp6ss_atb_clk", 0, &clk_input_length-1)==STRING.CUT("&clk", -1))
    ( 
      &match=1
    )
  )
  else if ("ssc_qdsp6ss_atb_clk"=="&clk")
  (
    &match=1
  )
  
  if (&match==1)
  (
    &clk_test=&CLK_TEST_SSC_QDSP6SS_ATB_CLK
    &clk_reg=0
    &clk_reg_name="No CBCR"
    &clk_name="ssc_qdsp6ss_atb_clk"
    &clk_reg_cbcr_type=""
    &clk_vote_bit=-1.
    &clk_multiplier=1.

    gosub Print_Clk_Info_Line
  )

  &match=0
  &wild_head=0
  &wild_tail=0
  &clk_input_length=STRING.LENGTH("&clk")
  &clk_itr_length=STRING.LENGTH("ssc_qdsp6ss_apb_clk")

  if (STRING.SCAN("&clk", "*", 0)==0)
  (
    &wild_head=1
  )
  if (STRING.SCAN("&clk", "*", 1)==(STRING.LENGTH("&clk")-1))
  (
    &wild_tail=1
  )

  if ((&wild_head==1)&&(&wild_tail==1))
  (
    if (STRING.SCAN("ssc_qdsp6ss_apb_clk", STRING.MID("&clk", 1, &clk_input_length-2), 0)!=-1)
    ( 
      &match=1
    )
  )
  else if (&wild_head==1)
  (
    if (STRING.MID("ssc_qdsp6ss_apb_clk", &clk_itr_length-&clk_input_length+1, &clk_input_length-1)==STRING.CUT("&clk", 1))
    ( 
      &match=1
    )
  )
  else if (&wild_tail==1)
  (
    if (STRING.MID("ssc_qdsp6ss_apb_clk", 0, &clk_input_length-1)==STRING.CUT("&clk", -1))
    ( 
      &match=1
    )
  )
  else if ("ssc_qdsp6ss_apb_clk"=="&clk")
  (
    &match=1
  )
  
  if (&match==1)
  (
    &clk_test=&CLK_TEST_SSC_QDSP6SS_APB_CLK
    &clk_reg=0
    &clk_reg_name="No CBCR"
    &clk_name="ssc_qdsp6ss_apb_clk"
    &clk_reg_cbcr_type=""
    &clk_vote_bit=-1.
    &clk_multiplier=1.

    gosub Print_Clk_Info_Line
  )

  &match=0
  &wild_head=0
  &wild_tail=0
  &clk_input_length=STRING.LENGTH("&clk")
  &clk_itr_length=STRING.LENGTH("ssc_qdsp6ss_timestamp_clk")

  if (STRING.SCAN("&clk", "*", 0)==0)
  (
    &wild_head=1
  )
  if (STRING.SCAN("&clk", "*", 1)==(STRING.LENGTH("&clk")-1))
  (
    &wild_tail=1
  )

  if ((&wild_head==1)&&(&wild_tail==1))
  (
    if (STRING.SCAN("ssc_qdsp6ss_timestamp_clk", STRING.MID("&clk", 1, &clk_input_length-2), 0)!=-1)
    ( 
      &match=1
    )
  )
  else if (&wild_head==1)
  (
    if (STRING.MID("ssc_qdsp6ss_timestamp_clk", &clk_itr_length-&clk_input_length+1, &clk_input_length-1)==STRING.CUT("&clk", 1))
    ( 
      &match=1
    )
  )
  else if (&wild_tail==1)
  (
    if (STRING.MID("ssc_qdsp6ss_timestamp_clk", 0, &clk_input_length-1)==STRING.CUT("&clk", -1))
    ( 
      &match=1
    )
  )
  else if ("ssc_qdsp6ss_timestamp_clk"=="&clk")
  (
    &match=1
  )
  
  if (&match==1)
  (
    &clk_test=&CLK_TEST_SSC_QDSP6SS_TIMESTAMP_CLK
    &clk_reg=0
    &clk_reg_name="No CBCR"
    &clk_name="ssc_qdsp6ss_timestamp_clk"
    &clk_reg_cbcr_type=""
    &clk_vote_bit=-1.
    &clk_multiplier=1.

    gosub Print_Clk_Info_Line
  )

  &match=0
  &wild_head=0
  &wild_tail=0
  &clk_input_length=STRING.LENGTH("&clk")
  &clk_itr_length=STRING.LENGTH("q6_pll_dtest")

  if (STRING.SCAN("&clk", "*", 0)==0)
  (
    &wild_head=1
  )
  if (STRING.SCAN("&clk", "*", 1)==(STRING.LENGTH("&clk")-1))
  (
    &wild_tail=1
  )

  if ((&wild_head==1)&&(&wild_tail==1))
  (
    if (STRING.SCAN("q6_pll_dtest", STRING.MID("&clk", 1, &clk_input_length-2), 0)!=-1)
    ( 
      &match=1
    )
  )
  else if (&wild_head==1)
  (
    if (STRING.MID("q6_pll_dtest", &clk_itr_length-&clk_input_length+1, &clk_input_length-1)==STRING.CUT("&clk", 1))
    ( 
      &match=1
    )
  )
  else if (&wild_tail==1)
  (
    if (STRING.MID("q6_pll_dtest", 0, &clk_input_length-1)==STRING.CUT("&clk", -1))
    ( 
      &match=1
    )
  )
  else if ("q6_pll_dtest"=="&clk")
  (
    &match=1
  )
  
  if (&match==1)
  (
    &clk_test=&CLK_TEST_Q6_PLL_DTEST
    &clk_reg=0
    &clk_reg_name="No CBCR"
    &clk_name="q6_pll_dtest"
    &clk_reg_cbcr_type=""
    &clk_vote_bit=-1.
    &clk_multiplier=1.

    gosub Print_Clk_Info_Line
  )

  &match=0
  &wild_head=0
  &wild_tail=0
  &clk_input_length=STRING.LENGTH("&clk")
  &clk_itr_length=STRING.LENGTH("q6_pll_lock_det")

  if (STRING.SCAN("&clk", "*", 0)==0)
  (
    &wild_head=1
  )
  if (STRING.SCAN("&clk", "*", 1)==(STRING.LENGTH("&clk")-1))
  (
    &wild_tail=1
  )

  if ((&wild_head==1)&&(&wild_tail==1))
  (
    if (STRING.SCAN("q6_pll_lock_det", STRING.MID("&clk", 1, &clk_input_length-2), 0)!=-1)
    ( 
      &match=1
    )
  )
  else if (&wild_head==1)
  (
    if (STRING.MID("q6_pll_lock_det", &clk_itr_length-&clk_input_length+1, &clk_input_length-1)==STRING.CUT("&clk", 1))
    ( 
      &match=1
    )
  )
  else if (&wild_tail==1)
  (
    if (STRING.MID("q6_pll_lock_det", 0, &clk_input_length-1)==STRING.CUT("&clk", -1))
    ( 
      &match=1
    )
  )
  else if ("q6_pll_lock_det"=="&clk")
  (
    &match=1
  )
  
  if (&match==1)
  (
    &clk_test=&CLK_TEST_Q6_PLL_LOCK_DET
    &clk_reg=0
    &clk_reg_name="No CBCR"
    &clk_name="q6_pll_lock_det"
    &clk_reg_cbcr_type=""
    &clk_vote_bit=-1.
    &clk_multiplier=1.

    gosub Print_Clk_Info_Line
  )

  &match=0
  &wild_head=0
  &wild_tail=0
  &clk_input_length=STRING.LENGTH("&clk")
  &clk_itr_length=STRING.LENGTH("q6ss_dbg_clk")

  if (STRING.SCAN("&clk", "*", 0)==0)
  (
    &wild_head=1
  )
  if (STRING.SCAN("&clk", "*", 1)==(STRING.LENGTH("&clk")-1))
  (
    &wild_tail=1
  )

  if ((&wild_head==1)&&(&wild_tail==1))
  (
    if (STRING.SCAN("q6ss_dbg_clk", STRING.MID("&clk", 1, &clk_input_length-2), 0)!=-1)
    ( 
      &match=1
    )
  )
  else if (&wild_head==1)
  (
    if (STRING.MID("q6ss_dbg_clk", &clk_itr_length-&clk_input_length+1, &clk_input_length-1)==STRING.CUT("&clk", 1))
    ( 
      &match=1
    )
  )
  else if (&wild_tail==1)
  (
    if (STRING.MID("q6ss_dbg_clk", 0, &clk_input_length-1)==STRING.CUT("&clk", -1))
    ( 
      &match=1
    )
  )
  else if ("q6ss_dbg_clk"=="&clk")
  (
    &match=1
  )
  
  if (&match==1)
  (
    &clk_test=&CLK_TEST_Q6SS_DBG_CLK
    &clk_reg=0
    &clk_reg_name="No CBCR"
    &clk_name="q6ss_dbg_clk"
    &clk_reg_cbcr_type=""
    &clk_vote_bit=-1.
    &clk_multiplier=1.

    gosub Print_Clk_Info_Line
  )

  &match=0
  &wild_head=0
  &wild_tail=0
  &clk_input_length=STRING.LENGTH("&clk")
  &clk_itr_length=STRING.LENGTH("scc_peel_pll_lock_det")

  if (STRING.SCAN("&clk", "*", 0)==0)
  (
    &wild_head=1
  )
  if (STRING.SCAN("&clk", "*", 1)==(STRING.LENGTH("&clk")-1))
  (
    &wild_tail=1
  )

  if ((&wild_head==1)&&(&wild_tail==1))
  (
    if (STRING.SCAN("scc_peel_pll_lock_det", STRING.MID("&clk", 1, &clk_input_length-2), 0)!=-1)
    ( 
      &match=1
    )
  )
  else if (&wild_head==1)
  (
    if (STRING.MID("scc_peel_pll_lock_det", &clk_itr_length-&clk_input_length+1, &clk_input_length-1)==STRING.CUT("&clk", 1))
    ( 
      &match=1
    )
  )
  else if (&wild_tail==1)
  (
    if (STRING.MID("scc_peel_pll_lock_det", 0, &clk_input_length-1)==STRING.CUT("&clk", -1))
    ( 
      &match=1
    )
  )
  else if ("scc_peel_pll_lock_det"=="&clk")
  (
    &match=1
  )
  
  if (&match==1)
  (
    &clk_test=&CLK_TEST_SCC_PEEL_PLL_LOCK_DET
    &clk_reg=0
    &clk_reg_name="No CBCR"
    &clk_name="scc_peel_pll_lock_det"
    &clk_reg_cbcr_type=""
    &clk_vote_bit=-1.
    &clk_multiplier=1.

    gosub Print_Clk_Info_Line
  )


  return



;-----------------------------------------------------------------------------
; Set appropriate mux settings for configurable clocks 
;-----------------------------------------------------------------------------

Set_Clock_Freq_Enter:

  ; Return for now. Need to figure out a way to map source to HW.
  return

  if ("&clk"=="gcc_sec_ctrl_acc_clk")
  (
    gosub PRINT_SET_CLOCK_FREQ_WARNING

    &clk_cmd_rcgr_addr=&HWIO_GCC_ACC_CMD_RCGR_ADDR
    &clk_cfg_rcgr_addr=&HWIO_GCC_ACC_CFG_RCGR_ADDR

    print "Choose frequency (MHz) from list below: " 

    print "19.2           37.5           75.0           " 
    print "150.0          200.0          " 

    print ""
    print "Enter desired frequency (r to return): "
    enter &clk_desired_freq
    print ""

    if ("&clk_desired_freq"=="19.2")
    (
      &clk_src_name="XO"
      &clk_src_sel=SRC_SEL TODO.
      &clk_src_div=2.
      &clk_m_val=0.
      &clk_n_val=0.
      &clk_2d_val=0.
      
      gosub Set_Clock_Freq
      return
    )
    else if ("&clk_desired_freq"=="37.5")
    (
      &clk_src_name="GPLL0_OUT_MAIN"
      &clk_src_sel=SRC_SEL TODO.
      &clk_src_div=32.
      &clk_m_val=0.
      &clk_n_val=0.
      &clk_2d_val=0.
      
      gosub Set_Clock_Freq
      return
    )
    else if ("&clk_desired_freq"=="75.0")
    (
      &clk_src_name="GPLL0_OUT_MAIN"
      &clk_src_sel=SRC_SEL TODO.
      &clk_src_div=16.
      &clk_m_val=0.
      &clk_n_val=0.
      &clk_2d_val=0.
      
      gosub Set_Clock_Freq
      return
    )
    else if ("&clk_desired_freq"=="150.0")
    (
      &clk_src_name="GPLL0_OUT_MAIN"
      &clk_src_sel=SRC_SEL TODO.
      &clk_src_div=8.
      &clk_m_val=0.
      &clk_n_val=0.
      &clk_2d_val=0.
      
      gosub Set_Clock_Freq
      return
    )
    else if ("&clk_desired_freq"=="200.0")
    (
      &clk_src_name="GPLL0_OUT_MAIN"
      &clk_src_sel=SRC_SEL TODO.
      &clk_src_div=6.
      &clk_m_val=0.
      &clk_n_val=0.
      &clk_2d_val=0.
      
      gosub Set_Clock_Freq
      return
    )
    else if ("&clk_desired_freq"=="r")
    (
      return
    )
    else
    (
      print "Invalid selection."
      goto Set_Clock_Freq_Enter
    )
  )

  if ("&clk"=="gcc_bimc_xo_clk")||("&clk"=="gcc_cfg_noc_ddr_cfg_clk")||("&clk"=="gcc_cnoc_bus_timeout5_ahb_clk")||("&clk"=="gcc_ddr_dim_cfg_clk")||("&clk"=="gcc_bimc_dtts_xo_clk")
  (
    gosub PRINT_SET_CLOCK_FREQ_WARNING

    &clk_cmd_rcgr_addr=&HWIO_GCC_BIMC_DDR_XO_CMD_RCGR_ADDR
    &clk_cfg_rcgr_addr=&HWIO_GCC_BIMC_DDR_XO_CFG_RCGR_ADDR

    print "Choose frequency (MHz) from list below: " 

    print "19.2           " 

    print ""
    print "Enter desired frequency (r to return): "
    enter &clk_desired_freq
    print ""

    if ("&clk_desired_freq"=="19.2")
    (
      &clk_src_name="XO"
      &clk_src_sel=SRC_SEL TODO.
      &clk_src_div=2.
      &clk_m_val=0.
      &clk_n_val=0.
      &clk_2d_val=0.
      
      gosub Set_Clock_Freq
      return
    )
    else if ("&clk_desired_freq"=="r")
    (
      return
    )
    else
    (
      print "Invalid selection."
      goto Set_Clock_Freq_Enter
    )
  )

  if ("&clk"=="gcc_blsp1_qup1_i2c_apps_clk")
  (
    gosub PRINT_SET_CLOCK_FREQ_WARNING

    &clk_cmd_rcgr_addr=&HWIO_GCC_BLSP1_QUP1_I2C_APPS_CMD_RCGR_ADDR
    &clk_cfg_rcgr_addr=&HWIO_GCC_BLSP1_QUP1_I2C_APPS_CFG_RCGR_ADDR

    print "Choose frequency (MHz) from list below: " 

    print "19.2           50.0           " 

    print ""
    print "Enter desired frequency (r to return): "
    enter &clk_desired_freq
    print ""

    if ("&clk_desired_freq"=="19.2")
    (
      &clk_src_name="XO"
      &clk_src_sel=SRC_SEL TODO.
      &clk_src_div=2.
      &clk_m_val=0.
      &clk_n_val=0.
      &clk_2d_val=0.
      
      gosub Set_Clock_Freq
      return
    )
    else if ("&clk_desired_freq"=="50.0")
    (
      &clk_src_name="GPLL0_OUT_MAIN"
      &clk_src_sel=SRC_SEL TODO.
      &clk_src_div=24.
      &clk_m_val=0.
      &clk_n_val=0.
      &clk_2d_val=0.
      
      gosub Set_Clock_Freq
      return
    )
    else if ("&clk_desired_freq"=="r")
    (
      return
    )
    else
    (
      print "Invalid selection."
      goto Set_Clock_Freq_Enter
    )
  )

  if ("&clk"=="gcc_blsp1_qup1_spi_apps_clk")
  (
    gosub PRINT_SET_CLOCK_FREQ_WARNING

    &clk_cmd_rcgr_addr=&HWIO_GCC_BLSP1_QUP1_SPI_APPS_CMD_RCGR_ADDR
    &clk_cfg_rcgr_addr=&HWIO_GCC_BLSP1_QUP1_SPI_APPS_CFG_RCGR_ADDR

    print "Choose frequency (MHz) from list below: " 

    print "0.96           4.8            9.6            " 
    print "15.0           19.2           25.0           " 
    print "50.0           " 

    print ""
    print "Enter desired frequency (r to return): "
    enter &clk_desired_freq
    print ""

    if ("&clk_desired_freq"=="0.96")
    (
      &clk_src_name="XO"
      &clk_src_sel=SRC_SEL TODO.
      &clk_src_div=20.
      &clk_m_val=1.
      &clk_n_val=2.
      &clk_2d_val=2.
      
      gosub Set_Clock_Freq
      return
    )
    else if ("&clk_desired_freq"=="4.8")
    (
      &clk_src_name="XO"
      &clk_src_sel=SRC_SEL TODO.
      &clk_src_div=8.
      &clk_m_val=0.
      &clk_n_val=0.
      &clk_2d_val=0.
      
      gosub Set_Clock_Freq
      return
    )
    else if ("&clk_desired_freq"=="9.6")
    (
      &clk_src_name="XO"
      &clk_src_sel=SRC_SEL TODO.
      &clk_src_div=4.
      &clk_m_val=0.
      &clk_n_val=0.
      &clk_2d_val=0.
      
      gosub Set_Clock_Freq
      return
    )
    else if ("&clk_desired_freq"=="15.0")
    (
      &clk_src_name="GPLL0_OUT_MAIN"
      &clk_src_sel=SRC_SEL TODO.
      &clk_src_div=20.
      &clk_m_val=1.
      &clk_n_val=4.
      &clk_2d_val=4.
      
      gosub Set_Clock_Freq
      return
    )
    else if ("&clk_desired_freq"=="19.2")
    (
      &clk_src_name="XO"
      &clk_src_sel=SRC_SEL TODO.
      &clk_src_div=2.
      &clk_m_val=0.
      &clk_n_val=0.
      &clk_2d_val=0.
      
      gosub Set_Clock_Freq
      return
    )
    else if ("&clk_desired_freq"=="25.0")
    (
      &clk_src_name="GPLL0_OUT_MAIN"
      &clk_src_sel=SRC_SEL TODO.
      &clk_src_div=24.
      &clk_m_val=1.
      &clk_n_val=2.
      &clk_2d_val=2.
      
      gosub Set_Clock_Freq
      return
    )
    else if ("&clk_desired_freq"=="50.0")
    (
      &clk_src_name="GPLL0_OUT_MAIN"
      &clk_src_sel=SRC_SEL TODO.
      &clk_src_div=24.
      &clk_m_val=0.
      &clk_n_val=0.
      &clk_2d_val=0.
      
      gosub Set_Clock_Freq
      return
    )
    else if ("&clk_desired_freq"=="r")
    (
      return
    )
    else
    (
      print "Invalid selection."
      goto Set_Clock_Freq_Enter
    )
  )

  if ("&clk"=="gcc_blsp1_qup2_i2c_apps_clk")
  (
    gosub PRINT_SET_CLOCK_FREQ_WARNING

    &clk_cmd_rcgr_addr=&HWIO_GCC_BLSP1_QUP2_I2C_APPS_CMD_RCGR_ADDR
    &clk_cfg_rcgr_addr=&HWIO_GCC_BLSP1_QUP2_I2C_APPS_CFG_RCGR_ADDR

    print "Choose frequency (MHz) from list below: " 

    print "19.2           50.0           " 

    print ""
    print "Enter desired frequency (r to return): "
    enter &clk_desired_freq
    print ""

    if ("&clk_desired_freq"=="19.2")
    (
      &clk_src_name="XO"
      &clk_src_sel=SRC_SEL TODO.
      &clk_src_div=2.
      &clk_m_val=0.
      &clk_n_val=0.
      &clk_2d_val=0.
      
      gosub Set_Clock_Freq
      return
    )
    else if ("&clk_desired_freq"=="50.0")
    (
      &clk_src_name="GPLL0_OUT_MAIN"
      &clk_src_sel=SRC_SEL TODO.
      &clk_src_div=24.
      &clk_m_val=0.
      &clk_n_val=0.
      &clk_2d_val=0.
      
      gosub Set_Clock_Freq
      return
    )
    else if ("&clk_desired_freq"=="r")
    (
      return
    )
    else
    (
      print "Invalid selection."
      goto Set_Clock_Freq_Enter
    )
  )

  if ("&clk"=="gcc_blsp1_qup2_spi_apps_clk")
  (
    gosub PRINT_SET_CLOCK_FREQ_WARNING

    &clk_cmd_rcgr_addr=&HWIO_GCC_BLSP1_QUP2_SPI_APPS_CMD_RCGR_ADDR
    &clk_cfg_rcgr_addr=&HWIO_GCC_BLSP1_QUP2_SPI_APPS_CFG_RCGR_ADDR

    print "Choose frequency (MHz) from list below: " 

    print "0.96           4.8            9.6            " 
    print "15.0           19.2           25.0           " 
    print "50.0           " 

    print ""
    print "Enter desired frequency (r to return): "
    enter &clk_desired_freq
    print ""

    if ("&clk_desired_freq"=="0.96")
    (
      &clk_src_name="XO"
      &clk_src_sel=SRC_SEL TODO.
      &clk_src_div=20.
      &clk_m_val=1.
      &clk_n_val=2.
      &clk_2d_val=2.
      
      gosub Set_Clock_Freq
      return
    )
    else if ("&clk_desired_freq"=="4.8")
    (
      &clk_src_name="XO"
      &clk_src_sel=SRC_SEL TODO.
      &clk_src_div=8.
      &clk_m_val=0.
      &clk_n_val=0.
      &clk_2d_val=0.
      
      gosub Set_Clock_Freq
      return
    )
    else if ("&clk_desired_freq"=="9.6")
    (
      &clk_src_name="XO"
      &clk_src_sel=SRC_SEL TODO.
      &clk_src_div=4.
      &clk_m_val=0.
      &clk_n_val=0.
      &clk_2d_val=0.
      
      gosub Set_Clock_Freq
      return
    )
    else if ("&clk_desired_freq"=="15.0")
    (
      &clk_src_name="GPLL0_OUT_MAIN"
      &clk_src_sel=SRC_SEL TODO.
      &clk_src_div=20.
      &clk_m_val=1.
      &clk_n_val=4.
      &clk_2d_val=4.
      
      gosub Set_Clock_Freq
      return
    )
    else if ("&clk_desired_freq"=="19.2")
    (
      &clk_src_name="XO"
      &clk_src_sel=SRC_SEL TODO.
      &clk_src_div=2.
      &clk_m_val=0.
      &clk_n_val=0.
      &clk_2d_val=0.
      
      gosub Set_Clock_Freq
      return
    )
    else if ("&clk_desired_freq"=="25.0")
    (
      &clk_src_name="GPLL0_OUT_MAIN"
      &clk_src_sel=SRC_SEL TODO.
      &clk_src_div=24.
      &clk_m_val=1.
      &clk_n_val=2.
      &clk_2d_val=2.
      
      gosub Set_Clock_Freq
      return
    )
    else if ("&clk_desired_freq"=="50.0")
    (
      &clk_src_name="GPLL0_OUT_MAIN"
      &clk_src_sel=SRC_SEL TODO.
      &clk_src_div=24.
      &clk_m_val=0.
      &clk_n_val=0.
      &clk_2d_val=0.
      
      gosub Set_Clock_Freq
      return
    )
    else if ("&clk_desired_freq"=="r")
    (
      return
    )
    else
    (
      print "Invalid selection."
      goto Set_Clock_Freq_Enter
    )
  )

  if ("&clk"=="gcc_blsp1_qup3_i2c_apps_clk")
  (
    gosub PRINT_SET_CLOCK_FREQ_WARNING

    &clk_cmd_rcgr_addr=&HWIO_GCC_BLSP1_QUP3_I2C_APPS_CMD_RCGR_ADDR
    &clk_cfg_rcgr_addr=&HWIO_GCC_BLSP1_QUP3_I2C_APPS_CFG_RCGR_ADDR

    print "Choose frequency (MHz) from list below: " 

    print "19.2           50.0           " 

    print ""
    print "Enter desired frequency (r to return): "
    enter &clk_desired_freq
    print ""

    if ("&clk_desired_freq"=="19.2")
    (
      &clk_src_name="XO"
      &clk_src_sel=SRC_SEL TODO.
      &clk_src_div=2.
      &clk_m_val=0.
      &clk_n_val=0.
      &clk_2d_val=0.
      
      gosub Set_Clock_Freq
      return
    )
    else if ("&clk_desired_freq"=="50.0")
    (
      &clk_src_name="GPLL0_OUT_MAIN"
      &clk_src_sel=SRC_SEL TODO.
      &clk_src_div=24.
      &clk_m_val=0.
      &clk_n_val=0.
      &clk_2d_val=0.
      
      gosub Set_Clock_Freq
      return
    )
    else if ("&clk_desired_freq"=="r")
    (
      return
    )
    else
    (
      print "Invalid selection."
      goto Set_Clock_Freq_Enter
    )
  )

  if ("&clk"=="gcc_blsp1_qup3_spi_apps_clk")
  (
    gosub PRINT_SET_CLOCK_FREQ_WARNING

    &clk_cmd_rcgr_addr=&HWIO_GCC_BLSP1_QUP3_SPI_APPS_CMD_RCGR_ADDR
    &clk_cfg_rcgr_addr=&HWIO_GCC_BLSP1_QUP3_SPI_APPS_CFG_RCGR_ADDR

    print "Choose frequency (MHz) from list below: " 

    print "0.96           4.8            9.6            " 
    print "15.0           19.2           25.0           " 
    print "50.0           " 

    print ""
    print "Enter desired frequency (r to return): "
    enter &clk_desired_freq
    print ""

    if ("&clk_desired_freq"=="0.96")
    (
      &clk_src_name="XO"
      &clk_src_sel=SRC_SEL TODO.
      &clk_src_div=20.
      &clk_m_val=1.
      &clk_n_val=2.
      &clk_2d_val=2.
      
      gosub Set_Clock_Freq
      return
    )
    else if ("&clk_desired_freq"=="4.8")
    (
      &clk_src_name="XO"
      &clk_src_sel=SRC_SEL TODO.
      &clk_src_div=8.
      &clk_m_val=0.
      &clk_n_val=0.
      &clk_2d_val=0.
      
      gosub Set_Clock_Freq
      return
    )
    else if ("&clk_desired_freq"=="9.6")
    (
      &clk_src_name="XO"
      &clk_src_sel=SRC_SEL TODO.
      &clk_src_div=4.
      &clk_m_val=0.
      &clk_n_val=0.
      &clk_2d_val=0.
      
      gosub Set_Clock_Freq
      return
    )
    else if ("&clk_desired_freq"=="15.0")
    (
      &clk_src_name="GPLL0_OUT_MAIN"
      &clk_src_sel=SRC_SEL TODO.
      &clk_src_div=20.
      &clk_m_val=1.
      &clk_n_val=4.
      &clk_2d_val=4.
      
      gosub Set_Clock_Freq
      return
    )
    else if ("&clk_desired_freq"=="19.2")
    (
      &clk_src_name="XO"
      &clk_src_sel=SRC_SEL TODO.
      &clk_src_div=2.
      &clk_m_val=0.
      &clk_n_val=0.
      &clk_2d_val=0.
      
      gosub Set_Clock_Freq
      return
    )
    else if ("&clk_desired_freq"=="25.0")
    (
      &clk_src_name="GPLL0_OUT_MAIN"
      &clk_src_sel=SRC_SEL TODO.
      &clk_src_div=24.
      &clk_m_val=1.
      &clk_n_val=2.
      &clk_2d_val=2.
      
      gosub Set_Clock_Freq
      return
    )
    else if ("&clk_desired_freq"=="50.0")
    (
      &clk_src_name="GPLL0_OUT_MAIN"
      &clk_src_sel=SRC_SEL TODO.
      &clk_src_div=24.
      &clk_m_val=0.
      &clk_n_val=0.
      &clk_2d_val=0.
      
      gosub Set_Clock_Freq
      return
    )
    else if ("&clk_desired_freq"=="r")
    (
      return
    )
    else
    (
      print "Invalid selection."
      goto Set_Clock_Freq_Enter
    )
  )

  if ("&clk"=="gcc_blsp1_qup4_i2c_apps_clk")
  (
    gosub PRINT_SET_CLOCK_FREQ_WARNING

    &clk_cmd_rcgr_addr=&HWIO_GCC_BLSP1_QUP4_I2C_APPS_CMD_RCGR_ADDR
    &clk_cfg_rcgr_addr=&HWIO_GCC_BLSP1_QUP4_I2C_APPS_CFG_RCGR_ADDR

    print "Choose frequency (MHz) from list below: " 

    print "19.2           50.0           " 

    print ""
    print "Enter desired frequency (r to return): "
    enter &clk_desired_freq
    print ""

    if ("&clk_desired_freq"=="19.2")
    (
      &clk_src_name="XO"
      &clk_src_sel=SRC_SEL TODO.
      &clk_src_div=2.
      &clk_m_val=0.
      &clk_n_val=0.
      &clk_2d_val=0.
      
      gosub Set_Clock_Freq
      return
    )
    else if ("&clk_desired_freq"=="50.0")
    (
      &clk_src_name="GPLL0_OUT_MAIN"
      &clk_src_sel=SRC_SEL TODO.
      &clk_src_div=24.
      &clk_m_val=0.
      &clk_n_val=0.
      &clk_2d_val=0.
      
      gosub Set_Clock_Freq
      return
    )
    else if ("&clk_desired_freq"=="r")
    (
      return
    )
    else
    (
      print "Invalid selection."
      goto Set_Clock_Freq_Enter
    )
  )

  if ("&clk"=="gcc_blsp1_qup4_spi_apps_clk")
  (
    gosub PRINT_SET_CLOCK_FREQ_WARNING

    &clk_cmd_rcgr_addr=&HWIO_GCC_BLSP1_QUP4_SPI_APPS_CMD_RCGR_ADDR
    &clk_cfg_rcgr_addr=&HWIO_GCC_BLSP1_QUP4_SPI_APPS_CFG_RCGR_ADDR

    print "Choose frequency (MHz) from list below: " 

    print "0.96           4.8            9.6            " 
    print "15.0           19.2           25.0           " 
    print "50.0           " 

    print ""
    print "Enter desired frequency (r to return): "
    enter &clk_desired_freq
    print ""

    if ("&clk_desired_freq"=="0.96")
    (
      &clk_src_name="XO"
      &clk_src_sel=SRC_SEL TODO.
      &clk_src_div=20.
      &clk_m_val=1.
      &clk_n_val=2.
      &clk_2d_val=2.
      
      gosub Set_Clock_Freq
      return
    )
    else if ("&clk_desired_freq"=="4.8")
    (
      &clk_src_name="XO"
      &clk_src_sel=SRC_SEL TODO.
      &clk_src_div=8.
      &clk_m_val=0.
      &clk_n_val=0.
      &clk_2d_val=0.
      
      gosub Set_Clock_Freq
      return
    )
    else if ("&clk_desired_freq"=="9.6")
    (
      &clk_src_name="XO"
      &clk_src_sel=SRC_SEL TODO.
      &clk_src_div=4.
      &clk_m_val=0.
      &clk_n_val=0.
      &clk_2d_val=0.
      
      gosub Set_Clock_Freq
      return
    )
    else if ("&clk_desired_freq"=="15.0")
    (
      &clk_src_name="GPLL0_OUT_MAIN"
      &clk_src_sel=SRC_SEL TODO.
      &clk_src_div=20.
      &clk_m_val=1.
      &clk_n_val=4.
      &clk_2d_val=4.
      
      gosub Set_Clock_Freq
      return
    )
    else if ("&clk_desired_freq"=="19.2")
    (
      &clk_src_name="XO"
      &clk_src_sel=SRC_SEL TODO.
      &clk_src_div=2.
      &clk_m_val=0.
      &clk_n_val=0.
      &clk_2d_val=0.
      
      gosub Set_Clock_Freq
      return
    )
    else if ("&clk_desired_freq"=="25.0")
    (
      &clk_src_name="GPLL0_OUT_MAIN"
      &clk_src_sel=SRC_SEL TODO.
      &clk_src_div=24.
      &clk_m_val=1.
      &clk_n_val=2.
      &clk_2d_val=2.
      
      gosub Set_Clock_Freq
      return
    )
    else if ("&clk_desired_freq"=="50.0")
    (
      &clk_src_name="GPLL0_OUT_MAIN"
      &clk_src_sel=SRC_SEL TODO.
      &clk_src_div=24.
      &clk_m_val=0.
      &clk_n_val=0.
      &clk_2d_val=0.
      
      gosub Set_Clock_Freq
      return
    )
    else if ("&clk_desired_freq"=="r")
    (
      return
    )
    else
    (
      print "Invalid selection."
      goto Set_Clock_Freq_Enter
    )
  )

  if ("&clk"=="gcc_blsp1_qup5_i2c_apps_clk")
  (
    gosub PRINT_SET_CLOCK_FREQ_WARNING

    &clk_cmd_rcgr_addr=&HWIO_GCC_BLSP1_QUP5_I2C_APPS_CMD_RCGR_ADDR
    &clk_cfg_rcgr_addr=&HWIO_GCC_BLSP1_QUP5_I2C_APPS_CFG_RCGR_ADDR

    print "Choose frequency (MHz) from list below: " 

    print "19.2           50.0           " 

    print ""
    print "Enter desired frequency (r to return): "
    enter &clk_desired_freq
    print ""

    if ("&clk_desired_freq"=="19.2")
    (
      &clk_src_name="XO"
      &clk_src_sel=SRC_SEL TODO.
      &clk_src_div=2.
      &clk_m_val=0.
      &clk_n_val=0.
      &clk_2d_val=0.
      
      gosub Set_Clock_Freq
      return
    )
    else if ("&clk_desired_freq"=="50.0")
    (
      &clk_src_name="GPLL0_OUT_MAIN"
      &clk_src_sel=SRC_SEL TODO.
      &clk_src_div=24.
      &clk_m_val=0.
      &clk_n_val=0.
      &clk_2d_val=0.
      
      gosub Set_Clock_Freq
      return
    )
    else if ("&clk_desired_freq"=="r")
    (
      return
    )
    else
    (
      print "Invalid selection."
      goto Set_Clock_Freq_Enter
    )
  )

  if ("&clk"=="gcc_blsp1_qup5_spi_apps_clk")
  (
    gosub PRINT_SET_CLOCK_FREQ_WARNING

    &clk_cmd_rcgr_addr=&HWIO_GCC_BLSP1_QUP5_SPI_APPS_CMD_RCGR_ADDR
    &clk_cfg_rcgr_addr=&HWIO_GCC_BLSP1_QUP5_SPI_APPS_CFG_RCGR_ADDR

    print "Choose frequency (MHz) from list below: " 

    print "0.96           4.8            9.6            " 
    print "15.0           19.2           25.0           " 
    print "50.0           " 

    print ""
    print "Enter desired frequency (r to return): "
    enter &clk_desired_freq
    print ""

    if ("&clk_desired_freq"=="0.96")
    (
      &clk_src_name="XO"
      &clk_src_sel=SRC_SEL TODO.
      &clk_src_div=20.
      &clk_m_val=1.
      &clk_n_val=2.
      &clk_2d_val=2.
      
      gosub Set_Clock_Freq
      return
    )
    else if ("&clk_desired_freq"=="4.8")
    (
      &clk_src_name="XO"
      &clk_src_sel=SRC_SEL TODO.
      &clk_src_div=8.
      &clk_m_val=0.
      &clk_n_val=0.
      &clk_2d_val=0.
      
      gosub Set_Clock_Freq
      return
    )
    else if ("&clk_desired_freq"=="9.6")
    (
      &clk_src_name="XO"
      &clk_src_sel=SRC_SEL TODO.
      &clk_src_div=4.
      &clk_m_val=0.
      &clk_n_val=0.
      &clk_2d_val=0.
      
      gosub Set_Clock_Freq
      return
    )
    else if ("&clk_desired_freq"=="15.0")
    (
      &clk_src_name="GPLL0_OUT_MAIN"
      &clk_src_sel=SRC_SEL TODO.
      &clk_src_div=20.
      &clk_m_val=1.
      &clk_n_val=4.
      &clk_2d_val=4.
      
      gosub Set_Clock_Freq
      return
    )
    else if ("&clk_desired_freq"=="19.2")
    (
      &clk_src_name="XO"
      &clk_src_sel=SRC_SEL TODO.
      &clk_src_div=2.
      &clk_m_val=0.
      &clk_n_val=0.
      &clk_2d_val=0.
      
      gosub Set_Clock_Freq
      return
    )
    else if ("&clk_desired_freq"=="25.0")
    (
      &clk_src_name="GPLL0_OUT_MAIN"
      &clk_src_sel=SRC_SEL TODO.
      &clk_src_div=24.
      &clk_m_val=1.
      &clk_n_val=2.
      &clk_2d_val=2.
      
      gosub Set_Clock_Freq
      return
    )
    else if ("&clk_desired_freq"=="50.0")
    (
      &clk_src_name="GPLL0_OUT_MAIN"
      &clk_src_sel=SRC_SEL TODO.
      &clk_src_div=24.
      &clk_m_val=0.
      &clk_n_val=0.
      &clk_2d_val=0.
      
      gosub Set_Clock_Freq
      return
    )
    else if ("&clk_desired_freq"=="r")
    (
      return
    )
    else
    (
      print "Invalid selection."
      goto Set_Clock_Freq_Enter
    )
  )

  if ("&clk"=="gcc_blsp1_qup6_i2c_apps_clk")
  (
    gosub PRINT_SET_CLOCK_FREQ_WARNING

    &clk_cmd_rcgr_addr=&HWIO_GCC_BLSP1_QUP6_I2C_APPS_CMD_RCGR_ADDR
    &clk_cfg_rcgr_addr=&HWIO_GCC_BLSP1_QUP6_I2C_APPS_CFG_RCGR_ADDR

    print "Choose frequency (MHz) from list below: " 

    print "19.2           50.0           " 

    print ""
    print "Enter desired frequency (r to return): "
    enter &clk_desired_freq
    print ""

    if ("&clk_desired_freq"=="19.2")
    (
      &clk_src_name="XO"
      &clk_src_sel=SRC_SEL TODO.
      &clk_src_div=2.
      &clk_m_val=0.
      &clk_n_val=0.
      &clk_2d_val=0.
      
      gosub Set_Clock_Freq
      return
    )
    else if ("&clk_desired_freq"=="50.0")
    (
      &clk_src_name="GPLL0_OUT_MAIN"
      &clk_src_sel=SRC_SEL TODO.
      &clk_src_div=24.
      &clk_m_val=0.
      &clk_n_val=0.
      &clk_2d_val=0.
      
      gosub Set_Clock_Freq
      return
    )
    else if ("&clk_desired_freq"=="r")
    (
      return
    )
    else
    (
      print "Invalid selection."
      goto Set_Clock_Freq_Enter
    )
  )

  if ("&clk"=="gcc_blsp1_qup6_spi_apps_clk")
  (
    gosub PRINT_SET_CLOCK_FREQ_WARNING

    &clk_cmd_rcgr_addr=&HWIO_GCC_BLSP1_QUP6_SPI_APPS_CMD_RCGR_ADDR
    &clk_cfg_rcgr_addr=&HWIO_GCC_BLSP1_QUP6_SPI_APPS_CFG_RCGR_ADDR

    print "Choose frequency (MHz) from list below: " 

    print "0.96           4.8            9.6            " 
    print "15.0           19.2           25.0           " 
    print "50.0           " 

    print ""
    print "Enter desired frequency (r to return): "
    enter &clk_desired_freq
    print ""

    if ("&clk_desired_freq"=="0.96")
    (
      &clk_src_name="XO"
      &clk_src_sel=SRC_SEL TODO.
      &clk_src_div=20.
      &clk_m_val=1.
      &clk_n_val=2.
      &clk_2d_val=2.
      
      gosub Set_Clock_Freq
      return
    )
    else if ("&clk_desired_freq"=="4.8")
    (
      &clk_src_name="XO"
      &clk_src_sel=SRC_SEL TODO.
      &clk_src_div=8.
      &clk_m_val=0.
      &clk_n_val=0.
      &clk_2d_val=0.
      
      gosub Set_Clock_Freq
      return
    )
    else if ("&clk_desired_freq"=="9.6")
    (
      &clk_src_name="XO"
      &clk_src_sel=SRC_SEL TODO.
      &clk_src_div=4.
      &clk_m_val=0.
      &clk_n_val=0.
      &clk_2d_val=0.
      
      gosub Set_Clock_Freq
      return
    )
    else if ("&clk_desired_freq"=="15.0")
    (
      &clk_src_name="GPLL0_OUT_MAIN"
      &clk_src_sel=SRC_SEL TODO.
      &clk_src_div=20.
      &clk_m_val=1.
      &clk_n_val=4.
      &clk_2d_val=4.
      
      gosub Set_Clock_Freq
      return
    )
    else if ("&clk_desired_freq"=="19.2")
    (
      &clk_src_name="XO"
      &clk_src_sel=SRC_SEL TODO.
      &clk_src_div=2.
      &clk_m_val=0.
      &clk_n_val=0.
      &clk_2d_val=0.
      
      gosub Set_Clock_Freq
      return
    )
    else if ("&clk_desired_freq"=="25.0")
    (
      &clk_src_name="GPLL0_OUT_MAIN"
      &clk_src_sel=SRC_SEL TODO.
      &clk_src_div=24.
      &clk_m_val=1.
      &clk_n_val=2.
      &clk_2d_val=2.
      
      gosub Set_Clock_Freq
      return
    )
    else if ("&clk_desired_freq"=="50.0")
    (
      &clk_src_name="GPLL0_OUT_MAIN"
      &clk_src_sel=SRC_SEL TODO.
      &clk_src_div=24.
      &clk_m_val=0.
      &clk_n_val=0.
      &clk_2d_val=0.
      
      gosub Set_Clock_Freq
      return
    )
    else if ("&clk_desired_freq"=="r")
    (
      return
    )
    else
    (
      print "Invalid selection."
      goto Set_Clock_Freq_Enter
    )
  )

  if ("&clk"=="gcc_blsp1_uart1_apps_clk")
  (
    gosub PRINT_SET_CLOCK_FREQ_WARNING

    &clk_cmd_rcgr_addr=&HWIO_GCC_BLSP1_UART1_APPS_CMD_RCGR_ADDR
    &clk_cfg_rcgr_addr=&HWIO_GCC_BLSP1_UART1_APPS_CFG_RCGR_ADDR

    print "Choose frequency (MHz) from list below: " 

    print "3.6864         7.3728         14.7456        " 
    print "16.0           19.2           24.0           " 
    print "32.0           40.0           46.4           " 
    print "48.0           51.2           56.0           " 
    print "58.9824        60.0           63.157895      " 

    print ""
    print "Enter desired frequency (r to return): "
    enter &clk_desired_freq
    print ""

    if ("&clk_desired_freq"=="3.6864")
    (
      &clk_src_name="GPLL0_OUT_MAIN"
      &clk_src_sel=SRC_SEL TODO.
      &clk_src_div=2.
      &clk_m_val=96.
      &clk_n_val=15625.
      &clk_2d_val=15625.
      
      gosub Set_Clock_Freq
      return
    )
    else if ("&clk_desired_freq"=="7.3728")
    (
      &clk_src_name="GPLL0_OUT_MAIN"
      &clk_src_sel=SRC_SEL TODO.
      &clk_src_div=2.
      &clk_m_val=192.
      &clk_n_val=15625.
      &clk_2d_val=15625.
      
      gosub Set_Clock_Freq
      return
    )
    else if ("&clk_desired_freq"=="14.7456")
    (
      &clk_src_name="GPLL0_OUT_MAIN"
      &clk_src_sel=SRC_SEL TODO.
      &clk_src_div=2.
      &clk_m_val=384.
      &clk_n_val=15625.
      &clk_2d_val=15625.
      
      gosub Set_Clock_Freq
      return
    )
    else if ("&clk_desired_freq"=="16.0")
    (
      &clk_src_name="GPLL0_OUT_MAIN"
      &clk_src_sel=SRC_SEL TODO.
      &clk_src_div=10.
      &clk_m_val=2.
      &clk_n_val=15.
      &clk_2d_val=15.
      
      gosub Set_Clock_Freq
      return
    )
    else if ("&clk_desired_freq"=="19.2")
    (
      &clk_src_name="XO"
      &clk_src_sel=SRC_SEL TODO.
      &clk_src_div=2.
      &clk_m_val=0.
      &clk_n_val=0.
      &clk_2d_val=0.
      
      gosub Set_Clock_Freq
      return
    )
    else if ("&clk_desired_freq"=="24.0")
    (
      &clk_src_name="GPLL0_OUT_MAIN"
      &clk_src_sel=SRC_SEL TODO.
      &clk_src_div=10.
      &clk_m_val=1.
      &clk_n_val=5.
      &clk_2d_val=5.
      
      gosub Set_Clock_Freq
      return
    )
    else if ("&clk_desired_freq"=="32.0")
    (
      &clk_src_name="GPLL0_OUT_MAIN"
      &clk_src_sel=SRC_SEL TODO.
      &clk_src_div=2.
      &clk_m_val=4.
      &clk_n_val=75.
      &clk_2d_val=75.
      
      gosub Set_Clock_Freq
      return
    )
    else if ("&clk_desired_freq"=="40.0")
    (
      &clk_src_name="GPLL0_OUT_MAIN"
      &clk_src_sel=SRC_SEL TODO.
      &clk_src_div=30.
      &clk_m_val=0.
      &clk_n_val=0.
      &clk_2d_val=0.
      
      gosub Set_Clock_Freq
      return
    )
    else if ("&clk_desired_freq"=="46.4")
    (
      &clk_src_name="GPLL0_OUT_MAIN"
      &clk_src_sel=SRC_SEL TODO.
      &clk_src_div=2.
      &clk_m_val=29.
      &clk_n_val=375.
      &clk_2d_val=375.
      
      gosub Set_Clock_Freq
      return
    )
    else if ("&clk_desired_freq"=="48.0")
    (
      &clk_src_name="GPLL0_OUT_MAIN"
      &clk_src_sel=SRC_SEL TODO.
      &clk_src_div=25.
      &clk_m_val=0.
      &clk_n_val=0.
      &clk_2d_val=0.
      
      gosub Set_Clock_Freq
      return
    )
    else if ("&clk_desired_freq"=="51.2")
    (
      &clk_src_name="GPLL0_OUT_MAIN"
      &clk_src_sel=SRC_SEL TODO.
      &clk_src_div=2.
      &clk_m_val=32.
      &clk_n_val=375.
      &clk_2d_val=375.
      
      gosub Set_Clock_Freq
      return
    )
    else if ("&clk_desired_freq"=="56.0")
    (
      &clk_src_name="GPLL0_OUT_MAIN"
      &clk_src_sel=SRC_SEL TODO.
      &clk_src_div=2.
      &clk_m_val=7.
      &clk_n_val=75.
      &clk_2d_val=75.
      
      gosub Set_Clock_Freq
      return
    )
    else if ("&clk_desired_freq"=="58.9824")
    (
      &clk_src_name="GPLL0_OUT_MAIN"
      &clk_src_sel=SRC_SEL TODO.
      &clk_src_div=2.
      &clk_m_val=1536.
      &clk_n_val=15625.
      &clk_2d_val=15625.
      
      gosub Set_Clock_Freq
      return
    )
    else if ("&clk_desired_freq"=="60.0")
    (
      &clk_src_name="GPLL0_OUT_MAIN"
      &clk_src_sel=SRC_SEL TODO.
      &clk_src_div=20.
      &clk_m_val=0.
      &clk_n_val=0.
      &clk_2d_val=0.
      
      gosub Set_Clock_Freq
      return
    )
    else if ("&clk_desired_freq"=="63.157895")
    (
      &clk_src_name="GPLL0_OUT_MAIN"
      &clk_src_sel=SRC_SEL TODO.
      &clk_src_div=19.
      &clk_m_val=0.
      &clk_n_val=0.
      &clk_2d_val=0.
      
      gosub Set_Clock_Freq
      return
    )
    else if ("&clk_desired_freq"=="r")
    (
      return
    )
    else
    (
      print "Invalid selection."
      goto Set_Clock_Freq_Enter
    )
  )

  if ("&clk"=="gcc_blsp1_uart2_apps_clk")
  (
    gosub PRINT_SET_CLOCK_FREQ_WARNING

    &clk_cmd_rcgr_addr=&HWIO_GCC_BLSP1_UART2_APPS_CMD_RCGR_ADDR
    &clk_cfg_rcgr_addr=&HWIO_GCC_BLSP1_UART2_APPS_CFG_RCGR_ADDR

    print "Choose frequency (MHz) from list below: " 

    print "3.6864         7.3728         14.7456        " 
    print "16.0           19.2           24.0           " 
    print "32.0           40.0           46.4           " 
    print "48.0           51.2           56.0           " 
    print "58.9824        60.0           63.157895      " 

    print ""
    print "Enter desired frequency (r to return): "
    enter &clk_desired_freq
    print ""

    if ("&clk_desired_freq"=="3.6864")
    (
      &clk_src_name="GPLL0_OUT_MAIN"
      &clk_src_sel=SRC_SEL TODO.
      &clk_src_div=2.
      &clk_m_val=96.
      &clk_n_val=15625.
      &clk_2d_val=15625.
      
      gosub Set_Clock_Freq
      return
    )
    else if ("&clk_desired_freq"=="7.3728")
    (
      &clk_src_name="GPLL0_OUT_MAIN"
      &clk_src_sel=SRC_SEL TODO.
      &clk_src_div=2.
      &clk_m_val=192.
      &clk_n_val=15625.
      &clk_2d_val=15625.
      
      gosub Set_Clock_Freq
      return
    )
    else if ("&clk_desired_freq"=="14.7456")
    (
      &clk_src_name="GPLL0_OUT_MAIN"
      &clk_src_sel=SRC_SEL TODO.
      &clk_src_div=2.
      &clk_m_val=384.
      &clk_n_val=15625.
      &clk_2d_val=15625.
      
      gosub Set_Clock_Freq
      return
    )
    else if ("&clk_desired_freq"=="16.0")
    (
      &clk_src_name="GPLL0_OUT_MAIN"
      &clk_src_sel=SRC_SEL TODO.
      &clk_src_div=10.
      &clk_m_val=2.
      &clk_n_val=15.
      &clk_2d_val=15.
      
      gosub Set_Clock_Freq
      return
    )
    else if ("&clk_desired_freq"=="19.2")
    (
      &clk_src_name="XO"
      &clk_src_sel=SRC_SEL TODO.
      &clk_src_div=2.
      &clk_m_val=0.
      &clk_n_val=0.
      &clk_2d_val=0.
      
      gosub Set_Clock_Freq
      return
    )
    else if ("&clk_desired_freq"=="24.0")
    (
      &clk_src_name="GPLL0_OUT_MAIN"
      &clk_src_sel=SRC_SEL TODO.
      &clk_src_div=10.
      &clk_m_val=1.
      &clk_n_val=5.
      &clk_2d_val=5.
      
      gosub Set_Clock_Freq
      return
    )
    else if ("&clk_desired_freq"=="32.0")
    (
      &clk_src_name="GPLL0_OUT_MAIN"
      &clk_src_sel=SRC_SEL TODO.
      &clk_src_div=2.
      &clk_m_val=4.
      &clk_n_val=75.
      &clk_2d_val=75.
      
      gosub Set_Clock_Freq
      return
    )
    else if ("&clk_desired_freq"=="40.0")
    (
      &clk_src_name="GPLL0_OUT_MAIN"
      &clk_src_sel=SRC_SEL TODO.
      &clk_src_div=30.
      &clk_m_val=0.
      &clk_n_val=0.
      &clk_2d_val=0.
      
      gosub Set_Clock_Freq
      return
    )
    else if ("&clk_desired_freq"=="46.4")
    (
      &clk_src_name="GPLL0_OUT_MAIN"
      &clk_src_sel=SRC_SEL TODO.
      &clk_src_div=2.
      &clk_m_val=29.
      &clk_n_val=375.
      &clk_2d_val=375.
      
      gosub Set_Clock_Freq
      return
    )
    else if ("&clk_desired_freq"=="48.0")
    (
      &clk_src_name="GPLL0_OUT_MAIN"
      &clk_src_sel=SRC_SEL TODO.
      &clk_src_div=25.
      &clk_m_val=0.
      &clk_n_val=0.
      &clk_2d_val=0.
      
      gosub Set_Clock_Freq
      return
    )
    else if ("&clk_desired_freq"=="51.2")
    (
      &clk_src_name="GPLL0_OUT_MAIN"
      &clk_src_sel=SRC_SEL TODO.
      &clk_src_div=2.
      &clk_m_val=32.
      &clk_n_val=375.
      &clk_2d_val=375.
      
      gosub Set_Clock_Freq
      return
    )
    else if ("&clk_desired_freq"=="56.0")
    (
      &clk_src_name="GPLL0_OUT_MAIN"
      &clk_src_sel=SRC_SEL TODO.
      &clk_src_div=2.
      &clk_m_val=7.
      &clk_n_val=75.
      &clk_2d_val=75.
      
      gosub Set_Clock_Freq
      return
    )
    else if ("&clk_desired_freq"=="58.9824")
    (
      &clk_src_name="GPLL0_OUT_MAIN"
      &clk_src_sel=SRC_SEL TODO.
      &clk_src_div=2.
      &clk_m_val=1536.
      &clk_n_val=15625.
      &clk_2d_val=15625.
      
      gosub Set_Clock_Freq
      return
    )
    else if ("&clk_desired_freq"=="60.0")
    (
      &clk_src_name="GPLL0_OUT_MAIN"
      &clk_src_sel=SRC_SEL TODO.
      &clk_src_div=20.
      &clk_m_val=0.
      &clk_n_val=0.
      &clk_2d_val=0.
      
      gosub Set_Clock_Freq
      return
    )
    else if ("&clk_desired_freq"=="63.157895")
    (
      &clk_src_name="GPLL0_OUT_MAIN"
      &clk_src_sel=SRC_SEL TODO.
      &clk_src_div=19.
      &clk_m_val=0.
      &clk_n_val=0.
      &clk_2d_val=0.
      
      gosub Set_Clock_Freq
      return
    )
    else if ("&clk_desired_freq"=="r")
    (
      return
    )
    else
    (
      print "Invalid selection."
      goto Set_Clock_Freq_Enter
    )
  )

  if ("&clk"=="gcc_blsp1_uart3_apps_clk")
  (
    gosub PRINT_SET_CLOCK_FREQ_WARNING

    &clk_cmd_rcgr_addr=&HWIO_GCC_BLSP1_UART3_APPS_CMD_RCGR_ADDR
    &clk_cfg_rcgr_addr=&HWIO_GCC_BLSP1_UART3_APPS_CFG_RCGR_ADDR

    print "Choose frequency (MHz) from list below: " 

    print "3.6864         7.3728         14.7456        " 
    print "16.0           19.2           24.0           " 
    print "32.0           40.0           46.4           " 
    print "48.0           51.2           56.0           " 
    print "58.9824        60.0           63.157895      " 

    print ""
    print "Enter desired frequency (r to return): "
    enter &clk_desired_freq
    print ""

    if ("&clk_desired_freq"=="3.6864")
    (
      &clk_src_name="GPLL0_OUT_MAIN"
      &clk_src_sel=SRC_SEL TODO.
      &clk_src_div=2.
      &clk_m_val=96.
      &clk_n_val=15625.
      &clk_2d_val=15625.
      
      gosub Set_Clock_Freq
      return
    )
    else if ("&clk_desired_freq"=="7.3728")
    (
      &clk_src_name="GPLL0_OUT_MAIN"
      &clk_src_sel=SRC_SEL TODO.
      &clk_src_div=2.
      &clk_m_val=192.
      &clk_n_val=15625.
      &clk_2d_val=15625.
      
      gosub Set_Clock_Freq
      return
    )
    else if ("&clk_desired_freq"=="14.7456")
    (
      &clk_src_name="GPLL0_OUT_MAIN"
      &clk_src_sel=SRC_SEL TODO.
      &clk_src_div=2.
      &clk_m_val=384.
      &clk_n_val=15625.
      &clk_2d_val=15625.
      
      gosub Set_Clock_Freq
      return
    )
    else if ("&clk_desired_freq"=="16.0")
    (
      &clk_src_name="GPLL0_OUT_MAIN"
      &clk_src_sel=SRC_SEL TODO.
      &clk_src_div=10.
      &clk_m_val=2.
      &clk_n_val=15.
      &clk_2d_val=15.
      
      gosub Set_Clock_Freq
      return
    )
    else if ("&clk_desired_freq"=="19.2")
    (
      &clk_src_name="XO"
      &clk_src_sel=SRC_SEL TODO.
      &clk_src_div=2.
      &clk_m_val=0.
      &clk_n_val=0.
      &clk_2d_val=0.
      
      gosub Set_Clock_Freq
      return
    )
    else if ("&clk_desired_freq"=="24.0")
    (
      &clk_src_name="GPLL0_OUT_MAIN"
      &clk_src_sel=SRC_SEL TODO.
      &clk_src_div=10.
      &clk_m_val=1.
      &clk_n_val=5.
      &clk_2d_val=5.
      
      gosub Set_Clock_Freq
      return
    )
    else if ("&clk_desired_freq"=="32.0")
    (
      &clk_src_name="GPLL0_OUT_MAIN"
      &clk_src_sel=SRC_SEL TODO.
      &clk_src_div=2.
      &clk_m_val=4.
      &clk_n_val=75.
      &clk_2d_val=75.
      
      gosub Set_Clock_Freq
      return
    )
    else if ("&clk_desired_freq"=="40.0")
    (
      &clk_src_name="GPLL0_OUT_MAIN"
      &clk_src_sel=SRC_SEL TODO.
      &clk_src_div=30.
      &clk_m_val=0.
      &clk_n_val=0.
      &clk_2d_val=0.
      
      gosub Set_Clock_Freq
      return
    )
    else if ("&clk_desired_freq"=="46.4")
    (
      &clk_src_name="GPLL0_OUT_MAIN"
      &clk_src_sel=SRC_SEL TODO.
      &clk_src_div=2.
      &clk_m_val=29.
      &clk_n_val=375.
      &clk_2d_val=375.
      
      gosub Set_Clock_Freq
      return
    )
    else if ("&clk_desired_freq"=="48.0")
    (
      &clk_src_name="GPLL0_OUT_MAIN"
      &clk_src_sel=SRC_SEL TODO.
      &clk_src_div=25.
      &clk_m_val=0.
      &clk_n_val=0.
      &clk_2d_val=0.
      
      gosub Set_Clock_Freq
      return
    )
    else if ("&clk_desired_freq"=="51.2")
    (
      &clk_src_name="GPLL0_OUT_MAIN"
      &clk_src_sel=SRC_SEL TODO.
      &clk_src_div=2.
      &clk_m_val=32.
      &clk_n_val=375.
      &clk_2d_val=375.
      
      gosub Set_Clock_Freq
      return
    )
    else if ("&clk_desired_freq"=="56.0")
    (
      &clk_src_name="GPLL0_OUT_MAIN"
      &clk_src_sel=SRC_SEL TODO.
      &clk_src_div=2.
      &clk_m_val=7.
      &clk_n_val=75.
      &clk_2d_val=75.
      
      gosub Set_Clock_Freq
      return
    )
    else if ("&clk_desired_freq"=="58.9824")
    (
      &clk_src_name="GPLL0_OUT_MAIN"
      &clk_src_sel=SRC_SEL TODO.
      &clk_src_div=2.
      &clk_m_val=1536.
      &clk_n_val=15625.
      &clk_2d_val=15625.
      
      gosub Set_Clock_Freq
      return
    )
    else if ("&clk_desired_freq"=="60.0")
    (
      &clk_src_name="GPLL0_OUT_MAIN"
      &clk_src_sel=SRC_SEL TODO.
      &clk_src_div=20.
      &clk_m_val=0.
      &clk_n_val=0.
      &clk_2d_val=0.
      
      gosub Set_Clock_Freq
      return
    )
    else if ("&clk_desired_freq"=="63.157895")
    (
      &clk_src_name="GPLL0_OUT_MAIN"
      &clk_src_sel=SRC_SEL TODO.
      &clk_src_div=19.
      &clk_m_val=0.
      &clk_n_val=0.
      &clk_2d_val=0.
      
      gosub Set_Clock_Freq
      return
    )
    else if ("&clk_desired_freq"=="r")
    (
      return
    )
    else
    (
      print "Invalid selection."
      goto Set_Clock_Freq_Enter
    )
  )

  if ("&clk"=="gcc_blsp1_uart4_apps_clk")
  (
    gosub PRINT_SET_CLOCK_FREQ_WARNING

    &clk_cmd_rcgr_addr=&HWIO_GCC_BLSP1_UART4_APPS_CMD_RCGR_ADDR
    &clk_cfg_rcgr_addr=&HWIO_GCC_BLSP1_UART4_APPS_CFG_RCGR_ADDR

    print "Choose frequency (MHz) from list below: " 

    print "3.6864         7.3728         14.7456        " 
    print "16.0           19.2           24.0           " 
    print "32.0           40.0           46.4           " 
    print "48.0           51.2           56.0           " 
    print "58.9824        60.0           63.157895      " 

    print ""
    print "Enter desired frequency (r to return): "
    enter &clk_desired_freq
    print ""

    if ("&clk_desired_freq"=="3.6864")
    (
      &clk_src_name="GPLL0_OUT_MAIN"
      &clk_src_sel=SRC_SEL TODO.
      &clk_src_div=2.
      &clk_m_val=96.
      &clk_n_val=15625.
      &clk_2d_val=15625.
      
      gosub Set_Clock_Freq
      return
    )
    else if ("&clk_desired_freq"=="7.3728")
    (
      &clk_src_name="GPLL0_OUT_MAIN"
      &clk_src_sel=SRC_SEL TODO.
      &clk_src_div=2.
      &clk_m_val=192.
      &clk_n_val=15625.
      &clk_2d_val=15625.
      
      gosub Set_Clock_Freq
      return
    )
    else if ("&clk_desired_freq"=="14.7456")
    (
      &clk_src_name="GPLL0_OUT_MAIN"
      &clk_src_sel=SRC_SEL TODO.
      &clk_src_div=2.
      &clk_m_val=384.
      &clk_n_val=15625.
      &clk_2d_val=15625.
      
      gosub Set_Clock_Freq
      return
    )
    else if ("&clk_desired_freq"=="16.0")
    (
      &clk_src_name="GPLL0_OUT_MAIN"
      &clk_src_sel=SRC_SEL TODO.
      &clk_src_div=10.
      &clk_m_val=2.
      &clk_n_val=15.
      &clk_2d_val=15.
      
      gosub Set_Clock_Freq
      return
    )
    else if ("&clk_desired_freq"=="19.2")
    (
      &clk_src_name="XO"
      &clk_src_sel=SRC_SEL TODO.
      &clk_src_div=2.
      &clk_m_val=0.
      &clk_n_val=0.
      &clk_2d_val=0.
      
      gosub Set_Clock_Freq
      return
    )
    else if ("&clk_desired_freq"=="24.0")
    (
      &clk_src_name="GPLL0_OUT_MAIN"
      &clk_src_sel=SRC_SEL TODO.
      &clk_src_div=10.
      &clk_m_val=1.
      &clk_n_val=5.
      &clk_2d_val=5.
      
      gosub Set_Clock_Freq
      return
    )
    else if ("&clk_desired_freq"=="32.0")
    (
      &clk_src_name="GPLL0_OUT_MAIN"
      &clk_src_sel=SRC_SEL TODO.
      &clk_src_div=2.
      &clk_m_val=4.
      &clk_n_val=75.
      &clk_2d_val=75.
      
      gosub Set_Clock_Freq
      return
    )
    else if ("&clk_desired_freq"=="40.0")
    (
      &clk_src_name="GPLL0_OUT_MAIN"
      &clk_src_sel=SRC_SEL TODO.
      &clk_src_div=30.
      &clk_m_val=0.
      &clk_n_val=0.
      &clk_2d_val=0.
      
      gosub Set_Clock_Freq
      return
    )
    else if ("&clk_desired_freq"=="46.4")
    (
      &clk_src_name="GPLL0_OUT_MAIN"
      &clk_src_sel=SRC_SEL TODO.
      &clk_src_div=2.
      &clk_m_val=29.
      &clk_n_val=375.
      &clk_2d_val=375.
      
      gosub Set_Clock_Freq
      return
    )
    else if ("&clk_desired_freq"=="48.0")
    (
      &clk_src_name="GPLL0_OUT_MAIN"
      &clk_src_sel=SRC_SEL TODO.
      &clk_src_div=25.
      &clk_m_val=0.
      &clk_n_val=0.
      &clk_2d_val=0.
      
      gosub Set_Clock_Freq
      return
    )
    else if ("&clk_desired_freq"=="51.2")
    (
      &clk_src_name="GPLL0_OUT_MAIN"
      &clk_src_sel=SRC_SEL TODO.
      &clk_src_div=2.
      &clk_m_val=32.
      &clk_n_val=375.
      &clk_2d_val=375.
      
      gosub Set_Clock_Freq
      return
    )
    else if ("&clk_desired_freq"=="56.0")
    (
      &clk_src_name="GPLL0_OUT_MAIN"
      &clk_src_sel=SRC_SEL TODO.
      &clk_src_div=2.
      &clk_m_val=7.
      &clk_n_val=75.
      &clk_2d_val=75.
      
      gosub Set_Clock_Freq
      return
    )
    else if ("&clk_desired_freq"=="58.9824")
    (
      &clk_src_name="GPLL0_OUT_MAIN"
      &clk_src_sel=SRC_SEL TODO.
      &clk_src_div=2.
      &clk_m_val=1536.
      &clk_n_val=15625.
      &clk_2d_val=15625.
      
      gosub Set_Clock_Freq
      return
    )
    else if ("&clk_desired_freq"=="60.0")
    (
      &clk_src_name="GPLL0_OUT_MAIN"
      &clk_src_sel=SRC_SEL TODO.
      &clk_src_div=20.
      &clk_m_val=0.
      &clk_n_val=0.
      &clk_2d_val=0.
      
      gosub Set_Clock_Freq
      return
    )
    else if ("&clk_desired_freq"=="63.157895")
    (
      &clk_src_name="GPLL0_OUT_MAIN"
      &clk_src_sel=SRC_SEL TODO.
      &clk_src_div=19.
      &clk_m_val=0.
      &clk_n_val=0.
      &clk_2d_val=0.
      
      gosub Set_Clock_Freq
      return
    )
    else if ("&clk_desired_freq"=="r")
    (
      return
    )
    else
    (
      print "Invalid selection."
      goto Set_Clock_Freq_Enter
    )
  )

  if ("&clk"=="gcc_blsp1_uart5_apps_clk")
  (
    gosub PRINT_SET_CLOCK_FREQ_WARNING

    &clk_cmd_rcgr_addr=&HWIO_GCC_BLSP1_UART5_APPS_CMD_RCGR_ADDR
    &clk_cfg_rcgr_addr=&HWIO_GCC_BLSP1_UART5_APPS_CFG_RCGR_ADDR

    print "Choose frequency (MHz) from list below: " 

    print "3.6864         7.3728         14.7456        " 
    print "16.0           19.2           24.0           " 
    print "32.0           40.0           46.4           " 
    print "48.0           51.2           56.0           " 
    print "58.9824        60.0           63.157895      " 

    print ""
    print "Enter desired frequency (r to return): "
    enter &clk_desired_freq
    print ""

    if ("&clk_desired_freq"=="3.6864")
    (
      &clk_src_name="GPLL0_OUT_MAIN"
      &clk_src_sel=SRC_SEL TODO.
      &clk_src_div=2.
      &clk_m_val=96.
      &clk_n_val=15625.
      &clk_2d_val=15625.
      
      gosub Set_Clock_Freq
      return
    )
    else if ("&clk_desired_freq"=="7.3728")
    (
      &clk_src_name="GPLL0_OUT_MAIN"
      &clk_src_sel=SRC_SEL TODO.
      &clk_src_div=2.
      &clk_m_val=192.
      &clk_n_val=15625.
      &clk_2d_val=15625.
      
      gosub Set_Clock_Freq
      return
    )
    else if ("&clk_desired_freq"=="14.7456")
    (
      &clk_src_name="GPLL0_OUT_MAIN"
      &clk_src_sel=SRC_SEL TODO.
      &clk_src_div=2.
      &clk_m_val=384.
      &clk_n_val=15625.
      &clk_2d_val=15625.
      
      gosub Set_Clock_Freq
      return
    )
    else if ("&clk_desired_freq"=="16.0")
    (
      &clk_src_name="GPLL0_OUT_MAIN"
      &clk_src_sel=SRC_SEL TODO.
      &clk_src_div=10.
      &clk_m_val=2.
      &clk_n_val=15.
      &clk_2d_val=15.
      
      gosub Set_Clock_Freq
      return
    )
    else if ("&clk_desired_freq"=="19.2")
    (
      &clk_src_name="XO"
      &clk_src_sel=SRC_SEL TODO.
      &clk_src_div=2.
      &clk_m_val=0.
      &clk_n_val=0.
      &clk_2d_val=0.
      
      gosub Set_Clock_Freq
      return
    )
    else if ("&clk_desired_freq"=="24.0")
    (
      &clk_src_name="GPLL0_OUT_MAIN"
      &clk_src_sel=SRC_SEL TODO.
      &clk_src_div=10.
      &clk_m_val=1.
      &clk_n_val=5.
      &clk_2d_val=5.
      
      gosub Set_Clock_Freq
      return
    )
    else if ("&clk_desired_freq"=="32.0")
    (
      &clk_src_name="GPLL0_OUT_MAIN"
      &clk_src_sel=SRC_SEL TODO.
      &clk_src_div=2.
      &clk_m_val=4.
      &clk_n_val=75.
      &clk_2d_val=75.
      
      gosub Set_Clock_Freq
      return
    )
    else if ("&clk_desired_freq"=="40.0")
    (
      &clk_src_name="GPLL0_OUT_MAIN"
      &clk_src_sel=SRC_SEL TODO.
      &clk_src_div=30.
      &clk_m_val=0.
      &clk_n_val=0.
      &clk_2d_val=0.
      
      gosub Set_Clock_Freq
      return
    )
    else if ("&clk_desired_freq"=="46.4")
    (
      &clk_src_name="GPLL0_OUT_MAIN"
      &clk_src_sel=SRC_SEL TODO.
      &clk_src_div=2.
      &clk_m_val=29.
      &clk_n_val=375.
      &clk_2d_val=375.
      
      gosub Set_Clock_Freq
      return
    )
    else if ("&clk_desired_freq"=="48.0")
    (
      &clk_src_name="GPLL0_OUT_MAIN"
      &clk_src_sel=SRC_SEL TODO.
      &clk_src_div=25.
      &clk_m_val=0.
      &clk_n_val=0.
      &clk_2d_val=0.
      
      gosub Set_Clock_Freq
      return
    )
    else if ("&clk_desired_freq"=="51.2")
    (
      &clk_src_name="GPLL0_OUT_MAIN"
      &clk_src_sel=SRC_SEL TODO.
      &clk_src_div=2.
      &clk_m_val=32.
      &clk_n_val=375.
      &clk_2d_val=375.
      
      gosub Set_Clock_Freq
      return
    )
    else if ("&clk_desired_freq"=="56.0")
    (
      &clk_src_name="GPLL0_OUT_MAIN"
      &clk_src_sel=SRC_SEL TODO.
      &clk_src_div=2.
      &clk_m_val=7.
      &clk_n_val=75.
      &clk_2d_val=75.
      
      gosub Set_Clock_Freq
      return
    )
    else if ("&clk_desired_freq"=="58.9824")
    (
      &clk_src_name="GPLL0_OUT_MAIN"
      &clk_src_sel=SRC_SEL TODO.
      &clk_src_div=2.
      &clk_m_val=1536.
      &clk_n_val=15625.
      &clk_2d_val=15625.
      
      gosub Set_Clock_Freq
      return
    )
    else if ("&clk_desired_freq"=="60.0")
    (
      &clk_src_name="GPLL0_OUT_MAIN"
      &clk_src_sel=SRC_SEL TODO.
      &clk_src_div=20.
      &clk_m_val=0.
      &clk_n_val=0.
      &clk_2d_val=0.
      
      gosub Set_Clock_Freq
      return
    )
    else if ("&clk_desired_freq"=="63.157895")
    (
      &clk_src_name="GPLL0_OUT_MAIN"
      &clk_src_sel=SRC_SEL TODO.
      &clk_src_div=19.
      &clk_m_val=0.
      &clk_n_val=0.
      &clk_2d_val=0.
      
      gosub Set_Clock_Freq
      return
    )
    else if ("&clk_desired_freq"=="r")
    (
      return
    )
    else
    (
      print "Invalid selection."
      goto Set_Clock_Freq_Enter
    )
  )

  if ("&clk"=="gcc_blsp1_uart6_apps_clk")
  (
    gosub PRINT_SET_CLOCK_FREQ_WARNING

    &clk_cmd_rcgr_addr=&HWIO_GCC_BLSP1_UART6_APPS_CMD_RCGR_ADDR
    &clk_cfg_rcgr_addr=&HWIO_GCC_BLSP1_UART6_APPS_CFG_RCGR_ADDR

    print "Choose frequency (MHz) from list below: " 

    print "3.6864         7.3728         14.7456        " 
    print "16.0           19.2           24.0           " 
    print "32.0           40.0           46.4           " 
    print "48.0           51.2           56.0           " 
    print "58.9824        60.0           63.157895      " 

    print ""
    print "Enter desired frequency (r to return): "
    enter &clk_desired_freq
    print ""

    if ("&clk_desired_freq"=="3.6864")
    (
      &clk_src_name="GPLL0_OUT_MAIN"
      &clk_src_sel=SRC_SEL TODO.
      &clk_src_div=2.
      &clk_m_val=96.
      &clk_n_val=15625.
      &clk_2d_val=15625.
      
      gosub Set_Clock_Freq
      return
    )
    else if ("&clk_desired_freq"=="7.3728")
    (
      &clk_src_name="GPLL0_OUT_MAIN"
      &clk_src_sel=SRC_SEL TODO.
      &clk_src_div=2.
      &clk_m_val=192.
      &clk_n_val=15625.
      &clk_2d_val=15625.
      
      gosub Set_Clock_Freq
      return
    )
    else if ("&clk_desired_freq"=="14.7456")
    (
      &clk_src_name="GPLL0_OUT_MAIN"
      &clk_src_sel=SRC_SEL TODO.
      &clk_src_div=2.
      &clk_m_val=384.
      &clk_n_val=15625.
      &clk_2d_val=15625.
      
      gosub Set_Clock_Freq
      return
    )
    else if ("&clk_desired_freq"=="16.0")
    (
      &clk_src_name="GPLL0_OUT_MAIN"
      &clk_src_sel=SRC_SEL TODO.
      &clk_src_div=10.
      &clk_m_val=2.
      &clk_n_val=15.
      &clk_2d_val=15.
      
      gosub Set_Clock_Freq
      return
    )
    else if ("&clk_desired_freq"=="19.2")
    (
      &clk_src_name="XO"
      &clk_src_sel=SRC_SEL TODO.
      &clk_src_div=2.
      &clk_m_val=0.
      &clk_n_val=0.
      &clk_2d_val=0.
      
      gosub Set_Clock_Freq
      return
    )
    else if ("&clk_desired_freq"=="24.0")
    (
      &clk_src_name="GPLL0_OUT_MAIN"
      &clk_src_sel=SRC_SEL TODO.
      &clk_src_div=10.
      &clk_m_val=1.
      &clk_n_val=5.
      &clk_2d_val=5.
      
      gosub Set_Clock_Freq
      return
    )
    else if ("&clk_desired_freq"=="32.0")
    (
      &clk_src_name="GPLL0_OUT_MAIN"
      &clk_src_sel=SRC_SEL TODO.
      &clk_src_div=2.
      &clk_m_val=4.
      &clk_n_val=75.
      &clk_2d_val=75.
      
      gosub Set_Clock_Freq
      return
    )
    else if ("&clk_desired_freq"=="40.0")
    (
      &clk_src_name="GPLL0_OUT_MAIN"
      &clk_src_sel=SRC_SEL TODO.
      &clk_src_div=30.
      &clk_m_val=0.
      &clk_n_val=0.
      &clk_2d_val=0.
      
      gosub Set_Clock_Freq
      return
    )
    else if ("&clk_desired_freq"=="46.4")
    (
      &clk_src_name="GPLL0_OUT_MAIN"
      &clk_src_sel=SRC_SEL TODO.
      &clk_src_div=2.
      &clk_m_val=29.
      &clk_n_val=375.
      &clk_2d_val=375.
      
      gosub Set_Clock_Freq
      return
    )
    else if ("&clk_desired_freq"=="48.0")
    (
      &clk_src_name="GPLL0_OUT_MAIN"
      &clk_src_sel=SRC_SEL TODO.
      &clk_src_div=25.
      &clk_m_val=0.
      &clk_n_val=0.
      &clk_2d_val=0.
      
      gosub Set_Clock_Freq
      return
    )
    else if ("&clk_desired_freq"=="51.2")
    (
      &clk_src_name="GPLL0_OUT_MAIN"
      &clk_src_sel=SRC_SEL TODO.
      &clk_src_div=2.
      &clk_m_val=32.
      &clk_n_val=375.
      &clk_2d_val=375.
      
      gosub Set_Clock_Freq
      return
    )
    else if ("&clk_desired_freq"=="56.0")
    (
      &clk_src_name="GPLL0_OUT_MAIN"
      &clk_src_sel=SRC_SEL TODO.
      &clk_src_div=2.
      &clk_m_val=7.
      &clk_n_val=75.
      &clk_2d_val=75.
      
      gosub Set_Clock_Freq
      return
    )
    else if ("&clk_desired_freq"=="58.9824")
    (
      &clk_src_name="GPLL0_OUT_MAIN"
      &clk_src_sel=SRC_SEL TODO.
      &clk_src_div=2.
      &clk_m_val=1536.
      &clk_n_val=15625.
      &clk_2d_val=15625.
      
      gosub Set_Clock_Freq
      return
    )
    else if ("&clk_desired_freq"=="60.0")
    (
      &clk_src_name="GPLL0_OUT_MAIN"
      &clk_src_sel=SRC_SEL TODO.
      &clk_src_div=20.
      &clk_m_val=0.
      &clk_n_val=0.
      &clk_2d_val=0.
      
      gosub Set_Clock_Freq
      return
    )
    else if ("&clk_desired_freq"=="63.157895")
    (
      &clk_src_name="GPLL0_OUT_MAIN"
      &clk_src_sel=SRC_SEL TODO.
      &clk_src_div=19.
      &clk_m_val=0.
      &clk_n_val=0.
      &clk_2d_val=0.
      
      gosub Set_Clock_Freq
      return
    )
    else if ("&clk_desired_freq"=="r")
    (
      return
    )
    else
    (
      print "Invalid selection."
      goto Set_Clock_Freq_Enter
    )
  )

  if ("&clk"=="gcc_blsp2_qup1_i2c_apps_clk")
  (
    gosub PRINT_SET_CLOCK_FREQ_WARNING

    &clk_cmd_rcgr_addr=&HWIO_GCC_BLSP2_QUP1_I2C_APPS_CMD_RCGR_ADDR
    &clk_cfg_rcgr_addr=&HWIO_GCC_BLSP2_QUP1_I2C_APPS_CFG_RCGR_ADDR

    print "Choose frequency (MHz) from list below: " 

    print "19.2           50.0           " 

    print ""
    print "Enter desired frequency (r to return): "
    enter &clk_desired_freq
    print ""

    if ("&clk_desired_freq"=="19.2")
    (
      &clk_src_name="XO"
      &clk_src_sel=SRC_SEL TODO.
      &clk_src_div=2.
      &clk_m_val=0.
      &clk_n_val=0.
      &clk_2d_val=0.
      
      gosub Set_Clock_Freq
      return
    )
    else if ("&clk_desired_freq"=="50.0")
    (
      &clk_src_name="GPLL0_OUT_MAIN"
      &clk_src_sel=SRC_SEL TODO.
      &clk_src_div=24.
      &clk_m_val=0.
      &clk_n_val=0.
      &clk_2d_val=0.
      
      gosub Set_Clock_Freq
      return
    )
    else if ("&clk_desired_freq"=="r")
    (
      return
    )
    else
    (
      print "Invalid selection."
      goto Set_Clock_Freq_Enter
    )
  )

  if ("&clk"=="gcc_blsp2_qup1_spi_apps_clk")
  (
    gosub PRINT_SET_CLOCK_FREQ_WARNING

    &clk_cmd_rcgr_addr=&HWIO_GCC_BLSP2_QUP1_SPI_APPS_CMD_RCGR_ADDR
    &clk_cfg_rcgr_addr=&HWIO_GCC_BLSP2_QUP1_SPI_APPS_CFG_RCGR_ADDR

    print "Choose frequency (MHz) from list below: " 

    print "0.96           4.8            9.6            " 
    print "15.0           19.2           25.0           " 
    print "50.0           " 

    print ""
    print "Enter desired frequency (r to return): "
    enter &clk_desired_freq
    print ""

    if ("&clk_desired_freq"=="0.96")
    (
      &clk_src_name="XO"
      &clk_src_sel=SRC_SEL TODO.
      &clk_src_div=20.
      &clk_m_val=1.
      &clk_n_val=2.
      &clk_2d_val=2.
      
      gosub Set_Clock_Freq
      return
    )
    else if ("&clk_desired_freq"=="4.8")
    (
      &clk_src_name="XO"
      &clk_src_sel=SRC_SEL TODO.
      &clk_src_div=8.
      &clk_m_val=0.
      &clk_n_val=0.
      &clk_2d_val=0.
      
      gosub Set_Clock_Freq
      return
    )
    else if ("&clk_desired_freq"=="9.6")
    (
      &clk_src_name="XO"
      &clk_src_sel=SRC_SEL TODO.
      &clk_src_div=4.
      &clk_m_val=0.
      &clk_n_val=0.
      &clk_2d_val=0.
      
      gosub Set_Clock_Freq
      return
    )
    else if ("&clk_desired_freq"=="15.0")
    (
      &clk_src_name="GPLL0_OUT_MAIN"
      &clk_src_sel=SRC_SEL TODO.
      &clk_src_div=20.
      &clk_m_val=1.
      &clk_n_val=4.
      &clk_2d_val=4.
      
      gosub Set_Clock_Freq
      return
    )
    else if ("&clk_desired_freq"=="19.2")
    (
      &clk_src_name="XO"
      &clk_src_sel=SRC_SEL TODO.
      &clk_src_div=2.
      &clk_m_val=0.
      &clk_n_val=0.
      &clk_2d_val=0.
      
      gosub Set_Clock_Freq
      return
    )
    else if ("&clk_desired_freq"=="25.0")
    (
      &clk_src_name="GPLL0_OUT_MAIN"
      &clk_src_sel=SRC_SEL TODO.
      &clk_src_div=24.
      &clk_m_val=1.
      &clk_n_val=2.
      &clk_2d_val=2.
      
      gosub Set_Clock_Freq
      return
    )
    else if ("&clk_desired_freq"=="50.0")
    (
      &clk_src_name="GPLL0_OUT_MAIN"
      &clk_src_sel=SRC_SEL TODO.
      &clk_src_div=24.
      &clk_m_val=0.
      &clk_n_val=0.
      &clk_2d_val=0.
      
      gosub Set_Clock_Freq
      return
    )
    else if ("&clk_desired_freq"=="r")
    (
      return
    )
    else
    (
      print "Invalid selection."
      goto Set_Clock_Freq_Enter
    )
  )

  if ("&clk"=="gcc_blsp2_qup2_i2c_apps_clk")
  (
    gosub PRINT_SET_CLOCK_FREQ_WARNING

    &clk_cmd_rcgr_addr=&HWIO_GCC_BLSP2_QUP2_I2C_APPS_CMD_RCGR_ADDR
    &clk_cfg_rcgr_addr=&HWIO_GCC_BLSP2_QUP2_I2C_APPS_CFG_RCGR_ADDR

    print "Choose frequency (MHz) from list below: " 

    print "19.2           50.0           " 

    print ""
    print "Enter desired frequency (r to return): "
    enter &clk_desired_freq
    print ""

    if ("&clk_desired_freq"=="19.2")
    (
      &clk_src_name="XO"
      &clk_src_sel=SRC_SEL TODO.
      &clk_src_div=2.
      &clk_m_val=0.
      &clk_n_val=0.
      &clk_2d_val=0.
      
      gosub Set_Clock_Freq
      return
    )
    else if ("&clk_desired_freq"=="50.0")
    (
      &clk_src_name="GPLL0_OUT_MAIN"
      &clk_src_sel=SRC_SEL TODO.
      &clk_src_div=24.
      &clk_m_val=0.
      &clk_n_val=0.
      &clk_2d_val=0.
      
      gosub Set_Clock_Freq
      return
    )
    else if ("&clk_desired_freq"=="r")
    (
      return
    )
    else
    (
      print "Invalid selection."
      goto Set_Clock_Freq_Enter
    )
  )

  if ("&clk"=="gcc_blsp2_qup2_spi_apps_clk")
  (
    gosub PRINT_SET_CLOCK_FREQ_WARNING

    &clk_cmd_rcgr_addr=&HWIO_GCC_BLSP2_QUP2_SPI_APPS_CMD_RCGR_ADDR
    &clk_cfg_rcgr_addr=&HWIO_GCC_BLSP2_QUP2_SPI_APPS_CFG_RCGR_ADDR

    print "Choose frequency (MHz) from list below: " 

    print "0.96           4.8            9.6            " 
    print "15.0           19.2           25.0           " 
    print "50.0           " 

    print ""
    print "Enter desired frequency (r to return): "
    enter &clk_desired_freq
    print ""

    if ("&clk_desired_freq"=="0.96")
    (
      &clk_src_name="XO"
      &clk_src_sel=SRC_SEL TODO.
      &clk_src_div=20.
      &clk_m_val=1.
      &clk_n_val=2.
      &clk_2d_val=2.
      
      gosub Set_Clock_Freq
      return
    )
    else if ("&clk_desired_freq"=="4.8")
    (
      &clk_src_name="XO"
      &clk_src_sel=SRC_SEL TODO.
      &clk_src_div=8.
      &clk_m_val=0.
      &clk_n_val=0.
      &clk_2d_val=0.
      
      gosub Set_Clock_Freq
      return
    )
    else if ("&clk_desired_freq"=="9.6")
    (
      &clk_src_name="XO"
      &clk_src_sel=SRC_SEL TODO.
      &clk_src_div=4.
      &clk_m_val=0.
      &clk_n_val=0.
      &clk_2d_val=0.
      
      gosub Set_Clock_Freq
      return
    )
    else if ("&clk_desired_freq"=="15.0")
    (
      &clk_src_name="GPLL0_OUT_MAIN"
      &clk_src_sel=SRC_SEL TODO.
      &clk_src_div=20.
      &clk_m_val=1.
      &clk_n_val=4.
      &clk_2d_val=4.
      
      gosub Set_Clock_Freq
      return
    )
    else if ("&clk_desired_freq"=="19.2")
    (
      &clk_src_name="XO"
      &clk_src_sel=SRC_SEL TODO.
      &clk_src_div=2.
      &clk_m_val=0.
      &clk_n_val=0.
      &clk_2d_val=0.
      
      gosub Set_Clock_Freq
      return
    )
    else if ("&clk_desired_freq"=="25.0")
    (
      &clk_src_name="GPLL0_OUT_MAIN"
      &clk_src_sel=SRC_SEL TODO.
      &clk_src_div=24.
      &clk_m_val=1.
      &clk_n_val=2.
      &clk_2d_val=2.
      
      gosub Set_Clock_Freq
      return
    )
    else if ("&clk_desired_freq"=="50.0")
    (
      &clk_src_name="GPLL0_OUT_MAIN"
      &clk_src_sel=SRC_SEL TODO.
      &clk_src_div=24.
      &clk_m_val=0.
      &clk_n_val=0.
      &clk_2d_val=0.
      
      gosub Set_Clock_Freq
      return
    )
    else if ("&clk_desired_freq"=="r")
    (
      return
    )
    else
    (
      print "Invalid selection."
      goto Set_Clock_Freq_Enter
    )
  )

  if ("&clk"=="gcc_blsp2_qup3_i2c_apps_clk")
  (
    gosub PRINT_SET_CLOCK_FREQ_WARNING

    &clk_cmd_rcgr_addr=&HWIO_GCC_BLSP2_QUP3_I2C_APPS_CMD_RCGR_ADDR
    &clk_cfg_rcgr_addr=&HWIO_GCC_BLSP2_QUP3_I2C_APPS_CFG_RCGR_ADDR

    print "Choose frequency (MHz) from list below: " 

    print "19.2           50.0           " 

    print ""
    print "Enter desired frequency (r to return): "
    enter &clk_desired_freq
    print ""

    if ("&clk_desired_freq"=="19.2")
    (
      &clk_src_name="XO"
      &clk_src_sel=SRC_SEL TODO.
      &clk_src_div=2.
      &clk_m_val=0.
      &clk_n_val=0.
      &clk_2d_val=0.
      
      gosub Set_Clock_Freq
      return
    )
    else if ("&clk_desired_freq"=="50.0")
    (
      &clk_src_name="GPLL0_OUT_MAIN"
      &clk_src_sel=SRC_SEL TODO.
      &clk_src_div=24.
      &clk_m_val=0.
      &clk_n_val=0.
      &clk_2d_val=0.
      
      gosub Set_Clock_Freq
      return
    )
    else if ("&clk_desired_freq"=="r")
    (
      return
    )
    else
    (
      print "Invalid selection."
      goto Set_Clock_Freq_Enter
    )
  )

  if ("&clk"=="gcc_blsp2_qup3_spi_apps_clk")
  (
    gosub PRINT_SET_CLOCK_FREQ_WARNING

    &clk_cmd_rcgr_addr=&HWIO_GCC_BLSP2_QUP3_SPI_APPS_CMD_RCGR_ADDR
    &clk_cfg_rcgr_addr=&HWIO_GCC_BLSP2_QUP3_SPI_APPS_CFG_RCGR_ADDR

    print "Choose frequency (MHz) from list below: " 

    print "0.96           4.8            9.6            " 
    print "15.0           19.2           25.0           " 
    print "50.0           " 

    print ""
    print "Enter desired frequency (r to return): "
    enter &clk_desired_freq
    print ""

    if ("&clk_desired_freq"=="0.96")
    (
      &clk_src_name="XO"
      &clk_src_sel=SRC_SEL TODO.
      &clk_src_div=20.
      &clk_m_val=1.
      &clk_n_val=2.
      &clk_2d_val=2.
      
      gosub Set_Clock_Freq
      return
    )
    else if ("&clk_desired_freq"=="4.8")
    (
      &clk_src_name="XO"
      &clk_src_sel=SRC_SEL TODO.
      &clk_src_div=8.
      &clk_m_val=0.
      &clk_n_val=0.
      &clk_2d_val=0.
      
      gosub Set_Clock_Freq
      return
    )
    else if ("&clk_desired_freq"=="9.6")
    (
      &clk_src_name="XO"
      &clk_src_sel=SRC_SEL TODO.
      &clk_src_div=4.
      &clk_m_val=0.
      &clk_n_val=0.
      &clk_2d_val=0.
      
      gosub Set_Clock_Freq
      return
    )
    else if ("&clk_desired_freq"=="15.0")
    (
      &clk_src_name="GPLL0_OUT_MAIN"
      &clk_src_sel=SRC_SEL TODO.
      &clk_src_div=20.
      &clk_m_val=1.
      &clk_n_val=4.
      &clk_2d_val=4.
      
      gosub Set_Clock_Freq
      return
    )
    else if ("&clk_desired_freq"=="19.2")
    (
      &clk_src_name="XO"
      &clk_src_sel=SRC_SEL TODO.
      &clk_src_div=2.
      &clk_m_val=0.
      &clk_n_val=0.
      &clk_2d_val=0.
      
      gosub Set_Clock_Freq
      return
    )
    else if ("&clk_desired_freq"=="25.0")
    (
      &clk_src_name="GPLL0_OUT_MAIN"
      &clk_src_sel=SRC_SEL TODO.
      &clk_src_div=24.
      &clk_m_val=1.
      &clk_n_val=2.
      &clk_2d_val=2.
      
      gosub Set_Clock_Freq
      return
    )
    else if ("&clk_desired_freq"=="50.0")
    (
      &clk_src_name="GPLL0_OUT_MAIN"
      &clk_src_sel=SRC_SEL TODO.
      &clk_src_div=24.
      &clk_m_val=0.
      &clk_n_val=0.
      &clk_2d_val=0.
      
      gosub Set_Clock_Freq
      return
    )
    else if ("&clk_desired_freq"=="r")
    (
      return
    )
    else
    (
      print "Invalid selection."
      goto Set_Clock_Freq_Enter
    )
  )

  if ("&clk"=="gcc_blsp2_qup4_i2c_apps_clk")
  (
    gosub PRINT_SET_CLOCK_FREQ_WARNING

    &clk_cmd_rcgr_addr=&HWIO_GCC_BLSP2_QUP4_I2C_APPS_CMD_RCGR_ADDR
    &clk_cfg_rcgr_addr=&HWIO_GCC_BLSP2_QUP4_I2C_APPS_CFG_RCGR_ADDR

    print "Choose frequency (MHz) from list below: " 

    print "19.2           50.0           " 

    print ""
    print "Enter desired frequency (r to return): "
    enter &clk_desired_freq
    print ""

    if ("&clk_desired_freq"=="19.2")
    (
      &clk_src_name="XO"
      &clk_src_sel=SRC_SEL TODO.
      &clk_src_div=2.
      &clk_m_val=0.
      &clk_n_val=0.
      &clk_2d_val=0.
      
      gosub Set_Clock_Freq
      return
    )
    else if ("&clk_desired_freq"=="50.0")
    (
      &clk_src_name="GPLL0_OUT_MAIN"
      &clk_src_sel=SRC_SEL TODO.
      &clk_src_div=24.
      &clk_m_val=0.
      &clk_n_val=0.
      &clk_2d_val=0.
      
      gosub Set_Clock_Freq
      return
    )
    else if ("&clk_desired_freq"=="r")
    (
      return
    )
    else
    (
      print "Invalid selection."
      goto Set_Clock_Freq_Enter
    )
  )

  if ("&clk"=="gcc_blsp2_qup4_spi_apps_clk")
  (
    gosub PRINT_SET_CLOCK_FREQ_WARNING

    &clk_cmd_rcgr_addr=&HWIO_GCC_BLSP2_QUP4_SPI_APPS_CMD_RCGR_ADDR
    &clk_cfg_rcgr_addr=&HWIO_GCC_BLSP2_QUP4_SPI_APPS_CFG_RCGR_ADDR

    print "Choose frequency (MHz) from list below: " 

    print "0.96           4.8            9.6            " 
    print "15.0           19.2           25.0           " 
    print "50.0           " 

    print ""
    print "Enter desired frequency (r to return): "
    enter &clk_desired_freq
    print ""

    if ("&clk_desired_freq"=="0.96")
    (
      &clk_src_name="XO"
      &clk_src_sel=SRC_SEL TODO.
      &clk_src_div=20.
      &clk_m_val=1.
      &clk_n_val=2.
      &clk_2d_val=2.
      
      gosub Set_Clock_Freq
      return
    )
    else if ("&clk_desired_freq"=="4.8")
    (
      &clk_src_name="XO"
      &clk_src_sel=SRC_SEL TODO.
      &clk_src_div=8.
      &clk_m_val=0.
      &clk_n_val=0.
      &clk_2d_val=0.
      
      gosub Set_Clock_Freq
      return
    )
    else if ("&clk_desired_freq"=="9.6")
    (
      &clk_src_name="XO"
      &clk_src_sel=SRC_SEL TODO.
      &clk_src_div=4.
      &clk_m_val=0.
      &clk_n_val=0.
      &clk_2d_val=0.
      
      gosub Set_Clock_Freq
      return
    )
    else if ("&clk_desired_freq"=="15.0")
    (
      &clk_src_name="GPLL0_OUT_MAIN"
      &clk_src_sel=SRC_SEL TODO.
      &clk_src_div=20.
      &clk_m_val=1.
      &clk_n_val=4.
      &clk_2d_val=4.
      
      gosub Set_Clock_Freq
      return
    )
    else if ("&clk_desired_freq"=="19.2")
    (
      &clk_src_name="XO"
      &clk_src_sel=SRC_SEL TODO.
      &clk_src_div=2.
      &clk_m_val=0.
      &clk_n_val=0.
      &clk_2d_val=0.
      
      gosub Set_Clock_Freq
      return
    )
    else if ("&clk_desired_freq"=="25.0")
    (
      &clk_src_name="GPLL0_OUT_MAIN"
      &clk_src_sel=SRC_SEL TODO.
      &clk_src_div=24.
      &clk_m_val=1.
      &clk_n_val=2.
      &clk_2d_val=2.
      
      gosub Set_Clock_Freq
      return
    )
    else if ("&clk_desired_freq"=="50.0")
    (
      &clk_src_name="GPLL0_OUT_MAIN"
      &clk_src_sel=SRC_SEL TODO.
      &clk_src_div=24.
      &clk_m_val=0.
      &clk_n_val=0.
      &clk_2d_val=0.
      
      gosub Set_Clock_Freq
      return
    )
    else if ("&clk_desired_freq"=="r")
    (
      return
    )
    else
    (
      print "Invalid selection."
      goto Set_Clock_Freq_Enter
    )
  )

  if ("&clk"=="gcc_blsp2_qup5_i2c_apps_clk")
  (
    gosub PRINT_SET_CLOCK_FREQ_WARNING

    &clk_cmd_rcgr_addr=&HWIO_GCC_BLSP2_QUP5_I2C_APPS_CMD_RCGR_ADDR
    &clk_cfg_rcgr_addr=&HWIO_GCC_BLSP2_QUP5_I2C_APPS_CFG_RCGR_ADDR

    print "Choose frequency (MHz) from list below: " 

    print "19.2           50.0           " 

    print ""
    print "Enter desired frequency (r to return): "
    enter &clk_desired_freq
    print ""

    if ("&clk_desired_freq"=="19.2")
    (
      &clk_src_name="XO"
      &clk_src_sel=SRC_SEL TODO.
      &clk_src_div=2.
      &clk_m_val=0.
      &clk_n_val=0.
      &clk_2d_val=0.
      
      gosub Set_Clock_Freq
      return
    )
    else if ("&clk_desired_freq"=="50.0")
    (
      &clk_src_name="GPLL0_OUT_MAIN"
      &clk_src_sel=SRC_SEL TODO.
      &clk_src_div=24.
      &clk_m_val=0.
      &clk_n_val=0.
      &clk_2d_val=0.
      
      gosub Set_Clock_Freq
      return
    )
    else if ("&clk_desired_freq"=="r")
    (
      return
    )
    else
    (
      print "Invalid selection."
      goto Set_Clock_Freq_Enter
    )
  )

  if ("&clk"=="gcc_blsp2_qup5_spi_apps_clk")
  (
    gosub PRINT_SET_CLOCK_FREQ_WARNING

    &clk_cmd_rcgr_addr=&HWIO_GCC_BLSP2_QUP5_SPI_APPS_CMD_RCGR_ADDR
    &clk_cfg_rcgr_addr=&HWIO_GCC_BLSP2_QUP5_SPI_APPS_CFG_RCGR_ADDR

    print "Choose frequency (MHz) from list below: " 

    print "0.96           4.8            9.6            " 
    print "15.0           19.2           25.0           " 
    print "50.0           " 

    print ""
    print "Enter desired frequency (r to return): "
    enter &clk_desired_freq
    print ""

    if ("&clk_desired_freq"=="0.96")
    (
      &clk_src_name="XO"
      &clk_src_sel=SRC_SEL TODO.
      &clk_src_div=20.
      &clk_m_val=1.
      &clk_n_val=2.
      &clk_2d_val=2.
      
      gosub Set_Clock_Freq
      return
    )
    else if ("&clk_desired_freq"=="4.8")
    (
      &clk_src_name="XO"
      &clk_src_sel=SRC_SEL TODO.
      &clk_src_div=8.
      &clk_m_val=0.
      &clk_n_val=0.
      &clk_2d_val=0.
      
      gosub Set_Clock_Freq
      return
    )
    else if ("&clk_desired_freq"=="9.6")
    (
      &clk_src_name="XO"
      &clk_src_sel=SRC_SEL TODO.
      &clk_src_div=4.
      &clk_m_val=0.
      &clk_n_val=0.
      &clk_2d_val=0.
      
      gosub Set_Clock_Freq
      return
    )
    else if ("&clk_desired_freq"=="15.0")
    (
      &clk_src_name="GPLL0_OUT_MAIN"
      &clk_src_sel=SRC_SEL TODO.
      &clk_src_div=20.
      &clk_m_val=1.
      &clk_n_val=4.
      &clk_2d_val=4.
      
      gosub Set_Clock_Freq
      return
    )
    else if ("&clk_desired_freq"=="19.2")
    (
      &clk_src_name="XO"
      &clk_src_sel=SRC_SEL TODO.
      &clk_src_div=2.
      &clk_m_val=0.
      &clk_n_val=0.
      &clk_2d_val=0.
      
      gosub Set_Clock_Freq
      return
    )
    else if ("&clk_desired_freq"=="25.0")
    (
      &clk_src_name="GPLL0_OUT_MAIN"
      &clk_src_sel=SRC_SEL TODO.
      &clk_src_div=24.
      &clk_m_val=1.
      &clk_n_val=2.
      &clk_2d_val=2.
      
      gosub Set_Clock_Freq
      return
    )
    else if ("&clk_desired_freq"=="50.0")
    (
      &clk_src_name="GPLL0_OUT_MAIN"
      &clk_src_sel=SRC_SEL TODO.
      &clk_src_div=24.
      &clk_m_val=0.
      &clk_n_val=0.
      &clk_2d_val=0.
      
      gosub Set_Clock_Freq
      return
    )
    else if ("&clk_desired_freq"=="r")
    (
      return
    )
    else
    (
      print "Invalid selection."
      goto Set_Clock_Freq_Enter
    )
  )

  if ("&clk"=="gcc_blsp2_qup6_i2c_apps_clk")
  (
    gosub PRINT_SET_CLOCK_FREQ_WARNING

    &clk_cmd_rcgr_addr=&HWIO_GCC_BLSP2_QUP6_I2C_APPS_CMD_RCGR_ADDR
    &clk_cfg_rcgr_addr=&HWIO_GCC_BLSP2_QUP6_I2C_APPS_CFG_RCGR_ADDR

    print "Choose frequency (MHz) from list below: " 

    print "19.2           50.0           " 

    print ""
    print "Enter desired frequency (r to return): "
    enter &clk_desired_freq
    print ""

    if ("&clk_desired_freq"=="19.2")
    (
      &clk_src_name="XO"
      &clk_src_sel=SRC_SEL TODO.
      &clk_src_div=2.
      &clk_m_val=0.
      &clk_n_val=0.
      &clk_2d_val=0.
      
      gosub Set_Clock_Freq
      return
    )
    else if ("&clk_desired_freq"=="50.0")
    (
      &clk_src_name="GPLL0_OUT_MAIN"
      &clk_src_sel=SRC_SEL TODO.
      &clk_src_div=24.
      &clk_m_val=0.
      &clk_n_val=0.
      &clk_2d_val=0.
      
      gosub Set_Clock_Freq
      return
    )
    else if ("&clk_desired_freq"=="r")
    (
      return
    )
    else
    (
      print "Invalid selection."
      goto Set_Clock_Freq_Enter
    )
  )

  if ("&clk"=="gcc_blsp2_qup6_spi_apps_clk")
  (
    gosub PRINT_SET_CLOCK_FREQ_WARNING

    &clk_cmd_rcgr_addr=&HWIO_GCC_BLSP2_QUP6_SPI_APPS_CMD_RCGR_ADDR
    &clk_cfg_rcgr_addr=&HWIO_GCC_BLSP2_QUP6_SPI_APPS_CFG_RCGR_ADDR

    print "Choose frequency (MHz) from list below: " 

    print "0.96           4.8            9.6            " 
    print "15.0           19.2           25.0           " 
    print "50.0           " 

    print ""
    print "Enter desired frequency (r to return): "
    enter &clk_desired_freq
    print ""

    if ("&clk_desired_freq"=="0.96")
    (
      &clk_src_name="XO"
      &clk_src_sel=SRC_SEL TODO.
      &clk_src_div=20.
      &clk_m_val=1.
      &clk_n_val=2.
      &clk_2d_val=2.
      
      gosub Set_Clock_Freq
      return
    )
    else if ("&clk_desired_freq"=="4.8")
    (
      &clk_src_name="XO"
      &clk_src_sel=SRC_SEL TODO.
      &clk_src_div=8.
      &clk_m_val=0.
      &clk_n_val=0.
      &clk_2d_val=0.
      
      gosub Set_Clock_Freq
      return
    )
    else if ("&clk_desired_freq"=="9.6")
    (
      &clk_src_name="XO"
      &clk_src_sel=SRC_SEL TODO.
      &clk_src_div=4.
      &clk_m_val=0.
      &clk_n_val=0.
      &clk_2d_val=0.
      
      gosub Set_Clock_Freq
      return
    )
    else if ("&clk_desired_freq"=="15.0")
    (
      &clk_src_name="GPLL0_OUT_MAIN"
      &clk_src_sel=SRC_SEL TODO.
      &clk_src_div=20.
      &clk_m_val=1.
      &clk_n_val=4.
      &clk_2d_val=4.
      
      gosub Set_Clock_Freq
      return
    )
    else if ("&clk_desired_freq"=="19.2")
    (
      &clk_src_name="XO"
      &clk_src_sel=SRC_SEL TODO.
      &clk_src_div=2.
      &clk_m_val=0.
      &clk_n_val=0.
      &clk_2d_val=0.
      
      gosub Set_Clock_Freq
      return
    )
    else if ("&clk_desired_freq"=="25.0")
    (
      &clk_src_name="GPLL0_OUT_MAIN"
      &clk_src_sel=SRC_SEL TODO.
      &clk_src_div=24.
      &clk_m_val=1.
      &clk_n_val=2.
      &clk_2d_val=2.
      
      gosub Set_Clock_Freq
      return
    )
    else if ("&clk_desired_freq"=="50.0")
    (
      &clk_src_name="GPLL0_OUT_MAIN"
      &clk_src_sel=SRC_SEL TODO.
      &clk_src_div=24.
      &clk_m_val=0.
      &clk_n_val=0.
      &clk_2d_val=0.
      
      gosub Set_Clock_Freq
      return
    )
    else if ("&clk_desired_freq"=="r")
    (
      return
    )
    else
    (
      print "Invalid selection."
      goto Set_Clock_Freq_Enter
    )
  )

  if ("&clk"=="gcc_blsp2_uart1_apps_clk")
  (
    gosub PRINT_SET_CLOCK_FREQ_WARNING

    &clk_cmd_rcgr_addr=&HWIO_GCC_BLSP2_UART1_APPS_CMD_RCGR_ADDR
    &clk_cfg_rcgr_addr=&HWIO_GCC_BLSP2_UART1_APPS_CFG_RCGR_ADDR

    print "Choose frequency (MHz) from list below: " 

    print "3.6864         7.3728         14.7456        " 
    print "16.0           19.2           24.0           " 
    print "32.0           40.0           46.4           " 
    print "48.0           51.2           56.0           " 
    print "58.9824        60.0           63.157895      " 

    print ""
    print "Enter desired frequency (r to return): "
    enter &clk_desired_freq
    print ""

    if ("&clk_desired_freq"=="3.6864")
    (
      &clk_src_name="GPLL0_OUT_MAIN"
      &clk_src_sel=SRC_SEL TODO.
      &clk_src_div=2.
      &clk_m_val=96.
      &clk_n_val=15625.
      &clk_2d_val=15625.
      
      gosub Set_Clock_Freq
      return
    )
    else if ("&clk_desired_freq"=="7.3728")
    (
      &clk_src_name="GPLL0_OUT_MAIN"
      &clk_src_sel=SRC_SEL TODO.
      &clk_src_div=2.
      &clk_m_val=192.
      &clk_n_val=15625.
      &clk_2d_val=15625.
      
      gosub Set_Clock_Freq
      return
    )
    else if ("&clk_desired_freq"=="14.7456")
    (
      &clk_src_name="GPLL0_OUT_MAIN"
      &clk_src_sel=SRC_SEL TODO.
      &clk_src_div=2.
      &clk_m_val=384.
      &clk_n_val=15625.
      &clk_2d_val=15625.
      
      gosub Set_Clock_Freq
      return
    )
    else if ("&clk_desired_freq"=="16.0")
    (
      &clk_src_name="GPLL0_OUT_MAIN"
      &clk_src_sel=SRC_SEL TODO.
      &clk_src_div=10.
      &clk_m_val=2.
      &clk_n_val=15.
      &clk_2d_val=15.
      
      gosub Set_Clock_Freq
      return
    )
    else if ("&clk_desired_freq"=="19.2")
    (
      &clk_src_name="XO"
      &clk_src_sel=SRC_SEL TODO.
      &clk_src_div=2.
      &clk_m_val=0.
      &clk_n_val=0.
      &clk_2d_val=0.
      
      gosub Set_Clock_Freq
      return
    )
    else if ("&clk_desired_freq"=="24.0")
    (
      &clk_src_name="GPLL0_OUT_MAIN"
      &clk_src_sel=SRC_SEL TODO.
      &clk_src_div=10.
      &clk_m_val=1.
      &clk_n_val=5.
      &clk_2d_val=5.
      
      gosub Set_Clock_Freq
      return
    )
    else if ("&clk_desired_freq"=="32.0")
    (
      &clk_src_name="GPLL0_OUT_MAIN"
      &clk_src_sel=SRC_SEL TODO.
      &clk_src_div=2.
      &clk_m_val=4.
      &clk_n_val=75.
      &clk_2d_val=75.
      
      gosub Set_Clock_Freq
      return
    )
    else if ("&clk_desired_freq"=="40.0")
    (
      &clk_src_name="GPLL0_OUT_MAIN"
      &clk_src_sel=SRC_SEL TODO.
      &clk_src_div=30.
      &clk_m_val=0.
      &clk_n_val=0.
      &clk_2d_val=0.
      
      gosub Set_Clock_Freq
      return
    )
    else if ("&clk_desired_freq"=="46.4")
    (
      &clk_src_name="GPLL0_OUT_MAIN"
      &clk_src_sel=SRC_SEL TODO.
      &clk_src_div=2.
      &clk_m_val=29.
      &clk_n_val=375.
      &clk_2d_val=375.
      
      gosub Set_Clock_Freq
      return
    )
    else if ("&clk_desired_freq"=="48.0")
    (
      &clk_src_name="GPLL0_OUT_MAIN"
      &clk_src_sel=SRC_SEL TODO.
      &clk_src_div=25.
      &clk_m_val=0.
      &clk_n_val=0.
      &clk_2d_val=0.
      
      gosub Set_Clock_Freq
      return
    )
    else if ("&clk_desired_freq"=="51.2")
    (
      &clk_src_name="GPLL0_OUT_MAIN"
      &clk_src_sel=SRC_SEL TODO.
      &clk_src_div=2.
      &clk_m_val=32.
      &clk_n_val=375.
      &clk_2d_val=375.
      
      gosub Set_Clock_Freq
      return
    )
    else if ("&clk_desired_freq"=="56.0")
    (
      &clk_src_name="GPLL0_OUT_MAIN"
      &clk_src_sel=SRC_SEL TODO.
      &clk_src_div=2.
      &clk_m_val=7.
      &clk_n_val=75.
      &clk_2d_val=75.
      
      gosub Set_Clock_Freq
      return
    )
    else if ("&clk_desired_freq"=="58.9824")
    (
      &clk_src_name="GPLL0_OUT_MAIN"
      &clk_src_sel=SRC_SEL TODO.
      &clk_src_div=2.
      &clk_m_val=1536.
      &clk_n_val=15625.
      &clk_2d_val=15625.
      
      gosub Set_Clock_Freq
      return
    )
    else if ("&clk_desired_freq"=="60.0")
    (
      &clk_src_name="GPLL0_OUT_MAIN"
      &clk_src_sel=SRC_SEL TODO.
      &clk_src_div=20.
      &clk_m_val=0.
      &clk_n_val=0.
      &clk_2d_val=0.
      
      gosub Set_Clock_Freq
      return
    )
    else if ("&clk_desired_freq"=="63.157895")
    (
      &clk_src_name="GPLL0_OUT_MAIN"
      &clk_src_sel=SRC_SEL TODO.
      &clk_src_div=19.
      &clk_m_val=0.
      &clk_n_val=0.
      &clk_2d_val=0.
      
      gosub Set_Clock_Freq
      return
    )
    else if ("&clk_desired_freq"=="r")
    (
      return
    )
    else
    (
      print "Invalid selection."
      goto Set_Clock_Freq_Enter
    )
  )

  if ("&clk"=="gcc_blsp2_uart2_apps_clk")
  (
    gosub PRINT_SET_CLOCK_FREQ_WARNING

    &clk_cmd_rcgr_addr=&HWIO_GCC_BLSP2_UART2_APPS_CMD_RCGR_ADDR
    &clk_cfg_rcgr_addr=&HWIO_GCC_BLSP2_UART2_APPS_CFG_RCGR_ADDR

    print "Choose frequency (MHz) from list below: " 

    print "3.6864         7.3728         14.7456        " 
    print "16.0           19.2           24.0           " 
    print "32.0           40.0           46.4           " 
    print "48.0           51.2           56.0           " 
    print "58.9824        60.0           63.157895      " 

    print ""
    print "Enter desired frequency (r to return): "
    enter &clk_desired_freq
    print ""

    if ("&clk_desired_freq"=="3.6864")
    (
      &clk_src_name="GPLL0_OUT_MAIN"
      &clk_src_sel=SRC_SEL TODO.
      &clk_src_div=2.
      &clk_m_val=96.
      &clk_n_val=15625.
      &clk_2d_val=15625.
      
      gosub Set_Clock_Freq
      return
    )
    else if ("&clk_desired_freq"=="7.3728")
    (
      &clk_src_name="GPLL0_OUT_MAIN"
      &clk_src_sel=SRC_SEL TODO.
      &clk_src_div=2.
      &clk_m_val=192.
      &clk_n_val=15625.
      &clk_2d_val=15625.
      
      gosub Set_Clock_Freq
      return
    )
    else if ("&clk_desired_freq"=="14.7456")
    (
      &clk_src_name="GPLL0_OUT_MAIN"
      &clk_src_sel=SRC_SEL TODO.
      &clk_src_div=2.
      &clk_m_val=384.
      &clk_n_val=15625.
      &clk_2d_val=15625.
      
      gosub Set_Clock_Freq
      return
    )
    else if ("&clk_desired_freq"=="16.0")
    (
      &clk_src_name="GPLL0_OUT_MAIN"
      &clk_src_sel=SRC_SEL TODO.
      &clk_src_div=10.
      &clk_m_val=2.
      &clk_n_val=15.
      &clk_2d_val=15.
      
      gosub Set_Clock_Freq
      return
    )
    else if ("&clk_desired_freq"=="19.2")
    (
      &clk_src_name="XO"
      &clk_src_sel=SRC_SEL TODO.
      &clk_src_div=2.
      &clk_m_val=0.
      &clk_n_val=0.
      &clk_2d_val=0.
      
      gosub Set_Clock_Freq
      return
    )
    else if ("&clk_desired_freq"=="24.0")
    (
      &clk_src_name="GPLL0_OUT_MAIN"
      &clk_src_sel=SRC_SEL TODO.
      &clk_src_div=10.
      &clk_m_val=1.
      &clk_n_val=5.
      &clk_2d_val=5.
      
      gosub Set_Clock_Freq
      return
    )
    else if ("&clk_desired_freq"=="32.0")
    (
      &clk_src_name="GPLL0_OUT_MAIN"
      &clk_src_sel=SRC_SEL TODO.
      &clk_src_div=2.
      &clk_m_val=4.
      &clk_n_val=75.
      &clk_2d_val=75.
      
      gosub Set_Clock_Freq
      return
    )
    else if ("&clk_desired_freq"=="40.0")
    (
      &clk_src_name="GPLL0_OUT_MAIN"
      &clk_src_sel=SRC_SEL TODO.
      &clk_src_div=30.
      &clk_m_val=0.
      &clk_n_val=0.
      &clk_2d_val=0.
      
      gosub Set_Clock_Freq
      return
    )
    else if ("&clk_desired_freq"=="46.4")
    (
      &clk_src_name="GPLL0_OUT_MAIN"
      &clk_src_sel=SRC_SEL TODO.
      &clk_src_div=2.
      &clk_m_val=29.
      &clk_n_val=375.
      &clk_2d_val=375.
      
      gosub Set_Clock_Freq
      return
    )
    else if ("&clk_desired_freq"=="48.0")
    (
      &clk_src_name="GPLL0_OUT_MAIN"
      &clk_src_sel=SRC_SEL TODO.
      &clk_src_div=25.
      &clk_m_val=0.
      &clk_n_val=0.
      &clk_2d_val=0.
      
      gosub Set_Clock_Freq
      return
    )
    else if ("&clk_desired_freq"=="51.2")
    (
      &clk_src_name="GPLL0_OUT_MAIN"
      &clk_src_sel=SRC_SEL TODO.
      &clk_src_div=2.
      &clk_m_val=32.
      &clk_n_val=375.
      &clk_2d_val=375.
      
      gosub Set_Clock_Freq
      return
    )
    else if ("&clk_desired_freq"=="56.0")
    (
      &clk_src_name="GPLL0_OUT_MAIN"
      &clk_src_sel=SRC_SEL TODO.
      &clk_src_div=2.
      &clk_m_val=7.
      &clk_n_val=75.
      &clk_2d_val=75.
      
      gosub Set_Clock_Freq
      return
    )
    else if ("&clk_desired_freq"=="58.9824")
    (
      &clk_src_name="GPLL0_OUT_MAIN"
      &clk_src_sel=SRC_SEL TODO.
      &clk_src_div=2.
      &clk_m_val=1536.
      &clk_n_val=15625.
      &clk_2d_val=15625.
      
      gosub Set_Clock_Freq
      return
    )
    else if ("&clk_desired_freq"=="60.0")
    (
      &clk_src_name="GPLL0_OUT_MAIN"
      &clk_src_sel=SRC_SEL TODO.
      &clk_src_div=20.
      &clk_m_val=0.
      &clk_n_val=0.
      &clk_2d_val=0.
      
      gosub Set_Clock_Freq
      return
    )
    else if ("&clk_desired_freq"=="63.157895")
    (
      &clk_src_name="GPLL0_OUT_MAIN"
      &clk_src_sel=SRC_SEL TODO.
      &clk_src_div=19.
      &clk_m_val=0.
      &clk_n_val=0.
      &clk_2d_val=0.
      
      gosub Set_Clock_Freq
      return
    )
    else if ("&clk_desired_freq"=="r")
    (
      return
    )
    else
    (
      print "Invalid selection."
      goto Set_Clock_Freq_Enter
    )
  )

  if ("&clk"=="gcc_blsp2_uart3_apps_clk")
  (
    gosub PRINT_SET_CLOCK_FREQ_WARNING

    &clk_cmd_rcgr_addr=&HWIO_GCC_BLSP2_UART3_APPS_CMD_RCGR_ADDR
    &clk_cfg_rcgr_addr=&HWIO_GCC_BLSP2_UART3_APPS_CFG_RCGR_ADDR

    print "Choose frequency (MHz) from list below: " 

    print "3.6864         7.3728         14.7456        " 
    print "16.0           19.2           24.0           " 
    print "32.0           40.0           46.4           " 
    print "48.0           51.2           56.0           " 
    print "58.9824        60.0           63.157895      " 

    print ""
    print "Enter desired frequency (r to return): "
    enter &clk_desired_freq
    print ""

    if ("&clk_desired_freq"=="3.6864")
    (
      &clk_src_name="GPLL0_OUT_MAIN"
      &clk_src_sel=SRC_SEL TODO.
      &clk_src_div=2.
      &clk_m_val=96.
      &clk_n_val=15625.
      &clk_2d_val=15625.
      
      gosub Set_Clock_Freq
      return
    )
    else if ("&clk_desired_freq"=="7.3728")
    (
      &clk_src_name="GPLL0_OUT_MAIN"
      &clk_src_sel=SRC_SEL TODO.
      &clk_src_div=2.
      &clk_m_val=192.
      &clk_n_val=15625.
      &clk_2d_val=15625.
      
      gosub Set_Clock_Freq
      return
    )
    else if ("&clk_desired_freq"=="14.7456")
    (
      &clk_src_name="GPLL0_OUT_MAIN"
      &clk_src_sel=SRC_SEL TODO.
      &clk_src_div=2.
      &clk_m_val=384.
      &clk_n_val=15625.
      &clk_2d_val=15625.
      
      gosub Set_Clock_Freq
      return
    )
    else if ("&clk_desired_freq"=="16.0")
    (
      &clk_src_name="GPLL0_OUT_MAIN"
      &clk_src_sel=SRC_SEL TODO.
      &clk_src_div=10.
      &clk_m_val=2.
      &clk_n_val=15.
      &clk_2d_val=15.
      
      gosub Set_Clock_Freq
      return
    )
    else if ("&clk_desired_freq"=="19.2")
    (
      &clk_src_name="XO"
      &clk_src_sel=SRC_SEL TODO.
      &clk_src_div=2.
      &clk_m_val=0.
      &clk_n_val=0.
      &clk_2d_val=0.
      
      gosub Set_Clock_Freq
      return
    )
    else if ("&clk_desired_freq"=="24.0")
    (
      &clk_src_name="GPLL0_OUT_MAIN"
      &clk_src_sel=SRC_SEL TODO.
      &clk_src_div=10.
      &clk_m_val=1.
      &clk_n_val=5.
      &clk_2d_val=5.
      
      gosub Set_Clock_Freq
      return
    )
    else if ("&clk_desired_freq"=="32.0")
    (
      &clk_src_name="GPLL0_OUT_MAIN"
      &clk_src_sel=SRC_SEL TODO.
      &clk_src_div=2.
      &clk_m_val=4.
      &clk_n_val=75.
      &clk_2d_val=75.
      
      gosub Set_Clock_Freq
      return
    )
    else if ("&clk_desired_freq"=="40.0")
    (
      &clk_src_name="GPLL0_OUT_MAIN"
      &clk_src_sel=SRC_SEL TODO.
      &clk_src_div=30.
      &clk_m_val=0.
      &clk_n_val=0.
      &clk_2d_val=0.
      
      gosub Set_Clock_Freq
      return
    )
    else if ("&clk_desired_freq"=="46.4")
    (
      &clk_src_name="GPLL0_OUT_MAIN"
      &clk_src_sel=SRC_SEL TODO.
      &clk_src_div=2.
      &clk_m_val=29.
      &clk_n_val=375.
      &clk_2d_val=375.
      
      gosub Set_Clock_Freq
      return
    )
    else if ("&clk_desired_freq"=="48.0")
    (
      &clk_src_name="GPLL0_OUT_MAIN"
      &clk_src_sel=SRC_SEL TODO.
      &clk_src_div=25.
      &clk_m_val=0.
      &clk_n_val=0.
      &clk_2d_val=0.
      
      gosub Set_Clock_Freq
      return
    )
    else if ("&clk_desired_freq"=="51.2")
    (
      &clk_src_name="GPLL0_OUT_MAIN"
      &clk_src_sel=SRC_SEL TODO.
      &clk_src_div=2.
      &clk_m_val=32.
      &clk_n_val=375.
      &clk_2d_val=375.
      
      gosub Set_Clock_Freq
      return
    )
    else if ("&clk_desired_freq"=="56.0")
    (
      &clk_src_name="GPLL0_OUT_MAIN"
      &clk_src_sel=SRC_SEL TODO.
      &clk_src_div=2.
      &clk_m_val=7.
      &clk_n_val=75.
      &clk_2d_val=75.
      
      gosub Set_Clock_Freq
      return
    )
    else if ("&clk_desired_freq"=="58.9824")
    (
      &clk_src_name="GPLL0_OUT_MAIN"
      &clk_src_sel=SRC_SEL TODO.
      &clk_src_div=2.
      &clk_m_val=1536.
      &clk_n_val=15625.
      &clk_2d_val=15625.
      
      gosub Set_Clock_Freq
      return
    )
    else if ("&clk_desired_freq"=="60.0")
    (
      &clk_src_name="GPLL0_OUT_MAIN"
      &clk_src_sel=SRC_SEL TODO.
      &clk_src_div=20.
      &clk_m_val=0.
      &clk_n_val=0.
      &clk_2d_val=0.
      
      gosub Set_Clock_Freq
      return
    )
    else if ("&clk_desired_freq"=="63.157895")
    (
      &clk_src_name="GPLL0_OUT_MAIN"
      &clk_src_sel=SRC_SEL TODO.
      &clk_src_div=19.
      &clk_m_val=0.
      &clk_n_val=0.
      &clk_2d_val=0.
      
      gosub Set_Clock_Freq
      return
    )
    else if ("&clk_desired_freq"=="r")
    (
      return
    )
    else
    (
      print "Invalid selection."
      goto Set_Clock_Freq_Enter
    )
  )

  if ("&clk"=="gcc_blsp2_uart4_apps_clk")
  (
    gosub PRINT_SET_CLOCK_FREQ_WARNING

    &clk_cmd_rcgr_addr=&HWIO_GCC_BLSP2_UART4_APPS_CMD_RCGR_ADDR
    &clk_cfg_rcgr_addr=&HWIO_GCC_BLSP2_UART4_APPS_CFG_RCGR_ADDR

    print "Choose frequency (MHz) from list below: " 

    print "3.6864         7.3728         14.7456        " 
    print "16.0           19.2           24.0           " 
    print "32.0           40.0           46.4           " 
    print "48.0           51.2           56.0           " 
    print "58.9824        60.0           63.157895      " 

    print ""
    print "Enter desired frequency (r to return): "
    enter &clk_desired_freq
    print ""

    if ("&clk_desired_freq"=="3.6864")
    (
      &clk_src_name="GPLL0_OUT_MAIN"
      &clk_src_sel=SRC_SEL TODO.
      &clk_src_div=2.
      &clk_m_val=96.
      &clk_n_val=15625.
      &clk_2d_val=15625.
      
      gosub Set_Clock_Freq
      return
    )
    else if ("&clk_desired_freq"=="7.3728")
    (
      &clk_src_name="GPLL0_OUT_MAIN"
      &clk_src_sel=SRC_SEL TODO.
      &clk_src_div=2.
      &clk_m_val=192.
      &clk_n_val=15625.
      &clk_2d_val=15625.
      
      gosub Set_Clock_Freq
      return
    )
    else if ("&clk_desired_freq"=="14.7456")
    (
      &clk_src_name="GPLL0_OUT_MAIN"
      &clk_src_sel=SRC_SEL TODO.
      &clk_src_div=2.
      &clk_m_val=384.
      &clk_n_val=15625.
      &clk_2d_val=15625.
      
      gosub Set_Clock_Freq
      return
    )
    else if ("&clk_desired_freq"=="16.0")
    (
      &clk_src_name="GPLL0_OUT_MAIN"
      &clk_src_sel=SRC_SEL TODO.
      &clk_src_div=10.
      &clk_m_val=2.
      &clk_n_val=15.
      &clk_2d_val=15.
      
      gosub Set_Clock_Freq
      return
    )
    else if ("&clk_desired_freq"=="19.2")
    (
      &clk_src_name="XO"
      &clk_src_sel=SRC_SEL TODO.
      &clk_src_div=2.
      &clk_m_val=0.
      &clk_n_val=0.
      &clk_2d_val=0.
      
      gosub Set_Clock_Freq
      return
    )
    else if ("&clk_desired_freq"=="24.0")
    (
      &clk_src_name="GPLL0_OUT_MAIN"
      &clk_src_sel=SRC_SEL TODO.
      &clk_src_div=10.
      &clk_m_val=1.
      &clk_n_val=5.
      &clk_2d_val=5.
      
      gosub Set_Clock_Freq
      return
    )
    else if ("&clk_desired_freq"=="32.0")
    (
      &clk_src_name="GPLL0_OUT_MAIN"
      &clk_src_sel=SRC_SEL TODO.
      &clk_src_div=2.
      &clk_m_val=4.
      &clk_n_val=75.
      &clk_2d_val=75.
      
      gosub Set_Clock_Freq
      return
    )
    else if ("&clk_desired_freq"=="40.0")
    (
      &clk_src_name="GPLL0_OUT_MAIN"
      &clk_src_sel=SRC_SEL TODO.
      &clk_src_div=30.
      &clk_m_val=0.
      &clk_n_val=0.
      &clk_2d_val=0.
      
      gosub Set_Clock_Freq
      return
    )
    else if ("&clk_desired_freq"=="46.4")
    (
      &clk_src_name="GPLL0_OUT_MAIN"
      &clk_src_sel=SRC_SEL TODO.
      &clk_src_div=2.
      &clk_m_val=29.
      &clk_n_val=375.
      &clk_2d_val=375.
      
      gosub Set_Clock_Freq
      return
    )
    else if ("&clk_desired_freq"=="48.0")
    (
      &clk_src_name="GPLL0_OUT_MAIN"
      &clk_src_sel=SRC_SEL TODO.
      &clk_src_div=25.
      &clk_m_val=0.
      &clk_n_val=0.
      &clk_2d_val=0.
      
      gosub Set_Clock_Freq
      return
    )
    else if ("&clk_desired_freq"=="51.2")
    (
      &clk_src_name="GPLL0_OUT_MAIN"
      &clk_src_sel=SRC_SEL TODO.
      &clk_src_div=2.
      &clk_m_val=32.
      &clk_n_val=375.
      &clk_2d_val=375.
      
      gosub Set_Clock_Freq
      return
    )
    else if ("&clk_desired_freq"=="56.0")
    (
      &clk_src_name="GPLL0_OUT_MAIN"
      &clk_src_sel=SRC_SEL TODO.
      &clk_src_div=2.
      &clk_m_val=7.
      &clk_n_val=75.
      &clk_2d_val=75.
      
      gosub Set_Clock_Freq
      return
    )
    else if ("&clk_desired_freq"=="58.9824")
    (
      &clk_src_name="GPLL0_OUT_MAIN"
      &clk_src_sel=SRC_SEL TODO.
      &clk_src_div=2.
      &clk_m_val=1536.
      &clk_n_val=15625.
      &clk_2d_val=15625.
      
      gosub Set_Clock_Freq
      return
    )
    else if ("&clk_desired_freq"=="60.0")
    (
      &clk_src_name="GPLL0_OUT_MAIN"
      &clk_src_sel=SRC_SEL TODO.
      &clk_src_div=20.
      &clk_m_val=0.
      &clk_n_val=0.
      &clk_2d_val=0.
      
      gosub Set_Clock_Freq
      return
    )
    else if ("&clk_desired_freq"=="63.157895")
    (
      &clk_src_name="GPLL0_OUT_MAIN"
      &clk_src_sel=SRC_SEL TODO.
      &clk_src_div=19.
      &clk_m_val=0.
      &clk_n_val=0.
      &clk_2d_val=0.
      
      gosub Set_Clock_Freq
      return
    )
    else if ("&clk_desired_freq"=="r")
    (
      return
    )
    else
    (
      print "Invalid selection."
      goto Set_Clock_Freq_Enter
    )
  )

  if ("&clk"=="gcc_blsp2_uart5_apps_clk")
  (
    gosub PRINT_SET_CLOCK_FREQ_WARNING

    &clk_cmd_rcgr_addr=&HWIO_GCC_BLSP2_UART5_APPS_CMD_RCGR_ADDR
    &clk_cfg_rcgr_addr=&HWIO_GCC_BLSP2_UART5_APPS_CFG_RCGR_ADDR

    print "Choose frequency (MHz) from list below: " 

    print "3.6864         7.3728         14.7456        " 
    print "16.0           19.2           24.0           " 
    print "32.0           40.0           46.4           " 
    print "48.0           51.2           56.0           " 
    print "58.9824        60.0           63.157895      " 

    print ""
    print "Enter desired frequency (r to return): "
    enter &clk_desired_freq
    print ""

    if ("&clk_desired_freq"=="3.6864")
    (
      &clk_src_name="GPLL0_OUT_MAIN"
      &clk_src_sel=SRC_SEL TODO.
      &clk_src_div=2.
      &clk_m_val=96.
      &clk_n_val=15625.
      &clk_2d_val=15625.
      
      gosub Set_Clock_Freq
      return
    )
    else if ("&clk_desired_freq"=="7.3728")
    (
      &clk_src_name="GPLL0_OUT_MAIN"
      &clk_src_sel=SRC_SEL TODO.
      &clk_src_div=2.
      &clk_m_val=192.
      &clk_n_val=15625.
      &clk_2d_val=15625.
      
      gosub Set_Clock_Freq
      return
    )
    else if ("&clk_desired_freq"=="14.7456")
    (
      &clk_src_name="GPLL0_OUT_MAIN"
      &clk_src_sel=SRC_SEL TODO.
      &clk_src_div=2.
      &clk_m_val=384.
      &clk_n_val=15625.
      &clk_2d_val=15625.
      
      gosub Set_Clock_Freq
      return
    )
    else if ("&clk_desired_freq"=="16.0")
    (
      &clk_src_name="GPLL0_OUT_MAIN"
      &clk_src_sel=SRC_SEL TODO.
      &clk_src_div=10.
      &clk_m_val=2.
      &clk_n_val=15.
      &clk_2d_val=15.
      
      gosub Set_Clock_Freq
      return
    )
    else if ("&clk_desired_freq"=="19.2")
    (
      &clk_src_name="XO"
      &clk_src_sel=SRC_SEL TODO.
      &clk_src_div=2.
      &clk_m_val=0.
      &clk_n_val=0.
      &clk_2d_val=0.
      
      gosub Set_Clock_Freq
      return
    )
    else if ("&clk_desired_freq"=="24.0")
    (
      &clk_src_name="GPLL0_OUT_MAIN"
      &clk_src_sel=SRC_SEL TODO.
      &clk_src_div=10.
      &clk_m_val=1.
      &clk_n_val=5.
      &clk_2d_val=5.
      
      gosub Set_Clock_Freq
      return
    )
    else if ("&clk_desired_freq"=="32.0")
    (
      &clk_src_name="GPLL0_OUT_MAIN"
      &clk_src_sel=SRC_SEL TODO.
      &clk_src_div=2.
      &clk_m_val=4.
      &clk_n_val=75.
      &clk_2d_val=75.
      
      gosub Set_Clock_Freq
      return
    )
    else if ("&clk_desired_freq"=="40.0")
    (
      &clk_src_name="GPLL0_OUT_MAIN"
      &clk_src_sel=SRC_SEL TODO.
      &clk_src_div=30.
      &clk_m_val=0.
      &clk_n_val=0.
      &clk_2d_val=0.
      
      gosub Set_Clock_Freq
      return
    )
    else if ("&clk_desired_freq"=="46.4")
    (
      &clk_src_name="GPLL0_OUT_MAIN"
      &clk_src_sel=SRC_SEL TODO.
      &clk_src_div=2.
      &clk_m_val=29.
      &clk_n_val=375.
      &clk_2d_val=375.
      
      gosub Set_Clock_Freq
      return
    )
    else if ("&clk_desired_freq"=="48.0")
    (
      &clk_src_name="GPLL0_OUT_MAIN"
      &clk_src_sel=SRC_SEL TODO.
      &clk_src_div=25.
      &clk_m_val=0.
      &clk_n_val=0.
      &clk_2d_val=0.
      
      gosub Set_Clock_Freq
      return
    )
    else if ("&clk_desired_freq"=="51.2")
    (
      &clk_src_name="GPLL0_OUT_MAIN"
      &clk_src_sel=SRC_SEL TODO.
      &clk_src_div=2.
      &clk_m_val=32.
      &clk_n_val=375.
      &clk_2d_val=375.
      
      gosub Set_Clock_Freq
      return
    )
    else if ("&clk_desired_freq"=="56.0")
    (
      &clk_src_name="GPLL0_OUT_MAIN"
      &clk_src_sel=SRC_SEL TODO.
      &clk_src_div=2.
      &clk_m_val=7.
      &clk_n_val=75.
      &clk_2d_val=75.
      
      gosub Set_Clock_Freq
      return
    )
    else if ("&clk_desired_freq"=="58.9824")
    (
      &clk_src_name="GPLL0_OUT_MAIN"
      &clk_src_sel=SRC_SEL TODO.
      &clk_src_div=2.
      &clk_m_val=1536.
      &clk_n_val=15625.
      &clk_2d_val=15625.
      
      gosub Set_Clock_Freq
      return
    )
    else if ("&clk_desired_freq"=="60.0")
    (
      &clk_src_name="GPLL0_OUT_MAIN"
      &clk_src_sel=SRC_SEL TODO.
      &clk_src_div=20.
      &clk_m_val=0.
      &clk_n_val=0.
      &clk_2d_val=0.
      
      gosub Set_Clock_Freq
      return
    )
    else if ("&clk_desired_freq"=="63.157895")
    (
      &clk_src_name="GPLL0_OUT_MAIN"
      &clk_src_sel=SRC_SEL TODO.
      &clk_src_div=19.
      &clk_m_val=0.
      &clk_n_val=0.
      &clk_2d_val=0.
      
      gosub Set_Clock_Freq
      return
    )
    else if ("&clk_desired_freq"=="r")
    (
      return
    )
    else
    (
      print "Invalid selection."
      goto Set_Clock_Freq_Enter
    )
  )

  if ("&clk"=="gcc_blsp2_uart6_apps_clk")
  (
    gosub PRINT_SET_CLOCK_FREQ_WARNING

    &clk_cmd_rcgr_addr=&HWIO_GCC_BLSP2_UART6_APPS_CMD_RCGR_ADDR
    &clk_cfg_rcgr_addr=&HWIO_GCC_BLSP2_UART6_APPS_CFG_RCGR_ADDR

    print "Choose frequency (MHz) from list below: " 

    print "3.6864         7.3728         14.7456        " 
    print "16.0           19.2           24.0           " 
    print "32.0           40.0           46.4           " 
    print "48.0           51.2           56.0           " 
    print "58.9824        60.0           63.157895      " 

    print ""
    print "Enter desired frequency (r to return): "
    enter &clk_desired_freq
    print ""

    if ("&clk_desired_freq"=="3.6864")
    (
      &clk_src_name="GPLL0_OUT_MAIN"
      &clk_src_sel=SRC_SEL TODO.
      &clk_src_div=2.
      &clk_m_val=96.
      &clk_n_val=15625.
      &clk_2d_val=15625.
      
      gosub Set_Clock_Freq
      return
    )
    else if ("&clk_desired_freq"=="7.3728")
    (
      &clk_src_name="GPLL0_OUT_MAIN"
      &clk_src_sel=SRC_SEL TODO.
      &clk_src_div=2.
      &clk_m_val=192.
      &clk_n_val=15625.
      &clk_2d_val=15625.
      
      gosub Set_Clock_Freq
      return
    )
    else if ("&clk_desired_freq"=="14.7456")
    (
      &clk_src_name="GPLL0_OUT_MAIN"
      &clk_src_sel=SRC_SEL TODO.
      &clk_src_div=2.
      &clk_m_val=384.
      &clk_n_val=15625.
      &clk_2d_val=15625.
      
      gosub Set_Clock_Freq
      return
    )
    else if ("&clk_desired_freq"=="16.0")
    (
      &clk_src_name="GPLL0_OUT_MAIN"
      &clk_src_sel=SRC_SEL TODO.
      &clk_src_div=10.
      &clk_m_val=2.
      &clk_n_val=15.
      &clk_2d_val=15.
      
      gosub Set_Clock_Freq
      return
    )
    else if ("&clk_desired_freq"=="19.2")
    (
      &clk_src_name="XO"
      &clk_src_sel=SRC_SEL TODO.
      &clk_src_div=2.
      &clk_m_val=0.
      &clk_n_val=0.
      &clk_2d_val=0.
      
      gosub Set_Clock_Freq
      return
    )
    else if ("&clk_desired_freq"=="24.0")
    (
      &clk_src_name="GPLL0_OUT_MAIN"
      &clk_src_sel=SRC_SEL TODO.
      &clk_src_div=10.
      &clk_m_val=1.
      &clk_n_val=5.
      &clk_2d_val=5.
      
      gosub Set_Clock_Freq
      return
    )
    else if ("&clk_desired_freq"=="32.0")
    (
      &clk_src_name="GPLL0_OUT_MAIN"
      &clk_src_sel=SRC_SEL TODO.
      &clk_src_div=2.
      &clk_m_val=4.
      &clk_n_val=75.
      &clk_2d_val=75.
      
      gosub Set_Clock_Freq
      return
    )
    else if ("&clk_desired_freq"=="40.0")
    (
      &clk_src_name="GPLL0_OUT_MAIN"
      &clk_src_sel=SRC_SEL TODO.
      &clk_src_div=30.
      &clk_m_val=0.
      &clk_n_val=0.
      &clk_2d_val=0.
      
      gosub Set_Clock_Freq
      return
    )
    else if ("&clk_desired_freq"=="46.4")
    (
      &clk_src_name="GPLL0_OUT_MAIN"
      &clk_src_sel=SRC_SEL TODO.
      &clk_src_div=2.
      &clk_m_val=29.
      &clk_n_val=375.
      &clk_2d_val=375.
      
      gosub Set_Clock_Freq
      return
    )
    else if ("&clk_desired_freq"=="48.0")
    (
      &clk_src_name="GPLL0_OUT_MAIN"
      &clk_src_sel=SRC_SEL TODO.
      &clk_src_div=25.
      &clk_m_val=0.
      &clk_n_val=0.
      &clk_2d_val=0.
      
      gosub Set_Clock_Freq
      return
    )
    else if ("&clk_desired_freq"=="51.2")
    (
      &clk_src_name="GPLL0_OUT_MAIN"
      &clk_src_sel=SRC_SEL TODO.
      &clk_src_div=2.
      &clk_m_val=32.
      &clk_n_val=375.
      &clk_2d_val=375.
      
      gosub Set_Clock_Freq
      return
    )
    else if ("&clk_desired_freq"=="56.0")
    (
      &clk_src_name="GPLL0_OUT_MAIN"
      &clk_src_sel=SRC_SEL TODO.
      &clk_src_div=2.
      &clk_m_val=7.
      &clk_n_val=75.
      &clk_2d_val=75.
      
      gosub Set_Clock_Freq
      return
    )
    else if ("&clk_desired_freq"=="58.9824")
    (
      &clk_src_name="GPLL0_OUT_MAIN"
      &clk_src_sel=SRC_SEL TODO.
      &clk_src_div=2.
      &clk_m_val=1536.
      &clk_n_val=15625.
      &clk_2d_val=15625.
      
      gosub Set_Clock_Freq
      return
    )
    else if ("&clk_desired_freq"=="60.0")
    (
      &clk_src_name="GPLL0_OUT_MAIN"
      &clk_src_sel=SRC_SEL TODO.
      &clk_src_div=20.
      &clk_m_val=0.
      &clk_n_val=0.
      &clk_2d_val=0.
      
      gosub Set_Clock_Freq
      return
    )
    else if ("&clk_desired_freq"=="63.157895")
    (
      &clk_src_name="GPLL0_OUT_MAIN"
      &clk_src_sel=SRC_SEL TODO.
      &clk_src_div=19.
      &clk_m_val=0.
      &clk_n_val=0.
      &clk_2d_val=0.
      
      gosub Set_Clock_Freq
      return
    )
    else if ("&clk_desired_freq"=="r")
    (
      return
    )
    else
    (
      print "Invalid selection."
      goto Set_Clock_Freq_Enter
    )
  )

  if ("&clk"=="gcc_blsp1_uart1_sim_clk")||("&clk"=="gcc_blsp1_uart2_sim_clk")||("&clk"=="gcc_blsp1_uart3_sim_clk")||("&clk"=="gcc_blsp1_uart4_sim_clk")||("&clk"=="gcc_blsp1_uart5_sim_clk")||("&clk"=="gcc_blsp1_uart6_sim_clk")||("&clk"=="gcc_blsp2_uart1_sim_clk")||("&clk"=="gcc_blsp2_uart2_sim_clk")||("&clk"=="gcc_blsp2_uart3_sim_clk")||("&clk"=="gcc_blsp2_uart4_sim_clk")||("&clk"=="gcc_blsp2_uart5_sim_clk")||("&clk"=="gcc_blsp2_uart6_sim_clk")
  (
    gosub PRINT_SET_CLOCK_FREQ_WARNING

    &clk_cmd_rcgr_addr=&HWIO_GCC_BLSP_UART_SIM_CMD_RCGR_ADDR
    &clk_cfg_rcgr_addr=&HWIO_GCC_BLSP_UART_SIM_CFG_RCGR_ADDR

    print "Choose frequency (MHz) from list below: " 

    print "3.84           " 

    print ""
    print "Enter desired frequency (r to return): "
    enter &clk_desired_freq
    print ""

    if ("&clk_desired_freq"=="3.84")
    (
      &clk_src_name="XO"
      &clk_src_sel=SRC_SEL TODO.
      &clk_src_div=10.
      &clk_m_val=0.
      &clk_n_val=0.
      &clk_2d_val=0.
      
      gosub Set_Clock_Freq
      return
    )
    else if ("&clk_desired_freq"=="r")
    (
      return
    )
    else
    (
      print "Invalid selection."
      goto Set_Clock_Freq_Enter
    )
  )

  if ("&clk"=="gcc_ce1_clk")
  (
    gosub PRINT_SET_CLOCK_FREQ_WARNING

    &clk_cmd_rcgr_addr=&HWIO_GCC_CE1_CMD_RCGR_ADDR
    &clk_cfg_rcgr_addr=&HWIO_GCC_CE1_CFG_RCGR_ADDR

    print "Choose frequency (MHz) from list below: " 

    print "42.857143      85.714286      171.428571     " 

    print ""
    print "Enter desired frequency (r to return): "
    enter &clk_desired_freq
    print ""

    if ("&clk_desired_freq"=="42.857143")
    (
      &clk_src_name="GPLL0_OUT_MAIN"
      &clk_src_sel=SRC_SEL TODO.
      &clk_src_div=28.
      &clk_m_val=0.
      &clk_n_val=0.
      &clk_2d_val=0.
      
      gosub Set_Clock_Freq
      return
    )
    else if ("&clk_desired_freq"=="85.714286")
    (
      &clk_src_name="GPLL0_OUT_MAIN"
      &clk_src_sel=SRC_SEL TODO.
      &clk_src_div=14.
      &clk_m_val=0.
      &clk_n_val=0.
      &clk_2d_val=0.
      
      gosub Set_Clock_Freq
      return
    )
    else if ("&clk_desired_freq"=="171.428571")
    (
      &clk_src_name="GPLL0_OUT_MAIN"
      &clk_src_sel=SRC_SEL TODO.
      &clk_src_div=7.
      &clk_m_val=0.
      &clk_n_val=0.
      &clk_2d_val=0.
      
      gosub Set_Clock_Freq
      return
    )
    else if ("&clk_desired_freq"=="r")
    (
      return
    )
    else
    (
      print "Invalid selection."
      goto Set_Clock_Freq_Enter
    )
  )

  if ("&clk"=="gcc_aggre0_cnoc_ahb_clk")||("&clk"=="gcc_aggre0_noc_mpu_cfg_ahb_clk")||("&clk"=="gcc_aggre1_cnoc_ahb_clk")||("&clk"=="gcc_aggre1_noc_mpu_cfg_ahb_clk")||("&clk"=="gcc_aggre2_cnoc_ahb_clk")||("&clk"=="gcc_aggre2_noc_mpu_cfg_ahb_clk")||("&clk"=="gcc_ahb_clk")||("&clk"=="gcc_bimc_cfg_ahb_clk")||("&clk"=="gcc_bimc_nius_cfg_ahb_clk")||("&clk"=="gcc_boot_rom_ahb_clk")||("&clk"=="gcc_ce1_ahb_clk")||("&clk"=="gcc_cfg_noc_ahb_clk")||("&clk"=="gcc_cnoc_bus_timeout0_ahb_clk")||("&clk"=="gcc_cnoc_bus_timeout1_ahb_clk")||("&clk"=="gcc_cnoc_bus_timeout2_ahb_clk")||("&clk"=="gcc_cnoc_bus_timeout3_ahb_clk")||("&clk"=="gcc_cnoc_bus_timeout4_ahb_clk")||("&clk"=="gcc_cnoc_bus_timeout6_ahb_clk")||("&clk"=="gcc_cnoc_bus_timeout7_ahb_clk")||("&clk"=="gcc_cnoc_bus_timeout8_ahb_clk")||("&clk"=="gcc_cnoc_bus_timeout9_ahb_clk")||("&clk"=="gcc_cnoc_mst_rpm_ahb_clk")||("&clk"=="gcc_dcc_ahb_clk")||("&clk"=="gcc_imem_cfg_ahb_clk")||("&clk"=="gcc_lpass_core_smmu_ahb_clk")||("&clk"=="gcc_lpass_q6_smmu_ahb_clk")||("&clk"=="gcc_lpass_smmu_aon_ahb_clk")||("&clk"=="gcc_mmss_noc_cfg_ahb_clk")||("&clk"=="gcc_mpm_ahb_clk")||("&clk"=="gcc_msg_ram_ahb_clk")||("&clk"=="gcc_noc_conf_xpu_ahb_clk")||("&clk"=="gcc_pcie_0_cfg_ahb_clk")||("&clk"=="gcc_pcie_1_cfg_ahb_clk")||("&clk"=="gcc_pcie_2_cfg_ahb_clk")||("&clk"=="gcc_pcie_phy_cfg_ahb_clk")||("&clk"=="gcc_periph_noc_cfg_ahb_clk")||("&clk"=="gcc_pimem_ahb_clk")||("&clk"=="gcc_prng_ahb_clk")||("&clk"=="gcc_qdss_cfg_ahb_clk")||("&clk"=="gcc_qdss_dap_ahb_clk")||("&clk"=="gcc_qdss_mpu_ahb_clk")||("&clk"=="gcc_rbcpr_cx_ahb_clk")||("&clk"=="gcc_rbcpr_mx_ahb_clk")||("&clk"=="gcc_rbcpr_xpu_ahb_clk")||("&clk"=="gcc_rpm_mst_m2_cnoc_ahb_clk")||("&clk"=="gcc_sec_ctrl_ahb_clk")||("&clk"=="gcc_sec_ctrl_boot_rom_patch_clk")||("&clk"=="gcc_smmu_aggre0_ahb_clk")||("&clk"=="gcc_smmu_aggre1_ahb_clk")||("&clk"=="gcc_smmu_aggre2_ahb_clk")||("&clk"=="gcc_snoc_cnoc_ahb_clk")||("&clk"=="gcc_spdm_cfg_ahb_clk")||("&clk"=="gcc_spdm_mstr_ahb_clk")||("&clk"=="gcc_spmi_cnoc_ahb_clk")||("&clk"=="gcc_ssc_cnoc_ahbs_clk")||("&clk"=="gcc_ssc_cnoc_mpu_clk")||("&clk"=="gcc_tcsr_ahb_clk")||("&clk"=="gcc_tlmm_ahb_clk")||("&clk"=="gcc_tlmm_clk")||("&clk"=="gcc_ufs_ahb_clk")||("&clk"=="gcc_aggre1_noc_msmpu_cfg_ahb_clk")||("&clk"=="gcc_aggre2_noc_msmpu_cfg_ahb_clk")||("&clk"=="gcc_ipa_ahb_clk")||("&clk"=="gcc_mss_cfg_ahb_clk")||("&clk"=="gcc_mss_msmpu_cfg_ahb_clk")||("&clk"=="gcc_mss_q6_cfg_ahb_clk")||("&clk"=="gcc_mss_q6_msmpu_cfg_ahb_clk")||("&clk"=="gcc_skl_ahb_clk")
  (
    gosub PRINT_SET_CLOCK_FREQ_WARNING

    &clk_cmd_rcgr_addr=&HWIO_GCC_CONFIG_NOC_CMD_RCGR_ADDR
    &clk_cfg_rcgr_addr=&HWIO_GCC_CONFIG_NOC_CFG_RCGR_ADDR

    print "Choose frequency (MHz) from list below: " 

    print "19.2           37.5           75.0           " 

    print ""
    print "Enter desired frequency (r to return): "
    enter &clk_desired_freq
    print ""

    if ("&clk_desired_freq"=="19.2")
    (
      &clk_src_name="XO"
      &clk_src_sel=SRC_SEL TODO.
      &clk_src_div=2.
      &clk_m_val=0.
      &clk_n_val=0.
      &clk_2d_val=0.
      
      gosub Set_Clock_Freq
      return
    )
    else if ("&clk_desired_freq"=="37.5")
    (
      &clk_src_name="GPLL0_OUT_MAIN"
      &clk_src_sel=SRC_SEL TODO.
      &clk_src_div=32.
      &clk_m_val=0.
      &clk_n_val=0.
      &clk_2d_val=0.
      
      gosub Set_Clock_Freq
      return
    )
    else if ("&clk_desired_freq"=="75.0")
    (
      &clk_src_name="GPLL0_OUT_MAIN"
      &clk_src_sel=SRC_SEL TODO.
      &clk_src_div=16.
      &clk_m_val=0.
      &clk_n_val=0.
      &clk_2d_val=0.
      
      gosub Set_Clock_Freq
      return
    )
    else if ("&clk_desired_freq"=="r")
    (
      return
    )
    else
    (
      print "Invalid selection."
      goto Set_Clock_Freq_Enter
    )
  )

  if ("&clk"=="gcc_dcd_xo_clk")||("&clk"=="gcc_pdm_xo4_clk")||("&clk"=="gcc_rpm_timer_clk")||("&clk"=="gcc_spdm_ff_clk")||("&clk"=="gcc_ssc_xo_clk")||("&clk"=="gcc_xo_clk")||("&clk"=="gcc_xo_div4_clk")||("&clk"=="gcc_qrefs_vbg_cal_clk")
  (
    gosub PRINT_SET_CLOCK_FREQ_WARNING

    &clk_cmd_rcgr_addr=&HWIO_GCC_GCC_XO_CMD_RCGR_ADDR
    &clk_cfg_rcgr_addr=&HWIO_GCC_GCC_XO_CFG_RCGR_ADDR

    print "Choose frequency (MHz) from list below: " 

    print "19.2           " 

    print ""
    print "Enter desired frequency (r to return): "
    enter &clk_desired_freq
    print ""

    if ("&clk_desired_freq"=="19.2")
    (
      &clk_src_name="XO"
      &clk_src_sel=SRC_SEL TODO.
      &clk_src_div=2.
      &clk_m_val=0.
      &clk_n_val=0.
      &clk_2d_val=0.
      
      gosub Set_Clock_Freq
      return
    )
    else if ("&clk_desired_freq"=="r")
    (
      return
    )
    else
    (
      print "Invalid selection."
      goto Set_Clock_Freq_Enter
    )
  )

  if ("&clk"=="gcc_gp1_clk")
  (
    gosub PRINT_SET_CLOCK_FREQ_WARNING

    &clk_cmd_rcgr_addr=&HWIO_GCC_GP1_CMD_RCGR_ADDR
    &clk_cfg_rcgr_addr=&HWIO_GCC_GP1_CFG_RCGR_ADDR

    print "Choose frequency (MHz) from list below: " 

    print "19.2           100.0          200.0          " 

    print ""
    print "Enter desired frequency (r to return): "
    enter &clk_desired_freq
    print ""

    if ("&clk_desired_freq"=="19.2")
    (
      &clk_src_name="XO"
      &clk_src_sel=SRC_SEL TODO.
      &clk_src_div=2.
      &clk_m_val=0.
      &clk_n_val=0.
      &clk_2d_val=0.
      
      gosub Set_Clock_Freq
      return
    )
    else if ("&clk_desired_freq"=="100.0")
    (
      &clk_src_name="GPLL0_OUT_MAIN"
      &clk_src_sel=SRC_SEL TODO.
      &clk_src_div=12.
      &clk_m_val=0.
      &clk_n_val=0.
      &clk_2d_val=0.
      
      gosub Set_Clock_Freq
      return
    )
    else if ("&clk_desired_freq"=="200.0")
    (
      &clk_src_name="GPLL0_OUT_MAIN"
      &clk_src_sel=SRC_SEL TODO.
      &clk_src_div=6.
      &clk_m_val=0.
      &clk_n_val=0.
      &clk_2d_val=0.
      
      gosub Set_Clock_Freq
      return
    )
    else if ("&clk_desired_freq"=="r")
    (
      return
    )
    else
    (
      print "Invalid selection."
      goto Set_Clock_Freq_Enter
    )
  )

  if ("&clk"=="gcc_gp2_clk")
  (
    gosub PRINT_SET_CLOCK_FREQ_WARNING

    &clk_cmd_rcgr_addr=&HWIO_GCC_GP2_CMD_RCGR_ADDR
    &clk_cfg_rcgr_addr=&HWIO_GCC_GP2_CFG_RCGR_ADDR

    print "Choose frequency (MHz) from list below: " 

    print "19.2           100.0          200.0          " 

    print ""
    print "Enter desired frequency (r to return): "
    enter &clk_desired_freq
    print ""

    if ("&clk_desired_freq"=="19.2")
    (
      &clk_src_name="XO"
      &clk_src_sel=SRC_SEL TODO.
      &clk_src_div=2.
      &clk_m_val=0.
      &clk_n_val=0.
      &clk_2d_val=0.
      
      gosub Set_Clock_Freq
      return
    )
    else if ("&clk_desired_freq"=="100.0")
    (
      &clk_src_name="GPLL0_OUT_MAIN"
      &clk_src_sel=SRC_SEL TODO.
      &clk_src_div=12.
      &clk_m_val=0.
      &clk_n_val=0.
      &clk_2d_val=0.
      
      gosub Set_Clock_Freq
      return
    )
    else if ("&clk_desired_freq"=="200.0")
    (
      &clk_src_name="GPLL0_OUT_MAIN"
      &clk_src_sel=SRC_SEL TODO.
      &clk_src_div=6.
      &clk_m_val=0.
      &clk_n_val=0.
      &clk_2d_val=0.
      
      gosub Set_Clock_Freq
      return
    )
    else if ("&clk_desired_freq"=="r")
    (
      return
    )
    else
    (
      print "Invalid selection."
      goto Set_Clock_Freq_Enter
    )
  )

  if ("&clk"=="gcc_gp3_clk")
  (
    gosub PRINT_SET_CLOCK_FREQ_WARNING

    &clk_cmd_rcgr_addr=&HWIO_GCC_GP3_CMD_RCGR_ADDR
    &clk_cfg_rcgr_addr=&HWIO_GCC_GP3_CFG_RCGR_ADDR

    print "Choose frequency (MHz) from list below: " 

    print "19.2           100.0          200.0          " 

    print ""
    print "Enter desired frequency (r to return): "
    enter &clk_desired_freq
    print ""

    if ("&clk_desired_freq"=="19.2")
    (
      &clk_src_name="XO"
      &clk_src_sel=SRC_SEL TODO.
      &clk_src_div=2.
      &clk_m_val=0.
      &clk_n_val=0.
      &clk_2d_val=0.
      
      gosub Set_Clock_Freq
      return
    )
    else if ("&clk_desired_freq"=="100.0")
    (
      &clk_src_name="GPLL0_OUT_MAIN"
      &clk_src_sel=SRC_SEL TODO.
      &clk_src_div=12.
      &clk_m_val=0.
      &clk_n_val=0.
      &clk_2d_val=0.
      
      gosub Set_Clock_Freq
      return
    )
    else if ("&clk_desired_freq"=="200.0")
    (
      &clk_src_name="GPLL0_OUT_MAIN"
      &clk_src_sel=SRC_SEL TODO.
      &clk_src_div=6.
      &clk_m_val=0.
      &clk_n_val=0.
      &clk_2d_val=0.
      
      gosub Set_Clock_Freq
      return
    )
    else if ("&clk_desired_freq"=="r")
    (
      return
    )
    else
    (
      print "Invalid selection."
      goto Set_Clock_Freq_Enter
    )
  )

  if ("&clk"=="gcc_hmss_ahb_clk")||("&clk"=="gcc_snoc_bus_timeout0_ahb_clk")||("&clk"=="gcc_sys_noc_hmss_ahb_clk")
  (
    gosub PRINT_SET_CLOCK_FREQ_WARNING

    &clk_cmd_rcgr_addr=&HWIO_GCC_HMSS_AHB_CMD_RCGR_ADDR
    &clk_cfg_rcgr_addr=&HWIO_GCC_HMSS_AHB_CFG_RCGR_ADDR

    print "Choose frequency (MHz) from list below: " 

    print "19.2           37.5           75.0           " 

    print ""
    print "Enter desired frequency (r to return): "
    enter &clk_desired_freq
    print ""

    if ("&clk_desired_freq"=="19.2")
    (
      &clk_src_name="XO"
      &clk_src_sel=SRC_SEL TODO.
      &clk_src_div=2.
      &clk_m_val=0.
      &clk_n_val=0.
      &clk_2d_val=0.
      
      gosub Set_Clock_Freq
      return
    )
    else if ("&clk_desired_freq"=="37.5")
    (
      &clk_src_name="GPLL0_OUT_MAIN"
      &clk_src_sel=SRC_SEL TODO.
      &clk_src_div=32.
      &clk_m_val=0.
      &clk_n_val=0.
      &clk_2d_val=0.
      
      gosub Set_Clock_Freq
      return
    )
    else if ("&clk_desired_freq"=="75.0")
    (
      &clk_src_name="GPLL0_OUT_MAIN"
      &clk_src_sel=SRC_SEL TODO.
      &clk_src_div=16.
      &clk_m_val=0.
      &clk_n_val=0.
      &clk_2d_val=0.
      
      gosub Set_Clock_Freq
      return
    )
    else if ("&clk_desired_freq"=="r")
    (
      return
    )
    else
    (
      print "Invalid selection."
      goto Set_Clock_Freq_Enter
    )
  )

  if ("&clk"=="gcc_hmss_rbcpr_clk")
  (
    gosub PRINT_SET_CLOCK_FREQ_WARNING

    &clk_cmd_rcgr_addr=&HWIO_GCC_HMSS_RBCPR_CMD_RCGR_ADDR
    &clk_cfg_rcgr_addr=&HWIO_GCC_HMSS_RBCPR_CFG_RCGR_ADDR

    print "Choose frequency (MHz) from list below: " 

    print "19.2           " 

    print ""
    print "Enter desired frequency (r to return): "
    enter &clk_desired_freq
    print ""

    if ("&clk_desired_freq"=="19.2")
    (
      &clk_src_name="XO"
      &clk_src_sel=SRC_SEL TODO.
      &clk_src_div=2.
      &clk_m_val=0.
      &clk_n_val=0.
      &clk_2d_val=0.
      
      gosub Set_Clock_Freq
      return
    )
    else if ("&clk_desired_freq"=="r")
    (
      return
    )
    else
    (
      print "Invalid selection."
      goto Set_Clock_Freq_Enter
    )
  )

  if ("&clk"=="gcc_aggre2_noc_ipa_clk")||("&clk"=="gcc_ipa_clk")
  (
    gosub PRINT_SET_CLOCK_FREQ_WARNING

    &clk_cmd_rcgr_addr=&HWIO_GCC_IPA_CMD_RCGR_ADDR
    &clk_cfg_rcgr_addr=&HWIO_GCC_IPA_CFG_RCGR_ADDR

    print "Choose frequency (MHz) from list below: " 

    print "37.5           75.0           150.0          " 

    print ""
    print "Enter desired frequency (r to return): "
    enter &clk_desired_freq
    print ""

    if ("&clk_desired_freq"=="37.5")
    (
      &clk_src_name="GPLL0_OUT_MAIN"
      &clk_src_sel=SRC_SEL TODO.
      &clk_src_div=32.
      &clk_m_val=0.
      &clk_n_val=0.
      &clk_2d_val=0.
      
      gosub Set_Clock_Freq
      return
    )
    else if ("&clk_desired_freq"=="75.0")
    (
      &clk_src_name="GPLL0_OUT_MAIN"
      &clk_src_sel=SRC_SEL TODO.
      &clk_src_div=16.
      &clk_m_val=0.
      &clk_n_val=0.
      &clk_2d_val=0.
      
      gosub Set_Clock_Freq
      return
    )
    else if ("&clk_desired_freq"=="150.0")
    (
      &clk_src_name="GPLL0_OUT_MAIN"
      &clk_src_sel=SRC_SEL TODO.
      &clk_src_div=8.
      &clk_m_val=0.
      &clk_n_val=0.
      &clk_2d_val=0.
      
      gosub Set_Clock_Freq
      return
    )
    else if ("&clk_desired_freq"=="r")
    (
      return
    )
    else
    (
      print "Invalid selection."
      goto Set_Clock_Freq_Enter
    )
  )

  if ("&clk"=="gcc_mss_vs_clk")
  (
    gosub PRINT_SET_CLOCK_FREQ_WARNING

    &clk_cmd_rcgr_addr=&HWIO_GCC_MSS_VS_CMD_RCGR_ADDR
    &clk_cfg_rcgr_addr=&HWIO_GCC_MSS_VS_CFG_RCGR_ADDR

    print "Choose frequency (MHz) from list below: " 

    print "400.0          600.0          " 

    print ""
    print "Enter desired frequency (r to return): "
    enter &clk_desired_freq
    print ""

    if ("&clk_desired_freq"=="400.0")
    (
      &clk_src_name="GPLL0_OUT_MAIN"
      &clk_src_sel=SRC_SEL TODO.
      &clk_src_div=3.
      &clk_m_val=0.
      &clk_n_val=0.
      &clk_2d_val=0.
      
      gosub Set_Clock_Freq
      return
    )
    else if ("&clk_desired_freq"=="600.0")
    (
      &clk_src_name="GPLL0_OUT_MAIN"
      &clk_src_sel=SRC_SEL TODO.
      &clk_src_div=2.
      &clk_m_val=0.
      &clk_n_val=0.
      &clk_2d_val=0.
      
      gosub Set_Clock_Freq
      return
    )
    else if ("&clk_desired_freq"=="r")
    (
      return
    )
    else
    (
      print "Invalid selection."
      goto Set_Clock_Freq_Enter
    )
  )

  if ("&clk"=="gcc_pcie_0_aux_clk")||("&clk"=="gcc_pcie_1_aux_clk")||("&clk"=="gcc_pcie_2_aux_clk")||("&clk"=="gcc_pcie_phy_aux_clk")
  (
    gosub PRINT_SET_CLOCK_FREQ_WARNING

    &clk_cmd_rcgr_addr=&HWIO_GCC_PCIE_AUX_CMD_RCGR_ADDR
    &clk_cfg_rcgr_addr=&HWIO_GCC_PCIE_AUX_CFG_RCGR_ADDR

    print "Choose frequency (MHz) from list below: " 

    print "1.010526       " 

    print ""
    print "Enter desired frequency (r to return): "
    enter &clk_desired_freq
    print ""

    if ("&clk_desired_freq"=="1.010526")
    (
      &clk_src_name="XO"
      &clk_src_sel=SRC_SEL TODO.
      &clk_src_div=2.
      &clk_m_val=1.
      &clk_n_val=19.
      &clk_2d_val=19.
      
      gosub Set_Clock_Freq
      return
    )
    else if ("&clk_desired_freq"=="r")
    (
      return
    )
    else
    (
      print "Invalid selection."
      goto Set_Clock_Freq_Enter
    )
  )

  if ("&clk"=="gcc_pdm2_clk")
  (
    gosub PRINT_SET_CLOCK_FREQ_WARNING

    &clk_cmd_rcgr_addr=&HWIO_GCC_PDM2_CMD_RCGR_ADDR
    &clk_cfg_rcgr_addr=&HWIO_GCC_PDM2_CFG_RCGR_ADDR

    print "Choose frequency (MHz) from list below: " 

    print "60.0           " 

    print ""
    print "Enter desired frequency (r to return): "
    enter &clk_desired_freq
    print ""

    if ("&clk_desired_freq"=="60.0")
    (
      &clk_src_name="GPLL0_OUT_MAIN"
      &clk_src_sel=SRC_SEL TODO.
      &clk_src_div=20.
      &clk_m_val=0.
      &clk_n_val=0.
      &clk_2d_val=0.
      
      gosub Set_Clock_Freq
      return
    )
    else if ("&clk_desired_freq"=="r")
    (
      return
    )
    else
    (
      print "Invalid selection."
      goto Set_Clock_Freq_Enter
    )
  )

  if ("&clk"=="gcc_aggre1_pnoc_ahb_clk")||("&clk"=="gcc_blsp1_ahb_clk")||("&clk"=="gcc_blsp2_ahb_clk")||("&clk"=="gcc_pdm_ahb_clk")||("&clk"=="gcc_periph_noc_ahb_clk")||("&clk"=="gcc_periph_noc_mpu_cfg_ahb_clk")||("&clk"=="gcc_pnoc_bus_timeout1_ahb_clk")||("&clk"=="gcc_pnoc_bus_timeout2_ahb_clk")||("&clk"=="gcc_pnoc_bus_timeout3_ahb_clk")||("&clk"=="gcc_pnoc_bus_timeout4_ahb_clk")||("&clk"=="gcc_sdcc1_ahb_clk")||("&clk"=="gcc_sdcc2_ahb_clk")||("&clk"=="gcc_sdcc3_ahb_clk")||("&clk"=="gcc_sdcc4_ahb_clk")||("&clk"=="gcc_snoc_pnoc_ahb_clk")||("&clk"=="gcc_spdm_pnoc_cy_clk")||("&clk"=="gcc_tsif_ahb_clk")||("&clk"=="gcc_usb_phy_cfg_ahb2phy_clk")||("&clk"=="gcc_qspi_ahb_clk")
  (
    gosub PRINT_SET_CLOCK_FREQ_WARNING

    &clk_cmd_rcgr_addr=&HWIO_GCC_PERIPH_NOC_CMD_RCGR_ADDR
    &clk_cfg_rcgr_addr=&HWIO_GCC_PERIPH_NOC_CFG_RCGR_ADDR

    print "Choose frequency (MHz) from list below: " 

    print "19.2           37.5           50.0           " 
    print "75.0           100.0          " 

    print ""
    print "Enter desired frequency (r to return): "
    enter &clk_desired_freq
    print ""

    if ("&clk_desired_freq"=="19.2")
    (
      &clk_src_name="XO"
      &clk_src_sel=SRC_SEL TODO.
      &clk_src_div=2.
      &clk_m_val=0.
      &clk_n_val=0.
      &clk_2d_val=0.
      
      gosub Set_Clock_Freq
      return
    )
    else if ("&clk_desired_freq"=="37.5")
    (
      &clk_src_name="GPLL0_OUT_MAIN"
      &clk_src_sel=SRC_SEL TODO.
      &clk_src_div=32.
      &clk_m_val=0.
      &clk_n_val=0.
      &clk_2d_val=0.
      
      gosub Set_Clock_Freq
      return
    )
    else if ("&clk_desired_freq"=="50.0")
    (
      &clk_src_name="GPLL0_OUT_MAIN"
      &clk_src_sel=SRC_SEL TODO.
      &clk_src_div=24.
      &clk_m_val=0.
      &clk_n_val=0.
      &clk_2d_val=0.
      
      gosub Set_Clock_Freq
      return
    )
    else if ("&clk_desired_freq"=="75.0")
    (
      &clk_src_name="GPLL0_OUT_MAIN"
      &clk_src_sel=SRC_SEL TODO.
      &clk_src_div=16.
      &clk_m_val=0.
      &clk_n_val=0.
      &clk_2d_val=0.
      
      gosub Set_Clock_Freq
      return
    )
    else if ("&clk_desired_freq"=="100.0")
    (
      &clk_src_name="GPLL0_OUT_MAIN"
      &clk_src_sel=SRC_SEL TODO.
      &clk_src_div=12.
      &clk_m_val=0.
      &clk_n_val=0.
      &clk_2d_val=0.
      
      gosub Set_Clock_Freq
      return
    )
    else if ("&clk_desired_freq"=="r")
    (
      return
    )
    else
    (
      print "Invalid selection."
      goto Set_Clock_Freq_Enter
    )
  )

  if ("&clk"=="gcc_bimc_pimem_axi_clk")||("&clk"=="gcc_pimem_axi_clk")||("&clk"=="gcc_sys_noc_pimem_axi_clk")
  (
    gosub PRINT_SET_CLOCK_FREQ_WARNING

    &clk_cmd_rcgr_addr=&HWIO_GCC_PIMEM_AXI_CMD_RCGR_ADDR
    &clk_cfg_rcgr_addr=&HWIO_GCC_PIMEM_AXI_CFG_RCGR_ADDR

    print "Choose frequency (MHz) from list below: " 

    print "19.2           50.0           100.0          " 
    print "150.0          200.0          240.0          " 

    print ""
    print "Enter desired frequency (r to return): "
    enter &clk_desired_freq
    print ""

    if ("&clk_desired_freq"=="19.2")
    (
      &clk_src_name="XO"
      &clk_src_sel=SRC_SEL TODO.
      &clk_src_div=2.
      &clk_m_val=0.
      &clk_n_val=0.
      &clk_2d_val=0.
      
      gosub Set_Clock_Freq
      return
    )
    else if ("&clk_desired_freq"=="50.0")
    (
      &clk_src_name="PLL0_EARLY_DIV_CLK_SRC"
      &clk_src_sel=SRC_SEL TODO.
      &clk_src_div=12.
      &clk_m_val=0.
      &clk_n_val=0.
      &clk_2d_val=0.
      
      gosub Set_Clock_Freq
      return
    )
    else if ("&clk_desired_freq"=="100.0")
    (
      &clk_src_name="GPLL0_OUT_MAIN"
      &clk_src_sel=SRC_SEL TODO.
      &clk_src_div=12.
      &clk_m_val=0.
      &clk_n_val=0.
      &clk_2d_val=0.
      
      gosub Set_Clock_Freq
      return
    )
    else if ("&clk_desired_freq"=="150.0")
    (
      &clk_src_name="GPLL0_OUT_MAIN"
      &clk_src_sel=SRC_SEL TODO.
      &clk_src_div=8.
      &clk_m_val=0.
      &clk_n_val=0.
      &clk_2d_val=0.
      
      gosub Set_Clock_Freq
      return
    )
    else if ("&clk_desired_freq"=="200.0")
    (
      &clk_src_name="GPLL0_OUT_MAIN"
      &clk_src_sel=SRC_SEL TODO.
      &clk_src_div=6.
      &clk_m_val=0.
      &clk_n_val=0.
      &clk_2d_val=0.
      
      gosub Set_Clock_Freq
      return
    )
    else if ("&clk_desired_freq"=="240.0")
    (
      &clk_src_name="GPLL0_OUT_MAIN"
      &clk_src_sel=SRC_SEL TODO.
      &clk_src_div=5.
      &clk_m_val=0.
      &clk_n_val=0.
      &clk_2d_val=0.
      
      gosub Set_Clock_Freq
      return
    )
    else if ("&clk_desired_freq"=="r")
    (
      return
    )
    else
    (
      print "Invalid selection."
      goto Set_Clock_Freq_Enter
    )
  )

  if ("&clk"=="gcc_aggre0_noc_at_clk")||("&clk"=="gcc_aggre1_noc_at_clk")||("&clk"=="gcc_aggre2_noc_at_clk")||("&clk"=="gcc_mmss_noc_at_clk")||("&clk"=="gcc_periph_noc_at_clk")||("&clk"=="gcc_qdss_at_clk")||("&clk"=="gcc_ssc_at_clk")||("&clk"=="gcc_sys_noc_at_clk")
  (
    gosub PRINT_SET_CLOCK_FREQ_WARNING

    &clk_cmd_rcgr_addr=&HWIO_GCC_QDSS_AT_CMD_RCGR_ADDR
    &clk_cfg_rcgr_addr=&HWIO_GCC_QDSS_AT_CFG_RCGR_ADDR

    print "Choose frequency (MHz) from list below: " 

    print "60.0           120.0          200.0          " 
    print "240.0          " 

    print ""
    print "Enter desired frequency (r to return): "
    enter &clk_desired_freq
    print ""

    if ("&clk_desired_freq"=="60.0")
    (
      &clk_src_name="PLL0_EARLY_DIV_CLK_SRC"
      &clk_src_sel=SRC_SEL TODO.
      &clk_src_div=10.
      &clk_m_val=0.
      &clk_n_val=0.
      &clk_2d_val=0.
      
      gosub Set_Clock_Freq
      return
    )
    else if ("&clk_desired_freq"=="120.0")
    (
      &clk_src_name="GPLL0_OUT_MAIN"
      &clk_src_sel=SRC_SEL TODO.
      &clk_src_div=10.
      &clk_m_val=0.
      &clk_n_val=0.
      &clk_2d_val=0.
      
      gosub Set_Clock_Freq
      return
    )
    else if ("&clk_desired_freq"=="200.0")
    (
      &clk_src_name="GPLL0_OUT_MAIN"
      &clk_src_sel=SRC_SEL TODO.
      &clk_src_div=6.
      &clk_m_val=0.
      &clk_n_val=0.
      &clk_2d_val=0.
      
      gosub Set_Clock_Freq
      return
    )
    else if ("&clk_desired_freq"=="240.0")
    (
      &clk_src_name="GPLL0_OUT_MAIN"
      &clk_src_sel=SRC_SEL TODO.
      &clk_src_div=5.
      &clk_m_val=0.
      &clk_n_val=0.
      &clk_2d_val=0.
      
      gosub Set_Clock_Freq
      return
    )
    else if ("&clk_desired_freq"=="r")
    (
      return
    )
    else
    (
      print "Invalid selection."
      goto Set_Clock_Freq_Enter
    )
  )

  if ("&clk"=="gcc_qdss_stm_clk")||("&clk"=="gcc_sys_noc_qdss_stm_axi_clk")
  (
    gosub PRINT_SET_CLOCK_FREQ_WARNING

    &clk_cmd_rcgr_addr=&HWIO_GCC_QDSS_STM_CMD_RCGR_ADDR
    &clk_cfg_rcgr_addr=&HWIO_GCC_QDSS_STM_CFG_RCGR_ADDR

    print "Choose frequency (MHz) from list below: " 

    print "50.0           100.0          200.0          " 

    print ""
    print "Enter desired frequency (r to return): "
    enter &clk_desired_freq
    print ""

    if ("&clk_desired_freq"=="50.0")
    (
      &clk_src_name="PLL0_EARLY_DIV_CLK_SRC"
      &clk_src_sel=SRC_SEL TODO.
      &clk_src_div=12.
      &clk_m_val=0.
      &clk_n_val=0.
      &clk_2d_val=0.
      
      gosub Set_Clock_Freq
      return
    )
    else if ("&clk_desired_freq"=="100.0")
    (
      &clk_src_name="GPLL0_OUT_MAIN"
      &clk_src_sel=SRC_SEL TODO.
      &clk_src_div=12.
      &clk_m_val=0.
      &clk_n_val=0.
      &clk_2d_val=0.
      
      gosub Set_Clock_Freq
      return
    )
    else if ("&clk_desired_freq"=="200.0")
    (
      &clk_src_name="GPLL0_OUT_MAIN"
      &clk_src_sel=SRC_SEL TODO.
      &clk_src_div=6.
      &clk_m_val=0.
      &clk_n_val=0.
      &clk_2d_val=0.
      
      gosub Set_Clock_Freq
      return
    )
    else if ("&clk_desired_freq"=="r")
    (
      return
    )
    else
    (
      print "Invalid selection."
      goto Set_Clock_Freq_Enter
    )
  )

  if ("&clk"=="gcc_qdss_traceclkin_clk")
  (
    gosub PRINT_SET_CLOCK_FREQ_WARNING

    &clk_cmd_rcgr_addr=&HWIO_GCC_QDSS_TRACECLKIN_CMD_RCGR_ADDR
    &clk_cfg_rcgr_addr=&HWIO_GCC_QDSS_TRACECLKIN_CFG_RCGR_ADDR

    print "Choose frequency (MHz) from list below: " 

    print "75.0           150.0          300.0          " 

    print ""
    print "Enter desired frequency (r to return): "
    enter &clk_desired_freq
    print ""

    if ("&clk_desired_freq"=="75.0")
    (
      &clk_src_name="PLL0_EARLY_DIV_CLK_SRC"
      &clk_src_sel=SRC_SEL TODO.
      &clk_src_div=8.
      &clk_m_val=0.
      &clk_n_val=0.
      &clk_2d_val=0.
      
      gosub Set_Clock_Freq
      return
    )
    else if ("&clk_desired_freq"=="150.0")
    (
      &clk_src_name="GPLL0_OUT_MAIN"
      &clk_src_sel=SRC_SEL TODO.
      &clk_src_div=8.
      &clk_m_val=0.
      &clk_n_val=0.
      &clk_2d_val=0.
      
      gosub Set_Clock_Freq
      return
    )
    else if ("&clk_desired_freq"=="300.0")
    (
      &clk_src_name="GPLL0_OUT_MAIN"
      &clk_src_sel=SRC_SEL TODO.
      &clk_src_div=4.
      &clk_m_val=0.
      &clk_n_val=0.
      &clk_2d_val=0.
      
      gosub Set_Clock_Freq
      return
    )
    else if ("&clk_desired_freq"=="r")
    (
      return
    )
    else
    (
      print "Invalid selection."
      goto Set_Clock_Freq_Enter
    )
  )

  if ("&clk"=="gcc_qdss_apb2jtag_clk")||("&clk"=="gcc_qdss_dap_clk")||("&clk"=="gcc_qdss_tsctr_div16_clk")||("&clk"=="gcc_qdss_tsctr_div2_clk")||("&clk"=="gcc_qdss_tsctr_div3_clk")||("&clk"=="gcc_qdss_tsctr_div4_clk")||("&clk"=="gcc_qdss_tsctr_div8_clk")||("&clk"=="gcc_ssc_apb_clk")
  (
    gosub PRINT_SET_CLOCK_FREQ_WARNING

    &clk_cmd_rcgr_addr=&HWIO_GCC_QDSS_TSCTR_CMD_RCGR_ADDR
    &clk_cfg_rcgr_addr=&HWIO_GCC_QDSS_TSCTR_CFG_RCGR_ADDR

    print "Choose frequency (MHz) from list below: " 

    print "150.0          300.0          400.0          " 
    print "600.0          " 

    print ""
    print "Enter desired frequency (r to return): "
    enter &clk_desired_freq
    print ""

    if ("&clk_desired_freq"=="150.0")
    (
      &clk_src_name="PLL0_EARLY_DIV_CLK_SRC"
      &clk_src_sel=SRC_SEL TODO.
      &clk_src_div=4.
      &clk_m_val=0.
      &clk_n_val=0.
      &clk_2d_val=0.
      
      gosub Set_Clock_Freq
      return
    )
    else if ("&clk_desired_freq"=="300.0")
    (
      &clk_src_name="GPLL0_OUT_MAIN"
      &clk_src_sel=SRC_SEL TODO.
      &clk_src_div=4.
      &clk_m_val=0.
      &clk_n_val=0.
      &clk_2d_val=0.
      
      gosub Set_Clock_Freq
      return
    )
    else if ("&clk_desired_freq"=="400.0")
    (
      &clk_src_name="GPLL0_OUT_MAIN"
      &clk_src_sel=SRC_SEL TODO.
      &clk_src_div=3.
      &clk_m_val=0.
      &clk_n_val=0.
      &clk_2d_val=0.
      
      gosub Set_Clock_Freq
      return
    )
    else if ("&clk_desired_freq"=="600.0")
    (
      &clk_src_name="GPLL0_OUT_MAIN"
      &clk_src_sel=SRC_SEL TODO.
      &clk_src_div=2.
      &clk_m_val=0.
      &clk_n_val=0.
      &clk_2d_val=0.
      
      gosub Set_Clock_Freq
      return
    )
    else if ("&clk_desired_freq"=="r")
    (
      return
    )
    else
    (
      print "Invalid selection."
      goto Set_Clock_Freq_Enter
    )
  )

  if ("&clk"=="gcc_rbcpr_cx_clk")
  (
    gosub PRINT_SET_CLOCK_FREQ_WARNING

    &clk_cmd_rcgr_addr=&HWIO_GCC_RBCPR_CX_CMD_RCGR_ADDR
    &clk_cfg_rcgr_addr=&HWIO_GCC_RBCPR_CX_CFG_RCGR_ADDR

    print "Choose frequency (MHz) from list below: " 

    print "19.2           " 

    print ""
    print "Enter desired frequency (r to return): "
    enter &clk_desired_freq
    print ""

    if ("&clk_desired_freq"=="19.2")
    (
      &clk_src_name="XO"
      &clk_src_sel=SRC_SEL TODO.
      &clk_src_div=2.
      &clk_m_val=0.
      &clk_n_val=0.
      &clk_2d_val=0.
      
      gosub Set_Clock_Freq
      return
    )
    else if ("&clk_desired_freq"=="r")
    (
      return
    )
    else
    (
      print "Invalid selection."
      goto Set_Clock_Freq_Enter
    )
  )

  if ("&clk"=="gcc_rbcpr_mx_clk")
  (
    gosub PRINT_SET_CLOCK_FREQ_WARNING

    &clk_cmd_rcgr_addr=&HWIO_GCC_RBCPR_MX_CMD_RCGR_ADDR
    &clk_cfg_rcgr_addr=&HWIO_GCC_RBCPR_MX_CFG_RCGR_ADDR

    print "Choose frequency (MHz) from list below: " 

    print "19.2           " 

    print ""
    print "Enter desired frequency (r to return): "
    enter &clk_desired_freq
    print ""

    if ("&clk_desired_freq"=="19.2")
    (
      &clk_src_name="XO"
      &clk_src_sel=SRC_SEL TODO.
      &clk_src_div=2.
      &clk_m_val=0.
      &clk_n_val=0.
      &clk_2d_val=0.
      
      gosub Set_Clock_Freq
      return
    )
    else if ("&clk_desired_freq"=="r")
    (
      return
    )
    else
    (
      print "Invalid selection."
      goto Set_Clock_Freq_Enter
    )
  )

  if ("&clk"=="gcc_rpm_bus_ahb_clk")||("&clk"=="gcc_rpm_proc_fclk")||("&clk"=="gcc_rpm_proc_hclk")||("&clk"=="gcc_spdm_rpm_cy_clk")
  (
    gosub PRINT_SET_CLOCK_FREQ_WARNING

    &clk_cmd_rcgr_addr=&HWIO_GCC_RPM_CMD_RCGR_ADDR
    &clk_cfg_rcgr_addr=&HWIO_GCC_RPM_CFG_RCGR_ADDR

    print "Choose frequency (MHz) from list below: " 

    print "19.2           300.0          400.0          " 
    print "600.0          " 

    print ""
    print "Enter desired frequency (r to return): "
    enter &clk_desired_freq
    print ""

    if ("&clk_desired_freq"=="19.2")
    (
      &clk_src_name="XO"
      &clk_src_sel=SRC_SEL TODO.
      &clk_src_div=2.
      &clk_m_val=0.
      &clk_n_val=0.
      &clk_2d_val=0.
      
      gosub Set_Clock_Freq
      return
    )
    else if ("&clk_desired_freq"=="300.0")
    (
      &clk_src_name="PLL0_EARLY_DIV_CLK_SRC"
      &clk_src_sel=SRC_SEL TODO.
      &clk_src_div=2.
      &clk_m_val=0.
      &clk_n_val=0.
      &clk_2d_val=0.
      
      gosub Set_Clock_Freq
      return
    )
    else if ("&clk_desired_freq"=="400.0")
    (
      &clk_src_name="GPLL0_OUT_MAIN"
      &clk_src_sel=SRC_SEL TODO.
      &clk_src_div=3.
      &clk_m_val=0.
      &clk_n_val=0.
      &clk_2d_val=0.
      
      gosub Set_Clock_Freq
      return
    )
    else if ("&clk_desired_freq"=="600.0")
    (
      &clk_src_name="GPLL0_OUT_MAIN"
      &clk_src_sel=SRC_SEL TODO.
      &clk_src_div=2.
      &clk_m_val=0.
      &clk_n_val=0.
      &clk_2d_val=0.
      
      gosub Set_Clock_Freq
      return
    )
    else if ("&clk_desired_freq"=="r")
    (
      return
    )
    else
    (
      print "Invalid selection."
      goto Set_Clock_Freq_Enter
    )
  )

  if ("&clk"=="gcc_sdcc1_apps_clk")
  (
    gosub PRINT_SET_CLOCK_FREQ_WARNING

    &clk_cmd_rcgr_addr=&HWIO_GCC_SDCC1_APPS_CMD_RCGR_ADDR
    &clk_cfg_rcgr_addr=&HWIO_GCC_SDCC1_APPS_CFG_RCGR_ADDR

    print "Choose frequency (MHz) from list below: " 

    print "0.144          0.4            20.0           " 
    print "25.0           50.0           96.0           " 
    print "96.0           192.0          192.0          " 
    print "384.0          " 

    print ""
    print "Enter desired frequency (r to return): "
    enter &clk_desired_freq
    print ""

    if ("&clk_desired_freq"=="0.144")
    (
      &clk_src_name="XO"
      &clk_src_sel=SRC_SEL TODO.
      &clk_src_div=32.
      &clk_m_val=3.
      &clk_n_val=25.
      &clk_2d_val=25.
      
      gosub Set_Clock_Freq
      return
    )
    else if ("&clk_desired_freq"=="0.4")
    (
      &clk_src_name="XO"
      &clk_src_sel=SRC_SEL TODO.
      &clk_src_div=24.
      &clk_m_val=1.
      &clk_n_val=4.
      &clk_2d_val=4.
      
      gosub Set_Clock_Freq
      return
    )
    else if ("&clk_desired_freq"=="20.0")
    (
      &clk_src_name="GPLL0_OUT_MAIN"
      &clk_src_sel=SRC_SEL TODO.
      &clk_src_div=30.
      &clk_m_val=1.
      &clk_n_val=2.
      &clk_2d_val=2.
      
      gosub Set_Clock_Freq
      return
    )
    else if ("&clk_desired_freq"=="25.0")
    (
      &clk_src_name="GPLL0_OUT_MAIN"
      &clk_src_sel=SRC_SEL TODO.
      &clk_src_div=24.
      &clk_m_val=1.
      &clk_n_val=2.
      &clk_2d_val=2.
      
      gosub Set_Clock_Freq
      return
    )
    else if ("&clk_desired_freq"=="50.0")
    (
      &clk_src_name="GPLL0_OUT_MAIN"
      &clk_src_sel=SRC_SEL TODO.
      &clk_src_div=24.
      &clk_m_val=0.
      &clk_n_val=0.
      &clk_2d_val=0.
      
      gosub Set_Clock_Freq
      return
    )
    else if ("&clk_desired_freq"=="96.0")
    (
      &clk_src_name="GPLL4_OUT_MAIN"
      &clk_src_sel=SRC_SEL TODO.
      &clk_src_div=8.
      &clk_m_val=0.
      &clk_n_val=0.
      &clk_2d_val=0.
      
      gosub Set_Clock_Freq
      return
    )
    else if ("&clk_desired_freq"=="96.0")
    (
      &clk_src_name="GPLL4_OUT_MAIN"
      &clk_src_sel=SRC_SEL TODO.
      &clk_src_div=8.
      &clk_m_val=0.
      &clk_n_val=0.
      &clk_2d_val=0.
      
      gosub Set_Clock_Freq
      return
    )
    else if ("&clk_desired_freq"=="192.0")
    (
      &clk_src_name="GPLL4_OUT_MAIN"
      &clk_src_sel=SRC_SEL TODO.
      &clk_src_div=4.
      &clk_m_val=0.
      &clk_n_val=0.
      &clk_2d_val=0.
      
      gosub Set_Clock_Freq
      return
    )
    else if ("&clk_desired_freq"=="192.0")
    (
      &clk_src_name="GPLL4_OUT_MAIN"
      &clk_src_sel=SRC_SEL TODO.
      &clk_src_div=4.
      &clk_m_val=0.
      &clk_n_val=0.
      &clk_2d_val=0.
      
      gosub Set_Clock_Freq
      return
    )
    else if ("&clk_desired_freq"=="384.0")
    (
      &clk_src_name="GPLL4_OUT_MAIN"
      &clk_src_sel=SRC_SEL TODO.
      &clk_src_div=2.
      &clk_m_val=0.
      &clk_n_val=0.
      &clk_2d_val=0.
      
      gosub Set_Clock_Freq
      return
    )
    else if ("&clk_desired_freq"=="r")
    (
      return
    )
    else
    (
      print "Invalid selection."
      goto Set_Clock_Freq_Enter
    )
  )

  if ("&clk"=="gcc_sdcc2_apps_clk")
  (
    gosub PRINT_SET_CLOCK_FREQ_WARNING

    &clk_cmd_rcgr_addr=&HWIO_GCC_SDCC2_APPS_CMD_RCGR_ADDR
    &clk_cfg_rcgr_addr=&HWIO_GCC_SDCC2_APPS_CFG_RCGR_ADDR

    print "Choose frequency (MHz) from list below: " 

    print "0.144          0.4            20.0           " 
    print "25.0           50.0           100.0          " 
    print "100.0          200.0          " 

    print ""
    print "Enter desired frequency (r to return): "
    enter &clk_desired_freq
    print ""

    if ("&clk_desired_freq"=="0.144")
    (
      &clk_src_name="XO"
      &clk_src_sel=SRC_SEL TODO.
      &clk_src_div=32.
      &clk_m_val=3.
      &clk_n_val=25.
      &clk_2d_val=25.
      
      gosub Set_Clock_Freq
      return
    )
    else if ("&clk_desired_freq"=="0.4")
    (
      &clk_src_name="XO"
      &clk_src_sel=SRC_SEL TODO.
      &clk_src_div=24.
      &clk_m_val=1.
      &clk_n_val=4.
      &clk_2d_val=4.
      
      gosub Set_Clock_Freq
      return
    )
    else if ("&clk_desired_freq"=="20.0")
    (
      &clk_src_name="GPLL0_OUT_MAIN"
      &clk_src_sel=SRC_SEL TODO.
      &clk_src_div=30.
      &clk_m_val=1.
      &clk_n_val=2.
      &clk_2d_val=2.
      
      gosub Set_Clock_Freq
      return
    )
    else if ("&clk_desired_freq"=="25.0")
    (
      &clk_src_name="GPLL0_OUT_MAIN"
      &clk_src_sel=SRC_SEL TODO.
      &clk_src_div=24.
      &clk_m_val=1.
      &clk_n_val=2.
      &clk_2d_val=2.
      
      gosub Set_Clock_Freq
      return
    )
    else if ("&clk_desired_freq"=="50.0")
    (
      &clk_src_name="GPLL0_OUT_MAIN"
      &clk_src_sel=SRC_SEL TODO.
      &clk_src_div=24.
      &clk_m_val=0.
      &clk_n_val=0.
      &clk_2d_val=0.
      
      gosub Set_Clock_Freq
      return
    )
    else if ("&clk_desired_freq"=="100.0")
    (
      &clk_src_name="GPLL0_OUT_MAIN"
      &clk_src_sel=SRC_SEL TODO.
      &clk_src_div=12.
      &clk_m_val=0.
      &clk_n_val=0.
      &clk_2d_val=0.
      
      gosub Set_Clock_Freq
      return
    )
    else if ("&clk_desired_freq"=="100.0")
    (
      &clk_src_name="GPLL0_OUT_MAIN"
      &clk_src_sel=SRC_SEL TODO.
      &clk_src_div=12.
      &clk_m_val=0.
      &clk_n_val=0.
      &clk_2d_val=0.
      
      gosub Set_Clock_Freq
      return
    )
    else if ("&clk_desired_freq"=="200.0")
    (
      &clk_src_name="GPLL0_OUT_MAIN"
      &clk_src_sel=SRC_SEL TODO.
      &clk_src_div=6.
      &clk_m_val=0.
      &clk_n_val=0.
      &clk_2d_val=0.
      
      gosub Set_Clock_Freq
      return
    )
    else if ("&clk_desired_freq"=="r")
    (
      return
    )
    else
    (
      print "Invalid selection."
      goto Set_Clock_Freq_Enter
    )
  )

  if ("&clk"=="gcc_sdcc3_apps_clk")
  (
    gosub PRINT_SET_CLOCK_FREQ_WARNING

    &clk_cmd_rcgr_addr=&HWIO_GCC_SDCC3_APPS_CMD_RCGR_ADDR
    &clk_cfg_rcgr_addr=&HWIO_GCC_SDCC3_APPS_CFG_RCGR_ADDR

    print "Choose frequency (MHz) from list below: " 

    print "0.144          0.4            20.0           " 
    print "25.0           50.0           100.0          " 
    print "100.0          200.0          " 

    print ""
    print "Enter desired frequency (r to return): "
    enter &clk_desired_freq
    print ""

    if ("&clk_desired_freq"=="0.144")
    (
      &clk_src_name="XO"
      &clk_src_sel=SRC_SEL TODO.
      &clk_src_div=32.
      &clk_m_val=3.
      &clk_n_val=25.
      &clk_2d_val=25.
      
      gosub Set_Clock_Freq
      return
    )
    else if ("&clk_desired_freq"=="0.4")
    (
      &clk_src_name="XO"
      &clk_src_sel=SRC_SEL TODO.
      &clk_src_div=24.
      &clk_m_val=1.
      &clk_n_val=4.
      &clk_2d_val=4.
      
      gosub Set_Clock_Freq
      return
    )
    else if ("&clk_desired_freq"=="20.0")
    (
      &clk_src_name="GPLL0_OUT_MAIN"
      &clk_src_sel=SRC_SEL TODO.
      &clk_src_div=30.
      &clk_m_val=1.
      &clk_n_val=2.
      &clk_2d_val=2.
      
      gosub Set_Clock_Freq
      return
    )
    else if ("&clk_desired_freq"=="25.0")
    (
      &clk_src_name="GPLL0_OUT_MAIN"
      &clk_src_sel=SRC_SEL TODO.
      &clk_src_div=24.
      &clk_m_val=1.
      &clk_n_val=2.
      &clk_2d_val=2.
      
      gosub Set_Clock_Freq
      return
    )
    else if ("&clk_desired_freq"=="50.0")
    (
      &clk_src_name="GPLL0_OUT_MAIN"
      &clk_src_sel=SRC_SEL TODO.
      &clk_src_div=24.
      &clk_m_val=0.
      &clk_n_val=0.
      &clk_2d_val=0.
      
      gosub Set_Clock_Freq
      return
    )
    else if ("&clk_desired_freq"=="100.0")
    (
      &clk_src_name="GPLL0_OUT_MAIN"
      &clk_src_sel=SRC_SEL TODO.
      &clk_src_div=12.
      &clk_m_val=0.
      &clk_n_val=0.
      &clk_2d_val=0.
      
      gosub Set_Clock_Freq
      return
    )
    else if ("&clk_desired_freq"=="100.0")
    (
      &clk_src_name="GPLL0_OUT_MAIN"
      &clk_src_sel=SRC_SEL TODO.
      &clk_src_div=12.
      &clk_m_val=0.
      &clk_n_val=0.
      &clk_2d_val=0.
      
      gosub Set_Clock_Freq
      return
    )
    else if ("&clk_desired_freq"=="200.0")
    (
      &clk_src_name="GPLL0_OUT_MAIN"
      &clk_src_sel=SRC_SEL TODO.
      &clk_src_div=6.
      &clk_m_val=0.
      &clk_n_val=0.
      &clk_2d_val=0.
      
      gosub Set_Clock_Freq
      return
    )
    else if ("&clk_desired_freq"=="r")
    (
      return
    )
    else
    (
      print "Invalid selection."
      goto Set_Clock_Freq_Enter
    )
  )

  if ("&clk"=="gcc_sdcc4_apps_clk")
  (
    gosub PRINT_SET_CLOCK_FREQ_WARNING

    &clk_cmd_rcgr_addr=&HWIO_GCC_SDCC4_APPS_CMD_RCGR_ADDR
    &clk_cfg_rcgr_addr=&HWIO_GCC_SDCC4_APPS_CFG_RCGR_ADDR

    print "Choose frequency (MHz) from list below: " 

    print "0.144          0.4            20.0           " 
    print "25.0           50.0           100.0          " 

    print ""
    print "Enter desired frequency (r to return): "
    enter &clk_desired_freq
    print ""

    if ("&clk_desired_freq"=="0.144")
    (
      &clk_src_name="XO"
      &clk_src_sel=SRC_SEL TODO.
      &clk_src_div=32.
      &clk_m_val=3.
      &clk_n_val=25.
      &clk_2d_val=25.
      
      gosub Set_Clock_Freq
      return
    )
    else if ("&clk_desired_freq"=="0.4")
    (
      &clk_src_name="XO"
      &clk_src_sel=SRC_SEL TODO.
      &clk_src_div=24.
      &clk_m_val=1.
      &clk_n_val=4.
      &clk_2d_val=4.
      
      gosub Set_Clock_Freq
      return
    )
    else if ("&clk_desired_freq"=="20.0")
    (
      &clk_src_name="GPLL0_OUT_MAIN"
      &clk_src_sel=SRC_SEL TODO.
      &clk_src_div=30.
      &clk_m_val=1.
      &clk_n_val=2.
      &clk_2d_val=2.
      
      gosub Set_Clock_Freq
      return
    )
    else if ("&clk_desired_freq"=="25.0")
    (
      &clk_src_name="GPLL0_OUT_MAIN"
      &clk_src_sel=SRC_SEL TODO.
      &clk_src_div=24.
      &clk_m_val=1.
      &clk_n_val=2.
      &clk_2d_val=2.
      
      gosub Set_Clock_Freq
      return
    )
    else if ("&clk_desired_freq"=="50.0")
    (
      &clk_src_name="GPLL0_OUT_MAIN"
      &clk_src_sel=SRC_SEL TODO.
      &clk_src_div=24.
      &clk_m_val=0.
      &clk_n_val=0.
      &clk_2d_val=0.
      
      gosub Set_Clock_Freq
      return
    )
    else if ("&clk_desired_freq"=="100.0")
    (
      &clk_src_name="GPLL0_OUT_MAIN"
      &clk_src_sel=SRC_SEL TODO.
      &clk_src_div=12.
      &clk_m_val=0.
      &clk_n_val=0.
      &clk_2d_val=0.
      
      gosub Set_Clock_Freq
      return
    )
    else if ("&clk_desired_freq"=="r")
    (
      return
    )
    else
    (
      print "Invalid selection."
      goto Set_Clock_Freq_Enter
    )
  )

  if ("&clk"=="gcc_spmi_ahb_clk")
  (
    gosub PRINT_SET_CLOCK_FREQ_WARNING

    &clk_cmd_rcgr_addr=&HWIO_GCC_SPMI_AHB_CMD_RCGR_ADDR
    &clk_cfg_rcgr_addr=&HWIO_GCC_SPMI_AHB_CFG_RCGR_ADDR

    print "Choose frequency (MHz) from list below: " 

    print "37.5           " 

    print ""
    print "Enter desired frequency (r to return): "
    enter &clk_desired_freq
    print ""

    if ("&clk_desired_freq"=="37.5")
    (
      &clk_src_name="GPLL0_OUT_MAIN"
      &clk_src_sel=SRC_SEL TODO.
      &clk_src_div=32.
      &clk_m_val=0.
      &clk_n_val=0.
      &clk_2d_val=0.
      
      gosub Set_Clock_Freq
      return
    )
    else if ("&clk_desired_freq"=="r")
    (
      return
    )
    else
    (
      print "Invalid selection."
      goto Set_Clock_Freq_Enter
    )
  )

  if ("&clk"=="gcc_spmi_ser_clk")
  (
    gosub PRINT_SET_CLOCK_FREQ_WARNING

    &clk_cmd_rcgr_addr=&HWIO_GCC_SPMI_SER_CMD_RCGR_ADDR
    &clk_cfg_rcgr_addr=&HWIO_GCC_SPMI_SER_CFG_RCGR_ADDR

    print "Choose frequency (MHz) from list below: " 

    print "19.2           " 

    print ""
    print "Enter desired frequency (r to return): "
    enter &clk_desired_freq
    print ""

    if ("&clk_desired_freq"=="19.2")
    (
      &clk_src_name="XO"
      &clk_src_sel=SRC_SEL TODO.
      &clk_src_div=2.
      &clk_m_val=0.
      &clk_n_val=0.
      &clk_2d_val=0.
      
      gosub Set_Clock_Freq
      return
    )
    else if ("&clk_desired_freq"=="r")
    (
      return
    )
    else
    (
      print "Invalid selection."
      goto Set_Clock_Freq_Enter
    )
  )

  if ("&clk"=="gcc_bimc_nius_hs_axi_clk")||("&clk"=="gcc_bimc_sysnoc_hs_axi_clk")||("&clk"=="gcc_lpass_q6_axi_clk")||("&clk"=="gcc_lpass_q6_smmu_axi_clk")||("&clk"=="gcc_sys_noc_hs_axi_clk")||("&clk"=="gcc_mss_mnoc_bimc_axi_clk")||("&clk"=="gcc_mss_msmpu_client_axi_clk")
  (
    gosub PRINT_SET_CLOCK_FREQ_WARNING

    &clk_cmd_rcgr_addr=&HWIO_GCC_SYS_NOC_HS_AXI_CMD_RCGR_ADDR
    &clk_cfg_rcgr_addr=&HWIO_GCC_SYS_NOC_HS_AXI_CFG_RCGR_ADDR

    print "Choose frequency (MHz) from list below: " 

    print "19.2           100.0          200.0          " 
    print "300.0          400.0          533.0          " 

    print ""
    print "Enter desired frequency (r to return): "
    enter &clk_desired_freq
    print ""

    if ("&clk_desired_freq"=="19.2")
    (
      &clk_src_name="XO"
      &clk_src_sel=SRC_SEL TODO.
      &clk_src_div=2.
      &clk_m_val=0.
      &clk_n_val=0.
      &clk_2d_val=0.
      
      gosub Set_Clock_Freq
      return
    )
    else if ("&clk_desired_freq"=="100.0")
    (
      &clk_src_name="PLL0_EARLY_DIV_CLK_SRC"
      &clk_src_sel=SRC_SEL TODO.
      &clk_src_div=6.
      &clk_m_val=0.
      &clk_n_val=0.
      &clk_2d_val=0.
      
      gosub Set_Clock_Freq
      return
    )
    else if ("&clk_desired_freq"=="200.0")
    (
      &clk_src_name="GPLL0_OUT_MAIN"
      &clk_src_sel=SRC_SEL TODO.
      &clk_src_div=6.
      &clk_m_val=0.
      &clk_n_val=0.
      &clk_2d_val=0.
      
      gosub Set_Clock_Freq
      return
    )
    else if ("&clk_desired_freq"=="300.0")
    (
      &clk_src_name="GPLL0_OUT_MAIN"
      &clk_src_sel=SRC_SEL TODO.
      &clk_src_div=4.
      &clk_m_val=0.
      &clk_n_val=0.
      &clk_2d_val=0.
      
      gosub Set_Clock_Freq
      return
    )
    else if ("&clk_desired_freq"=="400.0")
    (
      &clk_src_name="GPLL0_OUT_MAIN"
      &clk_src_sel=SRC_SEL TODO.
      &clk_src_div=3.
      &clk_m_val=0.
      &clk_n_val=0.
      &clk_2d_val=0.
      
      gosub Set_Clock_Freq
      return
    )
    else if ("&clk_desired_freq"=="533.0")
    (
      &clk_src_name="GPLL1_OUT_MAIN"
      &clk_src_sel=SRC_SEL TODO.
      &clk_src_div=2.
      &clk_m_val=0.
      &clk_n_val=0.
      &clk_2d_val=0.
      
      gosub Set_Clock_Freq
      return
    )
    else if ("&clk_desired_freq"=="r")
    (
      return
    )
    else
    (
      print "Invalid selection."
      goto Set_Clock_Freq_Enter
    )
  )

  if ("&clk"=="gcc_aggre0_snoc_axi_clk")||("&clk"=="gcc_aggre1_snoc_axi_clk")||("&clk"=="gcc_aggre2_snoc_axi_clk")||("&clk"=="gcc_bimc_nius_axi_clk")||("&clk"=="gcc_bimc_sysnoc_axi_clk")||("&clk"=="gcc_ce1_axi_clk")||("&clk"=="gcc_imem_axi_clk")||("&clk"=="gcc_lpass_sway_clk")||("&clk"=="gcc_mmss_sys_noc_axi_clk")||("&clk"=="gcc_pcie_0_mstr_axi_clk")||("&clk"=="gcc_pcie_0_slv_axi_clk")||("&clk"=="gcc_pcie_1_mstr_axi_clk")||("&clk"=="gcc_pcie_1_slv_axi_clk")||("&clk"=="gcc_pcie_2_mstr_axi_clk")||("&clk"=="gcc_pcie_2_slv_axi_clk")||("&clk"=="gcc_qdss_etr_usb_clk")||("&clk"=="gcc_smmu_aggre0_axi_clk")||("&clk"=="gcc_smmu_aggre1_axi_clk")||("&clk"=="gcc_smmu_aggre2_axi_clk")||("&clk"=="gcc_snoc_bus_timeout1_ahb_clk")||("&clk"=="gcc_snoc_bus_timeout3_ahb_clk")||("&clk"=="gcc_spdm_snoc_cy_clk")||("&clk"=="gcc_ssc_snoc_ahbm_clk")||("&clk"=="gcc_sys_noc_axi_clk")||("&clk"=="gcc_sys_noc_ssc_q6_axi_clk")||("&clk"=="gcc_aggre1_snoc_msmpu_client_axi_clk")||("&clk"=="gcc_aggre2_snoc_msmpu_client_axi_clk")||("&clk"=="gcc_mss_snoc_axi_clk")
  (
    gosub PRINT_SET_CLOCK_FREQ_WARNING

    &clk_cmd_rcgr_addr=&HWIO_GCC_SYSTEM_NOC_CMD_RCGR_ADDR
    &clk_cfg_rcgr_addr=&HWIO_GCC_SYSTEM_NOC_CFG_RCGR_ADDR

    print "Choose frequency (MHz) from list below: " 

    print "19.2           50.0           100.0          " 
    print "150.0          200.0          240.0          " 

    print ""
    print "Enter desired frequency (r to return): "
    enter &clk_desired_freq
    print ""

    if ("&clk_desired_freq"=="19.2")
    (
      &clk_src_name="XO"
      &clk_src_sel=SRC_SEL TODO.
      &clk_src_div=2.
      &clk_m_val=0.
      &clk_n_val=0.
      &clk_2d_val=0.
      
      gosub Set_Clock_Freq
      return
    )
    else if ("&clk_desired_freq"=="50.0")
    (
      &clk_src_name="PLL0_EARLY_DIV_CLK_SRC"
      &clk_src_sel=SRC_SEL TODO.
      &clk_src_div=12.
      &clk_m_val=0.
      &clk_n_val=0.
      &clk_2d_val=0.
      
      gosub Set_Clock_Freq
      return
    )
    else if ("&clk_desired_freq"=="100.0")
    (
      &clk_src_name="GPLL0_OUT_MAIN"
      &clk_src_sel=SRC_SEL TODO.
      &clk_src_div=12.
      &clk_m_val=0.
      &clk_n_val=0.
      &clk_2d_val=0.
      
      gosub Set_Clock_Freq
      return
    )
    else if ("&clk_desired_freq"=="150.0")
    (
      &clk_src_name="GPLL0_OUT_MAIN"
      &clk_src_sel=SRC_SEL TODO.
      &clk_src_div=8.
      &clk_m_val=0.
      &clk_n_val=0.
      &clk_2d_val=0.
      
      gosub Set_Clock_Freq
      return
    )
    else if ("&clk_desired_freq"=="200.0")
    (
      &clk_src_name="GPLL0_OUT_MAIN"
      &clk_src_sel=SRC_SEL TODO.
      &clk_src_div=6.
      &clk_m_val=0.
      &clk_n_val=0.
      &clk_2d_val=0.
      
      gosub Set_Clock_Freq
      return
    )
    else if ("&clk_desired_freq"=="240.0")
    (
      &clk_src_name="GPLL0_OUT_MAIN"
      &clk_src_sel=SRC_SEL TODO.
      &clk_src_div=5.
      &clk_m_val=0.
      &clk_n_val=0.
      &clk_2d_val=0.
      
      gosub Set_Clock_Freq
      return
    )
    else if ("&clk_desired_freq"=="r")
    (
      return
    )
    else
    (
      print "Invalid selection."
      goto Set_Clock_Freq_Enter
    )
  )

  if ("&clk"=="gcc_tsif_ref_clk")
  (
    gosub PRINT_SET_CLOCK_FREQ_WARNING

    &clk_cmd_rcgr_addr=&HWIO_GCC_TSIF_REF_CMD_RCGR_ADDR
    &clk_cfg_rcgr_addr=&HWIO_GCC_TSIF_REF_CFG_RCGR_ADDR

    print "Choose frequency (MHz) from list below: " 

    print "0.105495       0.105495       " 

    print ""
    print "Enter desired frequency (r to return): "
    enter &clk_desired_freq
    print ""

    if ("&clk_desired_freq"=="0.105495")
    (
      &clk_src_name="XO"
      &clk_src_sel=SRC_SEL TODO.
      &clk_src_div=2.
      &clk_m_val=1.
      &clk_n_val=182.
      &clk_2d_val=182.
      
      gosub Set_Clock_Freq
      return
    )
    else if ("&clk_desired_freq"=="0.105495")
    (
      &clk_src_name="EXTERNAL"
      &clk_src_sel=SRC_SEL TODO.
      &clk_src_div=2.
      &clk_m_val=0.
      &clk_n_val=0.
      &clk_2d_val=0.
      
      gosub Set_Clock_Freq
      return
    )
    else if ("&clk_desired_freq"=="r")
    (
      return
    )
    else
    (
      print "Invalid selection."
      goto Set_Clock_Freq_Enter
    )
  )

  if ("&clk"=="gcc_aggre2_ufs_axi_clk")||("&clk"=="gcc_sys_noc_ufs_axi_clk")||("&clk"=="gcc_ufs_axi_clk")||("&clk"=="gcc_ufs_rx_cfg_clk")||("&clk"=="gcc_ufs_tx_cfg_clk")
  (
    gosub PRINT_SET_CLOCK_FREQ_WARNING

    &clk_cmd_rcgr_addr=&HWIO_GCC_UFS_AXI_CMD_RCGR_ADDR
    &clk_cfg_rcgr_addr=&HWIO_GCC_UFS_AXI_CFG_RCGR_ADDR

    print "Choose frequency (MHz) from list below: " 

    print "100.0          200.0          240.0          " 

    print ""
    print "Enter desired frequency (r to return): "
    enter &clk_desired_freq
    print ""

    if ("&clk_desired_freq"=="100.0")
    (
      &clk_src_name="GPLL0_OUT_MAIN"
      &clk_src_sel=SRC_SEL TODO.
      &clk_src_div=12.
      &clk_m_val=0.
      &clk_n_val=0.
      &clk_2d_val=0.
      
      gosub Set_Clock_Freq
      return
    )
    else if ("&clk_desired_freq"=="200.0")
    (
      &clk_src_name="GPLL0_OUT_MAIN"
      &clk_src_sel=SRC_SEL TODO.
      &clk_src_div=6.
      &clk_m_val=0.
      &clk_n_val=0.
      &clk_2d_val=0.
      
      gosub Set_Clock_Freq
      return
    )
    else if ("&clk_desired_freq"=="240.0")
    (
      &clk_src_name="GPLL0_OUT_MAIN"
      &clk_src_sel=SRC_SEL TODO.
      &clk_src_div=5.
      &clk_m_val=0.
      &clk_n_val=0.
      &clk_2d_val=0.
      
      gosub Set_Clock_Freq
      return
    )
    else if ("&clk_desired_freq"=="r")
    (
      return
    )
    else
    (
      print "Invalid selection."
      goto Set_Clock_Freq_Enter
    )
  )

  if ("&clk"=="gcc_periph_noc_usb20_ahb_clk")||("&clk"=="gcc_pnoc_bus_timeout0_ahb_clk")||("&clk"=="gcc_usb20_master_clk")
  (
    gosub PRINT_SET_CLOCK_FREQ_WARNING

    &clk_cmd_rcgr_addr=&HWIO_GCC_USB20_MASTER_CMD_RCGR_ADDR
    &clk_cfg_rcgr_addr=&HWIO_GCC_USB20_MASTER_CFG_RCGR_ADDR

    print "Choose frequency (MHz) from list below: " 

    print "120.0          " 

    print ""
    print "Enter desired frequency (r to return): "
    enter &clk_desired_freq
    print ""

    if ("&clk_desired_freq"=="120.0")
    (
      &clk_src_name="GPLL0_OUT_MAIN"
      &clk_src_sel=SRC_SEL TODO.
      &clk_src_div=10.
      &clk_m_val=0.
      &clk_n_val=0.
      &clk_2d_val=0.
      
      gosub Set_Clock_Freq
      return
    )
    else if ("&clk_desired_freq"=="r")
    (
      return
    )
    else
    (
      print "Invalid selection."
      goto Set_Clock_Freq_Enter
    )
  )

  if ("&clk"=="gcc_usb20_mock_utmi_clk")
  (
    gosub PRINT_SET_CLOCK_FREQ_WARNING

    &clk_cmd_rcgr_addr=&HWIO_GCC_USB20_MOCK_UTMI_CMD_RCGR_ADDR
    &clk_cfg_rcgr_addr=&HWIO_GCC_USB20_MOCK_UTMI_CFG_RCGR_ADDR

    print "Choose frequency (MHz) from list below: " 

    print "19.2           " 

    print ""
    print "Enter desired frequency (r to return): "
    enter &clk_desired_freq
    print ""

    if ("&clk_desired_freq"=="19.2")
    (
      &clk_src_name="XO"
      &clk_src_sel=SRC_SEL TODO.
      &clk_src_div=2.
      &clk_m_val=0.
      &clk_n_val=0.
      &clk_2d_val=0.
      
      gosub Set_Clock_Freq
      return
    )
    else if ("&clk_desired_freq"=="r")
    (
      return
    )
    else
    (
      print "Invalid selection."
      goto Set_Clock_Freq_Enter
    )
  )

  if ("&clk"=="gcc_aggre2_usb3_axi_clk")||("&clk"=="gcc_snoc_bus_timeout2_ahb_clk")||("&clk"=="gcc_sys_noc_usb3_axi_clk")||("&clk"=="gcc_usb30_master_clk")
  (
    gosub PRINT_SET_CLOCK_FREQ_WARNING

    &clk_cmd_rcgr_addr=&HWIO_GCC_USB30_MASTER_CMD_RCGR_ADDR
    &clk_cfg_rcgr_addr=&HWIO_GCC_USB30_MASTER_CFG_RCGR_ADDR

    print "Choose frequency (MHz) from list below: " 

    print "19.2           120.0          150.0          " 

    print ""
    print "Enter desired frequency (r to return): "
    enter &clk_desired_freq
    print ""

    if ("&clk_desired_freq"=="19.2")
    (
      &clk_src_name="XO"
      &clk_src_sel=SRC_SEL TODO.
      &clk_src_div=2.
      &clk_m_val=0.
      &clk_n_val=0.
      &clk_2d_val=0.
      
      gosub Set_Clock_Freq
      return
    )
    else if ("&clk_desired_freq"=="120.0")
    (
      &clk_src_name="GPLL0_OUT_MAIN"
      &clk_src_sel=SRC_SEL TODO.
      &clk_src_div=10.
      &clk_m_val=0.
      &clk_n_val=0.
      &clk_2d_val=0.
      
      gosub Set_Clock_Freq
      return
    )
    else if ("&clk_desired_freq"=="150.0")
    (
      &clk_src_name="GPLL0_OUT_MAIN"
      &clk_src_sel=SRC_SEL TODO.
      &clk_src_div=8.
      &clk_m_val=0.
      &clk_n_val=0.
      &clk_2d_val=0.
      
      gosub Set_Clock_Freq
      return
    )
    else if ("&clk_desired_freq"=="r")
    (
      return
    )
    else
    (
      print "Invalid selection."
      goto Set_Clock_Freq_Enter
    )
  )

  if ("&clk"=="gcc_usb30_mock_utmi_clk")
  (
    gosub PRINT_SET_CLOCK_FREQ_WARNING

    &clk_cmd_rcgr_addr=&HWIO_GCC_USB30_MOCK_UTMI_CMD_RCGR_ADDR
    &clk_cfg_rcgr_addr=&HWIO_GCC_USB30_MOCK_UTMI_CFG_RCGR_ADDR

    print "Choose frequency (MHz) from list below: " 

    print "19.2           " 

    print ""
    print "Enter desired frequency (r to return): "
    enter &clk_desired_freq
    print ""

    if ("&clk_desired_freq"=="19.2")
    (
      &clk_src_name="XO"
      &clk_src_sel=SRC_SEL TODO.
      &clk_src_div=2.
      &clk_m_val=0.
      &clk_n_val=0.
      &clk_2d_val=0.
      
      gosub Set_Clock_Freq
      return
    )
    else if ("&clk_desired_freq"=="r")
    (
      return
    )
    else
    (
      print "Invalid selection."
      goto Set_Clock_Freq_Enter
    )
  )

  if ("&clk"=="gcc_usb3_phy_aux_clk")
  (
    gosub PRINT_SET_CLOCK_FREQ_WARNING

    &clk_cmd_rcgr_addr=&HWIO_GCC_USB3_PHY_AUX_CMD_RCGR_ADDR
    &clk_cfg_rcgr_addr=&HWIO_GCC_USB3_PHY_AUX_CFG_RCGR_ADDR

    print "Choose frequency (MHz) from list below: " 

    print "1.2            " 

    print ""
    print "Enter desired frequency (r to return): "
    enter &clk_desired_freq
    print ""

    if ("&clk_desired_freq"=="1.2")
    (
      &clk_src_name="XO"
      &clk_src_sel=SRC_SEL TODO.
      &clk_src_div=32.
      &clk_m_val=0.
      &clk_n_val=0.
      &clk_2d_val=0.
      
      gosub Set_Clock_Freq
      return
    )
    else if ("&clk_desired_freq"=="r")
    (
      return
    )
    else
    (
      print "Invalid selection."
      goto Set_Clock_Freq_Enter
    )
  )

  if ("&clk"=="gcc_vdda_vs_clk")
  (
    gosub PRINT_SET_CLOCK_FREQ_WARNING

    &clk_cmd_rcgr_addr=&HWIO_GCC_VDDA_VS_CMD_RCGR_ADDR
    &clk_cfg_rcgr_addr=&HWIO_GCC_VDDA_VS_CFG_RCGR_ADDR

    print "Choose frequency (MHz) from list below: " 

    print "300.0          400.0          400.0          " 
    print "533.0          600.0          " 

    print ""
    print "Enter desired frequency (r to return): "
    enter &clk_desired_freq
    print ""

    if ("&clk_desired_freq"=="300.0")
    (
      &clk_src_name="GPLL0_OUT_MAIN"
      &clk_src_sel=SRC_SEL TODO.
      &clk_src_div=4.
      &clk_m_val=0.
      &clk_n_val=0.
      &clk_2d_val=0.
      
      gosub Set_Clock_Freq
      return
    )
    else if ("&clk_desired_freq"=="400.0")
    (
      &clk_src_name="GPLL0_OUT_MAIN"
      &clk_src_sel=SRC_SEL TODO.
      &clk_src_div=3.
      &clk_m_val=0.
      &clk_n_val=0.
      &clk_2d_val=0.
      
      gosub Set_Clock_Freq
      return
    )
    else if ("&clk_desired_freq"=="400.0")
    (
      &clk_src_name="GPLL0_OUT_MAIN"
      &clk_src_sel=SRC_SEL TODO.
      &clk_src_div=3.
      &clk_m_val=0.
      &clk_n_val=0.
      &clk_2d_val=0.
      
      gosub Set_Clock_Freq
      return
    )
    else if ("&clk_desired_freq"=="533.0")
    (
      &clk_src_name="GPLL1_OUT_MAIN"
      &clk_src_sel=SRC_SEL TODO.
      &clk_src_div=2.
      &clk_m_val=0.
      &clk_n_val=0.
      &clk_2d_val=0.
      
      gosub Set_Clock_Freq
      return
    )
    else if ("&clk_desired_freq"=="600.0")
    (
      &clk_src_name="GPLL0_OUT_MAIN"
      &clk_src_sel=SRC_SEL TODO.
      &clk_src_div=2.
      &clk_m_val=0.
      &clk_n_val=0.
      &clk_2d_val=0.
      
      gosub Set_Clock_Freq
      return
    )
    else if ("&clk_desired_freq"=="r")
    (
      return
    )
    else
    (
      print "Invalid selection."
      goto Set_Clock_Freq_Enter
    )
  )

  if ("&clk"=="gcc_vddcx_vs_clk")
  (
    gosub PRINT_SET_CLOCK_FREQ_WARNING

    &clk_cmd_rcgr_addr=&HWIO_GCC_VDDCX_VS_CMD_RCGR_ADDR
    &clk_cfg_rcgr_addr=&HWIO_GCC_VDDCX_VS_CFG_RCGR_ADDR

    print "Choose frequency (MHz) from list below: " 

    print "300.0          400.0          400.0          " 
    print "533.0          600.0          " 

    print ""
    print "Enter desired frequency (r to return): "
    enter &clk_desired_freq
    print ""

    if ("&clk_desired_freq"=="300.0")
    (
      &clk_src_name="GPLL0_OUT_MAIN"
      &clk_src_sel=SRC_SEL TODO.
      &clk_src_div=4.
      &clk_m_val=0.
      &clk_n_val=0.
      &clk_2d_val=0.
      
      gosub Set_Clock_Freq
      return
    )
    else if ("&clk_desired_freq"=="400.0")
    (
      &clk_src_name="GPLL0_OUT_MAIN"
      &clk_src_sel=SRC_SEL TODO.
      &clk_src_div=3.
      &clk_m_val=0.
      &clk_n_val=0.
      &clk_2d_val=0.
      
      gosub Set_Clock_Freq
      return
    )
    else if ("&clk_desired_freq"=="400.0")
    (
      &clk_src_name="GPLL0_OUT_MAIN"
      &clk_src_sel=SRC_SEL TODO.
      &clk_src_div=3.
      &clk_m_val=0.
      &clk_n_val=0.
      &clk_2d_val=0.
      
      gosub Set_Clock_Freq
      return
    )
    else if ("&clk_desired_freq"=="533.0")
    (
      &clk_src_name="GPLL1_OUT_MAIN"
      &clk_src_sel=SRC_SEL TODO.
      &clk_src_div=2.
      &clk_m_val=0.
      &clk_n_val=0.
      &clk_2d_val=0.
      
      gosub Set_Clock_Freq
      return
    )
    else if ("&clk_desired_freq"=="600.0")
    (
      &clk_src_name="GPLL0_OUT_MAIN"
      &clk_src_sel=SRC_SEL TODO.
      &clk_src_div=2.
      &clk_m_val=0.
      &clk_n_val=0.
      &clk_2d_val=0.
      
      gosub Set_Clock_Freq
      return
    )
    else if ("&clk_desired_freq"=="r")
    (
      return
    )
    else
    (
      print "Invalid selection."
      goto Set_Clock_Freq_Enter
    )
  )

  if ("&clk"=="gcc_vddmx_vs_clk")
  (
    gosub PRINT_SET_CLOCK_FREQ_WARNING

    &clk_cmd_rcgr_addr=&HWIO_GCC_VDDMX_VS_CMD_RCGR_ADDR
    &clk_cfg_rcgr_addr=&HWIO_GCC_VDDMX_VS_CFG_RCGR_ADDR

    print "Choose frequency (MHz) from list below: " 

    print "300.0          400.0          400.0          " 
    print "533.0          600.0          " 

    print ""
    print "Enter desired frequency (r to return): "
    enter &clk_desired_freq
    print ""

    if ("&clk_desired_freq"=="300.0")
    (
      &clk_src_name="GPLL0_OUT_MAIN"
      &clk_src_sel=SRC_SEL TODO.
      &clk_src_div=4.
      &clk_m_val=0.
      &clk_n_val=0.
      &clk_2d_val=0.
      
      gosub Set_Clock_Freq
      return
    )
    else if ("&clk_desired_freq"=="400.0")
    (
      &clk_src_name="GPLL0_OUT_MAIN"
      &clk_src_sel=SRC_SEL TODO.
      &clk_src_div=3.
      &clk_m_val=0.
      &clk_n_val=0.
      &clk_2d_val=0.
      
      gosub Set_Clock_Freq
      return
    )
    else if ("&clk_desired_freq"=="400.0")
    (
      &clk_src_name="GPLL0_OUT_MAIN"
      &clk_src_sel=SRC_SEL TODO.
      &clk_src_div=3.
      &clk_m_val=0.
      &clk_n_val=0.
      &clk_2d_val=0.
      
      gosub Set_Clock_Freq
      return
    )
    else if ("&clk_desired_freq"=="533.0")
    (
      &clk_src_name="GPLL1_OUT_MAIN"
      &clk_src_sel=SRC_SEL TODO.
      &clk_src_div=2.
      &clk_m_val=0.
      &clk_n_val=0.
      &clk_2d_val=0.
      
      gosub Set_Clock_Freq
      return
    )
    else if ("&clk_desired_freq"=="600.0")
    (
      &clk_src_name="GPLL0_OUT_MAIN"
      &clk_src_sel=SRC_SEL TODO.
      &clk_src_div=2.
      &clk_m_val=0.
      &clk_n_val=0.
      &clk_2d_val=0.
      
      gosub Set_Clock_Freq
      return
    )
    else if ("&clk_desired_freq"=="r")
    (
      return
    )
    else
    (
      print "Invalid selection."
      goto Set_Clock_Freq_Enter
    )
  )

  if ("&clk"=="gcc_vs_ctrl_clk")
  (
    gosub PRINT_SET_CLOCK_FREQ_WARNING

    &clk_cmd_rcgr_addr=&HWIO_GCC_VS_CTRL_CMD_RCGR_ADDR
    &clk_cfg_rcgr_addr=&HWIO_GCC_VS_CTRL_CFG_RCGR_ADDR

    print "Choose frequency (MHz) from list below: " 

    print "19.2           " 

    print ""
    print "Enter desired frequency (r to return): "
    enter &clk_desired_freq
    print ""

    if ("&clk_desired_freq"=="19.2")
    (
      &clk_src_name="XO"
      &clk_src_sel=SRC_SEL TODO.
      &clk_src_div=2.
      &clk_m_val=0.
      &clk_n_val=0.
      &clk_2d_val=0.
      
      gosub Set_Clock_Freq
      return
    )
    else if ("&clk_desired_freq"=="r")
    (
      return
    )
    else
    (
      print "Invalid selection."
      goto Set_Clock_Freq_Enter
    )
  )

  if ("&clk"=="aon_clk_src")||("&clk"=="audio_core_qdsp_sway_aon_clk")||("&clk"=="audio_wrapper_aon_clk")||("&clk"=="audio_wrapper_bus_timeout_aon_clk")||("&clk"=="audio_wrapper_mpu_cfg_aon_clk")||("&clk"=="audio_wrapper_q6_ahbm_mpu_aon_clk")||("&clk"=="audio_wrapper_qos_ahbs_aon_clk")||("&clk"=="audio_wrapper_sysnoc_sway_aon_clk")||("&clk"=="q6ss_ahbm_aon_clk")||("&clk"=="q6ss_ahbs_aon_clk")
  (
    gosub PRINT_SET_CLOCK_FREQ_WARNING

    &clk_cmd_rcgr_addr=&HWIO_LPASS_AON_CMD_RCGR_ADDR
    &clk_cfg_rcgr_addr=&HWIO_LPASS_AON_CFG_RCGR_ADDR

    print "Choose frequency (MHz) from list below: " 

    print "19.2           38.4           38.4           " 
    print "76.8           153.6          " 

    print ""
    print "Enter desired frequency (r to return): "
    enter &clk_desired_freq
    print ""

    if ("&clk_desired_freq"=="19.2")
    (
      &clk_src_name="XO"
      &clk_src_sel=SRC_SEL TODO.
      &clk_src_div=2.
      &clk_m_val=0.
      &clk_n_val=0.
      &clk_2d_val=0.
      
      gosub Set_Clock_Freq
      return
    )
    else if ("&clk_desired_freq"=="38.4")
    (
      &clk_src_name="LPASS_LPAAUDIO_DIG_PLL_OUT_EARLY_SVS_CDIV"
      &clk_src_sel=SRC_SEL TODO.
      &clk_src_div=16.
      &clk_m_val=0.
      &clk_n_val=0.
      &clk_2d_val=0.
      
      gosub Set_Clock_Freq
      return
    )
    else if ("&clk_desired_freq"=="38.4")
    (
      &clk_src_name="LPASS_LPAAUDIO_DIG_PLL_OUT_EARLY_SVS_CDIV"
      &clk_src_sel=SRC_SEL TODO.
      &clk_src_div=16.
      &clk_m_val=0.
      &clk_n_val=0.
      &clk_2d_val=0.
      
      gosub Set_Clock_Freq
      return
    )
    else if ("&clk_desired_freq"=="76.8")
    (
      &clk_src_name="LPASS_LPAAUDIO_DIG_PLL_OUT_EARLY_SVS_CDIV"
      &clk_src_sel=SRC_SEL TODO.
      &clk_src_div=8.
      &clk_m_val=0.
      &clk_n_val=0.
      &clk_2d_val=0.
      
      gosub Set_Clock_Freq
      return
    )
    else if ("&clk_desired_freq"=="153.6")
    (
      &clk_src_name="LPASS_LPAAUDIO_DIG_PLL_OUT_EARLY_SVS_CDIV"
      &clk_src_sel=SRC_SEL TODO.
      &clk_src_div=4.
      &clk_m_val=0.
      &clk_n_val=0.
      &clk_2d_val=0.
      
      gosub Set_Clock_Freq
      return
    )
    else if ("&clk_desired_freq"=="r")
    (
      return
    )
    else
    (
      print "Invalid selection."
      goto Set_Clock_Freq_Enter
    )
  )

  if ("&clk"=="atime_clk_src")||("&clk"=="lpass_core_avsync_atime_clk")
  (
    gosub PRINT_SET_CLOCK_FREQ_WARNING

    &clk_cmd_rcgr_addr=&HWIO_LPASS_ATIME_CMD_RCGR_ADDR
    &clk_cfg_rcgr_addr=&HWIO_LPASS_ATIME_CFG_RCGR_ADDR

    print "Choose frequency (MHz) from list below: " 

    print "19.2           30.72          61.44          " 
    print "122.88         " 

    print ""
    print "Enter desired frequency (r to return): "
    enter &clk_desired_freq
    print ""

    if ("&clk_desired_freq"=="19.2")
    (
      &clk_src_name="XO"
      &clk_src_sel=SRC_SEL TODO.
      &clk_src_div=2.
      &clk_m_val=0.
      &clk_n_val=0.
      &clk_2d_val=0.
      
      gosub Set_Clock_Freq
      return
    )
    else if ("&clk_desired_freq"=="30.72")
    (
      &clk_src_name="LPASS_LPAAUDIO_DIG_PLL_OUT_AUX"
      &clk_src_sel=SRC_SEL TODO.
      &clk_src_div=8.
      &clk_m_val=0.
      &clk_n_val=0.
      &clk_2d_val=0.
      
      gosub Set_Clock_Freq
      return
    )
    else if ("&clk_desired_freq"=="61.44")
    (
      &clk_src_name="LPASS_LPAAUDIO_DIG_PLL_OUT_AUX"
      &clk_src_sel=SRC_SEL TODO.
      &clk_src_div=4.
      &clk_m_val=0.
      &clk_n_val=0.
      &clk_2d_val=0.
      
      gosub Set_Clock_Freq
      return
    )
    else if ("&clk_desired_freq"=="122.88")
    (
      &clk_src_name="LPASS_LPAAUDIO_DIG_PLL_OUT_AUX"
      &clk_src_sel=SRC_SEL TODO.
      &clk_src_div=2.
      &clk_m_val=0.
      &clk_n_val=0.
      &clk_2d_val=0.
      
      gosub Set_Clock_Freq
      return
    )
    else if ("&clk_desired_freq"=="r")
    (
      return
    )
    else
    (
      print "Invalid selection."
      goto Set_Clock_Freq_Enter
    )
  )

  if ("&clk"=="aud_slimbus_clk_src")||("&clk"=="audio_core_aud_slimbus_clk")
  (
    gosub PRINT_SET_CLOCK_FREQ_WARNING

    &clk_cmd_rcgr_addr=&HWIO_LPASS_AUD_SLIMBUS_CMD_RCGR_ADDR
    &clk_cfg_rcgr_addr=&HWIO_LPASS_AUD_SLIMBUS_CFG_RCGR_ADDR

    print "Choose frequency (MHz) from list below: " 

    print "24.576         " 

    print ""
    print "Enter desired frequency (r to return): "
    enter &clk_desired_freq
    print ""

    if ("&clk_desired_freq"=="24.576")
    (
      &clk_src_name="LPASS_LPAAUDIO_DIG_PLL_OUT_AUX"
      &clk_src_sel=SRC_SEL TODO.
      &clk_src_div=10.
      &clk_m_val=0.
      &clk_n_val=0.
      &clk_2d_val=0.
      
      gosub Set_Clock_Freq
      return
    )
    else if ("&clk_desired_freq"=="r")
    (
      return
    )
    else
    (
      print "Invalid selection."
      goto Set_Clock_Freq_Enter
    )
  )

  if ("&clk"=="core_clk_src")||("&clk"=="audio_core_aud_slimbus_core_clk")||("&clk"=="audio_core_core_clk")||("&clk"=="audio_core_lpm_core_clk")||("&clk"=="audio_core_peripheral_smmu_client_core_clk")||("&clk"=="audio_core_qca_slimbus_core_clk")||("&clk"=="audio_core_sysnoc_mport_core_clk")||("&clk"=="audio_core_bus_timeout_core_clk")
  (
    gosub PRINT_SET_CLOCK_FREQ_WARNING

    &clk_cmd_rcgr_addr=&HWIO_LPASS_CORE_CMD_RCGR_ADDR
    &clk_cfg_rcgr_addr=&HWIO_LPASS_CORE_CFG_RCGR_ADDR

    print "Choose frequency (MHz) from list below: " 

    print "19.2           38.4           38.4           " 
    print "76.8           153.6          " 

    print ""
    print "Enter desired frequency (r to return): "
    enter &clk_desired_freq
    print ""

    if ("&clk_desired_freq"=="19.2")
    (
      &clk_src_name="XO"
      &clk_src_sel=SRC_SEL TODO.
      &clk_src_div=2.
      &clk_m_val=0.
      &clk_n_val=0.
      &clk_2d_val=0.
      
      gosub Set_Clock_Freq
      return
    )
    else if ("&clk_desired_freq"=="38.4")
    (
      &clk_src_name="LPASS_LPAAUDIO_DIG_PLL_OUT_EARLY_SVS_CDIV"
      &clk_src_sel=SRC_SEL TODO.
      &clk_src_div=16.
      &clk_m_val=0.
      &clk_n_val=0.
      &clk_2d_val=0.
      
      gosub Set_Clock_Freq
      return
    )
    else if ("&clk_desired_freq"=="38.4")
    (
      &clk_src_name="LPASS_LPAAUDIO_DIG_PLL_OUT_EARLY_SVS_CDIV"
      &clk_src_sel=SRC_SEL TODO.
      &clk_src_div=16.
      &clk_m_val=0.
      &clk_n_val=0.
      &clk_2d_val=0.
      
      gosub Set_Clock_Freq
      return
    )
    else if ("&clk_desired_freq"=="76.8")
    (
      &clk_src_name="LPASS_LPAAUDIO_DIG_PLL_OUT_EARLY_SVS_CDIV"
      &clk_src_sel=SRC_SEL TODO.
      &clk_src_div=8.
      &clk_m_val=0.
      &clk_n_val=0.
      &clk_2d_val=0.
      
      gosub Set_Clock_Freq
      return
    )
    else if ("&clk_desired_freq"=="153.6")
    (
      &clk_src_name="LPASS_LPAAUDIO_DIG_PLL_OUT_EARLY_SVS_CDIV"
      &clk_src_sel=SRC_SEL TODO.
      &clk_src_div=4.
      &clk_m_val=0.
      &clk_n_val=0.
      &clk_2d_val=0.
      
      gosub Set_Clock_Freq
      return
    )
    else if ("&clk_desired_freq"=="r")
    (
      return
    )
    else
    (
      print "Invalid selection."
      goto Set_Clock_Freq_Enter
    )
  )

  if ("&clk"=="ext_mclk0_clk_src")||("&clk"=="audio_wrapper_ext_mclk0_clk")
  (
    gosub PRINT_SET_CLOCK_FREQ_WARNING

    &clk_cmd_rcgr_addr=&HWIO_LPASS_EXT_MCLK0_CMD_RCGR_ADDR
    &clk_cfg_rcgr_addr=&HWIO_LPASS_EXT_MCLK0_CFG_RCGR_ADDR

    print "Choose frequency (MHz) from list below: " 

    print "0.512          0.768          1.024          " 
    print "1.536          2.048          3.072          " 
    print "4.096          6.144          8.192          " 
    print "12.288         24.576         " 

    print ""
    print "Enter desired frequency (r to return): "
    enter &clk_desired_freq
    print ""

    if ("&clk_desired_freq"=="0.512")
    (
      &clk_src_name="LPASS_LPAAUDIO_DIG_PLL_OUT_AUX"
      &clk_src_sel=SRC_SEL TODO.
      &clk_src_div=30.
      &clk_m_val=1.
      &clk_n_val=16.
      &clk_2d_val=16.
      
      gosub Set_Clock_Freq
      return
    )
    else if ("&clk_desired_freq"=="0.768")
    (
      &clk_src_name="LPASS_LPAAUDIO_DIG_PLL_OUT_AUX"
      &clk_src_sel=SRC_SEL TODO.
      &clk_src_div=20.
      &clk_m_val=1.
      &clk_n_val=16.
      &clk_2d_val=16.
      
      gosub Set_Clock_Freq
      return
    )
    else if ("&clk_desired_freq"=="1.024")
    (
      &clk_src_name="LPASS_LPAAUDIO_DIG_PLL_OUT_AUX"
      &clk_src_sel=SRC_SEL TODO.
      &clk_src_div=30.
      &clk_m_val=1.
      &clk_n_val=8.
      &clk_2d_val=8.
      
      gosub Set_Clock_Freq
      return
    )
    else if ("&clk_desired_freq"=="1.536")
    (
      &clk_src_name="LPASS_LPAAUDIO_DIG_PLL_OUT_AUX"
      &clk_src_sel=SRC_SEL TODO.
      &clk_src_div=20.
      &clk_m_val=1.
      &clk_n_val=8.
      &clk_2d_val=8.
      
      gosub Set_Clock_Freq
      return
    )
    else if ("&clk_desired_freq"=="2.048")
    (
      &clk_src_name="LPASS_LPAAUDIO_DIG_PLL_OUT_AUX"
      &clk_src_sel=SRC_SEL TODO.
      &clk_src_div=30.
      &clk_m_val=1.
      &clk_n_val=4.
      &clk_2d_val=4.
      
      gosub Set_Clock_Freq
      return
    )
    else if ("&clk_desired_freq"=="3.072")
    (
      &clk_src_name="LPASS_LPAAUDIO_DIG_PLL_OUT_AUX"
      &clk_src_sel=SRC_SEL TODO.
      &clk_src_div=20.
      &clk_m_val=1.
      &clk_n_val=4.
      &clk_2d_val=4.
      
      gosub Set_Clock_Freq
      return
    )
    else if ("&clk_desired_freq"=="4.096")
    (
      &clk_src_name="LPASS_LPAAUDIO_DIG_PLL_OUT_AUX"
      &clk_src_sel=SRC_SEL TODO.
      &clk_src_div=30.
      &clk_m_val=1.
      &clk_n_val=2.
      &clk_2d_val=2.
      
      gosub Set_Clock_Freq
      return
    )
    else if ("&clk_desired_freq"=="6.144")
    (
      &clk_src_name="LPASS_LPAAUDIO_DIG_PLL_OUT_AUX"
      &clk_src_sel=SRC_SEL TODO.
      &clk_src_div=20.
      &clk_m_val=1.
      &clk_n_val=2.
      &clk_2d_val=2.
      
      gosub Set_Clock_Freq
      return
    )
    else if ("&clk_desired_freq"=="8.192")
    (
      &clk_src_name="LPASS_LPAAUDIO_DIG_PLL_OUT_AUX"
      &clk_src_sel=SRC_SEL TODO.
      &clk_src_div=30.
      &clk_m_val=0.
      &clk_n_val=0.
      &clk_2d_val=0.
      
      gosub Set_Clock_Freq
      return
    )
    else if ("&clk_desired_freq"=="12.288")
    (
      &clk_src_name="LPASS_LPAAUDIO_DIG_PLL_OUT_AUX"
      &clk_src_sel=SRC_SEL TODO.
      &clk_src_div=20.
      &clk_m_val=0.
      &clk_n_val=0.
      &clk_2d_val=0.
      
      gosub Set_Clock_Freq
      return
    )
    else if ("&clk_desired_freq"=="24.576")
    (
      &clk_src_name="LPASS_LPAAUDIO_DIG_PLL_OUT_AUX"
      &clk_src_sel=SRC_SEL TODO.
      &clk_src_div=10.
      &clk_m_val=0.
      &clk_n_val=0.
      &clk_2d_val=0.
      
      gosub Set_Clock_Freq
      return
    )
    else if ("&clk_desired_freq"=="r")
    (
      return
    )
    else
    (
      print "Invalid selection."
      goto Set_Clock_Freq_Enter
    )
  )

  if ("&clk"=="ext_mclk1_clk_src")||("&clk"=="audio_wrapper_ext_mclk1_clk")
  (
    gosub PRINT_SET_CLOCK_FREQ_WARNING

    &clk_cmd_rcgr_addr=&HWIO_LPASS_EXT_MCLK1_CMD_RCGR_ADDR
    &clk_cfg_rcgr_addr=&HWIO_LPASS_EXT_MCLK1_CFG_RCGR_ADDR

    print "Choose frequency (MHz) from list below: " 

    print "0.512          0.768          1.024          " 
    print "1.536          2.048          3.072          " 
    print "4.096          6.144          8.192          " 
    print "12.288         24.576         " 

    print ""
    print "Enter desired frequency (r to return): "
    enter &clk_desired_freq
    print ""

    if ("&clk_desired_freq"=="0.512")
    (
      &clk_src_name="LPASS_LPAAUDIO_DIG_PLL_OUT_AUX"
      &clk_src_sel=SRC_SEL TODO.
      &clk_src_div=30.
      &clk_m_val=1.
      &clk_n_val=16.
      &clk_2d_val=16.
      
      gosub Set_Clock_Freq
      return
    )
    else if ("&clk_desired_freq"=="0.768")
    (
      &clk_src_name="LPASS_LPAAUDIO_DIG_PLL_OUT_AUX"
      &clk_src_sel=SRC_SEL TODO.
      &clk_src_div=20.
      &clk_m_val=1.
      &clk_n_val=16.
      &clk_2d_val=16.
      
      gosub Set_Clock_Freq
      return
    )
    else if ("&clk_desired_freq"=="1.024")
    (
      &clk_src_name="LPASS_LPAAUDIO_DIG_PLL_OUT_AUX"
      &clk_src_sel=SRC_SEL TODO.
      &clk_src_div=30.
      &clk_m_val=1.
      &clk_n_val=8.
      &clk_2d_val=8.
      
      gosub Set_Clock_Freq
      return
    )
    else if ("&clk_desired_freq"=="1.536")
    (
      &clk_src_name="LPASS_LPAAUDIO_DIG_PLL_OUT_AUX"
      &clk_src_sel=SRC_SEL TODO.
      &clk_src_div=20.
      &clk_m_val=1.
      &clk_n_val=8.
      &clk_2d_val=8.
      
      gosub Set_Clock_Freq
      return
    )
    else if ("&clk_desired_freq"=="2.048")
    (
      &clk_src_name="LPASS_LPAAUDIO_DIG_PLL_OUT_AUX"
      &clk_src_sel=SRC_SEL TODO.
      &clk_src_div=30.
      &clk_m_val=1.
      &clk_n_val=4.
      &clk_2d_val=4.
      
      gosub Set_Clock_Freq
      return
    )
    else if ("&clk_desired_freq"=="3.072")
    (
      &clk_src_name="LPASS_LPAAUDIO_DIG_PLL_OUT_AUX"
      &clk_src_sel=SRC_SEL TODO.
      &clk_src_div=20.
      &clk_m_val=1.
      &clk_n_val=4.
      &clk_2d_val=4.
      
      gosub Set_Clock_Freq
      return
    )
    else if ("&clk_desired_freq"=="4.096")
    (
      &clk_src_name="LPASS_LPAAUDIO_DIG_PLL_OUT_AUX"
      &clk_src_sel=SRC_SEL TODO.
      &clk_src_div=30.
      &clk_m_val=1.
      &clk_n_val=2.
      &clk_2d_val=2.
      
      gosub Set_Clock_Freq
      return
    )
    else if ("&clk_desired_freq"=="6.144")
    (
      &clk_src_name="LPASS_LPAAUDIO_DIG_PLL_OUT_AUX"
      &clk_src_sel=SRC_SEL TODO.
      &clk_src_div=20.
      &clk_m_val=1.
      &clk_n_val=2.
      &clk_2d_val=2.
      
      gosub Set_Clock_Freq
      return
    )
    else if ("&clk_desired_freq"=="8.192")
    (
      &clk_src_name="LPASS_LPAAUDIO_DIG_PLL_OUT_AUX"
      &clk_src_sel=SRC_SEL TODO.
      &clk_src_div=30.
      &clk_m_val=0.
      &clk_n_val=0.
      &clk_2d_val=0.
      
      gosub Set_Clock_Freq
      return
    )
    else if ("&clk_desired_freq"=="12.288")
    (
      &clk_src_name="LPASS_LPAAUDIO_DIG_PLL_OUT_AUX"
      &clk_src_sel=SRC_SEL TODO.
      &clk_src_div=20.
      &clk_m_val=0.
      &clk_n_val=0.
      &clk_2d_val=0.
      
      gosub Set_Clock_Freq
      return
    )
    else if ("&clk_desired_freq"=="24.576")
    (
      &clk_src_name="LPASS_LPAAUDIO_DIG_PLL_OUT_AUX"
      &clk_src_sel=SRC_SEL TODO.
      &clk_src_div=10.
      &clk_m_val=0.
      &clk_n_val=0.
      &clk_2d_val=0.
      
      gosub Set_Clock_Freq
      return
    )
    else if ("&clk_desired_freq"=="r")
    (
      return
    )
    else
    (
      print "Invalid selection."
      goto Set_Clock_Freq_Enter
    )
  )

  if ("&clk"=="ext_mclk2_clk_src")||("&clk"=="audio_wrapper_ext_mclk2_clk")
  (
    gosub PRINT_SET_CLOCK_FREQ_WARNING

    &clk_cmd_rcgr_addr=&HWIO_LPASS_EXT_MCLK2_CMD_RCGR_ADDR
    &clk_cfg_rcgr_addr=&HWIO_LPASS_EXT_MCLK2_CFG_RCGR_ADDR

    print "Choose frequency (MHz) from list below: " 

    print "0.512          0.768          1.024          " 
    print "1.536          2.048          3.072          " 
    print "4.096          6.144          8.192          " 
    print "12.288         24.576         " 

    print ""
    print "Enter desired frequency (r to return): "
    enter &clk_desired_freq
    print ""

    if ("&clk_desired_freq"=="0.512")
    (
      &clk_src_name="LPASS_LPAAUDIO_DIG_PLL_OUT_AUX"
      &clk_src_sel=SRC_SEL TODO.
      &clk_src_div=30.
      &clk_m_val=1.
      &clk_n_val=16.
      &clk_2d_val=16.
      
      gosub Set_Clock_Freq
      return
    )
    else if ("&clk_desired_freq"=="0.768")
    (
      &clk_src_name="LPASS_LPAAUDIO_DIG_PLL_OUT_AUX"
      &clk_src_sel=SRC_SEL TODO.
      &clk_src_div=20.
      &clk_m_val=1.
      &clk_n_val=16.
      &clk_2d_val=16.
      
      gosub Set_Clock_Freq
      return
    )
    else if ("&clk_desired_freq"=="1.024")
    (
      &clk_src_name="LPASS_LPAAUDIO_DIG_PLL_OUT_AUX"
      &clk_src_sel=SRC_SEL TODO.
      &clk_src_div=30.
      &clk_m_val=1.
      &clk_n_val=8.
      &clk_2d_val=8.
      
      gosub Set_Clock_Freq
      return
    )
    else if ("&clk_desired_freq"=="1.536")
    (
      &clk_src_name="LPASS_LPAAUDIO_DIG_PLL_OUT_AUX"
      &clk_src_sel=SRC_SEL TODO.
      &clk_src_div=20.
      &clk_m_val=1.
      &clk_n_val=8.
      &clk_2d_val=8.
      
      gosub Set_Clock_Freq
      return
    )
    else if ("&clk_desired_freq"=="2.048")
    (
      &clk_src_name="LPASS_LPAAUDIO_DIG_PLL_OUT_AUX"
      &clk_src_sel=SRC_SEL TODO.
      &clk_src_div=30.
      &clk_m_val=1.
      &clk_n_val=4.
      &clk_2d_val=4.
      
      gosub Set_Clock_Freq
      return
    )
    else if ("&clk_desired_freq"=="3.072")
    (
      &clk_src_name="LPASS_LPAAUDIO_DIG_PLL_OUT_AUX"
      &clk_src_sel=SRC_SEL TODO.
      &clk_src_div=20.
      &clk_m_val=1.
      &clk_n_val=4.
      &clk_2d_val=4.
      
      gosub Set_Clock_Freq
      return
    )
    else if ("&clk_desired_freq"=="4.096")
    (
      &clk_src_name="LPASS_LPAAUDIO_DIG_PLL_OUT_AUX"
      &clk_src_sel=SRC_SEL TODO.
      &clk_src_div=30.
      &clk_m_val=1.
      &clk_n_val=2.
      &clk_2d_val=2.
      
      gosub Set_Clock_Freq
      return
    )
    else if ("&clk_desired_freq"=="6.144")
    (
      &clk_src_name="LPASS_LPAAUDIO_DIG_PLL_OUT_AUX"
      &clk_src_sel=SRC_SEL TODO.
      &clk_src_div=20.
      &clk_m_val=1.
      &clk_n_val=2.
      &clk_2d_val=2.
      
      gosub Set_Clock_Freq
      return
    )
    else if ("&clk_desired_freq"=="8.192")
    (
      &clk_src_name="LPASS_LPAAUDIO_DIG_PLL_OUT_AUX"
      &clk_src_sel=SRC_SEL TODO.
      &clk_src_div=30.
      &clk_m_val=0.
      &clk_n_val=0.
      &clk_2d_val=0.
      
      gosub Set_Clock_Freq
      return
    )
    else if ("&clk_desired_freq"=="12.288")
    (
      &clk_src_name="LPASS_LPAAUDIO_DIG_PLL_OUT_AUX"
      &clk_src_sel=SRC_SEL TODO.
      &clk_src_div=20.
      &clk_m_val=0.
      &clk_n_val=0.
      &clk_2d_val=0.
      
      gosub Set_Clock_Freq
      return
    )
    else if ("&clk_desired_freq"=="24.576")
    (
      &clk_src_name="LPASS_LPAAUDIO_DIG_PLL_OUT_AUX"
      &clk_src_sel=SRC_SEL TODO.
      &clk_src_div=10.
      &clk_m_val=0.
      &clk_n_val=0.
      &clk_2d_val=0.
      
      gosub Set_Clock_Freq
      return
    )
    else if ("&clk_desired_freq"=="r")
    (
      return
    )
    else
    (
      print "Invalid selection."
      goto Set_Clock_Freq_Enter
    )
  )

  if ("&clk"=="lpaif_pcmoe_clk_src")||("&clk"=="audio_core_lpaif_pcm_data_oe_clk")
  (
    gosub PRINT_SET_CLOCK_FREQ_WARNING

    &clk_cmd_rcgr_addr=&HWIO_LPASS_LPAIF_PCMOE_CMD_RCGR_ADDR
    &clk_cfg_rcgr_addr=&HWIO_LPASS_LPAIF_PCMOE_CFG_RCGR_ADDR

    print "Choose frequency (MHz) from list below: " 

    print "0.512          0.768          1.024          " 
    print "1.536          2.048          3.072          " 
    print "4.096          6.144          8.192          " 
    print "8.192          12.288         12.288         " 
    print "24.576         24.576         " 

    print ""
    print "Enter desired frequency (r to return): "
    enter &clk_desired_freq
    print ""

    if ("&clk_desired_freq"=="0.512")
    (
      &clk_src_name="LPASS_LPAAUDIO_DIG_PLL_OUT_AUX"
      &clk_src_sel=SRC_SEL TODO.
      &clk_src_div=30.
      &clk_m_val=1.
      &clk_n_val=16.
      &clk_2d_val=16.
      
      gosub Set_Clock_Freq
      return
    )
    else if ("&clk_desired_freq"=="0.768")
    (
      &clk_src_name="LPASS_LPAAUDIO_DIG_PLL_OUT_AUX"
      &clk_src_sel=SRC_SEL TODO.
      &clk_src_div=20.
      &clk_m_val=1.
      &clk_n_val=16.
      &clk_2d_val=16.
      
      gosub Set_Clock_Freq
      return
    )
    else if ("&clk_desired_freq"=="1.024")
    (
      &clk_src_name="LPASS_LPAAUDIO_DIG_PLL_OUT_AUX"
      &clk_src_sel=SRC_SEL TODO.
      &clk_src_div=30.
      &clk_m_val=1.
      &clk_n_val=8.
      &clk_2d_val=8.
      
      gosub Set_Clock_Freq
      return
    )
    else if ("&clk_desired_freq"=="1.536")
    (
      &clk_src_name="LPASS_LPAAUDIO_DIG_PLL_OUT_AUX"
      &clk_src_sel=SRC_SEL TODO.
      &clk_src_div=20.
      &clk_m_val=1.
      &clk_n_val=8.
      &clk_2d_val=8.
      
      gosub Set_Clock_Freq
      return
    )
    else if ("&clk_desired_freq"=="2.048")
    (
      &clk_src_name="LPASS_LPAAUDIO_DIG_PLL_OUT_AUX"
      &clk_src_sel=SRC_SEL TODO.
      &clk_src_div=30.
      &clk_m_val=1.
      &clk_n_val=4.
      &clk_2d_val=4.
      
      gosub Set_Clock_Freq
      return
    )
    else if ("&clk_desired_freq"=="3.072")
    (
      &clk_src_name="LPASS_LPAAUDIO_DIG_PLL_OUT_AUX"
      &clk_src_sel=SRC_SEL TODO.
      &clk_src_div=20.
      &clk_m_val=1.
      &clk_n_val=4.
      &clk_2d_val=4.
      
      gosub Set_Clock_Freq
      return
    )
    else if ("&clk_desired_freq"=="4.096")
    (
      &clk_src_name="LPASS_LPAAUDIO_DIG_PLL_OUT_AUX"
      &clk_src_sel=SRC_SEL TODO.
      &clk_src_div=30.
      &clk_m_val=1.
      &clk_n_val=2.
      &clk_2d_val=2.
      
      gosub Set_Clock_Freq
      return
    )
    else if ("&clk_desired_freq"=="6.144")
    (
      &clk_src_name="LPASS_LPAAUDIO_DIG_PLL_OUT_AUX"
      &clk_src_sel=SRC_SEL TODO.
      &clk_src_div=20.
      &clk_m_val=1.
      &clk_n_val=2.
      &clk_2d_val=2.
      
      gosub Set_Clock_Freq
      return
    )
    else if ("&clk_desired_freq"=="8.192")
    (
      &clk_src_name="LPASS_LPAAUDIO_DIG_PLL_OUT_AUX"
      &clk_src_sel=SRC_SEL TODO.
      &clk_src_div=30.
      &clk_m_val=0.
      &clk_n_val=0.
      &clk_2d_val=0.
      
      gosub Set_Clock_Freq
      return
    )
    else if ("&clk_desired_freq"=="8.192")
    (
      &clk_src_name="LPASS_LPAAUDIO_DIG_PLL_OUT_AUX"
      &clk_src_sel=SRC_SEL TODO.
      &clk_src_div=30.
      &clk_m_val=0.
      &clk_n_val=0.
      &clk_2d_val=0.
      
      gosub Set_Clock_Freq
      return
    )
    else if ("&clk_desired_freq"=="12.288")
    (
      &clk_src_name="LPASS_LPAAUDIO_DIG_PLL_OUT_AUX"
      &clk_src_sel=SRC_SEL TODO.
      &clk_src_div=20.
      &clk_m_val=0.
      &clk_n_val=0.
      &clk_2d_val=0.
      
      gosub Set_Clock_Freq
      return
    )
    else if ("&clk_desired_freq"=="12.288")
    (
      &clk_src_name="LPASS_LPAAUDIO_DIG_PLL_OUT_AUX"
      &clk_src_sel=SRC_SEL TODO.
      &clk_src_div=20.
      &clk_m_val=0.
      &clk_n_val=0.
      &clk_2d_val=0.
      
      gosub Set_Clock_Freq
      return
    )
    else if ("&clk_desired_freq"=="24.576")
    (
      &clk_src_name="LPASS_LPAAUDIO_DIG_PLL_OUT_AUX"
      &clk_src_sel=SRC_SEL TODO.
      &clk_src_div=10.
      &clk_m_val=0.
      &clk_n_val=0.
      &clk_2d_val=0.
      
      gosub Set_Clock_Freq
      return
    )
    else if ("&clk_desired_freq"=="24.576")
    (
      &clk_src_name="LPASS_LPAAUDIO_DIG_PLL_OUT_AUX"
      &clk_src_sel=SRC_SEL TODO.
      &clk_src_div=10.
      &clk_m_val=0.
      &clk_n_val=0.
      &clk_2d_val=0.
      
      gosub Set_Clock_Freq
      return
    )
    else if ("&clk_desired_freq"=="r")
    (
      return
    )
    else
    (
      print "Invalid selection."
      goto Set_Clock_Freq_Enter
    )
  )

  if ("&clk"=="lpaif_pri_clk_src")||("&clk"=="audio_core_lpaif_pri_ibit_clk")
  (
    gosub PRINT_SET_CLOCK_FREQ_WARNING

    &clk_cmd_rcgr_addr=&HWIO_LPASS_LPAIF_PRI_CMD_RCGR_ADDR
    &clk_cfg_rcgr_addr=&HWIO_LPASS_LPAIF_PRI_CFG_RCGR_ADDR

    print "Choose frequency (MHz) from list below: " 

    print "0.512          0.768          1.024          " 
    print "1.536          2.048          3.072          " 
    print "4.096          6.144          8.192          " 
    print "12.288         24.576         " 

    print ""
    print "Enter desired frequency (r to return): "
    enter &clk_desired_freq
    print ""

    if ("&clk_desired_freq"=="0.512")
    (
      &clk_src_name="LPASS_LPAAUDIO_DIG_PLL_OUT_AUX"
      &clk_src_sel=SRC_SEL TODO.
      &clk_src_div=30.
      &clk_m_val=1.
      &clk_n_val=16.
      &clk_2d_val=16.
      
      gosub Set_Clock_Freq
      return
    )
    else if ("&clk_desired_freq"=="0.768")
    (
      &clk_src_name="LPASS_LPAAUDIO_DIG_PLL_OUT_AUX"
      &clk_src_sel=SRC_SEL TODO.
      &clk_src_div=20.
      &clk_m_val=1.
      &clk_n_val=16.
      &clk_2d_val=16.
      
      gosub Set_Clock_Freq
      return
    )
    else if ("&clk_desired_freq"=="1.024")
    (
      &clk_src_name="LPASS_LPAAUDIO_DIG_PLL_OUT_AUX"
      &clk_src_sel=SRC_SEL TODO.
      &clk_src_div=30.
      &clk_m_val=1.
      &clk_n_val=8.
      &clk_2d_val=8.
      
      gosub Set_Clock_Freq
      return
    )
    else if ("&clk_desired_freq"=="1.536")
    (
      &clk_src_name="LPASS_LPAAUDIO_DIG_PLL_OUT_AUX"
      &clk_src_sel=SRC_SEL TODO.
      &clk_src_div=20.
      &clk_m_val=1.
      &clk_n_val=8.
      &clk_2d_val=8.
      
      gosub Set_Clock_Freq
      return
    )
    else if ("&clk_desired_freq"=="2.048")
    (
      &clk_src_name="LPASS_LPAAUDIO_DIG_PLL_OUT_AUX"
      &clk_src_sel=SRC_SEL TODO.
      &clk_src_div=30.
      &clk_m_val=1.
      &clk_n_val=4.
      &clk_2d_val=4.
      
      gosub Set_Clock_Freq
      return
    )
    else if ("&clk_desired_freq"=="3.072")
    (
      &clk_src_name="LPASS_LPAAUDIO_DIG_PLL_OUT_AUX"
      &clk_src_sel=SRC_SEL TODO.
      &clk_src_div=20.
      &clk_m_val=1.
      &clk_n_val=4.
      &clk_2d_val=4.
      
      gosub Set_Clock_Freq
      return
    )
    else if ("&clk_desired_freq"=="4.096")
    (
      &clk_src_name="LPASS_LPAAUDIO_DIG_PLL_OUT_AUX"
      &clk_src_sel=SRC_SEL TODO.
      &clk_src_div=30.
      &clk_m_val=1.
      &clk_n_val=2.
      &clk_2d_val=2.
      
      gosub Set_Clock_Freq
      return
    )
    else if ("&clk_desired_freq"=="6.144")
    (
      &clk_src_name="LPASS_LPAAUDIO_DIG_PLL_OUT_AUX"
      &clk_src_sel=SRC_SEL TODO.
      &clk_src_div=20.
      &clk_m_val=1.
      &clk_n_val=2.
      &clk_2d_val=2.
      
      gosub Set_Clock_Freq
      return
    )
    else if ("&clk_desired_freq"=="8.192")
    (
      &clk_src_name="LPASS_LPAAUDIO_DIG_PLL_OUT_AUX"
      &clk_src_sel=SRC_SEL TODO.
      &clk_src_div=30.
      &clk_m_val=0.
      &clk_n_val=0.
      &clk_2d_val=0.
      
      gosub Set_Clock_Freq
      return
    )
    else if ("&clk_desired_freq"=="12.288")
    (
      &clk_src_name="LPASS_LPAAUDIO_DIG_PLL_OUT_AUX"
      &clk_src_sel=SRC_SEL TODO.
      &clk_src_div=20.
      &clk_m_val=0.
      &clk_n_val=0.
      &clk_2d_val=0.
      
      gosub Set_Clock_Freq
      return
    )
    else if ("&clk_desired_freq"=="24.576")
    (
      &clk_src_name="LPASS_LPAAUDIO_DIG_PLL_OUT_AUX"
      &clk_src_sel=SRC_SEL TODO.
      &clk_src_div=10.
      &clk_m_val=0.
      &clk_n_val=0.
      &clk_2d_val=0.
      
      gosub Set_Clock_Freq
      return
    )
    else if ("&clk_desired_freq"=="r")
    (
      return
    )
    else
    (
      print "Invalid selection."
      goto Set_Clock_Freq_Enter
    )
  )

  if ("&clk"=="lpaif_quad_clk_src")||("&clk"=="audio_core_lpaif_quad_ibit_clk")
  (
    gosub PRINT_SET_CLOCK_FREQ_WARNING

    &clk_cmd_rcgr_addr=&HWIO_LPASS_LPAIF_QUAD_CMD_RCGR_ADDR
    &clk_cfg_rcgr_addr=&HWIO_LPASS_LPAIF_QUAD_CFG_RCGR_ADDR

    print "Choose frequency (MHz) from list below: " 

    print "0.512          0.768          1.024          " 
    print "1.536          2.048          3.072          " 
    print "4.096          6.144          8.192          " 
    print "12.288         24.576         " 

    print ""
    print "Enter desired frequency (r to return): "
    enter &clk_desired_freq
    print ""

    if ("&clk_desired_freq"=="0.512")
    (
      &clk_src_name="LPASS_LPAAUDIO_DIG_PLL_OUT_AUX"
      &clk_src_sel=SRC_SEL TODO.
      &clk_src_div=30.
      &clk_m_val=1.
      &clk_n_val=16.
      &clk_2d_val=16.
      
      gosub Set_Clock_Freq
      return
    )
    else if ("&clk_desired_freq"=="0.768")
    (
      &clk_src_name="LPASS_LPAAUDIO_DIG_PLL_OUT_AUX"
      &clk_src_sel=SRC_SEL TODO.
      &clk_src_div=20.
      &clk_m_val=1.
      &clk_n_val=16.
      &clk_2d_val=16.
      
      gosub Set_Clock_Freq
      return
    )
    else if ("&clk_desired_freq"=="1.024")
    (
      &clk_src_name="LPASS_LPAAUDIO_DIG_PLL_OUT_AUX"
      &clk_src_sel=SRC_SEL TODO.
      &clk_src_div=30.
      &clk_m_val=1.
      &clk_n_val=8.
      &clk_2d_val=8.
      
      gosub Set_Clock_Freq
      return
    )
    else if ("&clk_desired_freq"=="1.536")
    (
      &clk_src_name="LPASS_LPAAUDIO_DIG_PLL_OUT_AUX"
      &clk_src_sel=SRC_SEL TODO.
      &clk_src_div=20.
      &clk_m_val=1.
      &clk_n_val=8.
      &clk_2d_val=8.
      
      gosub Set_Clock_Freq
      return
    )
    else if ("&clk_desired_freq"=="2.048")
    (
      &clk_src_name="LPASS_LPAAUDIO_DIG_PLL_OUT_AUX"
      &clk_src_sel=SRC_SEL TODO.
      &clk_src_div=30.
      &clk_m_val=1.
      &clk_n_val=4.
      &clk_2d_val=4.
      
      gosub Set_Clock_Freq
      return
    )
    else if ("&clk_desired_freq"=="3.072")
    (
      &clk_src_name="LPASS_LPAAUDIO_DIG_PLL_OUT_AUX"
      &clk_src_sel=SRC_SEL TODO.
      &clk_src_div=20.
      &clk_m_val=1.
      &clk_n_val=4.
      &clk_2d_val=4.
      
      gosub Set_Clock_Freq
      return
    )
    else if ("&clk_desired_freq"=="4.096")
    (
      &clk_src_name="LPASS_LPAAUDIO_DIG_PLL_OUT_AUX"
      &clk_src_sel=SRC_SEL TODO.
      &clk_src_div=30.
      &clk_m_val=1.
      &clk_n_val=2.
      &clk_2d_val=2.
      
      gosub Set_Clock_Freq
      return
    )
    else if ("&clk_desired_freq"=="6.144")
    (
      &clk_src_name="LPASS_LPAAUDIO_DIG_PLL_OUT_AUX"
      &clk_src_sel=SRC_SEL TODO.
      &clk_src_div=20.
      &clk_m_val=1.
      &clk_n_val=2.
      &clk_2d_val=2.
      
      gosub Set_Clock_Freq
      return
    )
    else if ("&clk_desired_freq"=="8.192")
    (
      &clk_src_name="LPASS_LPAAUDIO_DIG_PLL_OUT_AUX"
      &clk_src_sel=SRC_SEL TODO.
      &clk_src_div=30.
      &clk_m_val=0.
      &clk_n_val=0.
      &clk_2d_val=0.
      
      gosub Set_Clock_Freq
      return
    )
    else if ("&clk_desired_freq"=="12.288")
    (
      &clk_src_name="LPASS_LPAAUDIO_DIG_PLL_OUT_AUX"
      &clk_src_sel=SRC_SEL TODO.
      &clk_src_div=20.
      &clk_m_val=0.
      &clk_n_val=0.
      &clk_2d_val=0.
      
      gosub Set_Clock_Freq
      return
    )
    else if ("&clk_desired_freq"=="24.576")
    (
      &clk_src_name="LPASS_LPAAUDIO_DIG_PLL_OUT_AUX"
      &clk_src_sel=SRC_SEL TODO.
      &clk_src_div=10.
      &clk_m_val=0.
      &clk_n_val=0.
      &clk_2d_val=0.
      
      gosub Set_Clock_Freq
      return
    )
    else if ("&clk_desired_freq"=="r")
    (
      return
    )
    else
    (
      print "Invalid selection."
      goto Set_Clock_Freq_Enter
    )
  )

  if ("&clk"=="lpaif_sec_clk_src")||("&clk"=="audio_core_lpaif_sec_ibit_clk")
  (
    gosub PRINT_SET_CLOCK_FREQ_WARNING

    &clk_cmd_rcgr_addr=&HWIO_LPASS_LPAIF_SEC_CMD_RCGR_ADDR
    &clk_cfg_rcgr_addr=&HWIO_LPASS_LPAIF_SEC_CFG_RCGR_ADDR

    print "Choose frequency (MHz) from list below: " 

    print "0.512          0.768          1.024          " 
    print "1.536          2.048          3.072          " 
    print "4.096          6.144          8.192          " 
    print "12.288         24.576         " 

    print ""
    print "Enter desired frequency (r to return): "
    enter &clk_desired_freq
    print ""

    if ("&clk_desired_freq"=="0.512")
    (
      &clk_src_name="LPASS_LPAAUDIO_DIG_PLL_OUT_AUX"
      &clk_src_sel=SRC_SEL TODO.
      &clk_src_div=30.
      &clk_m_val=1.
      &clk_n_val=16.
      &clk_2d_val=16.
      
      gosub Set_Clock_Freq
      return
    )
    else if ("&clk_desired_freq"=="0.768")
    (
      &clk_src_name="LPASS_LPAAUDIO_DIG_PLL_OUT_AUX"
      &clk_src_sel=SRC_SEL TODO.
      &clk_src_div=20.
      &clk_m_val=1.
      &clk_n_val=16.
      &clk_2d_val=16.
      
      gosub Set_Clock_Freq
      return
    )
    else if ("&clk_desired_freq"=="1.024")
    (
      &clk_src_name="LPASS_LPAAUDIO_DIG_PLL_OUT_AUX"
      &clk_src_sel=SRC_SEL TODO.
      &clk_src_div=30.
      &clk_m_val=1.
      &clk_n_val=8.
      &clk_2d_val=8.
      
      gosub Set_Clock_Freq
      return
    )
    else if ("&clk_desired_freq"=="1.536")
    (
      &clk_src_name="LPASS_LPAAUDIO_DIG_PLL_OUT_AUX"
      &clk_src_sel=SRC_SEL TODO.
      &clk_src_div=20.
      &clk_m_val=1.
      &clk_n_val=8.
      &clk_2d_val=8.
      
      gosub Set_Clock_Freq
      return
    )
    else if ("&clk_desired_freq"=="2.048")
    (
      &clk_src_name="LPASS_LPAAUDIO_DIG_PLL_OUT_AUX"
      &clk_src_sel=SRC_SEL TODO.
      &clk_src_div=30.
      &clk_m_val=1.
      &clk_n_val=4.
      &clk_2d_val=4.
      
      gosub Set_Clock_Freq
      return
    )
    else if ("&clk_desired_freq"=="3.072")
    (
      &clk_src_name="LPASS_LPAAUDIO_DIG_PLL_OUT_AUX"
      &clk_src_sel=SRC_SEL TODO.
      &clk_src_div=20.
      &clk_m_val=1.
      &clk_n_val=4.
      &clk_2d_val=4.
      
      gosub Set_Clock_Freq
      return
    )
    else if ("&clk_desired_freq"=="4.096")
    (
      &clk_src_name="LPASS_LPAAUDIO_DIG_PLL_OUT_AUX"
      &clk_src_sel=SRC_SEL TODO.
      &clk_src_div=30.
      &clk_m_val=1.
      &clk_n_val=2.
      &clk_2d_val=2.
      
      gosub Set_Clock_Freq
      return
    )
    else if ("&clk_desired_freq"=="6.144")
    (
      &clk_src_name="LPASS_LPAAUDIO_DIG_PLL_OUT_AUX"
      &clk_src_sel=SRC_SEL TODO.
      &clk_src_div=20.
      &clk_m_val=1.
      &clk_n_val=2.
      &clk_2d_val=2.
      
      gosub Set_Clock_Freq
      return
    )
    else if ("&clk_desired_freq"=="8.192")
    (
      &clk_src_name="LPASS_LPAAUDIO_DIG_PLL_OUT_AUX"
      &clk_src_sel=SRC_SEL TODO.
      &clk_src_div=30.
      &clk_m_val=0.
      &clk_n_val=0.
      &clk_2d_val=0.
      
      gosub Set_Clock_Freq
      return
    )
    else if ("&clk_desired_freq"=="12.288")
    (
      &clk_src_name="LPASS_LPAAUDIO_DIG_PLL_OUT_AUX"
      &clk_src_sel=SRC_SEL TODO.
      &clk_src_div=20.
      &clk_m_val=0.
      &clk_n_val=0.
      &clk_2d_val=0.
      
      gosub Set_Clock_Freq
      return
    )
    else if ("&clk_desired_freq"=="24.576")
    (
      &clk_src_name="LPASS_LPAAUDIO_DIG_PLL_OUT_AUX"
      &clk_src_sel=SRC_SEL TODO.
      &clk_src_div=10.
      &clk_m_val=0.
      &clk_n_val=0.
      &clk_2d_val=0.
      
      gosub Set_Clock_Freq
      return
    )
    else if ("&clk_desired_freq"=="r")
    (
      return
    )
    else
    (
      print "Invalid selection."
      goto Set_Clock_Freq_Enter
    )
  )

  if ("&clk"=="lpaif_spkr_clk_src")||("&clk"=="audio_core_lpaif_codec_spkr_ibit_clk")||("&clk"=="audio_core_lpaif_codec_spkr_osr_clk")
  (
    gosub PRINT_SET_CLOCK_FREQ_WARNING

    &clk_cmd_rcgr_addr=&HWIO_LPASS_LPAIF_SPKR_CMD_RCGR_ADDR
    &clk_cfg_rcgr_addr=&HWIO_LPASS_LPAIF_SPKR_CFG_RCGR_ADDR

    print "Choose frequency (MHz) from list below: " 

    print "0.512          0.768          1.024          " 
    print "1.536          2.048          3.072          " 
    print "4.096          6.144          8.192          " 
    print "12.288         24.576         " 

    print ""
    print "Enter desired frequency (r to return): "
    enter &clk_desired_freq
    print ""

    if ("&clk_desired_freq"=="0.512")
    (
      &clk_src_name="LPASS_LPAAUDIO_DIG_PLL_OUT_AUX"
      &clk_src_sel=SRC_SEL TODO.
      &clk_src_div=30.
      &clk_m_val=1.
      &clk_n_val=16.
      &clk_2d_val=16.
      
      gosub Set_Clock_Freq
      return
    )
    else if ("&clk_desired_freq"=="0.768")
    (
      &clk_src_name="LPASS_LPAAUDIO_DIG_PLL_OUT_AUX"
      &clk_src_sel=SRC_SEL TODO.
      &clk_src_div=20.
      &clk_m_val=1.
      &clk_n_val=16.
      &clk_2d_val=16.
      
      gosub Set_Clock_Freq
      return
    )
    else if ("&clk_desired_freq"=="1.024")
    (
      &clk_src_name="LPASS_LPAAUDIO_DIG_PLL_OUT_AUX"
      &clk_src_sel=SRC_SEL TODO.
      &clk_src_div=30.
      &clk_m_val=1.
      &clk_n_val=8.
      &clk_2d_val=8.
      
      gosub Set_Clock_Freq
      return
    )
    else if ("&clk_desired_freq"=="1.536")
    (
      &clk_src_name="LPASS_LPAAUDIO_DIG_PLL_OUT_AUX"
      &clk_src_sel=SRC_SEL TODO.
      &clk_src_div=20.
      &clk_m_val=1.
      &clk_n_val=8.
      &clk_2d_val=8.
      
      gosub Set_Clock_Freq
      return
    )
    else if ("&clk_desired_freq"=="2.048")
    (
      &clk_src_name="LPASS_LPAAUDIO_DIG_PLL_OUT_AUX"
      &clk_src_sel=SRC_SEL TODO.
      &clk_src_div=30.
      &clk_m_val=1.
      &clk_n_val=4.
      &clk_2d_val=4.
      
      gosub Set_Clock_Freq
      return
    )
    else if ("&clk_desired_freq"=="3.072")
    (
      &clk_src_name="LPASS_LPAAUDIO_DIG_PLL_OUT_AUX"
      &clk_src_sel=SRC_SEL TODO.
      &clk_src_div=20.
      &clk_m_val=1.
      &clk_n_val=4.
      &clk_2d_val=4.
      
      gosub Set_Clock_Freq
      return
    )
    else if ("&clk_desired_freq"=="4.096")
    (
      &clk_src_name="LPASS_LPAAUDIO_DIG_PLL_OUT_AUX"
      &clk_src_sel=SRC_SEL TODO.
      &clk_src_div=30.
      &clk_m_val=1.
      &clk_n_val=2.
      &clk_2d_val=2.
      
      gosub Set_Clock_Freq
      return
    )
    else if ("&clk_desired_freq"=="6.144")
    (
      &clk_src_name="LPASS_LPAAUDIO_DIG_PLL_OUT_AUX"
      &clk_src_sel=SRC_SEL TODO.
      &clk_src_div=20.
      &clk_m_val=1.
      &clk_n_val=2.
      &clk_2d_val=2.
      
      gosub Set_Clock_Freq
      return
    )
    else if ("&clk_desired_freq"=="8.192")
    (
      &clk_src_name="LPASS_LPAAUDIO_DIG_PLL_OUT_AUX"
      &clk_src_sel=SRC_SEL TODO.
      &clk_src_div=30.
      &clk_m_val=0.
      &clk_n_val=0.
      &clk_2d_val=0.
      
      gosub Set_Clock_Freq
      return
    )
    else if ("&clk_desired_freq"=="12.288")
    (
      &clk_src_name="LPASS_LPAAUDIO_DIG_PLL_OUT_AUX"
      &clk_src_sel=SRC_SEL TODO.
      &clk_src_div=20.
      &clk_m_val=0.
      &clk_n_val=0.
      &clk_2d_val=0.
      
      gosub Set_Clock_Freq
      return
    )
    else if ("&clk_desired_freq"=="24.576")
    (
      &clk_src_name="LPASS_LPAAUDIO_DIG_PLL_OUT_AUX"
      &clk_src_sel=SRC_SEL TODO.
      &clk_src_div=10.
      &clk_m_val=0.
      &clk_n_val=0.
      &clk_2d_val=0.
      
      gosub Set_Clock_Freq
      return
    )
    else if ("&clk_desired_freq"=="r")
    (
      return
    )
    else
    (
      print "Invalid selection."
      goto Set_Clock_Freq_Enter
    )
  )

  if ("&clk"=="lpaif_ter_clk_src")||("&clk"=="audio_core_lpaif_ter_ibit_clk")
  (
    gosub PRINT_SET_CLOCK_FREQ_WARNING

    &clk_cmd_rcgr_addr=&HWIO_LPASS_LPAIF_TER_CMD_RCGR_ADDR
    &clk_cfg_rcgr_addr=&HWIO_LPASS_LPAIF_TER_CFG_RCGR_ADDR

    print "Choose frequency (MHz) from list below: " 

    print "0.512          0.768          1.024          " 
    print "1.536          2.048          3.072          " 
    print "4.096          6.144          8.192          " 
    print "12.288         24.576         " 

    print ""
    print "Enter desired frequency (r to return): "
    enter &clk_desired_freq
    print ""

    if ("&clk_desired_freq"=="0.512")
    (
      &clk_src_name="LPASS_LPAAUDIO_DIG_PLL_OUT_AUX"
      &clk_src_sel=SRC_SEL TODO.
      &clk_src_div=30.
      &clk_m_val=1.
      &clk_n_val=16.
      &clk_2d_val=16.
      
      gosub Set_Clock_Freq
      return
    )
    else if ("&clk_desired_freq"=="0.768")
    (
      &clk_src_name="LPASS_LPAAUDIO_DIG_PLL_OUT_AUX"
      &clk_src_sel=SRC_SEL TODO.
      &clk_src_div=20.
      &clk_m_val=1.
      &clk_n_val=16.
      &clk_2d_val=16.
      
      gosub Set_Clock_Freq
      return
    )
    else if ("&clk_desired_freq"=="1.024")
    (
      &clk_src_name="LPASS_LPAAUDIO_DIG_PLL_OUT_AUX"
      &clk_src_sel=SRC_SEL TODO.
      &clk_src_div=30.
      &clk_m_val=1.
      &clk_n_val=8.
      &clk_2d_val=8.
      
      gosub Set_Clock_Freq
      return
    )
    else if ("&clk_desired_freq"=="1.536")
    (
      &clk_src_name="LPASS_LPAAUDIO_DIG_PLL_OUT_AUX"
      &clk_src_sel=SRC_SEL TODO.
      &clk_src_div=20.
      &clk_m_val=1.
      &clk_n_val=8.
      &clk_2d_val=8.
      
      gosub Set_Clock_Freq
      return
    )
    else if ("&clk_desired_freq"=="2.048")
    (
      &clk_src_name="LPASS_LPAAUDIO_DIG_PLL_OUT_AUX"
      &clk_src_sel=SRC_SEL TODO.
      &clk_src_div=30.
      &clk_m_val=1.
      &clk_n_val=4.
      &clk_2d_val=4.
      
      gosub Set_Clock_Freq
      return
    )
    else if ("&clk_desired_freq"=="3.072")
    (
      &clk_src_name="LPASS_LPAAUDIO_DIG_PLL_OUT_AUX"
      &clk_src_sel=SRC_SEL TODO.
      &clk_src_div=20.
      &clk_m_val=1.
      &clk_n_val=4.
      &clk_2d_val=4.
      
      gosub Set_Clock_Freq
      return
    )
    else if ("&clk_desired_freq"=="4.096")
    (
      &clk_src_name="LPASS_LPAAUDIO_DIG_PLL_OUT_AUX"
      &clk_src_sel=SRC_SEL TODO.
      &clk_src_div=30.
      &clk_m_val=1.
      &clk_n_val=2.
      &clk_2d_val=2.
      
      gosub Set_Clock_Freq
      return
    )
    else if ("&clk_desired_freq"=="6.144")
    (
      &clk_src_name="LPASS_LPAAUDIO_DIG_PLL_OUT_AUX"
      &clk_src_sel=SRC_SEL TODO.
      &clk_src_div=20.
      &clk_m_val=1.
      &clk_n_val=2.
      &clk_2d_val=2.
      
      gosub Set_Clock_Freq
      return
    )
    else if ("&clk_desired_freq"=="8.192")
    (
      &clk_src_name="LPASS_LPAAUDIO_DIG_PLL_OUT_AUX"
      &clk_src_sel=SRC_SEL TODO.
      &clk_src_div=30.
      &clk_m_val=0.
      &clk_n_val=0.
      &clk_2d_val=0.
      
      gosub Set_Clock_Freq
      return
    )
    else if ("&clk_desired_freq"=="12.288")
    (
      &clk_src_name="LPASS_LPAAUDIO_DIG_PLL_OUT_AUX"
      &clk_src_sel=SRC_SEL TODO.
      &clk_src_div=20.
      &clk_m_val=0.
      &clk_n_val=0.
      &clk_2d_val=0.
      
      gosub Set_Clock_Freq
      return
    )
    else if ("&clk_desired_freq"=="24.576")
    (
      &clk_src_name="LPASS_LPAAUDIO_DIG_PLL_OUT_AUX"
      &clk_src_sel=SRC_SEL TODO.
      &clk_src_div=10.
      &clk_m_val=0.
      &clk_n_val=0.
      &clk_2d_val=0.
      
      gosub Set_Clock_Freq
      return
    )
    else if ("&clk_desired_freq"=="r")
    (
      return
    )
    else
    (
      print "Invalid selection."
      goto Set_Clock_Freq_Enter
    )
  )

  if 
  (
    gosub PRINT_SET_CLOCK_FREQ_WARNING

    &clk_cmd_rcgr_addr=&HWIO_LPASS_QDSP6SS_CORE_CMD_RCGR_ADDR
    &clk_cfg_rcgr_addr=&HWIO_LPASS_QDSP6SS_CORE_CFG_RCGR_ADDR

    print "Choose frequency (MHz) from list below: " 

    print "19.2           86.4           124.8          " 
    print "172.8          249.6          297.6          " 
    print "422.4          460.8          480.0          " 
    print "652.8          729.6          " 

    print ""
    print "Enter desired frequency (r to return): "
    enter &clk_desired_freq
    print ""

    if ("&clk_desired_freq"=="19.2")
    (
      &clk_src_name="Q6_XO_CLK_SRC"
      &clk_src_sel=SRC_SEL TODO.
      &clk_src_div=2.
      &clk_m_val=0.
      &clk_n_val=0.
      &clk_2d_val=0.
      
      gosub Set_Clock_Freq
      return
    )
    else if ("&clk_desired_freq"=="86.4")
    (
      &clk_src_name="LPASS_QDSP6SS_PLL_OUT_MAIN"
      &clk_src_sel=SRC_SEL TODO.
      &clk_src_div=8.
      &clk_m_val=0.
      &clk_n_val=0.
      &clk_2d_val=0.
      
      gosub Set_Clock_Freq
      return
    )
    else if ("&clk_desired_freq"=="124.8")
    (
      &clk_src_name="LPASS_QDSP6SS_PLL_OUT_MAIN"
      &clk_src_sel=SRC_SEL TODO.
      &clk_src_div=8.
      &clk_m_val=0.
      &clk_n_val=0.
      &clk_2d_val=0.
      
      gosub Set_Clock_Freq
      return
    )
    else if ("&clk_desired_freq"=="172.8")
    (
      &clk_src_name="LPASS_QDSP6SS_PLL_OUT_MAIN"
      &clk_src_sel=SRC_SEL TODO.
      &clk_src_div=4.
      &clk_m_val=0.
      &clk_n_val=0.
      &clk_2d_val=0.
      
      gosub Set_Clock_Freq
      return
    )
    else if ("&clk_desired_freq"=="249.6")
    (
      &clk_src_name="LPASS_QDSP6SS_PLL_OUT_MAIN"
      &clk_src_sel=SRC_SEL TODO.
      &clk_src_div=2.
      &clk_m_val=0.
      &clk_n_val=0.
      &clk_2d_val=0.
      
      gosub Set_Clock_Freq
      return
    )
    else if ("&clk_desired_freq"=="297.6")
    (
      &clk_src_name="LPASS_QDSP6SS_PLL_OUT_MAIN"
      &clk_src_sel=SRC_SEL TODO.
      &clk_src_div=4.
      &clk_m_val=0.
      &clk_n_val=0.
      &clk_2d_val=0.
      
      gosub Set_Clock_Freq
      return
    )
    else if ("&clk_desired_freq"=="422.4")
    (
      &clk_src_name="LPASS_QDSP6SS_PLL_OUT_MAIN"
      &clk_src_sel=SRC_SEL TODO.
      &clk_src_div=2.
      &clk_m_val=0.
      &clk_n_val=0.
      &clk_2d_val=0.
      
      gosub Set_Clock_Freq
      return
    )
    else if ("&clk_desired_freq"=="460.8")
    (
      &clk_src_name="LPASS_QDSP6SS_PLL_OUT_MAIN"
      &clk_src_sel=SRC_SEL TODO.
      &clk_src_div=4.
      &clk_m_val=0.
      &clk_n_val=0.
      &clk_2d_val=0.
      
      gosub Set_Clock_Freq
      return
    )
    else if ("&clk_desired_freq"=="480.0")
    (
      &clk_src_name="LPASS_QDSP6SS_PLL_OUT_MAIN"
      &clk_src_sel=SRC_SEL TODO.
      &clk_src_div=2.
      &clk_m_val=0.
      &clk_n_val=0.
      &clk_2d_val=0.
      
      gosub Set_Clock_Freq
      return
    )
    else if ("&clk_desired_freq"=="652.8")
    (
      &clk_src_name="LPASS_QDSP6SS_PLL_OUT_MAIN"
      &clk_src_sel=SRC_SEL TODO.
      &clk_src_div=2.
      &clk_m_val=0.
      &clk_n_val=0.
      &clk_2d_val=0.
      
      gosub Set_Clock_Freq
      return
    )
    else if ("&clk_desired_freq"=="729.6")
    (
      &clk_src_name="LPASS_QDSP6SS_PLL_OUT_MAIN"
      &clk_src_sel=SRC_SEL TODO.
      &clk_src_div=2.
      &clk_m_val=0.
      &clk_n_val=0.
      &clk_2d_val=0.
      
      gosub Set_Clock_Freq
      return
    )
    else if ("&clk_desired_freq"=="r")
    (
      return
    )
    else
    (
      print "Invalid selection."
      goto Set_Clock_Freq_Enter
    )
  )

  if ("&clk"=="qca_slimbus_clk_src")||("&clk"=="audio_core_qca_slimbus_clk")
  (
    gosub PRINT_SET_CLOCK_FREQ_WARNING

    &clk_cmd_rcgr_addr=&HWIO_LPASS_QCA_SLIMBUS_CMD_RCGR_ADDR
    &clk_cfg_rcgr_addr=&HWIO_LPASS_QCA_SLIMBUS_CFG_RCGR_ADDR

    print "Choose frequency (MHz) from list below: " 

    print "24.576         " 

    print ""
    print "Enter desired frequency (r to return): "
    enter &clk_desired_freq
    print ""

    if ("&clk_desired_freq"=="24.576")
    (
      &clk_src_name="LPASS_LPAAUDIO_DIG_PLL_OUT_AUX"
      &clk_src_sel=SRC_SEL TODO.
      &clk_src_div=10.
      &clk_m_val=0.
      &clk_n_val=0.
      &clk_2d_val=0.
      
      gosub Set_Clock_Freq
      return
    )
    else if ("&clk_desired_freq"=="r")
    (
      return
    )
    else
    (
      print "Invalid selection."
      goto Set_Clock_Freq_Enter
    )
  )

  if ("&clk"=="resampler_clk_src")||("&clk"=="audio_core_resampler_core_clk")
  (
    gosub PRINT_SET_CLOCK_FREQ_WARNING

    &clk_cmd_rcgr_addr=&HWIO_LPASS_RESAMPLER_CMD_RCGR_ADDR
    &clk_cfg_rcgr_addr=&HWIO_LPASS_RESAMPLER_CFG_RCGR_ADDR

    print "Choose frequency (MHz) from list below: " 

    print "19.2           76.8           76.8           " 
    print "153.6          307.2          " 

    print ""
    print "Enter desired frequency (r to return): "
    enter &clk_desired_freq
    print ""

    if ("&clk_desired_freq"=="19.2")
    (
      &clk_src_name="XO"
      &clk_src_sel=SRC_SEL TODO.
      &clk_src_div=2.
      &clk_m_val=0.
      &clk_n_val=0.
      &clk_2d_val=0.
      
      gosub Set_Clock_Freq
      return
    )
    else if ("&clk_desired_freq"=="76.8")
    (
      &clk_src_name="LPASS_LPAAUDIO_DIG_PLL_OUT_EARLY_SVS_CDIV"
      &clk_src_sel=SRC_SEL TODO.
      &clk_src_div=8.
      &clk_m_val=0.
      &clk_n_val=0.
      &clk_2d_val=0.
      
      gosub Set_Clock_Freq
      return
    )
    else if ("&clk_desired_freq"=="76.8")
    (
      &clk_src_name="LPASS_LPAAUDIO_DIG_PLL_OUT_EARLY_SVS_CDIV"
      &clk_src_sel=SRC_SEL TODO.
      &clk_src_div=8.
      &clk_m_val=0.
      &clk_n_val=0.
      &clk_2d_val=0.
      
      gosub Set_Clock_Freq
      return
    )
    else if ("&clk_desired_freq"=="153.6")
    (
      &clk_src_name="LPASS_LPAAUDIO_DIG_PLL_OUT_EARLY_SVS_CDIV"
      &clk_src_sel=SRC_SEL TODO.
      &clk_src_div=4.
      &clk_m_val=0.
      &clk_n_val=0.
      &clk_2d_val=0.
      
      gosub Set_Clock_Freq
      return
    )
    else if ("&clk_desired_freq"=="307.2")
    (
      &clk_src_name="LPASS_LPAAUDIO_DIG_PLL_OUT_EARLY_SVS_CDIV"
      &clk_src_sel=SRC_SEL TODO.
      &clk_src_div=2.
      &clk_m_val=0.
      &clk_n_val=0.
      &clk_2d_val=0.
      
      gosub Set_Clock_Freq
      return
    )
    else if ("&clk_desired_freq"=="r")
    (
      return
    )
    else
    (
      print "Invalid selection."
      goto Set_Clock_Freq_Enter
    )
  )

  if ("&clk"=="xo_clk_src")||("&clk"=="audio_core_avsync_stc_xo_clk")||("&clk"=="audio_core_gdsc_xo_clk")||("&clk"=="audio_wrapper_q6_smmu_gdsc_xo_clk")||("&clk"=="audio_wrapper_qos_xo_lat_counter_clk")||("&clk"=="q6ss_xo_clk")
  (
    gosub PRINT_SET_CLOCK_FREQ_WARNING

    &clk_cmd_rcgr_addr=&HWIO_LPASS_XO_CMD_RCGR_ADDR
    &clk_cfg_rcgr_addr=&HWIO_LPASS_XO_CFG_RCGR_ADDR

    print "Choose frequency (MHz) from list below: " 

    print "19.2           " 

    print ""
    print "Enter desired frequency (r to return): "
    enter &clk_desired_freq
    print ""

    if ("&clk_desired_freq"=="19.2")
    (
      &clk_src_name="XO"
      &clk_src_sel=SRC_SEL TODO.
      &clk_src_div=2.
      &clk_m_val=0.
      &clk_n_val=0.
      &clk_2d_val=0.
      
      gosub Set_Clock_Freq
      return
    )
    else if ("&clk_desired_freq"=="r")
    (
      return
    )
    else
    (
      print "Invalid selection."
      goto Set_Clock_Freq_Enter
    )
  )

  if ("&clk"=="camss_ahb_clk")||("&clk"=="camss_cci_ahb_clk")||("&clk"=="camss_cpp_ahb_clk")||("&clk"=="camss_cpp_vbif_ahb_clk")||("&clk"=="camss_csi0_ahb_clk")||("&clk"=="camss_csi1_ahb_clk")||("&clk"=="camss_csi2_ahb_clk")||("&clk"=="camss_csi3_ahb_clk")||("&clk"=="camss_ispif_ahb_clk")||("&clk"=="camss_jpeg_ahb_clk")||("&clk"=="camss_micro_ahb_clk")||("&clk"=="camss_top_ahb_clk")||("&clk"=="camss_vfe0_ahb_clk")||("&clk"=="camss_vfe1_ahb_clk")||("&clk"=="camss_vfe_ahb_clk")||("&clk"=="fd_ahb_clk")||("&clk"=="gpu_ahb_clk")||("&clk"=="mdss_ahb_clk")||("&clk"=="mdss_hdmi_ahb_clk")||("&clk"=="mmss_bto_ahb_clk")||("&clk"=="mmss_misc_ahb_clk")||("&clk"=="mmss_mmagic_ahb_clk")||("&clk"=="mmss_mmagic_cfg_ahb_clk")||("&clk"=="mmss_rbcpr_ahb_clk")||("&clk"=="mmss_spdm_ahb_clk")||("&clk"=="smmu_cpp_ahb_clk")||("&clk"=="smmu_jpeg_ahb_clk")||("&clk"=="smmu_mdp_ahb_clk")||("&clk"=="smmu_rot_ahb_clk")||("&clk"=="smmu_vfe_ahb_clk")||("&clk"=="smmu_video_ahb_clk")||("&clk"=="throttle_camss_ahb_clk")||("&clk"=="throttle_mdss_ahb_clk")||("&clk"=="throttle_video_ahb_clk")||("&clk"=="video_ahb_clk")||("&clk"=="vmem_ahb_clk")
  (
    gosub PRINT_SET_CLOCK_FREQ_WARNING

    &clk_cmd_rcgr_addr=&HWIO_MMSS_AHB_CMD_RCGR_ADDR
    &clk_cfg_rcgr_addr=&HWIO_MMSS_AHB_CFG_RCGR_ADDR

    print "Choose frequency (MHz) from list below: " 

    print "19.2           40.0           80.0           " 
    print "80.0           " 

    print ""
    print "Enter desired frequency (r to return): "
    enter &clk_desired_freq
    print ""

    if ("&clk_desired_freq"=="19.2")
    (
      &clk_src_name="XO"
      &clk_src_sel=SRC_SEL TODO.
      &clk_src_div=2.
      &clk_m_val=0.
      &clk_n_val=0.
      &clk_2d_val=0.
      
      gosub Set_Clock_Freq
      return
    )
    else if ("&clk_desired_freq"=="40.0")
    (
      &clk_src_name="EXTERNAL"
      &clk_src_sel=SRC_SEL TODO.
      &clk_src_div=2.
      &clk_m_val=0.
      &clk_n_val=0.
      &clk_2d_val=0.
      
      gosub Set_Clock_Freq
      return
    )
    else if ("&clk_desired_freq"=="80.0")
    (
      &clk_src_name="MMPLL0_PLL_OUT_MAIN"
      &clk_src_sel=SRC_SEL TODO.
      &clk_src_div=20.
      &clk_m_val=0.
      &clk_n_val=0.
      &clk_2d_val=0.
      
      gosub Set_Clock_Freq
      return
    )
    else if ("&clk_desired_freq"=="80.0")
    (
      &clk_src_name="EXTERNAL"
      &clk_src_sel=SRC_SEL TODO.
      &clk_src_div=2.
      &clk_m_val=0.
      &clk_n_val=0.
      &clk_2d_val=0.
      
      gosub Set_Clock_Freq
      return
    )
    else if ("&clk_desired_freq"=="r")
    (
      return
    )
    else
    (
      print "Invalid selection."
      goto Set_Clock_Freq_Enter
    )
  )

  if ("&clk"=="camss_cpp_axi_clk")||("&clk"=="camss_jpeg_axi_clk")||("&clk"=="camss_vfe_axi_clk")||("&clk"=="mdss_axi_clk")||("&clk"=="mmagic_bimc_axi_clk")||("&clk"=="mmagic_camss_axi_clk")||("&clk"=="mmagic_mdss_axi_clk")||("&clk"=="mmagic_video_axi_clk")||("&clk"=="mmss_mmagic_axi_clk")||("&clk"=="mmss_s0_axi_clk")||("&clk"=="mmss_spdm_axi_clk")||("&clk"=="mmss_spdm_rm_axi_clk")||("&clk"=="smmu_cpp_axi_clk")||("&clk"=="smmu_jpeg_axi_clk")||("&clk"=="smmu_mdp_axi_clk")||("&clk"=="smmu_rot_axi_clk")||("&clk"=="smmu_vfe_axi_clk")||("&clk"=="smmu_video_axi_clk")||("&clk"=="throttle_camss_axi_clk")||("&clk"=="throttle_mdss_axi_clk")||("&clk"=="throttle_video_axi_clk")||("&clk"=="video_axi_clk")
  (
    gosub PRINT_SET_CLOCK_FREQ_WARNING

    &clk_cmd_rcgr_addr=&HWIO_MMSS_AXI_CMD_RCGR_ADDR
    &clk_cfg_rcgr_addr=&HWIO_MMSS_AXI_CFG_RCGR_ADDR

    print "Choose frequency (MHz) from list below: " 

    print "75.0           100.0          171.428571     " 
    print "200.0          320.0          320.0          " 
    print "400.0          405.0          " 

    print ""
    print "Enter desired frequency (r to return): "
    enter &clk_desired_freq
    print ""

    if ("&clk_desired_freq"=="75.0")
    (
      &clk_src_name="EXTERNAL"
      &clk_src_sel=SRC_SEL TODO.
      &clk_src_div=2.
      &clk_m_val=0.
      &clk_n_val=0.
      &clk_2d_val=0.
      
      gosub Set_Clock_Freq
      return
    )
    else if ("&clk_desired_freq"=="100.0")
    (
      &clk_src_name="GPLL0_OUT_MAIN"
      &clk_src_sel=SRC_SEL TODO.
      &clk_src_div=12.
      &clk_m_val=0.
      &clk_n_val=0.
      &clk_2d_val=0.
      
      gosub Set_Clock_Freq
      return
    )
    else if ("&clk_desired_freq"=="171.428571")
    (
      &clk_src_name="EXTERNAL"
      &clk_src_sel=SRC_SEL TODO.
      &clk_src_div=2.
      &clk_m_val=0.
      &clk_n_val=0.
      &clk_2d_val=0.
      
      gosub Set_Clock_Freq
      return
    )
    else if ("&clk_desired_freq"=="200.0")
    (
      &clk_src_name="GPLL0_OUT_MAIN"
      &clk_src_sel=SRC_SEL TODO.
      &clk_src_div=6.
      &clk_m_val=0.
      &clk_n_val=0.
      &clk_2d_val=0.
      
      gosub Set_Clock_Freq
      return
    )
    else if ("&clk_desired_freq"=="320.0")
    (
      &clk_src_name="MMPLL0_PLL_OUT_MAIN"
      &clk_src_sel=SRC_SEL TODO.
      &clk_src_div=5.
      &clk_m_val=0.
      &clk_n_val=0.
      &clk_2d_val=0.
      
      gosub Set_Clock_Freq
      return
    )
    else if ("&clk_desired_freq"=="320.0")
    (
      &clk_src_name="EXTERNAL"
      &clk_src_sel=SRC_SEL TODO.
      &clk_src_div=2.
      &clk_m_val=0.
      &clk_n_val=0.
      &clk_2d_val=0.
      
      gosub Set_Clock_Freq
      return
    )
    else if ("&clk_desired_freq"=="400.0")
    (
      &clk_src_name="MMPLL0_PLL_OUT_MAIN"
      &clk_src_sel=SRC_SEL TODO.
      &clk_src_div=4.
      &clk_m_val=0.
      &clk_n_val=0.
      &clk_2d_val=0.
      
      gosub Set_Clock_Freq
      return
    )
    else if ("&clk_desired_freq"=="405.0")
    (
      &clk_src_name="EXTERNAL"
      &clk_src_sel=SRC_SEL TODO.
      &clk_src_div=2.
      &clk_m_val=0.
      &clk_n_val=0.
      &clk_2d_val=0.
      
      gosub Set_Clock_Freq
      return
    )
    else if ("&clk_desired_freq"=="r")
    (
      return
    )
    else
    (
      print "Invalid selection."
      goto Set_Clock_Freq_Enter
    )
  )

  if ("&clk"=="mdss_byte0_clk")
  (
    gosub PRINT_SET_CLOCK_FREQ_WARNING

    &clk_cmd_rcgr_addr=&HWIO_MMSS_BYTE0_CMD_RCGR_ADDR
    &clk_cfg_rcgr_addr=&HWIO_MMSS_BYTE0_CFG_RCGR_ADDR

    print "Choose frequency (MHz) from list below: " 

    print "131.25         210.0          262.5          " 

    print ""
    print "Enter desired frequency (r to return): "
    enter &clk_desired_freq
    print ""

    if ("&clk_desired_freq"=="131.25")
    (
      &clk_src_name="EXTERNAL"
      &clk_src_sel=SRC_SEL TODO.
      &clk_src_div=2.
      &clk_m_val=0.
      &clk_n_val=0.
      &clk_2d_val=0.
      
      gosub Set_Clock_Freq
      return
    )
    else if ("&clk_desired_freq"=="210.0")
    (
      &clk_src_name="EXTERNAL"
      &clk_src_sel=SRC_SEL TODO.
      &clk_src_div=2.
      &clk_m_val=0.
      &clk_n_val=0.
      &clk_2d_val=0.
      
      gosub Set_Clock_Freq
      return
    )
    else if ("&clk_desired_freq"=="262.5")
    (
      &clk_src_name="EXTERNAL"
      &clk_src_sel=SRC_SEL TODO.
      &clk_src_div=2.
      &clk_m_val=0.
      &clk_n_val=0.
      &clk_2d_val=0.
      
      gosub Set_Clock_Freq
      return
    )
    else if ("&clk_desired_freq"=="r")
    (
      return
    )
    else
    (
      print "Invalid selection."
      goto Set_Clock_Freq_Enter
    )
  )

  if ("&clk"=="mdss_byte1_clk")
  (
    gosub PRINT_SET_CLOCK_FREQ_WARNING

    &clk_cmd_rcgr_addr=&HWIO_MMSS_BYTE1_CMD_RCGR_ADDR
    &clk_cfg_rcgr_addr=&HWIO_MMSS_BYTE1_CFG_RCGR_ADDR

    print "Choose frequency (MHz) from list below: " 

    print "131.25         210.0          262.5          " 

    print ""
    print "Enter desired frequency (r to return): "
    enter &clk_desired_freq
    print ""

    if ("&clk_desired_freq"=="131.25")
    (
      &clk_src_name="EXTERNAL"
      &clk_src_sel=SRC_SEL TODO.
      &clk_src_div=2.
      &clk_m_val=0.
      &clk_n_val=0.
      &clk_2d_val=0.
      
      gosub Set_Clock_Freq
      return
    )
    else if ("&clk_desired_freq"=="210.0")
    (
      &clk_src_name="EXTERNAL"
      &clk_src_sel=SRC_SEL TODO.
      &clk_src_div=2.
      &clk_m_val=0.
      &clk_n_val=0.
      &clk_2d_val=0.
      
      gosub Set_Clock_Freq
      return
    )
    else if ("&clk_desired_freq"=="262.5")
    (
      &clk_src_name="EXTERNAL"
      &clk_src_sel=SRC_SEL TODO.
      &clk_src_div=2.
      &clk_m_val=0.
      &clk_n_val=0.
      &clk_2d_val=0.
      
      gosub Set_Clock_Freq
      return
    )
    else if ("&clk_desired_freq"=="r")
    (
      return
    )
    else
    (
      print "Invalid selection."
      goto Set_Clock_Freq_Enter
    )
  )

  if ("&clk"=="camss_gp0_clk")
  (
    gosub PRINT_SET_CLOCK_FREQ_WARNING

    &clk_cmd_rcgr_addr=&HWIO_MMSS_CAMSS_GP0_CMD_RCGR_ADDR
    &clk_cfg_rcgr_addr=&HWIO_MMSS_CAMSS_GP0_CFG_RCGR_ADDR

    print "Choose frequency (MHz) from list below: " 

    print "0.01           0.024          50.0           " 
    print "100.0          200.0          " 

    print ""
    print "Enter desired frequency (r to return): "
    enter &clk_desired_freq
    print ""

    if ("&clk_desired_freq"=="0.01")
    (
      &clk_src_name="XO"
      &clk_src_sel=SRC_SEL TODO.
      &clk_src_div=32.
      &clk_m_val=1.
      &clk_n_val=120.
      &clk_2d_val=120.
      
      gosub Set_Clock_Freq
      return
    )
    else if ("&clk_desired_freq"=="0.024")
    (
      &clk_src_name="XO"
      &clk_src_sel=SRC_SEL TODO.
      &clk_src_div=32.
      &clk_m_val=1.
      &clk_n_val=50.
      &clk_2d_val=50.
      
      gosub Set_Clock_Freq
      return
    )
    else if ("&clk_desired_freq"=="50.0")
    (
      &clk_src_name="EXTERNAL"
      &clk_src_sel=SRC_SEL TODO.
      &clk_src_div=2.
      &clk_m_val=0.
      &clk_n_val=0.
      &clk_2d_val=0.
      
      gosub Set_Clock_Freq
      return
    )
    else if ("&clk_desired_freq"=="100.0")
    (
      &clk_src_name="EXTERNAL"
      &clk_src_sel=SRC_SEL TODO.
      &clk_src_div=2.
      &clk_m_val=0.
      &clk_n_val=0.
      &clk_2d_val=0.
      
      gosub Set_Clock_Freq
      return
    )
    else if ("&clk_desired_freq"=="200.0")
    (
      &clk_src_name="EXTERNAL"
      &clk_src_sel=SRC_SEL TODO.
      &clk_src_div=2.
      &clk_m_val=0.
      &clk_n_val=0.
      &clk_2d_val=0.
      
      gosub Set_Clock_Freq
      return
    )
    else if ("&clk_desired_freq"=="r")
    (
      return
    )
    else
    (
      print "Invalid selection."
      goto Set_Clock_Freq_Enter
    )
  )

  if ("&clk"=="camss_gp1_clk")
  (
    gosub PRINT_SET_CLOCK_FREQ_WARNING

    &clk_cmd_rcgr_addr=&HWIO_MMSS_CAMSS_GP1_CMD_RCGR_ADDR
    &clk_cfg_rcgr_addr=&HWIO_MMSS_CAMSS_GP1_CFG_RCGR_ADDR

    print "Choose frequency (MHz) from list below: " 

    print "0.01           0.024          50.0           " 
    print "100.0          200.0          " 

    print ""
    print "Enter desired frequency (r to return): "
    enter &clk_desired_freq
    print ""

    if ("&clk_desired_freq"=="0.01")
    (
      &clk_src_name="XO"
      &clk_src_sel=SRC_SEL TODO.
      &clk_src_div=32.
      &clk_m_val=1.
      &clk_n_val=120.
      &clk_2d_val=120.
      
      gosub Set_Clock_Freq
      return
    )
    else if ("&clk_desired_freq"=="0.024")
    (
      &clk_src_name="XO"
      &clk_src_sel=SRC_SEL TODO.
      &clk_src_div=32.
      &clk_m_val=1.
      &clk_n_val=50.
      &clk_2d_val=50.
      
      gosub Set_Clock_Freq
      return
    )
    else if ("&clk_desired_freq"=="50.0")
    (
      &clk_src_name="EXTERNAL"
      &clk_src_sel=SRC_SEL TODO.
      &clk_src_div=2.
      &clk_m_val=0.
      &clk_n_val=0.
      &clk_2d_val=0.
      
      gosub Set_Clock_Freq
      return
    )
    else if ("&clk_desired_freq"=="100.0")
    (
      &clk_src_name="EXTERNAL"
      &clk_src_sel=SRC_SEL TODO.
      &clk_src_div=2.
      &clk_m_val=0.
      &clk_n_val=0.
      &clk_2d_val=0.
      
      gosub Set_Clock_Freq
      return
    )
    else if ("&clk_desired_freq"=="200.0")
    (
      &clk_src_name="EXTERNAL"
      &clk_src_sel=SRC_SEL TODO.
      &clk_src_div=2.
      &clk_m_val=0.
      &clk_n_val=0.
      &clk_2d_val=0.
      
      gosub Set_Clock_Freq
      return
    )
    else if ("&clk_desired_freq"=="r")
    (
      return
    )
    else
    (
      print "Invalid selection."
      goto Set_Clock_Freq_Enter
    )
  )

  if ("&clk"=="camss_cci_clk")
  (
    gosub PRINT_SET_CLOCK_FREQ_WARNING

    &clk_cmd_rcgr_addr=&HWIO_MMSS_CCI_CMD_RCGR_ADDR
    &clk_cfg_rcgr_addr=&HWIO_MMSS_CCI_CFG_RCGR_ADDR

    print "Choose frequency (MHz) from list below: " 

    print "19.2           19.2           50.0           " 
    print "50.0           100.0          100.0          " 

    print ""
    print "Enter desired frequency (r to return): "
    enter &clk_desired_freq
    print ""

    if ("&clk_desired_freq"=="19.2")
    (
      &clk_src_name="XO"
      &clk_src_sel=SRC_SEL TODO.
      &clk_src_div=2.
      &clk_m_val=0.
      &clk_n_val=0.
      &clk_2d_val=0.
      
      gosub Set_Clock_Freq
      return
    )
    else if ("&clk_desired_freq"=="19.2")
    (
      &clk_src_name="EXTERNAL"
      &clk_src_sel=SRC_SEL TODO.
      &clk_src_div=2.
      &clk_m_val=0.
      &clk_n_val=0.
      &clk_2d_val=0.
      
      gosub Set_Clock_Freq
      return
    )
    else if ("&clk_desired_freq"=="50.0")
    (
      &clk_src_name="GPLL0_OUT_MAIN"
      &clk_src_sel=SRC_SEL TODO.
      &clk_src_div=24.
      &clk_m_val=0.
      &clk_n_val=0.
      &clk_2d_val=0.
      
      gosub Set_Clock_Freq
      return
    )
    else if ("&clk_desired_freq"=="50.0")
    (
      &clk_src_name="EXTERNAL"
      &clk_src_sel=SRC_SEL TODO.
      &clk_src_div=2.
      &clk_m_val=0.
      &clk_n_val=0.
      &clk_2d_val=0.
      
      gosub Set_Clock_Freq
      return
    )
    else if ("&clk_desired_freq"=="100.0")
    (
      &clk_src_name="GPLL0_OUT_MAIN"
      &clk_src_sel=SRC_SEL TODO.
      &clk_src_div=12.
      &clk_m_val=0.
      &clk_n_val=0.
      &clk_2d_val=0.
      
      gosub Set_Clock_Freq
      return
    )
    else if ("&clk_desired_freq"=="100.0")
    (
      &clk_src_name="EXTERNAL"
      &clk_src_sel=SRC_SEL TODO.
      &clk_src_div=2.
      &clk_m_val=0.
      &clk_n_val=0.
      &clk_2d_val=0.
      
      gosub Set_Clock_Freq
      return
    )
    else if ("&clk_desired_freq"=="r")
    (
      return
    )
    else
    (
      print "Invalid selection."
      goto Set_Clock_Freq_Enter
    )
  )

  if ("&clk"=="camss_cpp_clk")||("&clk"=="mmss_spdm_cpp_clk")
  (
    gosub PRINT_SET_CLOCK_FREQ_WARNING

    &clk_cmd_rcgr_addr=&HWIO_MMSS_CPP_CMD_RCGR_ADDR
    &clk_cfg_rcgr_addr=&HWIO_MMSS_CPP_CFG_RCGR_ADDR

    print "Choose frequency (MHz) from list below: " 

    print "100.0          200.0          200.0          " 
    print "320.0          480.0          480.0          " 
    print "640.0          640.0          " 

    print ""
    print "Enter desired frequency (r to return): "
    enter &clk_desired_freq
    print ""

    if ("&clk_desired_freq"=="100.0")
    (
      &clk_src_name="EXTERNAL"
      &clk_src_sel=SRC_SEL TODO.
      &clk_src_div=2.
      &clk_m_val=0.
      &clk_n_val=0.
      &clk_2d_val=0.
      
      gosub Set_Clock_Freq
      return
    )
    else if ("&clk_desired_freq"=="200.0")
    (
      &clk_src_name="GPLL0_OUT_MAIN"
      &clk_src_sel=SRC_SEL TODO.
      &clk_src_div=6.
      &clk_m_val=0.
      &clk_n_val=0.
      &clk_2d_val=0.
      
      gosub Set_Clock_Freq
      return
    )
    else if ("&clk_desired_freq"=="200.0")
    (
      &clk_src_name="EXTERNAL"
      &clk_src_sel=SRC_SEL TODO.
      &clk_src_div=2.
      &clk_m_val=0.
      &clk_n_val=0.
      &clk_2d_val=0.
      
      gosub Set_Clock_Freq
      return
    )
    else if ("&clk_desired_freq"=="320.0")
    (
      &clk_src_name="MMPLL0_PLL_OUT_MAIN"
      &clk_src_sel=SRC_SEL TODO.
      &clk_src_div=5.
      &clk_m_val=0.
      &clk_n_val=0.
      &clk_2d_val=0.
      
      gosub Set_Clock_Freq
      return
    )
    else if ("&clk_desired_freq"=="480.0")
    (
      &clk_src_name="MMPLL4_PLL_OUT_MAIN"
      &clk_src_sel=SRC_SEL TODO.
      &clk_src_div=4.
      &clk_m_val=0.
      &clk_n_val=0.
      &clk_2d_val=0.
      
      gosub Set_Clock_Freq
      return
    )
    else if ("&clk_desired_freq"=="480.0")
    (
      &clk_src_name="EXTERNAL"
      &clk_src_sel=SRC_SEL TODO.
      &clk_src_div=2.
      &clk_m_val=0.
      &clk_n_val=0.
      &clk_2d_val=0.
      
      gosub Set_Clock_Freq
      return
    )
    else if ("&clk_desired_freq"=="640.0")
    (
      &clk_src_name="MMPLL4_PLL_OUT_MAIN"
      &clk_src_sel=SRC_SEL TODO.
      &clk_src_div=3.
      &clk_m_val=0.
      &clk_n_val=0.
      &clk_2d_val=0.
      
      gosub Set_Clock_Freq
      return
    )
    else if ("&clk_desired_freq"=="640.0")
    (
      &clk_src_name="EXTERNAL"
      &clk_src_sel=SRC_SEL TODO.
      &clk_src_div=2.
      &clk_m_val=0.
      &clk_n_val=0.
      &clk_2d_val=0.
      
      gosub Set_Clock_Freq
      return
    )
    else if ("&clk_desired_freq"=="r")
    (
      return
    )
    else
    (
      print "Invalid selection."
      goto Set_Clock_Freq_Enter
    )
  )

  if ("&clk"=="camss_csi0_clk")||("&clk"=="camss_csi0phy_clk")||("&clk"=="camss_csi0pix_clk")||("&clk"=="camss_csi0rdi_clk")||("&clk"=="mmss_spdm_csi0_clk")
  (
    gosub PRINT_SET_CLOCK_FREQ_WARNING

    &clk_cmd_rcgr_addr=&HWIO_MMSS_CSI0_CMD_RCGR_ADDR
    &clk_cfg_rcgr_addr=&HWIO_MMSS_CSI0_CFG_RCGR_ADDR

    print "Choose frequency (MHz) from list below: " 

    print "100.0          200.0          200.0          " 
    print "480.0          480.0          600.0          " 
    print "600.0          " 

    print ""
    print "Enter desired frequency (r to return): "
    enter &clk_desired_freq
    print ""

    if ("&clk_desired_freq"=="100.0")
    (
      &clk_src_name="EXTERNAL"
      &clk_src_sel=SRC_SEL TODO.
      &clk_src_div=2.
      &clk_m_val=0.
      &clk_n_val=0.
      &clk_2d_val=0.
      
      gosub Set_Clock_Freq
      return
    )
    else if ("&clk_desired_freq"=="200.0")
    (
      &clk_src_name="GPLL0_OUT_MAIN"
      &clk_src_sel=SRC_SEL TODO.
      &clk_src_div=6.
      &clk_m_val=0.
      &clk_n_val=0.
      &clk_2d_val=0.
      
      gosub Set_Clock_Freq
      return
    )
    else if ("&clk_desired_freq"=="200.0")
    (
      &clk_src_name="EXTERNAL"
      &clk_src_sel=SRC_SEL TODO.
      &clk_src_div=2.
      &clk_m_val=0.
      &clk_n_val=0.
      &clk_2d_val=0.
      
      gosub Set_Clock_Freq
      return
    )
    else if ("&clk_desired_freq"=="480.0")
    (
      &clk_src_name="MMPLL4_PLL_OUT_MAIN"
      &clk_src_sel=SRC_SEL TODO.
      &clk_src_div=4.
      &clk_m_val=0.
      &clk_n_val=0.
      &clk_2d_val=0.
      
      gosub Set_Clock_Freq
      return
    )
    else if ("&clk_desired_freq"=="480.0")
    (
      &clk_src_name="EXTERNAL"
      &clk_src_sel=SRC_SEL TODO.
      &clk_src_div=2.
      &clk_m_val=0.
      &clk_n_val=0.
      &clk_2d_val=0.
      
      gosub Set_Clock_Freq
      return
    )
    else if ("&clk_desired_freq"=="600.0")
    (
      &clk_src_name="GPLL0_OUT_MAIN"
      &clk_src_sel=SRC_SEL TODO.
      &clk_src_div=2.
      &clk_m_val=0.
      &clk_n_val=0.
      &clk_2d_val=0.
      
      gosub Set_Clock_Freq
      return
    )
    else if ("&clk_desired_freq"=="600.0")
    (
      &clk_src_name="EXTERNAL"
      &clk_src_sel=SRC_SEL TODO.
      &clk_src_div=2.
      &clk_m_val=0.
      &clk_n_val=0.
      &clk_2d_val=0.
      
      gosub Set_Clock_Freq
      return
    )
    else if ("&clk_desired_freq"=="r")
    (
      return
    )
    else
    (
      print "Invalid selection."
      goto Set_Clock_Freq_Enter
    )
  )

  if ("&clk"=="camss_csi0phytimer_clk")
  (
    gosub PRINT_SET_CLOCK_FREQ_WARNING

    &clk_cmd_rcgr_addr=&HWIO_MMSS_CSI0PHYTIMER_CMD_RCGR_ADDR
    &clk_cfg_rcgr_addr=&HWIO_MMSS_CSI0PHYTIMER_CFG_RCGR_ADDR

    print "Choose frequency (MHz) from list below: " 

    print "100.0          200.0          266.666667     " 
    print "266.666667     " 

    print ""
    print "Enter desired frequency (r to return): "
    enter &clk_desired_freq
    print ""

    if ("&clk_desired_freq"=="100.0")
    (
      &clk_src_name="EXTERNAL"
      &clk_src_sel=SRC_SEL TODO.
      &clk_src_div=2.
      &clk_m_val=0.
      &clk_n_val=0.
      &clk_2d_val=0.
      
      gosub Set_Clock_Freq
      return
    )
    else if ("&clk_desired_freq"=="200.0")
    (
      &clk_src_name="MMPLL0_PLL_OUT_MAIN"
      &clk_src_sel=SRC_SEL TODO.
      &clk_src_div=8.
      &clk_m_val=0.
      &clk_n_val=0.
      &clk_2d_val=0.
      
      gosub Set_Clock_Freq
      return
    )
    else if ("&clk_desired_freq"=="266.666667")
    (
      &clk_src_name="MMPLL0_PLL_OUT_MAIN"
      &clk_src_sel=SRC_SEL TODO.
      &clk_src_div=6.
      &clk_m_val=0.
      &clk_n_val=0.
      &clk_2d_val=0.
      
      gosub Set_Clock_Freq
      return
    )
    else if ("&clk_desired_freq"=="266.666667")
    (
      &clk_src_name="EXTERNAL"
      &clk_src_sel=SRC_SEL TODO.
      &clk_src_div=2.
      &clk_m_val=0.
      &clk_n_val=0.
      &clk_2d_val=0.
      
      gosub Set_Clock_Freq
      return
    )
    else if ("&clk_desired_freq"=="r")
    (
      return
    )
    else
    (
      print "Invalid selection."
      goto Set_Clock_Freq_Enter
    )
  )

  if ("&clk"=="camss_csi1_clk")||("&clk"=="camss_csi1phy_clk")||("&clk"=="camss_csi1pix_clk")||("&clk"=="camss_csi1rdi_clk")
  (
    gosub PRINT_SET_CLOCK_FREQ_WARNING

    &clk_cmd_rcgr_addr=&HWIO_MMSS_CSI1_CMD_RCGR_ADDR
    &clk_cfg_rcgr_addr=&HWIO_MMSS_CSI1_CFG_RCGR_ADDR

    print "Choose frequency (MHz) from list below: " 

    print "100.0          200.0          200.0          " 
    print "480.0          480.0          600.0          " 
    print "600.0          " 

    print ""
    print "Enter desired frequency (r to return): "
    enter &clk_desired_freq
    print ""

    if ("&clk_desired_freq"=="100.0")
    (
      &clk_src_name="EXTERNAL"
      &clk_src_sel=SRC_SEL TODO.
      &clk_src_div=2.
      &clk_m_val=0.
      &clk_n_val=0.
      &clk_2d_val=0.
      
      gosub Set_Clock_Freq
      return
    )
    else if ("&clk_desired_freq"=="200.0")
    (
      &clk_src_name="GPLL0_OUT_MAIN"
      &clk_src_sel=SRC_SEL TODO.
      &clk_src_div=6.
      &clk_m_val=0.
      &clk_n_val=0.
      &clk_2d_val=0.
      
      gosub Set_Clock_Freq
      return
    )
    else if ("&clk_desired_freq"=="200.0")
    (
      &clk_src_name="EXTERNAL"
      &clk_src_sel=SRC_SEL TODO.
      &clk_src_div=2.
      &clk_m_val=0.
      &clk_n_val=0.
      &clk_2d_val=0.
      
      gosub Set_Clock_Freq
      return
    )
    else if ("&clk_desired_freq"=="480.0")
    (
      &clk_src_name="MMPLL4_PLL_OUT_MAIN"
      &clk_src_sel=SRC_SEL TODO.
      &clk_src_div=4.
      &clk_m_val=0.
      &clk_n_val=0.
      &clk_2d_val=0.
      
      gosub Set_Clock_Freq
      return
    )
    else if ("&clk_desired_freq"=="480.0")
    (
      &clk_src_name="EXTERNAL"
      &clk_src_sel=SRC_SEL TODO.
      &clk_src_div=2.
      &clk_m_val=0.
      &clk_n_val=0.
      &clk_2d_val=0.
      
      gosub Set_Clock_Freq
      return
    )
    else if ("&clk_desired_freq"=="600.0")
    (
      &clk_src_name="GPLL0_OUT_MAIN"
      &clk_src_sel=SRC_SEL TODO.
      &clk_src_div=2.
      &clk_m_val=0.
      &clk_n_val=0.
      &clk_2d_val=0.
      
      gosub Set_Clock_Freq
      return
    )
    else if ("&clk_desired_freq"=="600.0")
    (
      &clk_src_name="EXTERNAL"
      &clk_src_sel=SRC_SEL TODO.
      &clk_src_div=2.
      &clk_m_val=0.
      &clk_n_val=0.
      &clk_2d_val=0.
      
      gosub Set_Clock_Freq
      return
    )
    else if ("&clk_desired_freq"=="r")
    (
      return
    )
    else
    (
      print "Invalid selection."
      goto Set_Clock_Freq_Enter
    )
  )

  if ("&clk"=="camss_csi1phytimer_clk")
  (
    gosub PRINT_SET_CLOCK_FREQ_WARNING

    &clk_cmd_rcgr_addr=&HWIO_MMSS_CSI1PHYTIMER_CMD_RCGR_ADDR
    &clk_cfg_rcgr_addr=&HWIO_MMSS_CSI1PHYTIMER_CFG_RCGR_ADDR

    print "Choose frequency (MHz) from list below: " 

    print "100.0          200.0          266.666667     " 
    print "266.666667     " 

    print ""
    print "Enter desired frequency (r to return): "
    enter &clk_desired_freq
    print ""

    if ("&clk_desired_freq"=="100.0")
    (
      &clk_src_name="EXTERNAL"
      &clk_src_sel=SRC_SEL TODO.
      &clk_src_div=2.
      &clk_m_val=0.
      &clk_n_val=0.
      &clk_2d_val=0.
      
      gosub Set_Clock_Freq
      return
    )
    else if ("&clk_desired_freq"=="200.0")
    (
      &clk_src_name="MMPLL0_PLL_OUT_MAIN"
      &clk_src_sel=SRC_SEL TODO.
      &clk_src_div=8.
      &clk_m_val=0.
      &clk_n_val=0.
      &clk_2d_val=0.
      
      gosub Set_Clock_Freq
      return
    )
    else if ("&clk_desired_freq"=="266.666667")
    (
      &clk_src_name="MMPLL0_PLL_OUT_MAIN"
      &clk_src_sel=SRC_SEL TODO.
      &clk_src_div=6.
      &clk_m_val=0.
      &clk_n_val=0.
      &clk_2d_val=0.
      
      gosub Set_Clock_Freq
      return
    )
    else if ("&clk_desired_freq"=="266.666667")
    (
      &clk_src_name="EXTERNAL"
      &clk_src_sel=SRC_SEL TODO.
      &clk_src_div=2.
      &clk_m_val=0.
      &clk_n_val=0.
      &clk_2d_val=0.
      
      gosub Set_Clock_Freq
      return
    )
    else if ("&clk_desired_freq"=="r")
    (
      return
    )
    else
    (
      print "Invalid selection."
      goto Set_Clock_Freq_Enter
    )
  )

  if ("&clk"=="camss_csi2_clk")||("&clk"=="camss_csi2phy_clk")||("&clk"=="camss_csi2pix_clk")||("&clk"=="camss_csi2rdi_clk")
  (
    gosub PRINT_SET_CLOCK_FREQ_WARNING

    &clk_cmd_rcgr_addr=&HWIO_MMSS_CSI2_CMD_RCGR_ADDR
    &clk_cfg_rcgr_addr=&HWIO_MMSS_CSI2_CFG_RCGR_ADDR

    print "Choose frequency (MHz) from list below: " 

    print "100.0          200.0          200.0          " 
    print "480.0          480.0          600.0          " 
    print "600.0          " 

    print ""
    print "Enter desired frequency (r to return): "
    enter &clk_desired_freq
    print ""

    if ("&clk_desired_freq"=="100.0")
    (
      &clk_src_name="EXTERNAL"
      &clk_src_sel=SRC_SEL TODO.
      &clk_src_div=2.
      &clk_m_val=0.
      &clk_n_val=0.
      &clk_2d_val=0.
      
      gosub Set_Clock_Freq
      return
    )
    else if ("&clk_desired_freq"=="200.0")
    (
      &clk_src_name="GPLL0_OUT_MAIN"
      &clk_src_sel=SRC_SEL TODO.
      &clk_src_div=6.
      &clk_m_val=0.
      &clk_n_val=0.
      &clk_2d_val=0.
      
      gosub Set_Clock_Freq
      return
    )
    else if ("&clk_desired_freq"=="200.0")
    (
      &clk_src_name="EXTERNAL"
      &clk_src_sel=SRC_SEL TODO.
      &clk_src_div=2.
      &clk_m_val=0.
      &clk_n_val=0.
      &clk_2d_val=0.
      
      gosub Set_Clock_Freq
      return
    )
    else if ("&clk_desired_freq"=="480.0")
    (
      &clk_src_name="MMPLL4_PLL_OUT_MAIN"
      &clk_src_sel=SRC_SEL TODO.
      &clk_src_div=4.
      &clk_m_val=0.
      &clk_n_val=0.
      &clk_2d_val=0.
      
      gosub Set_Clock_Freq
      return
    )
    else if ("&clk_desired_freq"=="480.0")
    (
      &clk_src_name="EXTERNAL"
      &clk_src_sel=SRC_SEL TODO.
      &clk_src_div=2.
      &clk_m_val=0.
      &clk_n_val=0.
      &clk_2d_val=0.
      
      gosub Set_Clock_Freq
      return
    )
    else if ("&clk_desired_freq"=="600.0")
    (
      &clk_src_name="GPLL0_OUT_MAIN"
      &clk_src_sel=SRC_SEL TODO.
      &clk_src_div=2.
      &clk_m_val=0.
      &clk_n_val=0.
      &clk_2d_val=0.
      
      gosub Set_Clock_Freq
      return
    )
    else if ("&clk_desired_freq"=="600.0")
    (
      &clk_src_name="EXTERNAL"
      &clk_src_sel=SRC_SEL TODO.
      &clk_src_div=2.
      &clk_m_val=0.
      &clk_n_val=0.
      &clk_2d_val=0.
      
      gosub Set_Clock_Freq
      return
    )
    else if ("&clk_desired_freq"=="r")
    (
      return
    )
    else
    (
      print "Invalid selection."
      goto Set_Clock_Freq_Enter
    )
  )

  if ("&clk"=="camss_csi2phytimer_clk")
  (
    gosub PRINT_SET_CLOCK_FREQ_WARNING

    &clk_cmd_rcgr_addr=&HWIO_MMSS_CSI2PHYTIMER_CMD_RCGR_ADDR
    &clk_cfg_rcgr_addr=&HWIO_MMSS_CSI2PHYTIMER_CFG_RCGR_ADDR

    print "Choose frequency (MHz) from list below: " 

    print "100.0          200.0          266.666667     " 
    print "266.666667     " 

    print ""
    print "Enter desired frequency (r to return): "
    enter &clk_desired_freq
    print ""

    if ("&clk_desired_freq"=="100.0")
    (
      &clk_src_name="EXTERNAL"
      &clk_src_sel=SRC_SEL TODO.
      &clk_src_div=2.
      &clk_m_val=0.
      &clk_n_val=0.
      &clk_2d_val=0.
      
      gosub Set_Clock_Freq
      return
    )
    else if ("&clk_desired_freq"=="200.0")
    (
      &clk_src_name="MMPLL0_PLL_OUT_MAIN"
      &clk_src_sel=SRC_SEL TODO.
      &clk_src_div=8.
      &clk_m_val=0.
      &clk_n_val=0.
      &clk_2d_val=0.
      
      gosub Set_Clock_Freq
      return
    )
    else if ("&clk_desired_freq"=="266.666667")
    (
      &clk_src_name="MMPLL0_PLL_OUT_MAIN"
      &clk_src_sel=SRC_SEL TODO.
      &clk_src_div=6.
      &clk_m_val=0.
      &clk_n_val=0.
      &clk_2d_val=0.
      
      gosub Set_Clock_Freq
      return
    )
    else if ("&clk_desired_freq"=="266.666667")
    (
      &clk_src_name="EXTERNAL"
      &clk_src_sel=SRC_SEL TODO.
      &clk_src_div=2.
      &clk_m_val=0.
      &clk_n_val=0.
      &clk_2d_val=0.
      
      gosub Set_Clock_Freq
      return
    )
    else if ("&clk_desired_freq"=="r")
    (
      return
    )
    else
    (
      print "Invalid selection."
      goto Set_Clock_Freq_Enter
    )
  )

  if ("&clk"=="camss_csi3_clk")||("&clk"=="camss_csi3phy_clk")||("&clk"=="camss_csi3pix_clk")||("&clk"=="camss_csi3rdi_clk")
  (
    gosub PRINT_SET_CLOCK_FREQ_WARNING

    &clk_cmd_rcgr_addr=&HWIO_MMSS_CSI3_CMD_RCGR_ADDR
    &clk_cfg_rcgr_addr=&HWIO_MMSS_CSI3_CFG_RCGR_ADDR

    print "Choose frequency (MHz) from list below: " 

    print "100.0          200.0          200.0          " 
    print "480.0          480.0          600.0          " 
    print "600.0          " 

    print ""
    print "Enter desired frequency (r to return): "
    enter &clk_desired_freq
    print ""

    if ("&clk_desired_freq"=="100.0")
    (
      &clk_src_name="EXTERNAL"
      &clk_src_sel=SRC_SEL TODO.
      &clk_src_div=2.
      &clk_m_val=0.
      &clk_n_val=0.
      &clk_2d_val=0.
      
      gosub Set_Clock_Freq
      return
    )
    else if ("&clk_desired_freq"=="200.0")
    (
      &clk_src_name="GPLL0_OUT_MAIN"
      &clk_src_sel=SRC_SEL TODO.
      &clk_src_div=6.
      &clk_m_val=0.
      &clk_n_val=0.
      &clk_2d_val=0.
      
      gosub Set_Clock_Freq
      return
    )
    else if ("&clk_desired_freq"=="200.0")
    (
      &clk_src_name="EXTERNAL"
      &clk_src_sel=SRC_SEL TODO.
      &clk_src_div=2.
      &clk_m_val=0.
      &clk_n_val=0.
      &clk_2d_val=0.
      
      gosub Set_Clock_Freq
      return
    )
    else if ("&clk_desired_freq"=="480.0")
    (
      &clk_src_name="MMPLL4_PLL_OUT_MAIN"
      &clk_src_sel=SRC_SEL TODO.
      &clk_src_div=4.
      &clk_m_val=0.
      &clk_n_val=0.
      &clk_2d_val=0.
      
      gosub Set_Clock_Freq
      return
    )
    else if ("&clk_desired_freq"=="480.0")
    (
      &clk_src_name="EXTERNAL"
      &clk_src_sel=SRC_SEL TODO.
      &clk_src_div=2.
      &clk_m_val=0.
      &clk_n_val=0.
      &clk_2d_val=0.
      
      gosub Set_Clock_Freq
      return
    )
    else if ("&clk_desired_freq"=="600.0")
    (
      &clk_src_name="GPLL0_OUT_MAIN"
      &clk_src_sel=SRC_SEL TODO.
      &clk_src_div=2.
      &clk_m_val=0.
      &clk_n_val=0.
      &clk_2d_val=0.
      
      gosub Set_Clock_Freq
      return
    )
    else if ("&clk_desired_freq"=="600.0")
    (
      &clk_src_name="EXTERNAL"
      &clk_src_sel=SRC_SEL TODO.
      &clk_src_div=2.
      &clk_m_val=0.
      &clk_n_val=0.
      &clk_2d_val=0.
      
      gosub Set_Clock_Freq
      return
    )
    else if ("&clk_desired_freq"=="r")
    (
      return
    )
    else
    (
      print "Invalid selection."
      goto Set_Clock_Freq_Enter
    )
  )

  if ("&clk"=="camss_csiphy0_3p_clk")
  (
    gosub PRINT_SET_CLOCK_FREQ_WARNING

    &clk_cmd_rcgr_addr=&HWIO_MMSS_CSIPHY0_3P_CMD_RCGR_ADDR
    &clk_cfg_rcgr_addr=&HWIO_MMSS_CSIPHY0_3P_CFG_RCGR_ADDR

    print "Choose frequency (MHz) from list below: " 

    print "100.0          200.0          200.0          " 
    print "320.0          320.0          384.0          " 
    print "384.0          " 

    print ""
    print "Enter desired frequency (r to return): "
    enter &clk_desired_freq
    print ""

    if ("&clk_desired_freq"=="100.0")
    (
      &clk_src_name="EXTERNAL"
      &clk_src_sel=SRC_SEL TODO.
      &clk_src_div=2.
      &clk_m_val=0.
      &clk_n_val=0.
      &clk_2d_val=0.
      
      gosub Set_Clock_Freq
      return
    )
    else if ("&clk_desired_freq"=="200.0")
    (
      &clk_src_name="GPLL0_OUT_MAIN"
      &clk_src_sel=SRC_SEL TODO.
      &clk_src_div=6.
      &clk_m_val=0.
      &clk_n_val=0.
      &clk_2d_val=0.
      
      gosub Set_Clock_Freq
      return
    )
    else if ("&clk_desired_freq"=="200.0")
    (
      &clk_src_name="EXTERNAL"
      &clk_src_sel=SRC_SEL TODO.
      &clk_src_div=2.
      &clk_m_val=0.
      &clk_n_val=0.
      &clk_2d_val=0.
      
      gosub Set_Clock_Freq
      return
    )
    else if ("&clk_desired_freq"=="320.0")
    (
      &clk_src_name="MMPLL4_PLL_OUT_MAIN"
      &clk_src_sel=SRC_SEL TODO.
      &clk_src_div=6.
      &clk_m_val=0.
      &clk_n_val=0.
      &clk_2d_val=0.
      
      gosub Set_Clock_Freq
      return
    )
    else if ("&clk_desired_freq"=="320.0")
    (
      &clk_src_name="EXTERNAL"
      &clk_src_sel=SRC_SEL TODO.
      &clk_src_div=2.
      &clk_m_val=0.
      &clk_n_val=0.
      &clk_2d_val=0.
      
      gosub Set_Clock_Freq
      return
    )
    else if ("&clk_desired_freq"=="384.0")
    (
      &clk_src_name="MMPLL4_PLL_OUT_MAIN"
      &clk_src_sel=SRC_SEL TODO.
      &clk_src_div=5.
      &clk_m_val=0.
      &clk_n_val=0.
      &clk_2d_val=0.
      
      gosub Set_Clock_Freq
      return
    )
    else if ("&clk_desired_freq"=="384.0")
    (
      &clk_src_name="EXTERNAL"
      &clk_src_sel=SRC_SEL TODO.
      &clk_src_div=2.
      &clk_m_val=0.
      &clk_n_val=0.
      &clk_2d_val=0.
      
      gosub Set_Clock_Freq
      return
    )
    else if ("&clk_desired_freq"=="r")
    (
      return
    )
    else
    (
      print "Invalid selection."
      goto Set_Clock_Freq_Enter
    )
  )

  if ("&clk"=="camss_csiphy1_3p_clk")
  (
    gosub PRINT_SET_CLOCK_FREQ_WARNING

    &clk_cmd_rcgr_addr=&HWIO_MMSS_CSIPHY1_3P_CMD_RCGR_ADDR
    &clk_cfg_rcgr_addr=&HWIO_MMSS_CSIPHY1_3P_CFG_RCGR_ADDR

    print "Choose frequency (MHz) from list below: " 

    print "100.0          200.0          200.0          " 
    print "320.0          320.0          384.0          " 
    print "384.0          " 

    print ""
    print "Enter desired frequency (r to return): "
    enter &clk_desired_freq
    print ""

    if ("&clk_desired_freq"=="100.0")
    (
      &clk_src_name="EXTERNAL"
      &clk_src_sel=SRC_SEL TODO.
      &clk_src_div=2.
      &clk_m_val=0.
      &clk_n_val=0.
      &clk_2d_val=0.
      
      gosub Set_Clock_Freq
      return
    )
    else if ("&clk_desired_freq"=="200.0")
    (
      &clk_src_name="GPLL0_OUT_MAIN"
      &clk_src_sel=SRC_SEL TODO.
      &clk_src_div=6.
      &clk_m_val=0.
      &clk_n_val=0.
      &clk_2d_val=0.
      
      gosub Set_Clock_Freq
      return
    )
    else if ("&clk_desired_freq"=="200.0")
    (
      &clk_src_name="EXTERNAL"
      &clk_src_sel=SRC_SEL TODO.
      &clk_src_div=2.
      &clk_m_val=0.
      &clk_n_val=0.
      &clk_2d_val=0.
      
      gosub Set_Clock_Freq
      return
    )
    else if ("&clk_desired_freq"=="320.0")
    (
      &clk_src_name="MMPLL4_PLL_OUT_MAIN"
      &clk_src_sel=SRC_SEL TODO.
      &clk_src_div=6.
      &clk_m_val=0.
      &clk_n_val=0.
      &clk_2d_val=0.
      
      gosub Set_Clock_Freq
      return
    )
    else if ("&clk_desired_freq"=="320.0")
    (
      &clk_src_name="EXTERNAL"
      &clk_src_sel=SRC_SEL TODO.
      &clk_src_div=2.
      &clk_m_val=0.
      &clk_n_val=0.
      &clk_2d_val=0.
      
      gosub Set_Clock_Freq
      return
    )
    else if ("&clk_desired_freq"=="384.0")
    (
      &clk_src_name="MMPLL4_PLL_OUT_MAIN"
      &clk_src_sel=SRC_SEL TODO.
      &clk_src_div=5.
      &clk_m_val=0.
      &clk_n_val=0.
      &clk_2d_val=0.
      
      gosub Set_Clock_Freq
      return
    )
    else if ("&clk_desired_freq"=="384.0")
    (
      &clk_src_name="EXTERNAL"
      &clk_src_sel=SRC_SEL TODO.
      &clk_src_div=2.
      &clk_m_val=0.
      &clk_n_val=0.
      &clk_2d_val=0.
      
      gosub Set_Clock_Freq
      return
    )
    else if ("&clk_desired_freq"=="r")
    (
      return
    )
    else
    (
      print "Invalid selection."
      goto Set_Clock_Freq_Enter
    )
  )

  if ("&clk"=="camss_csiphy2_3p_clk")
  (
    gosub PRINT_SET_CLOCK_FREQ_WARNING

    &clk_cmd_rcgr_addr=&HWIO_MMSS_CSIPHY2_3P_CMD_RCGR_ADDR
    &clk_cfg_rcgr_addr=&HWIO_MMSS_CSIPHY2_3P_CFG_RCGR_ADDR

    print "Choose frequency (MHz) from list below: " 

    print "100.0          200.0          200.0          " 
    print "320.0          320.0          384.0          " 
    print "384.0          " 

    print ""
    print "Enter desired frequency (r to return): "
    enter &clk_desired_freq
    print ""

    if ("&clk_desired_freq"=="100.0")
    (
      &clk_src_name="EXTERNAL"
      &clk_src_sel=SRC_SEL TODO.
      &clk_src_div=2.
      &clk_m_val=0.
      &clk_n_val=0.
      &clk_2d_val=0.
      
      gosub Set_Clock_Freq
      return
    )
    else if ("&clk_desired_freq"=="200.0")
    (
      &clk_src_name="GPLL0_OUT_MAIN"
      &clk_src_sel=SRC_SEL TODO.
      &clk_src_div=6.
      &clk_m_val=0.
      &clk_n_val=0.
      &clk_2d_val=0.
      
      gosub Set_Clock_Freq
      return
    )
    else if ("&clk_desired_freq"=="200.0")
    (
      &clk_src_name="EXTERNAL"
      &clk_src_sel=SRC_SEL TODO.
      &clk_src_div=2.
      &clk_m_val=0.
      &clk_n_val=0.
      &clk_2d_val=0.
      
      gosub Set_Clock_Freq
      return
    )
    else if ("&clk_desired_freq"=="320.0")
    (
      &clk_src_name="MMPLL4_PLL_OUT_MAIN"
      &clk_src_sel=SRC_SEL TODO.
      &clk_src_div=6.
      &clk_m_val=0.
      &clk_n_val=0.
      &clk_2d_val=0.
      
      gosub Set_Clock_Freq
      return
    )
    else if ("&clk_desired_freq"=="320.0")
    (
      &clk_src_name="EXTERNAL"
      &clk_src_sel=SRC_SEL TODO.
      &clk_src_div=2.
      &clk_m_val=0.
      &clk_n_val=0.
      &clk_2d_val=0.
      
      gosub Set_Clock_Freq
      return
    )
    else if ("&clk_desired_freq"=="384.0")
    (
      &clk_src_name="MMPLL4_PLL_OUT_MAIN"
      &clk_src_sel=SRC_SEL TODO.
      &clk_src_div=5.
      &clk_m_val=0.
      &clk_n_val=0.
      &clk_2d_val=0.
      
      gosub Set_Clock_Freq
      return
    )
    else if ("&clk_desired_freq"=="384.0")
    (
      &clk_src_name="EXTERNAL"
      &clk_src_sel=SRC_SEL TODO.
      &clk_src_div=2.
      &clk_m_val=0.
      &clk_n_val=0.
      &clk_2d_val=0.
      
      gosub Set_Clock_Freq
      return
    )
    else if ("&clk_desired_freq"=="r")
    (
      return
    )
    else
    (
      print "Invalid selection."
      goto Set_Clock_Freq_Enter
    )
  )

  if ("&clk"=="dsa_core_clk")
  (
    gosub PRINT_SET_CLOCK_FREQ_WARNING

    &clk_cmd_rcgr_addr=&HWIO_MMSS_DSA_CORE_CMD_RCGR_ADDR
    &clk_cfg_rcgr_addr=&HWIO_MMSS_DSA_CORE_CFG_RCGR_ADDR

    print "Choose frequency (MHz) from list below: " 

    print "300.0          " 

    print ""
    print "Enter desired frequency (r to return): "
    enter &clk_desired_freq
    print ""

    if ("&clk_desired_freq"=="300.0")
    (
      &clk_src_name="EXTERNAL"
      &clk_src_sel=SRC_SEL TODO.
      &clk_src_div=2.
      &clk_m_val=0.
      &clk_n_val=0.
      &clk_2d_val=0.
      
      gosub Set_Clock_Freq
      return
    )
    else if ("&clk_desired_freq"=="r")
    (
      return
    )
    else
    (
      print "Invalid selection."
      goto Set_Clock_Freq_Enter
    )
  )

  if ("&clk"=="mdss_edpaux_clk")
  (
    gosub PRINT_SET_CLOCK_FREQ_WARNING

    &clk_cmd_rcgr_addr=&HWIO_MMSS_EDPAUX_CMD_RCGR_ADDR
    &clk_cfg_rcgr_addr=&HWIO_MMSS_EDPAUX_CFG_RCGR_ADDR

    print "Choose frequency (MHz) from list below: " 

    print "19.2           " 

    print ""
    print "Enter desired frequency (r to return): "
    enter &clk_desired_freq
    print ""

    if ("&clk_desired_freq"=="19.2")
    (
      &clk_src_name="EXTERNAL"
      &clk_src_sel=SRC_SEL TODO.
      &clk_src_div=2.
      &clk_m_val=0.
      &clk_n_val=0.
      &clk_2d_val=0.
      
      gosub Set_Clock_Freq
      return
    )
    else if ("&clk_desired_freq"=="r")
    (
      return
    )
    else
    (
      print "Invalid selection."
      goto Set_Clock_Freq_Enter
    )
  )

  if ("&clk"=="mdss_edpgtc_clk")
  (
    gosub PRINT_SET_CLOCK_FREQ_WARNING

    &clk_cmd_rcgr_addr=&HWIO_MMSS_EDPGTC_CMD_RCGR_ADDR
    &clk_cfg_rcgr_addr=&HWIO_MMSS_EDPGTC_CFG_RCGR_ADDR

    print "Choose frequency (MHz) from list below: " 

    print "300.0          " 

    print ""
    print "Enter desired frequency (r to return): "
    enter &clk_desired_freq
    print ""

    if ("&clk_desired_freq"=="300.0")
    (
      &clk_src_name="EXTERNAL"
      &clk_src_sel=SRC_SEL TODO.
      &clk_src_div=2.
      &clk_m_val=0.
      &clk_n_val=0.
      &clk_2d_val=0.
      
      gosub Set_Clock_Freq
      return
    )
    else if ("&clk_desired_freq"=="r")
    (
      return
    )
    else
    (
      print "Invalid selection."
      goto Set_Clock_Freq_Enter
    )
  )

  if ("&clk"=="mdss_edplink_clk")
  (
    gosub PRINT_SET_CLOCK_FREQ_WARNING

    &clk_cmd_rcgr_addr=&HWIO_MMSS_EDPLINK_CMD_RCGR_ADDR
    &clk_cfg_rcgr_addr=&HWIO_MMSS_EDPLINK_CFG_RCGR_ADDR

    print "Choose frequency (MHz) from list below: " 

    print "162.0          270.0          540.0          " 

    print ""
    print "Enter desired frequency (r to return): "
    enter &clk_desired_freq
    print ""

    if ("&clk_desired_freq"=="162.0")
    (
      &clk_src_name="EXTERNAL"
      &clk_src_sel=SRC_SEL TODO.
      &clk_src_div=2.
      &clk_m_val=0.
      &clk_n_val=0.
      &clk_2d_val=0.
      
      gosub Set_Clock_Freq
      return
    )
    else if ("&clk_desired_freq"=="270.0")
    (
      &clk_src_name="EXTERNAL"
      &clk_src_sel=SRC_SEL TODO.
      &clk_src_div=2.
      &clk_m_val=0.
      &clk_n_val=0.
      &clk_2d_val=0.
      
      gosub Set_Clock_Freq
      return
    )
    else if ("&clk_desired_freq"=="540.0")
    (
      &clk_src_name="EXTERNAL"
      &clk_src_sel=SRC_SEL TODO.
      &clk_src_div=2.
      &clk_m_val=0.
      &clk_n_val=0.
      &clk_2d_val=0.
      
      gosub Set_Clock_Freq
      return
    )
    else if ("&clk_desired_freq"=="r")
    (
      return
    )
    else
    (
      print "Invalid selection."
      goto Set_Clock_Freq_Enter
    )
  )

  if ("&clk"=="mdss_edppixel_clk")
  (
    gosub PRINT_SET_CLOCK_FREQ_WARNING

    &clk_cmd_rcgr_addr=&HWIO_MMSS_EDPPIXEL_CMD_RCGR_ADDR
    &clk_cfg_rcgr_addr=&HWIO_MMSS_EDPPIXEL_CFG_RCGR_ADDR

    print "Choose frequency (MHz) from list below: " 

    print "168.75         337.5          675.0          " 

    print ""
    print "Enter desired frequency (r to return): "
    enter &clk_desired_freq
    print ""

    if ("&clk_desired_freq"=="168.75")
    (
      &clk_src_name="EXTERNAL"
      &clk_src_sel=SRC_SEL TODO.
      &clk_src_div=2.
      &clk_m_val=0.
      &clk_n_val=0.
      &clk_2d_val=0.
      
      gosub Set_Clock_Freq
      return
    )
    else if ("&clk_desired_freq"=="337.5")
    (
      &clk_src_name="EXTERNAL"
      &clk_src_sel=SRC_SEL TODO.
      &clk_src_div=2.
      &clk_m_val=0.
      &clk_n_val=0.
      &clk_2d_val=0.
      
      gosub Set_Clock_Freq
      return
    )
    else if ("&clk_desired_freq"=="675.0")
    (
      &clk_src_name="EXTERNAL"
      &clk_src_sel=SRC_SEL TODO.
      &clk_src_div=2.
      &clk_m_val=0.
      &clk_n_val=0.
      &clk_2d_val=0.
      
      gosub Set_Clock_Freq
      return
    )
    else if ("&clk_desired_freq"=="r")
    (
      return
    )
    else
    (
      print "Invalid selection."
      goto Set_Clock_Freq_Enter
    )
  )

  if ("&clk"=="mdss_esc0_clk")
  (
    gosub PRINT_SET_CLOCK_FREQ_WARNING

    &clk_cmd_rcgr_addr=&HWIO_MMSS_ESC0_CMD_RCGR_ADDR
    &clk_cfg_rcgr_addr=&HWIO_MMSS_ESC0_CFG_RCGR_ADDR

    print "Choose frequency (MHz) from list below: " 

    print "19.2           " 

    print ""
    print "Enter desired frequency (r to return): "
    enter &clk_desired_freq
    print ""

    if ("&clk_desired_freq"=="19.2")
    (
      &clk_src_name="EXTERNAL"
      &clk_src_sel=SRC_SEL TODO.
      &clk_src_div=2.
      &clk_m_val=0.
      &clk_n_val=0.
      &clk_2d_val=0.
      
      gosub Set_Clock_Freq
      return
    )
    else if ("&clk_desired_freq"=="r")
    (
      return
    )
    else
    (
      print "Invalid selection."
      goto Set_Clock_Freq_Enter
    )
  )

  if ("&clk"=="mdss_esc1_clk")
  (
    gosub PRINT_SET_CLOCK_FREQ_WARNING

    &clk_cmd_rcgr_addr=&HWIO_MMSS_ESC1_CMD_RCGR_ADDR
    &clk_cfg_rcgr_addr=&HWIO_MMSS_ESC1_CFG_RCGR_ADDR

    print "Choose frequency (MHz) from list below: " 

    print "19.2           " 

    print ""
    print "Enter desired frequency (r to return): "
    enter &clk_desired_freq
    print ""

    if ("&clk_desired_freq"=="19.2")
    (
      &clk_src_name="EXTERNAL"
      &clk_src_sel=SRC_SEL TODO.
      &clk_src_div=2.
      &clk_m_val=0.
      &clk_n_val=0.
      &clk_2d_val=0.
      
      gosub Set_Clock_Freq
      return
    )
    else if ("&clk_desired_freq"=="r")
    (
      return
    )
    else
    (
      print "Invalid selection."
      goto Set_Clock_Freq_Enter
    )
  )

  if ("&clk"=="mdss_extpclk_clk")
  (
    gosub PRINT_SET_CLOCK_FREQ_WARNING

    &clk_cmd_rcgr_addr=&HWIO_MMSS_EXTPCLK_CMD_RCGR_ADDR
    &clk_cfg_rcgr_addr=&HWIO_MMSS_EXTPCLK_CFG_RCGR_ADDR

    print "Choose frequency (MHz) from list below: " 

    print "150.0          300.0          600.0          " 

    print ""
    print "Enter desired frequency (r to return): "
    enter &clk_desired_freq
    print ""

    if ("&clk_desired_freq"=="150.0")
    (
      &clk_src_name="EXTERNAL"
      &clk_src_sel=SRC_SEL TODO.
      &clk_src_div=2.
      &clk_m_val=0.
      &clk_n_val=0.
      &clk_2d_val=0.
      
      gosub Set_Clock_Freq
      return
    )
    else if ("&clk_desired_freq"=="300.0")
    (
      &clk_src_name="EXTERNAL"
      &clk_src_sel=SRC_SEL TODO.
      &clk_src_div=2.
      &clk_m_val=0.
      &clk_n_val=0.
      &clk_2d_val=0.
      
      gosub Set_Clock_Freq
      return
    )
    else if ("&clk_desired_freq"=="600.0")
    (
      &clk_src_name="EXTERNAL"
      &clk_src_sel=SRC_SEL TODO.
      &clk_src_div=2.
      &clk_m_val=0.
      &clk_n_val=0.
      &clk_2d_val=0.
      
      gosub Set_Clock_Freq
      return
    )
    else if ("&clk_desired_freq"=="r")
    (
      return
    )
    else
    (
      print "Invalid selection."
      goto Set_Clock_Freq_Enter
    )
  )

  if ("&clk"=="fd_core_clk")||("&clk"=="fd_core_uar_clk")
  (
    gosub PRINT_SET_CLOCK_FREQ_WARNING

    &clk_cmd_rcgr_addr=&HWIO_MMSS_FD_CORE_CMD_RCGR_ADDR
    &clk_cfg_rcgr_addr=&HWIO_MMSS_FD_CORE_CFG_RCGR_ADDR

    print "Choose frequency (MHz) from list below: " 

    print "100.0          200.0          200.0          " 
    print "400.0          400.0          " 

    print ""
    print "Enter desired frequency (r to return): "
    enter &clk_desired_freq
    print ""

    if ("&clk_desired_freq"=="100.0")
    (
      &clk_src_name="EXTERNAL"
      &clk_src_sel=SRC_SEL TODO.
      &clk_src_div=2.
      &clk_m_val=0.
      &clk_n_val=0.
      &clk_2d_val=0.
      
      gosub Set_Clock_Freq
      return
    )
    else if ("&clk_desired_freq"=="200.0")
    (
      &clk_src_name="GPLL0_OUT_MAIN"
      &clk_src_sel=SRC_SEL TODO.
      &clk_src_div=6.
      &clk_m_val=0.
      &clk_n_val=0.
      &clk_2d_val=0.
      
      gosub Set_Clock_Freq
      return
    )
    else if ("&clk_desired_freq"=="200.0")
    (
      &clk_src_name="EXTERNAL"
      &clk_src_sel=SRC_SEL TODO.
      &clk_src_div=2.
      &clk_m_val=0.
      &clk_n_val=0.
      &clk_2d_val=0.
      
      gosub Set_Clock_Freq
      return
    )
    else if ("&clk_desired_freq"=="400.0")
    (
      &clk_src_name="MMPLL0_PLL_OUT_MAIN"
      &clk_src_sel=SRC_SEL TODO.
      &clk_src_div=4.
      &clk_m_val=0.
      &clk_n_val=0.
      &clk_2d_val=0.
      
      gosub Set_Clock_Freq
      return
    )
    else if ("&clk_desired_freq"=="400.0")
    (
      &clk_src_name="EXTERNAL"
      &clk_src_sel=SRC_SEL TODO.
      &clk_src_div=2.
      &clk_m_val=0.
      &clk_n_val=0.
      &clk_2d_val=0.
      
      gosub Set_Clock_Freq
      return
    )
    else if ("&clk_desired_freq"=="r")
    (
      return
    )
    else
    (
      print "Invalid selection."
      goto Set_Clock_Freq_Enter
    )
  )

  if ("&clk"=="gpu_gx_gfx3d_clk")||("&clk"=="mmss_spdm_debug_clk")||("&clk"=="mmss_spdm_gfx3d_clk")
  (
    gosub PRINT_SET_CLOCK_FREQ_WARNING

    &clk_cmd_rcgr_addr=&HWIO_MMSS_GFX3D_CMD_RCGR_ADDR
    &clk_cfg_rcgr_addr=&HWIO_MMSS_GFX3D_CFG_RCGR_ADDR

    print "Choose frequency (MHz) from list below: " 

    print "125.0          214.0          315.0          " 
    print "500.0          604.8          " 

    print ""
    print "Enter desired frequency (r to return): "
    enter &clk_desired_freq
    print ""

    if ("&clk_desired_freq"=="125.0")
    (
      &clk_src_name="MMPLL2_PLL_OUT_MAIN"
      &clk_src_sel=SRC_SEL TODO.
      &clk_src_div=2.
      &clk_m_val=0.
      &clk_n_val=0.
      &clk_2d_val=0.
      
      gosub Set_Clock_Freq
      return
    )
    else if ("&clk_desired_freq"=="214.0")
    (
      &clk_src_name="MMPLL2_PLL_OUT_MAIN"
      &clk_src_sel=SRC_SEL TODO.
      &clk_src_div=2.
      &clk_m_val=0.
      &clk_n_val=0.
      &clk_2d_val=0.
      
      gosub Set_Clock_Freq
      return
    )
    else if ("&clk_desired_freq"=="315.0")
    (
      &clk_src_name="MMPLL2_PLL_OUT_MAIN"
      &clk_src_sel=SRC_SEL TODO.
      &clk_src_div=2.
      &clk_m_val=0.
      &clk_n_val=0.
      &clk_2d_val=0.
      
      gosub Set_Clock_Freq
      return
    )
    else if ("&clk_desired_freq"=="500.0")
    (
      &clk_src_name="MMPLL2_PLL_OUT_MAIN"
      &clk_src_sel=SRC_SEL TODO.
      &clk_src_div=2.
      &clk_m_val=0.
      &clk_n_val=0.
      &clk_2d_val=0.
      
      gosub Set_Clock_Freq
      return
    )
    else if ("&clk_desired_freq"=="604.8")
    (
      &clk_src_name="MMPLL9_PLL_OUT_MAIN"
      &clk_src_sel=SRC_SEL TODO.
      &clk_src_div=2.
      &clk_m_val=0.
      &clk_n_val=0.
      &clk_2d_val=0.
      
      gosub Set_Clock_Freq
      return
    )
    else if ("&clk_desired_freq"=="r")
    (
      return
    )
    else
    (
      print "Invalid selection."
      goto Set_Clock_Freq_Enter
    )
  )

  if ("&clk"=="mdss_hdmi_clk")
  (
    gosub PRINT_SET_CLOCK_FREQ_WARNING

    &clk_cmd_rcgr_addr=&HWIO_MMSS_HDMI_CMD_RCGR_ADDR
    &clk_cfg_rcgr_addr=&HWIO_MMSS_HDMI_CFG_RCGR_ADDR

    print "Choose frequency (MHz) from list below: " 

    print "19.2           " 

    print ""
    print "Enter desired frequency (r to return): "
    enter &clk_desired_freq
    print ""

    if ("&clk_desired_freq"=="19.2")
    (
      &clk_src_name="EXTERNAL"
      &clk_src_sel=SRC_SEL TODO.
      &clk_src_div=2.
      &clk_m_val=0.
      &clk_n_val=0.
      &clk_2d_val=0.
      
      gosub Set_Clock_Freq
      return
    )
    else if ("&clk_desired_freq"=="r")
    (
      return
    )
    else
    (
      print "Invalid selection."
      goto Set_Clock_Freq_Enter
    )
  )

  if ("&clk"=="gpu_aon_isense_clk")
  (
    gosub PRINT_SET_CLOCK_FREQ_WARNING

    &clk_cmd_rcgr_addr=&HWIO_MMSS_ISENSE_CMD_RCGR_ADDR
    &clk_cfg_rcgr_addr=&HWIO_MMSS_ISENSE_CFG_RCGR_ADDR

    print "Choose frequency (MHz) from list below: " 

    print "107.0          125.0          214.0          " 
    print "315.0          315.0          500.0          " 
    print "500.0          604.8          604.8          " 

    print ""
    print "Enter desired frequency (r to return): "
    enter &clk_desired_freq
    print ""

    if ("&clk_desired_freq"=="107.0")
    (
      &clk_src_name="EXTERNAL"
      &clk_src_sel=SRC_SEL TODO.
      &clk_src_div=2.
      &clk_m_val=0.
      &clk_n_val=0.
      &clk_2d_val=0.
      
      gosub Set_Clock_Freq
      return
    )
    else if ("&clk_desired_freq"=="125.0")
    (
      &clk_src_name="MMPLL2_PLL_OUT_MAIN"
      &clk_src_sel=SRC_SEL TODO.
      &clk_src_div=2.
      &clk_m_val=0.
      &clk_n_val=0.
      &clk_2d_val=0.
      
      gosub Set_Clock_Freq
      return
    )
    else if ("&clk_desired_freq"=="214.0")
    (
      &clk_src_name="MMPLL2_PLL_OUT_MAIN"
      &clk_src_sel=SRC_SEL TODO.
      &clk_src_div=2.
      &clk_m_val=0.
      &clk_n_val=0.
      &clk_2d_val=0.
      
      gosub Set_Clock_Freq
      return
    )
    else if ("&clk_desired_freq"=="315.0")
    (
      &clk_src_name="MMPLL2_PLL_OUT_MAIN"
      &clk_src_sel=SRC_SEL TODO.
      &clk_src_div=2.
      &clk_m_val=0.
      &clk_n_val=0.
      &clk_2d_val=0.
      
      gosub Set_Clock_Freq
      return
    )
    else if ("&clk_desired_freq"=="315.0")
    (
      &clk_src_name="EXTERNAL"
      &clk_src_sel=SRC_SEL TODO.
      &clk_src_div=2.
      &clk_m_val=0.
      &clk_n_val=0.
      &clk_2d_val=0.
      
      gosub Set_Clock_Freq
      return
    )
    else if ("&clk_desired_freq"=="500.0")
    (
      &clk_src_name="MMPLL2_PLL_OUT_MAIN"
      &clk_src_sel=SRC_SEL TODO.
      &clk_src_div=2.
      &clk_m_val=0.
      &clk_n_val=0.
      &clk_2d_val=0.
      
      gosub Set_Clock_Freq
      return
    )
    else if ("&clk_desired_freq"=="500.0")
    (
      &clk_src_name="EXTERNAL"
      &clk_src_sel=SRC_SEL TODO.
      &clk_src_div=2.
      &clk_m_val=0.
      &clk_n_val=0.
      &clk_2d_val=0.
      
      gosub Set_Clock_Freq
      return
    )
    else if ("&clk_desired_freq"=="604.8")
    (
      &clk_src_name="MMPLL9_PLL_OUT_MAIN"
      &clk_src_sel=SRC_SEL TODO.
      &clk_src_div=2.
      &clk_m_val=0.
      &clk_n_val=0.
      &clk_2d_val=0.
      
      gosub Set_Clock_Freq
      return
    )
    else if ("&clk_desired_freq"=="604.8")
    (
      &clk_src_name="EXTERNAL"
      &clk_src_sel=SRC_SEL TODO.
      &clk_src_div=2.
      &clk_m_val=0.
      &clk_n_val=0.
      &clk_2d_val=0.
      
      gosub Set_Clock_Freq
      return
    )
    else if ("&clk_desired_freq"=="r")
    (
      return
    )
    else
    (
      print "Invalid selection."
      goto Set_Clock_Freq_Enter
    )
  )

  if ("&clk"=="camss_jpeg0_clk")||("&clk"=="mmss_spdm_jpeg0_clk")
  (
    gosub PRINT_SET_CLOCK_FREQ_WARNING

    &clk_cmd_rcgr_addr=&HWIO_MMSS_JPEG0_CMD_RCGR_ADDR
    &clk_cfg_rcgr_addr=&HWIO_MMSS_JPEG0_CFG_RCGR_ADDR

    print "Choose frequency (MHz) from list below: " 

    print "75.0           150.0          150.0          " 
    print "228.571429     266.666667     320.0          " 
    print "320.0          480.0          480.0          " 

    print ""
    print "Enter desired frequency (r to return): "
    enter &clk_desired_freq
    print ""

    if ("&clk_desired_freq"=="75.0")
    (
      &clk_src_name="EXTERNAL"
      &clk_src_sel=SRC_SEL TODO.
      &clk_src_div=2.
      &clk_m_val=0.
      &clk_n_val=0.
      &clk_2d_val=0.
      
      gosub Set_Clock_Freq
      return
    )
    else if ("&clk_desired_freq"=="150.0")
    (
      &clk_src_name="GPLL0_OUT_MAIN"
      &clk_src_sel=SRC_SEL TODO.
      &clk_src_div=8.
      &clk_m_val=0.
      &clk_n_val=0.
      &clk_2d_val=0.
      
      gosub Set_Clock_Freq
      return
    )
    else if ("&clk_desired_freq"=="150.0")
    (
      &clk_src_name="EXTERNAL"
      &clk_src_sel=SRC_SEL TODO.
      &clk_src_div=2.
      &clk_m_val=0.
      &clk_n_val=0.
      &clk_2d_val=0.
      
      gosub Set_Clock_Freq
      return
    )
    else if ("&clk_desired_freq"=="228.571429")
    (
      &clk_src_name="MMPLL0_PLL_OUT_MAIN"
      &clk_src_sel=SRC_SEL TODO.
      &clk_src_div=7.
      &clk_m_val=0.
      &clk_n_val=0.
      &clk_2d_val=0.
      
      gosub Set_Clock_Freq
      return
    )
    else if ("&clk_desired_freq"=="266.666667")
    (
      &clk_src_name="MMPLL0_PLL_OUT_MAIN"
      &clk_src_sel=SRC_SEL TODO.
      &clk_src_div=6.
      &clk_m_val=0.
      &clk_n_val=0.
      &clk_2d_val=0.
      
      gosub Set_Clock_Freq
      return
    )
    else if ("&clk_desired_freq"=="320.0")
    (
      &clk_src_name="MMPLL0_PLL_OUT_MAIN"
      &clk_src_sel=SRC_SEL TODO.
      &clk_src_div=5.
      &clk_m_val=0.
      &clk_n_val=0.
      &clk_2d_val=0.
      
      gosub Set_Clock_Freq
      return
    )
    else if ("&clk_desired_freq"=="320.0")
    (
      &clk_src_name="EXTERNAL"
      &clk_src_sel=SRC_SEL TODO.
      &clk_src_div=2.
      &clk_m_val=0.
      &clk_n_val=0.
      &clk_2d_val=0.
      
      gosub Set_Clock_Freq
      return
    )
    else if ("&clk_desired_freq"=="480.0")
    (
      &clk_src_name="MMPLL4_PLL_OUT_MAIN"
      &clk_src_sel=SRC_SEL TODO.
      &clk_src_div=4.
      &clk_m_val=0.
      &clk_n_val=0.
      &clk_2d_val=0.
      
      gosub Set_Clock_Freq
      return
    )
    else if ("&clk_desired_freq"=="480.0")
    (
      &clk_src_name="EXTERNAL"
      &clk_src_sel=SRC_SEL TODO.
      &clk_src_div=2.
      &clk_m_val=0.
      &clk_n_val=0.
      &clk_2d_val=0.
      
      gosub Set_Clock_Freq
      return
    )
    else if ("&clk_desired_freq"=="r")
    (
      return
    )
    else
    (
      print "Invalid selection."
      goto Set_Clock_Freq_Enter
    )
  )

  if ("&clk"=="camss_jpeg2_clk")||("&clk"=="mmss_spdm_jpeg2_clk")
  (
    gosub PRINT_SET_CLOCK_FREQ_WARNING

    &clk_cmd_rcgr_addr=&HWIO_MMSS_JPEG2_CMD_RCGR_ADDR
    &clk_cfg_rcgr_addr=&HWIO_MMSS_JPEG2_CFG_RCGR_ADDR

    print "Choose frequency (MHz) from list below: " 

    print "75.0           150.0          150.0          " 
    print "228.571429     266.666667     266.666667     " 
    print "320.0          320.0          " 

    print ""
    print "Enter desired frequency (r to return): "
    enter &clk_desired_freq
    print ""

    if ("&clk_desired_freq"=="75.0")
    (
      &clk_src_name="EXTERNAL"
      &clk_src_sel=SRC_SEL TODO.
      &clk_src_div=2.
      &clk_m_val=0.
      &clk_n_val=0.
      &clk_2d_val=0.
      
      gosub Set_Clock_Freq
      return
    )
    else if ("&clk_desired_freq"=="150.0")
    (
      &clk_src_name="GPLL0_OUT_MAIN"
      &clk_src_sel=SRC_SEL TODO.
      &clk_src_div=8.
      &clk_m_val=0.
      &clk_n_val=0.
      &clk_2d_val=0.
      
      gosub Set_Clock_Freq
      return
    )
    else if ("&clk_desired_freq"=="150.0")
    (
      &clk_src_name="EXTERNAL"
      &clk_src_sel=SRC_SEL TODO.
      &clk_src_div=2.
      &clk_m_val=0.
      &clk_n_val=0.
      &clk_2d_val=0.
      
      gosub Set_Clock_Freq
      return
    )
    else if ("&clk_desired_freq"=="228.571429")
    (
      &clk_src_name="MMPLL0_PLL_OUT_MAIN"
      &clk_src_sel=SRC_SEL TODO.
      &clk_src_div=7.
      &clk_m_val=0.
      &clk_n_val=0.
      &clk_2d_val=0.
      
      gosub Set_Clock_Freq
      return
    )
    else if ("&clk_desired_freq"=="266.666667")
    (
      &clk_src_name="MMPLL0_PLL_OUT_MAIN"
      &clk_src_sel=SRC_SEL TODO.
      &clk_src_div=6.
      &clk_m_val=0.
      &clk_n_val=0.
      &clk_2d_val=0.
      
      gosub Set_Clock_Freq
      return
    )
    else if ("&clk_desired_freq"=="266.666667")
    (
      &clk_src_name="EXTERNAL"
      &clk_src_sel=SRC_SEL TODO.
      &clk_src_div=2.
      &clk_m_val=0.
      &clk_n_val=0.
      &clk_2d_val=0.
      
      gosub Set_Clock_Freq
      return
    )
    else if ("&clk_desired_freq"=="320.0")
    (
      &clk_src_name="MMPLL0_PLL_OUT_MAIN"
      &clk_src_sel=SRC_SEL TODO.
      &clk_src_div=5.
      &clk_m_val=0.
      &clk_n_val=0.
      &clk_2d_val=0.
      
      gosub Set_Clock_Freq
      return
    )
    else if ("&clk_desired_freq"=="320.0")
    (
      &clk_src_name="EXTERNAL"
      &clk_src_sel=SRC_SEL TODO.
      &clk_src_div=2.
      &clk_m_val=0.
      &clk_n_val=0.
      &clk_2d_val=0.
      
      gosub Set_Clock_Freq
      return
    )
    else if ("&clk_desired_freq"=="r")
    (
      return
    )
    else
    (
      print "Invalid selection."
      goto Set_Clock_Freq_Enter
    )
  )

  if ("&clk"=="camss_jpeg_dma_clk")||("&clk"=="mmss_spdm_jpeg_dma_clk")
  (
    gosub PRINT_SET_CLOCK_FREQ_WARNING

    &clk_cmd_rcgr_addr=&HWIO_MMSS_JPEG_DMA_CMD_RCGR_ADDR
    &clk_cfg_rcgr_addr=&HWIO_MMSS_JPEG_DMA_CFG_RCGR_ADDR

    print "Choose frequency (MHz) from list below: " 

    print "75.0           150.0          150.0          " 
    print "228.571429     266.666667     320.0          " 
    print "320.0          480.0          480.0          " 

    print ""
    print "Enter desired frequency (r to return): "
    enter &clk_desired_freq
    print ""

    if ("&clk_desired_freq"=="75.0")
    (
      &clk_src_name="EXTERNAL"
      &clk_src_sel=SRC_SEL TODO.
      &clk_src_div=2.
      &clk_m_val=0.
      &clk_n_val=0.
      &clk_2d_val=0.
      
      gosub Set_Clock_Freq
      return
    )
    else if ("&clk_desired_freq"=="150.0")
    (
      &clk_src_name="GPLL0_OUT_MAIN"
      &clk_src_sel=SRC_SEL TODO.
      &clk_src_div=8.
      &clk_m_val=0.
      &clk_n_val=0.
      &clk_2d_val=0.
      
      gosub Set_Clock_Freq
      return
    )
    else if ("&clk_desired_freq"=="150.0")
    (
      &clk_src_name="EXTERNAL"
      &clk_src_sel=SRC_SEL TODO.
      &clk_src_div=2.
      &clk_m_val=0.
      &clk_n_val=0.
      &clk_2d_val=0.
      
      gosub Set_Clock_Freq
      return
    )
    else if ("&clk_desired_freq"=="228.571429")
    (
      &clk_src_name="MMPLL0_PLL_OUT_MAIN"
      &clk_src_sel=SRC_SEL TODO.
      &clk_src_div=7.
      &clk_m_val=0.
      &clk_n_val=0.
      &clk_2d_val=0.
      
      gosub Set_Clock_Freq
      return
    )
    else if ("&clk_desired_freq"=="266.666667")
    (
      &clk_src_name="MMPLL0_PLL_OUT_MAIN"
      &clk_src_sel=SRC_SEL TODO.
      &clk_src_div=6.
      &clk_m_val=0.
      &clk_n_val=0.
      &clk_2d_val=0.
      
      gosub Set_Clock_Freq
      return
    )
    else if ("&clk_desired_freq"=="320.0")
    (
      &clk_src_name="MMPLL0_PLL_OUT_MAIN"
      &clk_src_sel=SRC_SEL TODO.
      &clk_src_div=5.
      &clk_m_val=0.
      &clk_n_val=0.
      &clk_2d_val=0.
      
      gosub Set_Clock_Freq
      return
    )
    else if ("&clk_desired_freq"=="320.0")
    (
      &clk_src_name="EXTERNAL"
      &clk_src_sel=SRC_SEL TODO.
      &clk_src_div=2.
      &clk_m_val=0.
      &clk_n_val=0.
      &clk_2d_val=0.
      
      gosub Set_Clock_Freq
      return
    )
    else if ("&clk_desired_freq"=="480.0")
    (
      &clk_src_name="MMPLL4_PLL_OUT_MAIN"
      &clk_src_sel=SRC_SEL TODO.
      &clk_src_div=4.
      &clk_m_val=0.
      &clk_n_val=0.
      &clk_2d_val=0.
      
      gosub Set_Clock_Freq
      return
    )
    else if ("&clk_desired_freq"=="480.0")
    (
      &clk_src_name="EXTERNAL"
      &clk_src_sel=SRC_SEL TODO.
      &clk_src_div=2.
      &clk_m_val=0.
      &clk_n_val=0.
      &clk_2d_val=0.
      
      gosub Set_Clock_Freq
      return
    )
    else if ("&clk_desired_freq"=="r")
    (
      return
    )
    else
    (
      print "Invalid selection."
      goto Set_Clock_Freq_Enter
    )
  )

  if ("&clk"=="mmss_mmagic_maxi_clk")||("&clk"=="mmss_spdm_rm_maxi_clk")||("&clk"=="video_maxi_clk")||("&clk"=="vmem_maxi_clk")
  (
    gosub PRINT_SET_CLOCK_FREQ_WARNING

    &clk_cmd_rcgr_addr=&HWIO_MMSS_MAXI_CMD_RCGR_ADDR
    &clk_cfg_rcgr_addr=&HWIO_MMSS_MAXI_CFG_RCGR_ADDR

    print "Choose frequency (MHz) from list below: " 

    print "75.0           100.0          171.428571     " 
    print "200.0          320.0          320.0          " 
    print "400.0          405.0          " 

    print ""
    print "Enter desired frequency (r to return): "
    enter &clk_desired_freq
    print ""

    if ("&clk_desired_freq"=="75.0")
    (
      &clk_src_name="EXTERNAL"
      &clk_src_sel=SRC_SEL TODO.
      &clk_src_div=2.
      &clk_m_val=0.
      &clk_n_val=0.
      &clk_2d_val=0.
      
      gosub Set_Clock_Freq
      return
    )
    else if ("&clk_desired_freq"=="100.0")
    (
      &clk_src_name="GPLL0_OUT_MAIN"
      &clk_src_sel=SRC_SEL TODO.
      &clk_src_div=12.
      &clk_m_val=0.
      &clk_n_val=0.
      &clk_2d_val=0.
      
      gosub Set_Clock_Freq
      return
    )
    else if ("&clk_desired_freq"=="171.428571")
    (
      &clk_src_name="EXTERNAL"
      &clk_src_sel=SRC_SEL TODO.
      &clk_src_div=2.
      &clk_m_val=0.
      &clk_n_val=0.
      &clk_2d_val=0.
      
      gosub Set_Clock_Freq
      return
    )
    else if ("&clk_desired_freq"=="200.0")
    (
      &clk_src_name="GPLL0_OUT_MAIN"
      &clk_src_sel=SRC_SEL TODO.
      &clk_src_div=6.
      &clk_m_val=0.
      &clk_n_val=0.
      &clk_2d_val=0.
      
      gosub Set_Clock_Freq
      return
    )
    else if ("&clk_desired_freq"=="320.0")
    (
      &clk_src_name="MMPLL0_PLL_OUT_MAIN"
      &clk_src_sel=SRC_SEL TODO.
      &clk_src_div=5.
      &clk_m_val=0.
      &clk_n_val=0.
      &clk_2d_val=0.
      
      gosub Set_Clock_Freq
      return
    )
    else if ("&clk_desired_freq"=="320.0")
    (
      &clk_src_name="EXTERNAL"
      &clk_src_sel=SRC_SEL TODO.
      &clk_src_div=2.
      &clk_m_val=0.
      &clk_n_val=0.
      &clk_2d_val=0.
      
      gosub Set_Clock_Freq
      return
    )
    else if ("&clk_desired_freq"=="400.0")
    (
      &clk_src_name="MMPLL0_PLL_OUT_MAIN"
      &clk_src_sel=SRC_SEL TODO.
      &clk_src_div=4.
      &clk_m_val=0.
      &clk_n_val=0.
      &clk_2d_val=0.
      
      gosub Set_Clock_Freq
      return
    )
    else if ("&clk_desired_freq"=="405.0")
    (
      &clk_src_name="EXTERNAL"
      &clk_src_sel=SRC_SEL TODO.
      &clk_src_div=2.
      &clk_m_val=0.
      &clk_n_val=0.
      &clk_2d_val=0.
      
      gosub Set_Clock_Freq
      return
    )
    else if ("&clk_desired_freq"=="r")
    (
      return
    )
    else
    (
      print "Invalid selection."
      goto Set_Clock_Freq_Enter
    )
  )

  if ("&clk"=="camss_mclk0_clk")
  (
    gosub PRINT_SET_CLOCK_FREQ_WARNING

    &clk_cmd_rcgr_addr=&HWIO_MMSS_MCLK0_CMD_RCGR_ADDR
    &clk_cfg_rcgr_addr=&HWIO_MMSS_MCLK0_CFG_RCGR_ADDR

    print "Choose frequency (MHz) from list below: " 

    print "4.8            9.6            19.2           " 
    print "33.333333      48.0           66.666667      " 
    print "66.666667      68.571429      " 

    print ""
    print "Enter desired frequency (r to return): "
    enter &clk_desired_freq
    print ""

    if ("&clk_desired_freq"=="4.8")
    (
      &clk_src_name="XO"
      &clk_src_sel=SRC_SEL TODO.
      &clk_src_div=8.
      &clk_m_val=0.
      &clk_n_val=0.
      &clk_2d_val=0.
      
      gosub Set_Clock_Freq
      return
    )
    else if ("&clk_desired_freq"=="9.6")
    (
      &clk_src_name="XO"
      &clk_src_sel=SRC_SEL TODO.
      &clk_src_div=4.
      &clk_m_val=0.
      &clk_n_val=0.
      &clk_2d_val=0.
      
      gosub Set_Clock_Freq
      return
    )
    else if ("&clk_desired_freq"=="19.2")
    (
      &clk_src_name="XO"
      &clk_src_sel=SRC_SEL TODO.
      &clk_src_div=2.
      &clk_m_val=0.
      &clk_n_val=0.
      &clk_2d_val=0.
      
      gosub Set_Clock_Freq
      return
    )
    else if ("&clk_desired_freq"=="33.333333")
    (
      &clk_src_name="EXTERNAL"
      &clk_src_sel=SRC_SEL TODO.
      &clk_src_div=2.
      &clk_m_val=0.
      &clk_n_val=0.
      &clk_2d_val=0.
      
      gosub Set_Clock_Freq
      return
    )
    else if ("&clk_desired_freq"=="48.0")
    (
      &clk_src_name="GPLL0_OUT_MAIN"
      &clk_src_sel=SRC_SEL TODO.
      &clk_src_div=2.
      &clk_m_val=2.
      &clk_n_val=25.
      &clk_2d_val=25.
      
      gosub Set_Clock_Freq
      return
    )
    else if ("&clk_desired_freq"=="66.666667")
    (
      &clk_src_name="GPLL0_OUT_MAIN"
      &clk_src_sel=SRC_SEL TODO.
      &clk_src_div=2.
      &clk_m_val=1.
      &clk_n_val=9.
      &clk_2d_val=9.
      
      gosub Set_Clock_Freq
      return
    )
    else if ("&clk_desired_freq"=="66.666667")
    (
      &clk_src_name="EXTERNAL"
      &clk_src_sel=SRC_SEL TODO.
      &clk_src_div=2.
      &clk_m_val=0.
      &clk_n_val=0.
      &clk_2d_val=0.
      
      gosub Set_Clock_Freq
      return
    )
    else if ("&clk_desired_freq"=="68.571429")
    (
      &clk_src_name="EXTERNAL"
      &clk_src_sel=SRC_SEL TODO.
      &clk_src_div=2.
      &clk_m_val=0.
      &clk_n_val=0.
      &clk_2d_val=0.
      
      gosub Set_Clock_Freq
      return
    )
    else if ("&clk_desired_freq"=="r")
    (
      return
    )
    else
    (
      print "Invalid selection."
      goto Set_Clock_Freq_Enter
    )
  )

  if ("&clk"=="camss_mclk1_clk")
  (
    gosub PRINT_SET_CLOCK_FREQ_WARNING

    &clk_cmd_rcgr_addr=&HWIO_MMSS_MCLK1_CMD_RCGR_ADDR
    &clk_cfg_rcgr_addr=&HWIO_MMSS_MCLK1_CFG_RCGR_ADDR

    print "Choose frequency (MHz) from list below: " 

    print "4.8            9.6            19.2           " 
    print "33.333333      48.0           66.666667      " 
    print "66.666667      68.571429      " 

    print ""
    print "Enter desired frequency (r to return): "
    enter &clk_desired_freq
    print ""

    if ("&clk_desired_freq"=="4.8")
    (
      &clk_src_name="XO"
      &clk_src_sel=SRC_SEL TODO.
      &clk_src_div=8.
      &clk_m_val=0.
      &clk_n_val=0.
      &clk_2d_val=0.
      
      gosub Set_Clock_Freq
      return
    )
    else if ("&clk_desired_freq"=="9.6")
    (
      &clk_src_name="XO"
      &clk_src_sel=SRC_SEL TODO.
      &clk_src_div=4.
      &clk_m_val=0.
      &clk_n_val=0.
      &clk_2d_val=0.
      
      gosub Set_Clock_Freq
      return
    )
    else if ("&clk_desired_freq"=="19.2")
    (
      &clk_src_name="XO"
      &clk_src_sel=SRC_SEL TODO.
      &clk_src_div=2.
      &clk_m_val=0.
      &clk_n_val=0.
      &clk_2d_val=0.
      
      gosub Set_Clock_Freq
      return
    )
    else if ("&clk_desired_freq"=="33.333333")
    (
      &clk_src_name="EXTERNAL"
      &clk_src_sel=SRC_SEL TODO.
      &clk_src_div=2.
      &clk_m_val=0.
      &clk_n_val=0.
      &clk_2d_val=0.
      
      gosub Set_Clock_Freq
      return
    )
    else if ("&clk_desired_freq"=="48.0")
    (
      &clk_src_name="GPLL0_OUT_MAIN"
      &clk_src_sel=SRC_SEL TODO.
      &clk_src_div=2.
      &clk_m_val=2.
      &clk_n_val=25.
      &clk_2d_val=25.
      
      gosub Set_Clock_Freq
      return
    )
    else if ("&clk_desired_freq"=="66.666667")
    (
      &clk_src_name="GPLL0_OUT_MAIN"
      &clk_src_sel=SRC_SEL TODO.
      &clk_src_div=2.
      &clk_m_val=1.
      &clk_n_val=9.
      &clk_2d_val=9.
      
      gosub Set_Clock_Freq
      return
    )
    else if ("&clk_desired_freq"=="66.666667")
    (
      &clk_src_name="EXTERNAL"
      &clk_src_sel=SRC_SEL TODO.
      &clk_src_div=2.
      &clk_m_val=0.
      &clk_n_val=0.
      &clk_2d_val=0.
      
      gosub Set_Clock_Freq
      return
    )
    else if ("&clk_desired_freq"=="68.571429")
    (
      &clk_src_name="EXTERNAL"
      &clk_src_sel=SRC_SEL TODO.
      &clk_src_div=2.
      &clk_m_val=0.
      &clk_n_val=0.
      &clk_2d_val=0.
      
      gosub Set_Clock_Freq
      return
    )
    else if ("&clk_desired_freq"=="r")
    (
      return
    )
    else
    (
      print "Invalid selection."
      goto Set_Clock_Freq_Enter
    )
  )

  if ("&clk"=="camss_mclk2_clk")
  (
    gosub PRINT_SET_CLOCK_FREQ_WARNING

    &clk_cmd_rcgr_addr=&HWIO_MMSS_MCLK2_CMD_RCGR_ADDR
    &clk_cfg_rcgr_addr=&HWIO_MMSS_MCLK2_CFG_RCGR_ADDR

    print "Choose frequency (MHz) from list below: " 

    print "4.8            9.6            19.2           " 
    print "33.333333      48.0           66.666667      " 
    print "66.666667      68.571429      " 

    print ""
    print "Enter desired frequency (r to return): "
    enter &clk_desired_freq
    print ""

    if ("&clk_desired_freq"=="4.8")
    (
      &clk_src_name="XO"
      &clk_src_sel=SRC_SEL TODO.
      &clk_src_div=8.
      &clk_m_val=0.
      &clk_n_val=0.
      &clk_2d_val=0.
      
      gosub Set_Clock_Freq
      return
    )
    else if ("&clk_desired_freq"=="9.6")
    (
      &clk_src_name="XO"
      &clk_src_sel=SRC_SEL TODO.
      &clk_src_div=4.
      &clk_m_val=0.
      &clk_n_val=0.
      &clk_2d_val=0.
      
      gosub Set_Clock_Freq
      return
    )
    else if ("&clk_desired_freq"=="19.2")
    (
      &clk_src_name="XO"
      &clk_src_sel=SRC_SEL TODO.
      &clk_src_div=2.
      &clk_m_val=0.
      &clk_n_val=0.
      &clk_2d_val=0.
      
      gosub Set_Clock_Freq
      return
    )
    else if ("&clk_desired_freq"=="33.333333")
    (
      &clk_src_name="EXTERNAL"
      &clk_src_sel=SRC_SEL TODO.
      &clk_src_div=2.
      &clk_m_val=0.
      &clk_n_val=0.
      &clk_2d_val=0.
      
      gosub Set_Clock_Freq
      return
    )
    else if ("&clk_desired_freq"=="48.0")
    (
      &clk_src_name="GPLL0_OUT_MAIN"
      &clk_src_sel=SRC_SEL TODO.
      &clk_src_div=2.
      &clk_m_val=2.
      &clk_n_val=25.
      &clk_2d_val=25.
      
      gosub Set_Clock_Freq
      return
    )
    else if ("&clk_desired_freq"=="66.666667")
    (
      &clk_src_name="GPLL0_OUT_MAIN"
      &clk_src_sel=SRC_SEL TODO.
      &clk_src_div=2.
      &clk_m_val=1.
      &clk_n_val=9.
      &clk_2d_val=9.
      
      gosub Set_Clock_Freq
      return
    )
    else if ("&clk_desired_freq"=="66.666667")
    (
      &clk_src_name="EXTERNAL"
      &clk_src_sel=SRC_SEL TODO.
      &clk_src_div=2.
      &clk_m_val=0.
      &clk_n_val=0.
      &clk_2d_val=0.
      
      gosub Set_Clock_Freq
      return
    )
    else if ("&clk_desired_freq"=="68.571429")
    (
      &clk_src_name="EXTERNAL"
      &clk_src_sel=SRC_SEL TODO.
      &clk_src_div=2.
      &clk_m_val=0.
      &clk_n_val=0.
      &clk_2d_val=0.
      
      gosub Set_Clock_Freq
      return
    )
    else if ("&clk_desired_freq"=="r")
    (
      return
    )
    else
    (
      print "Invalid selection."
      goto Set_Clock_Freq_Enter
    )
  )

  if ("&clk"=="camss_mclk3_clk")
  (
    gosub PRINT_SET_CLOCK_FREQ_WARNING

    &clk_cmd_rcgr_addr=&HWIO_MMSS_MCLK3_CMD_RCGR_ADDR
    &clk_cfg_rcgr_addr=&HWIO_MMSS_MCLK3_CFG_RCGR_ADDR

    print "Choose frequency (MHz) from list below: " 

    print "4.8            9.6            19.2           " 
    print "33.333333      48.0           66.666667      " 
    print "66.666667      68.571429      " 

    print ""
    print "Enter desired frequency (r to return): "
    enter &clk_desired_freq
    print ""

    if ("&clk_desired_freq"=="4.8")
    (
      &clk_src_name="XO"
      &clk_src_sel=SRC_SEL TODO.
      &clk_src_div=8.
      &clk_m_val=0.
      &clk_n_val=0.
      &clk_2d_val=0.
      
      gosub Set_Clock_Freq
      return
    )
    else if ("&clk_desired_freq"=="9.6")
    (
      &clk_src_name="XO"
      &clk_src_sel=SRC_SEL TODO.
      &clk_src_div=4.
      &clk_m_val=0.
      &clk_n_val=0.
      &clk_2d_val=0.
      
      gosub Set_Clock_Freq
      return
    )
    else if ("&clk_desired_freq"=="19.2")
    (
      &clk_src_name="XO"
      &clk_src_sel=SRC_SEL TODO.
      &clk_src_div=2.
      &clk_m_val=0.
      &clk_n_val=0.
      &clk_2d_val=0.
      
      gosub Set_Clock_Freq
      return
    )
    else if ("&clk_desired_freq"=="33.333333")
    (
      &clk_src_name="EXTERNAL"
      &clk_src_sel=SRC_SEL TODO.
      &clk_src_div=2.
      &clk_m_val=0.
      &clk_n_val=0.
      &clk_2d_val=0.
      
      gosub Set_Clock_Freq
      return
    )
    else if ("&clk_desired_freq"=="48.0")
    (
      &clk_src_name="GPLL0_OUT_MAIN"
      &clk_src_sel=SRC_SEL TODO.
      &clk_src_div=2.
      &clk_m_val=2.
      &clk_n_val=25.
      &clk_2d_val=25.
      
      gosub Set_Clock_Freq
      return
    )
    else if ("&clk_desired_freq"=="66.666667")
    (
      &clk_src_name="GPLL0_OUT_MAIN"
      &clk_src_sel=SRC_SEL TODO.
      &clk_src_div=2.
      &clk_m_val=1.
      &clk_n_val=9.
      &clk_2d_val=9.
      
      gosub Set_Clock_Freq
      return
    )
    else if ("&clk_desired_freq"=="66.666667")
    (
      &clk_src_name="EXTERNAL"
      &clk_src_sel=SRC_SEL TODO.
      &clk_src_div=2.
      &clk_m_val=0.
      &clk_n_val=0.
      &clk_2d_val=0.
      
      gosub Set_Clock_Freq
      return
    )
    else if ("&clk_desired_freq"=="68.571429")
    (
      &clk_src_name="EXTERNAL"
      &clk_src_sel=SRC_SEL TODO.
      &clk_src_div=2.
      &clk_m_val=0.
      &clk_n_val=0.
      &clk_2d_val=0.
      
      gosub Set_Clock_Freq
      return
    )
    else if ("&clk_desired_freq"=="r")
    (
      return
    )
    else
    (
      print "Invalid selection."
      goto Set_Clock_Freq_Enter
    )
  )

  if ("&clk"=="mdss_mdp_clk")||("&clk"=="mmss_spdm_mdp_clk")
  (
    gosub PRINT_SET_CLOCK_FREQ_WARNING

    &clk_cmd_rcgr_addr=&HWIO_MMSS_MDP_CMD_RCGR_ADDR
    &clk_cfg_rcgr_addr=&HWIO_MMSS_MDP_CFG_RCGR_ADDR

    print "Choose frequency (MHz) from list below: " 

    print "85.714286      100.0          150.0          " 
    print "171.428571     171.428571     200.0          " 
    print "275.0          275.0          300.0          " 
    print "330.0          330.0          412.5          " 
    print "412.5          " 

    print ""
    print "Enter desired frequency (r to return): "
    enter &clk_desired_freq
    print ""

    if ("&clk_desired_freq"=="85.714286")
    (
      &clk_src_name="GPLL0_OUT_MAIN"
      &clk_src_sel=SRC_SEL TODO.
      &clk_src_div=14.
      &clk_m_val=0.
      &clk_n_val=0.
      &clk_2d_val=0.
      
      gosub Set_Clock_Freq
      return
    )
    else if ("&clk_desired_freq"=="100.0")
    (
      &clk_src_name="GPLL0_OUT_MAIN"
      &clk_src_sel=SRC_SEL TODO.
      &clk_src_div=12.
      &clk_m_val=0.
      &clk_n_val=0.
      &clk_2d_val=0.
      
      gosub Set_Clock_Freq
      return
    )
    else if ("&clk_desired_freq"=="150.0")
    (
      &clk_src_name="GPLL0_OUT_MAIN"
      &clk_src_sel=SRC_SEL TODO.
      &clk_src_div=8.
      &clk_m_val=0.
      &clk_n_val=0.
      &clk_2d_val=0.
      
      gosub Set_Clock_Freq
      return
    )
    else if ("&clk_desired_freq"=="171.428571")
    (
      &clk_src_name="GPLL0_OUT_MAIN"
      &clk_src_sel=SRC_SEL TODO.
      &clk_src_div=7.
      &clk_m_val=0.
      &clk_n_val=0.
      &clk_2d_val=0.
      
      gosub Set_Clock_Freq
      return
    )
    else if ("&clk_desired_freq"=="171.428571")
    (
      &clk_src_name="EXTERNAL"
      &clk_src_sel=SRC_SEL TODO.
      &clk_src_div=2.
      &clk_m_val=0.
      &clk_n_val=0.
      &clk_2d_val=0.
      
      gosub Set_Clock_Freq
      return
    )
    else if ("&clk_desired_freq"=="200.0")
    (
      &clk_src_name="GPLL0_OUT_MAIN"
      &clk_src_sel=SRC_SEL TODO.
      &clk_src_div=6.
      &clk_m_val=0.
      &clk_n_val=0.
      &clk_2d_val=0.
      
      gosub Set_Clock_Freq
      return
    )
    else if ("&clk_desired_freq"=="275.0")
    (
      &clk_src_name="MMPLL5_PLL_OUT_MAIN"
      &clk_src_sel=SRC_SEL TODO.
      &clk_src_div=6.
      &clk_m_val=0.
      &clk_n_val=0.
      &clk_2d_val=0.
      
      gosub Set_Clock_Freq
      return
    )
    else if ("&clk_desired_freq"=="275.0")
    (
      &clk_src_name="EXTERNAL"
      &clk_src_sel=SRC_SEL TODO.
      &clk_src_div=2.
      &clk_m_val=0.
      &clk_n_val=0.
      &clk_2d_val=0.
      
      gosub Set_Clock_Freq
      return
    )
    else if ("&clk_desired_freq"=="300.0")
    (
      &clk_src_name="GPLL0_OUT_MAIN"
      &clk_src_sel=SRC_SEL TODO.
      &clk_src_div=4.
      &clk_m_val=0.
      &clk_n_val=0.
      &clk_2d_val=0.
      
      gosub Set_Clock_Freq
      return
    )
    else if ("&clk_desired_freq"=="330.0")
    (
      &clk_src_name="MMPLL5_PLL_OUT_MAIN"
      &clk_src_sel=SRC_SEL TODO.
      &clk_src_div=5.
      &clk_m_val=0.
      &clk_n_val=0.
      &clk_2d_val=0.
      
      gosub Set_Clock_Freq
      return
    )
    else if ("&clk_desired_freq"=="330.0")
    (
      &clk_src_name="EXTERNAL"
      &clk_src_sel=SRC_SEL TODO.
      &clk_src_div=2.
      &clk_m_val=0.
      &clk_n_val=0.
      &clk_2d_val=0.
      
      gosub Set_Clock_Freq
      return
    )
    else if ("&clk_desired_freq"=="412.5")
    (
      &clk_src_name="MMPLL5_PLL_OUT_MAIN"
      &clk_src_sel=SRC_SEL TODO.
      &clk_src_div=4.
      &clk_m_val=0.
      &clk_n_val=0.
      &clk_2d_val=0.
      
      gosub Set_Clock_Freq
      return
    )
    else if ("&clk_desired_freq"=="412.5")
    (
      &clk_src_name="EXTERNAL"
      &clk_src_sel=SRC_SEL TODO.
      &clk_src_div=2.
      &clk_m_val=0.
      &clk_n_val=0.
      &clk_2d_val=0.
      
      gosub Set_Clock_Freq
      return
    )
    else if ("&clk_desired_freq"=="r")
    (
      return
    )
    else
    (
      print "Invalid selection."
      goto Set_Clock_Freq_Enter
    )
  )

  if ("&clk"=="mdss_pclk0_clk")||("&clk"=="mmss_spdm_pclk0_clk")
  (
    gosub PRINT_SET_CLOCK_FREQ_WARNING

    &clk_cmd_rcgr_addr=&HWIO_MMSS_PCLK0_CMD_RCGR_ADDR
    &clk_cfg_rcgr_addr=&HWIO_MMSS_PCLK0_CFG_RCGR_ADDR

    print "Choose frequency (MHz) from list below: " 

    print "175.0          280.0          350.0          " 

    print ""
    print "Enter desired frequency (r to return): "
    enter &clk_desired_freq
    print ""

    if ("&clk_desired_freq"=="175.0")
    (
      &clk_src_name="EXTERNAL"
      &clk_src_sel=SRC_SEL TODO.
      &clk_src_div=2.
      &clk_m_val=0.
      &clk_n_val=0.
      &clk_2d_val=0.
      
      gosub Set_Clock_Freq
      return
    )
    else if ("&clk_desired_freq"=="280.0")
    (
      &clk_src_name="EXTERNAL"
      &clk_src_sel=SRC_SEL TODO.
      &clk_src_div=2.
      &clk_m_val=0.
      &clk_n_val=0.
      &clk_2d_val=0.
      
      gosub Set_Clock_Freq
      return
    )
    else if ("&clk_desired_freq"=="350.0")
    (
      &clk_src_name="EXTERNAL"
      &clk_src_sel=SRC_SEL TODO.
      &clk_src_div=2.
      &clk_m_val=0.
      &clk_n_val=0.
      &clk_2d_val=0.
      
      gosub Set_Clock_Freq
      return
    )
    else if ("&clk_desired_freq"=="r")
    (
      return
    )
    else
    (
      print "Invalid selection."
      goto Set_Clock_Freq_Enter
    )
  )

  if ("&clk"=="mdss_pclk1_clk")||("&clk"=="mmss_spdm_pclk1_clk")
  (
    gosub PRINT_SET_CLOCK_FREQ_WARNING

    &clk_cmd_rcgr_addr=&HWIO_MMSS_PCLK1_CMD_RCGR_ADDR
    &clk_cfg_rcgr_addr=&HWIO_MMSS_PCLK1_CFG_RCGR_ADDR

    print "Choose frequency (MHz) from list below: " 

    print "175.0          280.0          350.0          " 

    print ""
    print "Enter desired frequency (r to return): "
    enter &clk_desired_freq
    print ""

    if ("&clk_desired_freq"=="175.0")
    (
      &clk_src_name="EXTERNAL"
      &clk_src_sel=SRC_SEL TODO.
      &clk_src_div=2.
      &clk_m_val=0.
      &clk_n_val=0.
      &clk_2d_val=0.
      
      gosub Set_Clock_Freq
      return
    )
    else if ("&clk_desired_freq"=="280.0")
    (
      &clk_src_name="EXTERNAL"
      &clk_src_sel=SRC_SEL TODO.
      &clk_src_div=2.
      &clk_m_val=0.
      &clk_n_val=0.
      &clk_2d_val=0.
      
      gosub Set_Clock_Freq
      return
    )
    else if ("&clk_desired_freq"=="350.0")
    (
      &clk_src_name="EXTERNAL"
      &clk_src_sel=SRC_SEL TODO.
      &clk_src_div=2.
      &clk_m_val=0.
      &clk_n_val=0.
      &clk_2d_val=0.
      
      gosub Set_Clock_Freq
      return
    )
    else if ("&clk_desired_freq"=="r")
    (
      return
    )
    else
    (
      print "Invalid selection."
      goto Set_Clock_Freq_Enter
    )
  )

  if ("&clk"=="gpu_gx_rbbmtimer_clk")
  (
    gosub PRINT_SET_CLOCK_FREQ_WARNING

    &clk_cmd_rcgr_addr=&HWIO_MMSS_RBBMTIMER_CMD_RCGR_ADDR
    &clk_cfg_rcgr_addr=&HWIO_MMSS_RBBMTIMER_CFG_RCGR_ADDR

    print "Choose frequency (MHz) from list below: " 

    print "19.2           " 

    print ""
    print "Enter desired frequency (r to return): "
    enter &clk_desired_freq
    print ""

    if ("&clk_desired_freq"=="19.2")
    (
      &clk_src_name="EXTERNAL"
      &clk_src_sel=SRC_SEL TODO.
      &clk_src_div=2.
      &clk_m_val=0.
      &clk_n_val=0.
      &clk_2d_val=0.
      
      gosub Set_Clock_Freq
      return
    )
    else if ("&clk_desired_freq"=="r")
    (
      return
    )
    else
    (
      print "Invalid selection."
      goto Set_Clock_Freq_Enter
    )
  )

  if ("&clk"=="mmss_rbcpr_clk")
  (
    gosub PRINT_SET_CLOCK_FREQ_WARNING

    &clk_cmd_rcgr_addr=&HWIO_MMSS_RBCPR_CMD_RCGR_ADDR
    &clk_cfg_rcgr_addr=&HWIO_MMSS_RBCPR_CFG_RCGR_ADDR

    print "Choose frequency (MHz) from list below: " 

    print "19.2           19.2           50.0           " 
    print "50.0           " 

    print ""
    print "Enter desired frequency (r to return): "
    enter &clk_desired_freq
    print ""

    if ("&clk_desired_freq"=="19.2")
    (
      &clk_src_name="XO"
      &clk_src_sel=SRC_SEL TODO.
      &clk_src_div=2.
      &clk_m_val=0.
      &clk_n_val=0.
      &clk_2d_val=0.
      
      gosub Set_Clock_Freq
      return
    )
    else if ("&clk_desired_freq"=="19.2")
    (
      &clk_src_name="EXTERNAL"
      &clk_src_sel=SRC_SEL TODO.
      &clk_src_div=2.
      &clk_m_val=0.
      &clk_n_val=0.
      &clk_2d_val=0.
      
      gosub Set_Clock_Freq
      return
    )
    else if ("&clk_desired_freq"=="50.0")
    (
      &clk_src_name="GPLL0_OUT_MAIN"
      &clk_src_sel=SRC_SEL TODO.
      &clk_src_div=24.
      &clk_m_val=0.
      &clk_n_val=0.
      &clk_2d_val=0.
      
      gosub Set_Clock_Freq
      return
    )
    else if ("&clk_desired_freq"=="50.0")
    (
      &clk_src_name="EXTERNAL"
      &clk_src_sel=SRC_SEL TODO.
      &clk_src_div=2.
      &clk_m_val=0.
      &clk_n_val=0.
      &clk_2d_val=0.
      
      gosub Set_Clock_Freq
      return
    )
    else if ("&clk_desired_freq"=="r")
    (
      return
    )
    else
    (
      print "Invalid selection."
      goto Set_Clock_Freq_Enter
    )
  )

  if ("&clk"=="camss_csi_vfe0_clk")||("&clk"=="camss_vfe0_clk")||("&clk"=="camss_vfe0_stream_clk")||("&clk"=="mmss_spdm_vfe0_clk")
  (
    gosub PRINT_SET_CLOCK_FREQ_WARNING

    &clk_cmd_rcgr_addr=&HWIO_MMSS_VFE0_CMD_RCGR_ADDR
    &clk_cfg_rcgr_addr=&HWIO_MMSS_VFE0_CFG_RCGR_ADDR

    print "Choose frequency (MHz) from list below: " 

    print "100.0          200.0          200.0          " 
    print "320.0          480.0          480.0          " 
    print "600.0          600.0          " 

    print ""
    print "Enter desired frequency (r to return): "
    enter &clk_desired_freq
    print ""

    if ("&clk_desired_freq"=="100.0")
    (
      &clk_src_name="EXTERNAL"
      &clk_src_sel=SRC_SEL TODO.
      &clk_src_div=2.
      &clk_m_val=0.
      &clk_n_val=0.
      &clk_2d_val=0.
      
      gosub Set_Clock_Freq
      return
    )
    else if ("&clk_desired_freq"=="200.0")
    (
      &clk_src_name="GPLL0_OUT_MAIN"
      &clk_src_sel=SRC_SEL TODO.
      &clk_src_div=6.
      &clk_m_val=0.
      &clk_n_val=0.
      &clk_2d_val=0.
      
      gosub Set_Clock_Freq
      return
    )
    else if ("&clk_desired_freq"=="200.0")
    (
      &clk_src_name="EXTERNAL"
      &clk_src_sel=SRC_SEL TODO.
      &clk_src_div=2.
      &clk_m_val=0.
      &clk_n_val=0.
      &clk_2d_val=0.
      
      gosub Set_Clock_Freq
      return
    )
    else if ("&clk_desired_freq"=="320.0")
    (
      &clk_src_name="MMPLL0_PLL_OUT_MAIN"
      &clk_src_sel=SRC_SEL TODO.
      &clk_src_div=5.
      &clk_m_val=0.
      &clk_n_val=0.
      &clk_2d_val=0.
      
      gosub Set_Clock_Freq
      return
    )
    else if ("&clk_desired_freq"=="480.0")
    (
      &clk_src_name="MMPLL4_PLL_OUT_MAIN"
      &clk_src_sel=SRC_SEL TODO.
      &clk_src_div=4.
      &clk_m_val=0.
      &clk_n_val=0.
      &clk_2d_val=0.
      
      gosub Set_Clock_Freq
      return
    )
    else if ("&clk_desired_freq"=="480.0")
    (
      &clk_src_name="EXTERNAL"
      &clk_src_sel=SRC_SEL TODO.
      &clk_src_div=2.
      &clk_m_val=0.
      &clk_n_val=0.
      &clk_2d_val=0.
      
      gosub Set_Clock_Freq
      return
    )
    else if ("&clk_desired_freq"=="600.0")
    (
      &clk_src_name="GPLL0_OUT_MAIN"
      &clk_src_sel=SRC_SEL TODO.
      &clk_src_div=2.
      &clk_m_val=0.
      &clk_n_val=0.
      &clk_2d_val=0.
      
      gosub Set_Clock_Freq
      return
    )
    else if ("&clk_desired_freq"=="600.0")
    (
      &clk_src_name="EXTERNAL"
      &clk_src_sel=SRC_SEL TODO.
      &clk_src_div=2.
      &clk_m_val=0.
      &clk_n_val=0.
      &clk_2d_val=0.
      
      gosub Set_Clock_Freq
      return
    )
    else if ("&clk_desired_freq"=="r")
    (
      return
    )
    else
    (
      print "Invalid selection."
      goto Set_Clock_Freq_Enter
    )
  )

  if ("&clk"=="camss_csi_vfe1_clk")||("&clk"=="camss_vfe1_clk")||("&clk"=="camss_vfe1_stream_clk")||("&clk"=="mmss_spdm_vfe1_clk")
  (
    gosub PRINT_SET_CLOCK_FREQ_WARNING

    &clk_cmd_rcgr_addr=&HWIO_MMSS_VFE1_CMD_RCGR_ADDR
    &clk_cfg_rcgr_addr=&HWIO_MMSS_VFE1_CFG_RCGR_ADDR

    print "Choose frequency (MHz) from list below: " 

    print "100.0          200.0          200.0          " 
    print "320.0          480.0          480.0          " 
    print "600.0          600.0          " 

    print ""
    print "Enter desired frequency (r to return): "
    enter &clk_desired_freq
    print ""

    if ("&clk_desired_freq"=="100.0")
    (
      &clk_src_name="EXTERNAL"
      &clk_src_sel=SRC_SEL TODO.
      &clk_src_div=2.
      &clk_m_val=0.
      &clk_n_val=0.
      &clk_2d_val=0.
      
      gosub Set_Clock_Freq
      return
    )
    else if ("&clk_desired_freq"=="200.0")
    (
      &clk_src_name="GPLL0_OUT_MAIN"
      &clk_src_sel=SRC_SEL TODO.
      &clk_src_div=6.
      &clk_m_val=0.
      &clk_n_val=0.
      &clk_2d_val=0.
      
      gosub Set_Clock_Freq
      return
    )
    else if ("&clk_desired_freq"=="200.0")
    (
      &clk_src_name="EXTERNAL"
      &clk_src_sel=SRC_SEL TODO.
      &clk_src_div=2.
      &clk_m_val=0.
      &clk_n_val=0.
      &clk_2d_val=0.
      
      gosub Set_Clock_Freq
      return
    )
    else if ("&clk_desired_freq"=="320.0")
    (
      &clk_src_name="MMPLL0_PLL_OUT_MAIN"
      &clk_src_sel=SRC_SEL TODO.
      &clk_src_div=5.
      &clk_m_val=0.
      &clk_n_val=0.
      &clk_2d_val=0.
      
      gosub Set_Clock_Freq
      return
    )
    else if ("&clk_desired_freq"=="480.0")
    (
      &clk_src_name="MMPLL4_PLL_OUT_MAIN"
      &clk_src_sel=SRC_SEL TODO.
      &clk_src_div=4.
      &clk_m_val=0.
      &clk_n_val=0.
      &clk_2d_val=0.
      
      gosub Set_Clock_Freq
      return
    )
    else if ("&clk_desired_freq"=="480.0")
    (
      &clk_src_name="EXTERNAL"
      &clk_src_sel=SRC_SEL TODO.
      &clk_src_div=2.
      &clk_m_val=0.
      &clk_n_val=0.
      &clk_2d_val=0.
      
      gosub Set_Clock_Freq
      return
    )
    else if ("&clk_desired_freq"=="600.0")
    (
      &clk_src_name="GPLL0_OUT_MAIN"
      &clk_src_sel=SRC_SEL TODO.
      &clk_src_div=2.
      &clk_m_val=0.
      &clk_n_val=0.
      &clk_2d_val=0.
      
      gosub Set_Clock_Freq
      return
    )
    else if ("&clk_desired_freq"=="600.0")
    (
      &clk_src_name="EXTERNAL"
      &clk_src_sel=SRC_SEL TODO.
      &clk_src_div=2.
      &clk_m_val=0.
      &clk_n_val=0.
      &clk_2d_val=0.
      
      gosub Set_Clock_Freq
      return
    )
    else if ("&clk_desired_freq"=="r")
    (
      return
    )
    else
    (
      print "Invalid selection."
      goto Set_Clock_Freq_Enter
    )
  )

  if ("&clk"=="mmss_spdm_video_core_clk")||("&clk"=="video_core_clk")
  (
    gosub PRINT_SET_CLOCK_FREQ_WARNING

    &clk_cmd_rcgr_addr=&HWIO_MMSS_VIDEO_CORE_CMD_RCGR_ADDR
    &clk_cfg_rcgr_addr=&HWIO_MMSS_VIDEO_CORE_CFG_RCGR_ADDR

    print "Choose frequency (MHz) from list below: " 

    print "75.0           150.0          150.0          " 
    print "320.0          320.0          490.0          " 
    print "516.0          516.0          " 

    print ""
    print "Enter desired frequency (r to return): "
    enter &clk_desired_freq
    print ""

    if ("&clk_desired_freq"=="75.0")
    (
      &clk_src_name="EXTERNAL"
      &clk_src_sel=SRC_SEL TODO.
      &clk_src_div=2.
      &clk_m_val=0.
      &clk_n_val=0.
      &clk_2d_val=0.
      
      gosub Set_Clock_Freq
      return
    )
    else if ("&clk_desired_freq"=="150.0")
    (
      &clk_src_name="GPLL0_OUT_MAIN"
      &clk_src_sel=SRC_SEL TODO.
      &clk_src_div=8.
      &clk_m_val=0.
      &clk_n_val=0.
      &clk_2d_val=0.
      
      gosub Set_Clock_Freq
      return
    )
    else if ("&clk_desired_freq"=="150.0")
    (
      &clk_src_name="EXTERNAL"
      &clk_src_sel=SRC_SEL TODO.
      &clk_src_div=2.
      &clk_m_val=0.
      &clk_n_val=0.
      &clk_2d_val=0.
      
      gosub Set_Clock_Freq
      return
    )
    else if ("&clk_desired_freq"=="320.0")
    (
      &clk_src_name="MMPLL0_PLL_OUT_MAIN"
      &clk_src_sel=SRC_SEL TODO.
      &clk_src_div=5.
      &clk_m_val=0.
      &clk_n_val=0.
      &clk_2d_val=0.
      
      gosub Set_Clock_Freq
      return
    )
    else if ("&clk_desired_freq"=="320.0")
    (
      &clk_src_name="EXTERNAL"
      &clk_src_sel=SRC_SEL TODO.
      &clk_src_div=2.
      &clk_m_val=0.
      &clk_n_val=0.
      &clk_2d_val=0.
      
      gosub Set_Clock_Freq
      return
    )
    else if ("&clk_desired_freq"=="490.0")
    (
      &clk_src_name="MMPLL3_PLL_OUT_MAIN"
      &clk_src_sel=SRC_SEL TODO.
      &clk_src_div=4.
      &clk_m_val=0.
      &clk_n_val=0.
      &clk_2d_val=0.
      
      gosub Set_Clock_Freq
      return
    )
    else if ("&clk_desired_freq"=="516.0")
    (
      &clk_src_name="MMPLL3_PLL_OUT_MAIN"
      &clk_src_sel=SRC_SEL TODO.
      &clk_src_div=4.
      &clk_m_val=0.
      &clk_n_val=0.
      &clk_2d_val=0.
      
      gosub Set_Clock_Freq
      return
    )
    else if ("&clk_desired_freq"=="516.0")
    (
      &clk_src_name="EXTERNAL"
      &clk_src_sel=SRC_SEL TODO.
      &clk_src_div=2.
      &clk_m_val=0.
      &clk_n_val=0.
      &clk_2d_val=0.
      
      gosub Set_Clock_Freq
      return
    )
    else if ("&clk_desired_freq"=="r")
    (
      return
    )
    else
    (
      print "Invalid selection."
      goto Set_Clock_Freq_Enter
    )
  )

  if ("&clk"=="video_subcore0_clk")
  (
    gosub PRINT_SET_CLOCK_FREQ_WARNING

    &clk_cmd_rcgr_addr=&HWIO_MMSS_VIDEO_SUBCORE0_CMD_RCGR_ADDR
    &clk_cfg_rcgr_addr=&HWIO_MMSS_VIDEO_SUBCORE0_CFG_RCGR_ADDR

    print "Choose frequency (MHz) from list below: " 

    print "75.0           150.0          150.0          " 
    print "320.0          320.0          490.0          " 
    print "490.0          " 

    print ""
    print "Enter desired frequency (r to return): "
    enter &clk_desired_freq
    print ""

    if ("&clk_desired_freq"=="75.0")
    (
      &clk_src_name="EXTERNAL"
      &clk_src_sel=SRC_SEL TODO.
      &clk_src_div=2.
      &clk_m_val=0.
      &clk_n_val=0.
      &clk_2d_val=0.
      
      gosub Set_Clock_Freq
      return
    )
    else if ("&clk_desired_freq"=="150.0")
    (
      &clk_src_name="GPLL0_OUT_MAIN"
      &clk_src_sel=SRC_SEL TODO.
      &clk_src_div=8.
      &clk_m_val=0.
      &clk_n_val=0.
      &clk_2d_val=0.
      
      gosub Set_Clock_Freq
      return
    )
    else if ("&clk_desired_freq"=="150.0")
    (
      &clk_src_name="EXTERNAL"
      &clk_src_sel=SRC_SEL TODO.
      &clk_src_div=2.
      &clk_m_val=0.
      &clk_n_val=0.
      &clk_2d_val=0.
      
      gosub Set_Clock_Freq
      return
    )
    else if ("&clk_desired_freq"=="320.0")
    (
      &clk_src_name="MMPLL0_PLL_OUT_MAIN"
      &clk_src_sel=SRC_SEL TODO.
      &clk_src_div=5.
      &clk_m_val=0.
      &clk_n_val=0.
      &clk_2d_val=0.
      
      gosub Set_Clock_Freq
      return
    )
    else if ("&clk_desired_freq"=="320.0")
    (
      &clk_src_name="EXTERNAL"
      &clk_src_sel=SRC_SEL TODO.
      &clk_src_div=2.
      &clk_m_val=0.
      &clk_n_val=0.
      &clk_2d_val=0.
      
      gosub Set_Clock_Freq
      return
    )
    else if ("&clk_desired_freq"=="490.0")
    (
      &clk_src_name="MMPLL3_PLL_OUT_MAIN"
      &clk_src_sel=SRC_SEL TODO.
      &clk_src_div=4.
      &clk_m_val=0.
      &clk_n_val=0.
      &clk_2d_val=0.
      
      gosub Set_Clock_Freq
      return
    )
    else if ("&clk_desired_freq"=="490.0")
    (
      &clk_src_name="EXTERNAL"
      &clk_src_sel=SRC_SEL TODO.
      &clk_src_div=2.
      &clk_m_val=0.
      &clk_n_val=0.
      &clk_2d_val=0.
      
      gosub Set_Clock_Freq
      return
    )
    else if ("&clk_desired_freq"=="r")
    (
      return
    )
    else
    (
      print "Invalid selection."
      goto Set_Clock_Freq_Enter
    )
  )

  if ("&clk"=="video_subcore1_clk")
  (
    gosub PRINT_SET_CLOCK_FREQ_WARNING

    &clk_cmd_rcgr_addr=&HWIO_MMSS_VIDEO_SUBCORE1_CMD_RCGR_ADDR
    &clk_cfg_rcgr_addr=&HWIO_MMSS_VIDEO_SUBCORE1_CFG_RCGR_ADDR

    print "Choose frequency (MHz) from list below: " 

    print "75.0           150.0          150.0          " 
    print "320.0          320.0          490.0          " 
    print "516.0          516.0          " 

    print ""
    print "Enter desired frequency (r to return): "
    enter &clk_desired_freq
    print ""

    if ("&clk_desired_freq"=="75.0")
    (
      &clk_src_name="EXTERNAL"
      &clk_src_sel=SRC_SEL TODO.
      &clk_src_div=2.
      &clk_m_val=0.
      &clk_n_val=0.
      &clk_2d_val=0.
      
      gosub Set_Clock_Freq
      return
    )
    else if ("&clk_desired_freq"=="150.0")
    (
      &clk_src_name="GPLL0_OUT_MAIN"
      &clk_src_sel=SRC_SEL TODO.
      &clk_src_div=8.
      &clk_m_val=0.
      &clk_n_val=0.
      &clk_2d_val=0.
      
      gosub Set_Clock_Freq
      return
    )
    else if ("&clk_desired_freq"=="150.0")
    (
      &clk_src_name="EXTERNAL"
      &clk_src_sel=SRC_SEL TODO.
      &clk_src_div=2.
      &clk_m_val=0.
      &clk_n_val=0.
      &clk_2d_val=0.
      
      gosub Set_Clock_Freq
      return
    )
    else if ("&clk_desired_freq"=="320.0")
    (
      &clk_src_name="MMPLL0_PLL_OUT_MAIN"
      &clk_src_sel=SRC_SEL TODO.
      &clk_src_div=5.
      &clk_m_val=0.
      &clk_n_val=0.
      &clk_2d_val=0.
      
      gosub Set_Clock_Freq
      return
    )
    else if ("&clk_desired_freq"=="320.0")
    (
      &clk_src_name="EXTERNAL"
      &clk_src_sel=SRC_SEL TODO.
      &clk_src_div=2.
      &clk_m_val=0.
      &clk_n_val=0.
      &clk_2d_val=0.
      
      gosub Set_Clock_Freq
      return
    )
    else if ("&clk_desired_freq"=="490.0")
    (
      &clk_src_name="MMPLL3_PLL_OUT_MAIN"
      &clk_src_sel=SRC_SEL TODO.
      &clk_src_div=4.
      &clk_m_val=0.
      &clk_n_val=0.
      &clk_2d_val=0.
      
      gosub Set_Clock_Freq
      return
    )
    else if ("&clk_desired_freq"=="516.0")
    (
      &clk_src_name="MMPLL3_PLL_OUT_MAIN"
      &clk_src_sel=SRC_SEL TODO.
      &clk_src_div=4.
      &clk_m_val=0.
      &clk_n_val=0.
      &clk_2d_val=0.
      
      gosub Set_Clock_Freq
      return
    )
    else if ("&clk_desired_freq"=="516.0")
    (
      &clk_src_name="EXTERNAL"
      &clk_src_sel=SRC_SEL TODO.
      &clk_src_div=2.
      &clk_m_val=0.
      &clk_n_val=0.
      &clk_2d_val=0.
      
      gosub Set_Clock_Freq
      return
    )
    else if ("&clk_desired_freq"=="r")
    (
      return
    )
    else
    (
      print "Invalid selection."
      goto Set_Clock_Freq_Enter
    )
  )

  if ("&clk"=="mdss_vsync_clk")
  (
    gosub PRINT_SET_CLOCK_FREQ_WARNING

    &clk_cmd_rcgr_addr=&HWIO_MMSS_VSYNC_CMD_RCGR_ADDR
    &clk_cfg_rcgr_addr=&HWIO_MMSS_VSYNC_CFG_RCGR_ADDR

    print "Choose frequency (MHz) from list below: " 

    print "19.2           " 

    print ""
    print "Enter desired frequency (r to return): "
    enter &clk_desired_freq
    print ""

    if ("&clk_desired_freq"=="19.2")
    (
      &clk_src_name="EXTERNAL"
      &clk_src_sel=SRC_SEL TODO.
      &clk_src_div=2.
      &clk_m_val=0.
      &clk_n_val=0.
      &clk_2d_val=0.
      
      gosub Set_Clock_Freq
      return
    )
    else if ("&clk_desired_freq"=="r")
    (
      return
    )
    else
    (
      print "Invalid selection."
      goto Set_Clock_Freq_Enter
    )
  )

  if ("&clk"=="clk_src_bit_coxm_mnd")||("&clk"=="clk_bit_coxm")
  (
    gosub PRINT_SET_CLOCK_FREQ_WARNING

    &clk_cmd_rcgr_addr=&HWIO_MSS_BIT_COXM_MND_CMD_RCGR_ADDR
    &clk_cfg_rcgr_addr=&HWIO_MSS_BIT_COXM_MND_CFG_RCGR_ADDR

    print "Choose frequency (MHz) from list below: " 

    print "1.8432         16.0           32.0           " 
    print "48.0           51.2           " 

    print ""
    print "Enter desired frequency (r to return): "
    enter &clk_desired_freq
    print ""

    if ("&clk_desired_freq"=="1.8432")
    (
      &clk_src_name="GPLL0_OUT_MAIN"
      &clk_src_sel=SRC_SEL TODO.
      &clk_src_div=2.
      &clk_m_val=96.
      &clk_n_val=15625.
      &clk_2d_val=15625.
      
      gosub Set_Clock_Freq
      return
    )
    else if ("&clk_desired_freq"=="16.0")
    (
      &clk_src_name="GPLL0_OUT_MAIN"
      &clk_src_sel=SRC_SEL TODO.
      &clk_src_div=2.
      &clk_m_val=4.
      &clk_n_val=75.
      &clk_2d_val=75.
      
      gosub Set_Clock_Freq
      return
    )
    else if ("&clk_desired_freq"=="32.0")
    (
      &clk_src_name="GPLL0_OUT_MAIN"
      &clk_src_sel=SRC_SEL TODO.
      &clk_src_div=2.
      &clk_m_val=8.
      &clk_n_val=75.
      &clk_2d_val=75.
      
      gosub Set_Clock_Freq
      return
    )
    else if ("&clk_desired_freq"=="48.0")
    (
      &clk_src_name="GPLL0_OUT_MAIN"
      &clk_src_sel=SRC_SEL TODO.
      &clk_src_div=2.
      &clk_m_val=4.
      &clk_n_val=25.
      &clk_2d_val=25.
      
      gosub Set_Clock_Freq
      return
    )
    else if ("&clk_desired_freq"=="51.2")
    (
      &clk_src_name="GPLL0_OUT_MAIN"
      &clk_src_sel=SRC_SEL TODO.
      &clk_src_div=2.
      &clk_m_val=64.
      &clk_n_val=375.
      &clk_2d_val=375.
      
      gosub Set_Clock_Freq
      return
    )
    else if ("&clk_desired_freq"=="r")
    (
      return
    )
    else
    (
      print "Invalid selection."
      goto Set_Clock_Freq_Enter
    )
  )

  if ("&clk"=="clk_src_bus_mss_config")||("&clk"=="clk_bus_config")||("&clk"=="clk_bus_coxm")||("&clk"=="clk_bus_crypto")||("&clk"=="clk_bus_mgpi")||("&clk"=="clk_bus_mvc")||("&clk"=="clk_bus_nav")||("&clk"=="clk_bus_pll_outctrl")||("&clk"=="clk_bus_q6")||("&clk"=="clk_bus_rbcpr")||("&clk"=="clk_bus_rfc")||("&clk"=="clk_bus_slave_timeout")||("&clk"=="clk_bus_stmr")||("&clk"=="clk_bus_uim0")||("&clk"=="clk_bus_uim1")||("&clk"=="clk_bus_uim2")||("&clk"=="clk_bus_uim3")||("&clk"=="mss_dgr_ahb_clk")||("&clk"=="mss_dgr_freerun_ahb_clk")
  (
    gosub PRINT_SET_CLOCK_FREQ_WARNING

    &clk_cmd_rcgr_addr=&HWIO_MSS_BUS_CMD_RCGR_ADDR
    &clk_cfg_rcgr_addr=&HWIO_MSS_BUS_CFG_RCGR_ADDR

    print "Choose frequency (MHz) from list below: " 

    print "19.2           75.0           " 

    print ""
    print "Enter desired frequency (r to return): "
    enter &clk_desired_freq
    print ""

    if ("&clk_desired_freq"=="19.2")
    (
      &clk_src_name="XO"
      &clk_src_sel=SRC_SEL TODO.
      &clk_src_div=2.
      &clk_m_val=0.
      &clk_n_val=0.
      &clk_2d_val=0.
      
      gosub Set_Clock_Freq
      return
    )
    else if ("&clk_desired_freq"=="75.0")
    (
      &clk_src_name="GPLL0_OUT_MAIN"
      &clk_src_sel=SRC_SEL TODO.
      &clk_src_div=8.
      &clk_m_val=0.
      &clk_n_val=0.
      &clk_2d_val=0.
      
      gosub Set_Clock_Freq
      return
    )
    else if ("&clk_desired_freq"=="r")
    (
      return
    )
    else
    (
      print "Invalid selection."
      goto Set_Clock_Freq_Enter
    )
  )

  if ("&clk"=="clk_q6")
  (
    gosub PRINT_SET_CLOCK_FREQ_WARNING

    &clk_cmd_rcgr_addr=&HWIO_MSS_QDSP6SS_CORE_CMD_RCGR_ADDR
    &clk_cfg_rcgr_addr=&HWIO_MSS_QDSP6SS_CORE_CFG_RCGR_ADDR

    print "Choose frequency (MHz) from list below: " 

    print "19.2           115.2          144.0          " 
    print "230.4          288.0          345.6          " 
    print "364.8          384.0          499.2          " 
    print "518.4          576.0          652.8          " 
    print "729.6          806.4          844.8          " 

    print ""
    print "Enter desired frequency (r to return): "
    enter &clk_desired_freq
    print ""

    if ("&clk_desired_freq"=="19.2")
    (
      &clk_src_name="XO"
      &clk_src_sel=SRC_SEL TODO.
      &clk_src_div=2.
      &clk_m_val=0.
      &clk_n_val=0.
      &clk_2d_val=0.
      
      gosub Set_Clock_Freq
      return
    )
    else if ("&clk_desired_freq"=="115.2")
    (
      &clk_src_name="QDSP6SS_PLL_OUT_MAIN"
      &clk_src_sel=SRC_SEL TODO.
      &clk_src_div=10.
      &clk_m_val=0.
      &clk_n_val=0.
      &clk_2d_val=0.
      
      gosub Set_Clock_Freq
      return
    )
    else if ("&clk_desired_freq"=="144.0")
    (
      &clk_src_name="QDSP6SS_PLL_OUT_MAIN"
      &clk_src_sel=SRC_SEL TODO.
      &clk_src_div=8.
      &clk_m_val=0.
      &clk_n_val=0.
      &clk_2d_val=0.
      
      gosub Set_Clock_Freq
      return
    )
    else if ("&clk_desired_freq"=="230.4")
    (
      &clk_src_name="QDSP6SS_PLL_OUT_MAIN"
      &clk_src_sel=SRC_SEL TODO.
      &clk_src_div=5.
      &clk_m_val=0.
      &clk_n_val=0.
      &clk_2d_val=0.
      
      gosub Set_Clock_Freq
      return
    )
    else if ("&clk_desired_freq"=="288.0")
    (
      &clk_src_name="QDSP6SS_PLL_OUT_MAIN"
      &clk_src_sel=SRC_SEL TODO.
      &clk_src_div=4.
      &clk_m_val=0.
      &clk_n_val=0.
      &clk_2d_val=0.
      
      gosub Set_Clock_Freq
      return
    )
    else if ("&clk_desired_freq"=="345.6")
    (
      &clk_src_name="QDSP6SS_PLL_OUT_MAIN"
      &clk_src_sel=SRC_SEL TODO.
      &clk_src_div=4.
      &clk_m_val=0.
      &clk_n_val=0.
      &clk_2d_val=0.
      
      gosub Set_Clock_Freq
      return
    )
    else if ("&clk_desired_freq"=="364.8")
    (
      &clk_src_name="QDSP6SS_PLL_OUT_MAIN"
      &clk_src_sel=SRC_SEL TODO.
      &clk_src_div=4.
      &clk_m_val=0.
      &clk_n_val=0.
      &clk_2d_val=0.
      
      gosub Set_Clock_Freq
      return
    )
    else if ("&clk_desired_freq"=="384.0")
    (
      &clk_src_name="QDSP6SS_PLL_OUT_MAIN"
      &clk_src_sel=SRC_SEL TODO.
      &clk_src_div=4.
      &clk_m_val=0.
      &clk_n_val=0.
      &clk_2d_val=0.
      
      gosub Set_Clock_Freq
      return
    )
    else if ("&clk_desired_freq"=="499.2")
    (
      &clk_src_name="QDSP6SS_PLL_OUT_MAIN"
      &clk_src_sel=SRC_SEL TODO.
      &clk_src_div=3.
      &clk_m_val=0.
      &clk_n_val=0.
      &clk_2d_val=0.
      
      gosub Set_Clock_Freq
      return
    )
    else if ("&clk_desired_freq"=="518.4")
    (
      &clk_src_name="QDSP6SS_PLL_OUT_MAIN"
      &clk_src_sel=SRC_SEL TODO.
      &clk_src_div=2.
      &clk_m_val=0.
      &clk_n_val=0.
      &clk_2d_val=0.
      
      gosub Set_Clock_Freq
      return
    )
    else if ("&clk_desired_freq"=="576.0")
    (
      &clk_src_name="QDSP6SS_PLL_OUT_MAIN"
      &clk_src_sel=SRC_SEL TODO.
      &clk_src_div=2.
      &clk_m_val=0.
      &clk_n_val=0.
      &clk_2d_val=0.
      
      gosub Set_Clock_Freq
      return
    )
    else if ("&clk_desired_freq"=="652.8")
    (
      &clk_src_name="QDSP6SS_PLL_OUT_MAIN"
      &clk_src_sel=SRC_SEL TODO.
      &clk_src_div=2.
      &clk_m_val=0.
      &clk_n_val=0.
      &clk_2d_val=0.
      
      gosub Set_Clock_Freq
      return
    )
    else if ("&clk_desired_freq"=="729.6")
    (
      &clk_src_name="QDSP6SS_PLL_OUT_MAIN"
      &clk_src_sel=SRC_SEL TODO.
      &clk_src_div=2.
      &clk_m_val=0.
      &clk_n_val=0.
      &clk_2d_val=0.
      
      gosub Set_Clock_Freq
      return
    )
    else if ("&clk_desired_freq"=="806.4")
    (
      &clk_src_name="QDSP6SS_PLL_OUT_MAIN"
      &clk_src_sel=SRC_SEL TODO.
      &clk_src_div=2.
      &clk_m_val=0.
      &clk_n_val=0.
      &clk_2d_val=0.
      
      gosub Set_Clock_Freq
      return
    )
    else if ("&clk_desired_freq"=="844.8")
    (
      &clk_src_name="QDSP6SS_PLL_OUT_MAIN"
      &clk_src_sel=SRC_SEL TODO.
      &clk_src_div=2.
      &clk_m_val=0.
      &clk_n_val=0.
      &clk_2d_val=0.
      
      gosub Set_Clock_Freq
      return
    )
    else if ("&clk_desired_freq"=="r")
    (
      return
    )
    else
    (
      print "Invalid selection."
      goto Set_Clock_Freq_Enter
    )
  )

  if ("&clk"=="clk_src_rbcpr_ref")||("&clk"=="clk_rbcpr_ref")
  (
    gosub PRINT_SET_CLOCK_FREQ_WARNING

    &clk_cmd_rcgr_addr=&HWIO_MSS_RBCPR_REF_CMD_RCGR_ADDR
    &clk_cfg_rcgr_addr=&HWIO_MSS_RBCPR_REF_CFG_RCGR_ADDR

    print "Choose frequency (MHz) from list below: " 

    print "19.2           50.0           " 

    print ""
    print "Enter desired frequency (r to return): "
    enter &clk_desired_freq
    print ""

    if ("&clk_desired_freq"=="19.2")
    (
      &clk_src_name="XO"
      &clk_src_sel=SRC_SEL TODO.
      &clk_src_div=2.
      &clk_m_val=0.
      &clk_n_val=0.
      &clk_2d_val=0.
      
      gosub Set_Clock_Freq
      return
    )
    else if ("&clk_desired_freq"=="50.0")
    (
      &clk_src_name="GPLL0_OUT_MAIN"
      &clk_src_sel=SRC_SEL TODO.
      &clk_src_div=12.
      &clk_m_val=0.
      &clk_n_val=0.
      &clk_2d_val=0.
      
      gosub Set_Clock_Freq
      return
    )
    else if ("&clk_desired_freq"=="r")
    (
      return
    )
    else
    (
      print "Invalid selection."
      goto Set_Clock_Freq_Enter
    )
  )

  if ("&clk"=="clk_src_uim")||("&clk"=="clk_card_src_uim0")||("&clk"=="clk_card_src_uim1")||("&clk"=="clk_card_src_uim2")||("&clk"=="clk_card_src_uim3")
  (
    gosub PRINT_SET_CLOCK_FREQ_WARNING

    &clk_cmd_rcgr_addr=&HWIO_MSS_UIM_CMD_RCGR_ADDR
    &clk_cfg_rcgr_addr=&HWIO_MSS_UIM_CFG_RCGR_ADDR

    print "Choose frequency (MHz) from list below: " 

    print "3.84           4.8            " 

    print ""
    print "Enter desired frequency (r to return): "
    enter &clk_desired_freq
    print ""

    if ("&clk_desired_freq"=="3.84")
    (
      &clk_src_name="XO"
      &clk_src_sel=SRC_SEL TODO.
      &clk_src_div=10.
      &clk_m_val=0.
      &clk_n_val=0.
      &clk_2d_val=0.
      
      gosub Set_Clock_Freq
      return
    )
    else if ("&clk_desired_freq"=="4.8")
    (
      &clk_src_name="XO"
      &clk_src_sel=SRC_SEL TODO.
      &clk_src_div=8.
      &clk_m_val=0.
      &clk_n_val=0.
      &clk_2d_val=0.
      
      gosub Set_Clock_Freq
      return
    )
    else if ("&clk_desired_freq"=="r")
    (
      return
    )
    else
    (
      print "Invalid selection."
      goto Set_Clock_Freq_Enter
    )
  )

  if ("&clk"=="clk_src_uim0_mnd")||("&clk"=="clk_uart_bit_uim0")
  (
    gosub PRINT_SET_CLOCK_FREQ_WARNING

    &clk_cmd_rcgr_addr=&HWIO_MSS_UIM0_MND_CMD_RCGR_ADDR
    &clk_cfg_rcgr_addr=&HWIO_MSS_UIM0_MND_CFG_RCGR_ADDR

    print "Choose frequency (MHz) from list below: " 

    print "4.80768        4.9536         4.96128        " 
    print "5.12           5.28384        5.28512        " 
    print "5.76           5.77536        6.32832        " 
    print "6.34368        6.4            6.6048         " 
    print "6.60608        6.6064         6.60672        " 
    print "6.60736        7.04512        7.0464         " 
    print "7.04688        7.04704        7.04768        " 
    print "7.18848        7.2            7.20128        " 
    print "7.20384        7.43232        7.68           " 
    print "7.92576        7.92768        7.92832        " 
    print "7.9296         8.0            8.25792        " 
    print "8.25856        8.45568        8.45632        " 
    print "8.45824        8.64           8.8064         " 
    print "8.80832        8.80864        8.80896        " 
    print "9.0            9.00096        9.51168        " 
    print "9.6            " 

    print ""
    print "Enter desired frequency (r to return): "
    enter &clk_desired_freq
    print ""

    if ("&clk_desired_freq"=="4.80768")
    (
      &clk_src_name="XO"
      &clk_src_sel=SRC_SEL TODO.
      &clk_src_div=2.
      &clk_m_val=313.
      &clk_n_val=1250.
      &clk_2d_val=1250.
      
      gosub Set_Clock_Freq
      return
    )
    else if ("&clk_desired_freq"=="4.9536")
    (
      &clk_src_name="XO"
      &clk_src_sel=SRC_SEL TODO.
      &clk_src_div=2.
      &clk_m_val=129.
      &clk_n_val=500.
      &clk_2d_val=500.
      
      gosub Set_Clock_Freq
      return
    )
    else if ("&clk_desired_freq"=="4.96128")
    (
      &clk_src_name="XO"
      &clk_src_sel=SRC_SEL TODO.
      &clk_src_div=2.
      &clk_m_val=323.
      &clk_n_val=1250.
      &clk_2d_val=1250.
      
      gosub Set_Clock_Freq
      return
    )
    else if ("&clk_desired_freq"=="5.12")
    (
      &clk_src_name="XO"
      &clk_src_sel=SRC_SEL TODO.
      &clk_src_div=2.
      &clk_m_val=4.
      &clk_n_val=15.
      &clk_2d_val=15.
      
      gosub Set_Clock_Freq
      return
    )
    else if ("&clk_desired_freq"=="5.28384")
    (
      &clk_src_name="XO"
      &clk_src_sel=SRC_SEL TODO.
      &clk_src_div=2.
      &clk_m_val=172.
      &clk_n_val=625.
      &clk_2d_val=625.
      
      gosub Set_Clock_Freq
      return
    )
    else if ("&clk_desired_freq"=="5.28512")
    (
      &clk_src_name="XO"
      &clk_src_sel=SRC_SEL TODO.
      &clk_src_div=2.
      &clk_m_val=4129.
      &clk_n_val=15000.
      &clk_2d_val=15000.
      
      gosub Set_Clock_Freq
      return
    )
    else if ("&clk_desired_freq"=="5.76")
    (
      &clk_src_name="XO"
      &clk_src_sel=SRC_SEL TODO.
      &clk_src_div=2.
      &clk_m_val=3.
      &clk_n_val=10.
      &clk_2d_val=10.
      
      gosub Set_Clock_Freq
      return
    )
    else if ("&clk_desired_freq"=="5.77536")
    (
      &clk_src_name="XO"
      &clk_src_sel=SRC_SEL TODO.
      &clk_src_div=2.
      &clk_m_val=188.
      &clk_n_val=625.
      &clk_2d_val=625.
      
      gosub Set_Clock_Freq
      return
    )
    else if ("&clk_desired_freq"=="6.32832")
    (
      &clk_src_name="XO"
      &clk_src_sel=SRC_SEL TODO.
      &clk_src_div=2.
      &clk_m_val=206.
      &clk_n_val=625.
      &clk_2d_val=625.
      
      gosub Set_Clock_Freq
      return
    )
    else if ("&clk_desired_freq"=="6.34368")
    (
      &clk_src_name="XO"
      &clk_src_sel=SRC_SEL TODO.
      &clk_src_div=2.
      &clk_m_val=413.
      &clk_n_val=1250.
      &clk_2d_val=1250.
      
      gosub Set_Clock_Freq
      return
    )
    else if ("&clk_desired_freq"=="6.4")
    (
      &clk_src_name="XO"
      &clk_src_sel=SRC_SEL TODO.
      &clk_src_div=2.
      &clk_m_val=1.
      &clk_n_val=3.
      &clk_2d_val=3.
      
      gosub Set_Clock_Freq
      return
    )
    else if ("&clk_desired_freq"=="6.6048")
    (
      &clk_src_name="XO"
      &clk_src_sel=SRC_SEL TODO.
      &clk_src_div=2.
      &clk_m_val=43.
      &clk_n_val=125.
      &clk_2d_val=125.
      
      gosub Set_Clock_Freq
      return
    )
    else if ("&clk_desired_freq"=="6.60608")
    (
      &clk_src_name="XO"
      &clk_src_sel=SRC_SEL TODO.
      &clk_src_div=2.
      &clk_m_val=5161.
      &clk_n_val=15000.
      &clk_2d_val=15000.
      
      gosub Set_Clock_Freq
      return
    )
    else if ("&clk_desired_freq"=="6.6064")
    (
      &clk_src_name="XO"
      &clk_src_sel=SRC_SEL TODO.
      &clk_src_div=2.
      &clk_m_val=4129.
      &clk_n_val=12000.
      &clk_2d_val=12000.
      
      gosub Set_Clock_Freq
      return
    )
    else if ("&clk_desired_freq"=="6.60672")
    (
      &clk_src_name="XO"
      &clk_src_sel=SRC_SEL TODO.
      &clk_src_div=2.
      &clk_m_val=3441.
      &clk_n_val=10000.
      &clk_2d_val=10000.
      
      gosub Set_Clock_Freq
      return
    )
    else if ("&clk_desired_freq"=="6.60736")
    (
      &clk_src_name="XO"
      &clk_src_sel=SRC_SEL TODO.
      &clk_src_div=2.
      &clk_m_val=2581.
      &clk_n_val=7500.
      &clk_2d_val=7500.
      
      gosub Set_Clock_Freq
      return
    )
    else if ("&clk_desired_freq"=="7.04512")
    (
      &clk_src_name="XO"
      &clk_src_sel=SRC_SEL TODO.
      &clk_src_div=2.
      &clk_m_val=688.
      &clk_n_val=1875.
      &clk_2d_val=1875.
      
      gosub Set_Clock_Freq
      return
    )
    else if ("&clk_desired_freq"=="7.0464")
    (
      &clk_src_name="XO"
      &clk_src_sel=SRC_SEL TODO.
      &clk_src_div=2.
      &clk_m_val=367.
      &clk_n_val=1000.
      &clk_2d_val=1000.
      
      gosub Set_Clock_Freq
      return
    )
    else if ("&clk_desired_freq"=="7.04688")
    (
      &clk_src_name="XO"
      &clk_src_sel=SRC_SEL TODO.
      &clk_src_div=2.
      &clk_m_val=14681.
      &clk_n_val=40000.
      &clk_2d_val=40000.
      
      gosub Set_Clock_Freq
      return
    )
    else if ("&clk_desired_freq"=="7.04704")
    (
      &clk_src_name="XO"
      &clk_src_sel=SRC_SEL TODO.
      &clk_src_div=2.
      &clk_m_val=11011.
      &clk_n_val=30000.
      &clk_2d_val=30000.
      
      gosub Set_Clock_Freq
      return
    )
    else if ("&clk_desired_freq"=="7.04768")
    (
      &clk_src_name="XO"
      &clk_src_sel=SRC_SEL TODO.
      &clk_src_div=2.
      &clk_m_val=2753.
      &clk_n_val=7500.
      &clk_2d_val=7500.
      
      gosub Set_Clock_Freq
      return
    )
    else if ("&clk_desired_freq"=="7.18848")
    (
      &clk_src_name="XO"
      &clk_src_sel=SRC_SEL TODO.
      &clk_src_div=2.
      &clk_m_val=234.
      &clk_n_val=625.
      &clk_2d_val=625.
      
      gosub Set_Clock_Freq
      return
    )
    else if ("&clk_desired_freq"=="7.2")
    (
      &clk_src_name="XO"
      &clk_src_sel=SRC_SEL TODO.
      &clk_src_div=2.
      &clk_m_val=3.
      &clk_n_val=8.
      &clk_2d_val=8.
      
      gosub Set_Clock_Freq
      return
    )
    else if ("&clk_desired_freq"=="7.20128")
    (
      &clk_src_name="XO"
      &clk_src_sel=SRC_SEL TODO.
      &clk_src_div=2.
      &clk_m_val=2813.
      &clk_n_val=7500.
      &clk_2d_val=7500.
      
      gosub Set_Clock_Freq
      return
    )
    else if ("&clk_desired_freq"=="7.20384")
    (
      &clk_src_name="XO"
      &clk_src_sel=SRC_SEL TODO.
      &clk_src_div=2.
      &clk_m_val=469.
      &clk_n_val=1250.
      &clk_2d_val=1250.
      
      gosub Set_Clock_Freq
      return
    )
    else if ("&clk_desired_freq"=="7.43232")
    (
      &clk_src_name="XO"
      &clk_src_sel=SRC_SEL TODO.
      &clk_src_div=2.
      &clk_m_val=3871.
      &clk_n_val=10000.
      &clk_2d_val=10000.
      
      gosub Set_Clock_Freq
      return
    )
    else if ("&clk_desired_freq"=="7.68")
    (
      &clk_src_name="XO"
      &clk_src_sel=SRC_SEL TODO.
      &clk_src_div=2.
      &clk_m_val=2.
      &clk_n_val=5.
      &clk_2d_val=5.
      
      gosub Set_Clock_Freq
      return
    )
    else if ("&clk_desired_freq"=="7.92576")
    (
      &clk_src_name="XO"
      &clk_src_sel=SRC_SEL TODO.
      &clk_src_div=2.
      &clk_m_val=258.
      &clk_n_val=625.
      &clk_2d_val=625.
      
      gosub Set_Clock_Freq
      return
    )
    else if ("&clk_desired_freq"=="7.92768")
    (
      &clk_src_name="XO"
      &clk_src_sel=SRC_SEL TODO.
      &clk_src_div=2.
      &clk_m_val=4129.
      &clk_n_val=10000.
      &clk_2d_val=10000.
      
      gosub Set_Clock_Freq
      return
    )
    else if ("&clk_desired_freq"=="7.92832")
    (
      &clk_src_name="XO"
      &clk_src_sel=SRC_SEL TODO.
      &clk_src_div=2.
      &clk_m_val=3097.
      &clk_n_val=7500.
      &clk_2d_val=7500.
      
      gosub Set_Clock_Freq
      return
    )
    else if ("&clk_desired_freq"=="7.9296")
    (
      &clk_src_name="XO"
      &clk_src_sel=SRC_SEL TODO.
      &clk_src_div=2.
      &clk_m_val=413.
      &clk_n_val=1000.
      &clk_2d_val=1000.
      
      gosub Set_Clock_Freq
      return
    )
    else if ("&clk_desired_freq"=="8.0")
    (
      &clk_src_name="XO"
      &clk_src_sel=SRC_SEL TODO.
      &clk_src_div=2.
      &clk_m_val=5.
      &clk_n_val=12.
      &clk_2d_val=12.
      
      gosub Set_Clock_Freq
      return
    )
    else if ("&clk_desired_freq"=="8.25792")
    (
      &clk_src_name="XO"
      &clk_src_sel=SRC_SEL TODO.
      &clk_src_div=2.
      &clk_m_val=4301.
      &clk_n_val=10000.
      &clk_2d_val=10000.
      
      gosub Set_Clock_Freq
      return
    )
    else if ("&clk_desired_freq"=="8.25856")
    (
      &clk_src_name="XO"
      &clk_src_sel=SRC_SEL TODO.
      &clk_src_div=2.
      &clk_m_val=1613.
      &clk_n_val=3750.
      &clk_2d_val=3750.
      
      gosub Set_Clock_Freq
      return
    )
    else if ("&clk_desired_freq"=="8.45568")
    (
      &clk_src_name="XO"
      &clk_src_sel=SRC_SEL TODO.
      &clk_src_div=2.
      &clk_m_val=1101.
      &clk_n_val=2500.
      &clk_2d_val=2500.
      
      gosub Set_Clock_Freq
      return
    )
    else if ("&clk_desired_freq"=="8.45632")
    (
      &clk_src_name="XO"
      &clk_src_sel=SRC_SEL TODO.
      &clk_src_div=2.
      &clk_m_val=13213.
      &clk_n_val=30000.
      &clk_2d_val=30000.
      
      gosub Set_Clock_Freq
      return
    )
    else if ("&clk_desired_freq"=="8.45824")
    (
      &clk_src_name="XO"
      &clk_src_sel=SRC_SEL TODO.
      &clk_src_div=2.
      &clk_m_val=826.
      &clk_n_val=1875.
      &clk_2d_val=1875.
      
      gosub Set_Clock_Freq
      return
    )
    else if ("&clk_desired_freq"=="8.64")
    (
      &clk_src_name="XO"
      &clk_src_sel=SRC_SEL TODO.
      &clk_src_div=2.
      &clk_m_val=9.
      &clk_n_val=20.
      &clk_2d_val=20.
      
      gosub Set_Clock_Freq
      return
    )
    else if ("&clk_desired_freq"=="8.8064")
    (
      &clk_src_name="XO"
      &clk_src_sel=SRC_SEL TODO.
      &clk_src_div=2.
      &clk_m_val=172.
      &clk_n_val=375.
      &clk_2d_val=375.
      
      gosub Set_Clock_Freq
      return
    )
    else if ("&clk_desired_freq"=="8.80832")
    (
      &clk_src_name="XO"
      &clk_src_sel=SRC_SEL TODO.
      &clk_src_div=2.
      &clk_m_val=13763.
      &clk_n_val=30000.
      &clk_2d_val=30000.
      
      gosub Set_Clock_Freq
      return
    )
    else if ("&clk_desired_freq"=="8.80864")
    (
      &clk_src_name="XO"
      &clk_src_sel=SRC_SEL TODO.
      &clk_src_div=2.
      &clk_m_val=27527.
      &clk_n_val=60000.
      &clk_2d_val=60000.
      
      gosub Set_Clock_Freq
      return
    )
    else if ("&clk_desired_freq"=="8.80896")
    (
      &clk_src_name="XO"
      &clk_src_sel=SRC_SEL TODO.
      &clk_src_div=2.
      &clk_m_val=1147.
      &clk_n_val=2500.
      &clk_2d_val=2500.
      
      gosub Set_Clock_Freq
      return
    )
    else if ("&clk_desired_freq"=="9.0")
    (
      &clk_src_name="XO"
      &clk_src_sel=SRC_SEL TODO.
      &clk_src_div=2.
      &clk_m_val=15.
      &clk_n_val=32.
      &clk_2d_val=32.
      
      gosub Set_Clock_Freq
      return
    )
    else if ("&clk_desired_freq"=="9.00096")
    (
      &clk_src_name="XO"
      &clk_src_sel=SRC_SEL TODO.
      &clk_src_div=2.
      &clk_m_val=293.
      &clk_n_val=625.
      &clk_2d_val=625.
      
      gosub Set_Clock_Freq
      return
    )
    else if ("&clk_desired_freq"=="9.51168")
    (
      &clk_src_name="XO"
      &clk_src_sel=SRC_SEL TODO.
      &clk_src_div=2.
      &clk_m_val=2477.
      &clk_n_val=5000.
      &clk_2d_val=5000.
      
      gosub Set_Clock_Freq
      return
    )
    else if ("&clk_desired_freq"=="9.6")
    (
      &clk_src_name="XO"
      &clk_src_sel=SRC_SEL TODO.
      &clk_src_div=2.
      &clk_m_val=1.
      &clk_n_val=2.
      &clk_2d_val=2.
      
      gosub Set_Clock_Freq
      return
    )
    else if ("&clk_desired_freq"=="r")
    (
      return
    )
    else
    (
      print "Invalid selection."
      goto Set_Clock_Freq_Enter
    )
  )

  if ("&clk"=="clk_src_uim1_mnd")||("&clk"=="clk_uart_bit_uim1")
  (
    gosub PRINT_SET_CLOCK_FREQ_WARNING

    &clk_cmd_rcgr_addr=&HWIO_MSS_UIM1_MND_CMD_RCGR_ADDR
    &clk_cfg_rcgr_addr=&HWIO_MSS_UIM1_MND_CFG_RCGR_ADDR

    print "Choose frequency (MHz) from list below: " 

    print "4.80768        4.9536         4.96128        " 
    print "5.12           5.28384        5.28512        " 
    print "5.76           5.77536        6.32832        " 
    print "6.34368        6.4            6.6048         " 
    print "6.60608        6.6064         6.60672        " 
    print "6.60736        7.04512        7.0464         " 
    print "7.04688        7.04704        7.04768        " 
    print "7.18848        7.2            7.20128        " 
    print "7.20384        7.43232        7.68           " 
    print "7.92576        7.92768        7.92832        " 
    print "7.9296         8.0            8.25792        " 
    print "8.25856        8.45568        8.45632        " 
    print "8.45824        8.64           8.8064         " 
    print "8.80832        8.80864        8.80896        " 
    print "9.0            9.00096        9.51168        " 
    print "9.6            " 

    print ""
    print "Enter desired frequency (r to return): "
    enter &clk_desired_freq
    print ""

    if ("&clk_desired_freq"=="4.80768")
    (
      &clk_src_name="XO"
      &clk_src_sel=SRC_SEL TODO.
      &clk_src_div=2.
      &clk_m_val=313.
      &clk_n_val=1250.
      &clk_2d_val=1250.
      
      gosub Set_Clock_Freq
      return
    )
    else if ("&clk_desired_freq"=="4.9536")
    (
      &clk_src_name="XO"
      &clk_src_sel=SRC_SEL TODO.
      &clk_src_div=2.
      &clk_m_val=129.
      &clk_n_val=500.
      &clk_2d_val=500.
      
      gosub Set_Clock_Freq
      return
    )
    else if ("&clk_desired_freq"=="4.96128")
    (
      &clk_src_name="XO"
      &clk_src_sel=SRC_SEL TODO.
      &clk_src_div=2.
      &clk_m_val=323.
      &clk_n_val=1250.
      &clk_2d_val=1250.
      
      gosub Set_Clock_Freq
      return
    )
    else if ("&clk_desired_freq"=="5.12")
    (
      &clk_src_name="XO"
      &clk_src_sel=SRC_SEL TODO.
      &clk_src_div=2.
      &clk_m_val=4.
      &clk_n_val=15.
      &clk_2d_val=15.
      
      gosub Set_Clock_Freq
      return
    )
    else if ("&clk_desired_freq"=="5.28384")
    (
      &clk_src_name="XO"
      &clk_src_sel=SRC_SEL TODO.
      &clk_src_div=2.
      &clk_m_val=172.
      &clk_n_val=625.
      &clk_2d_val=625.
      
      gosub Set_Clock_Freq
      return
    )
    else if ("&clk_desired_freq"=="5.28512")
    (
      &clk_src_name="XO"
      &clk_src_sel=SRC_SEL TODO.
      &clk_src_div=2.
      &clk_m_val=4129.
      &clk_n_val=15000.
      &clk_2d_val=15000.
      
      gosub Set_Clock_Freq
      return
    )
    else if ("&clk_desired_freq"=="5.76")
    (
      &clk_src_name="XO"
      &clk_src_sel=SRC_SEL TODO.
      &clk_src_div=2.
      &clk_m_val=3.
      &clk_n_val=10.
      &clk_2d_val=10.
      
      gosub Set_Clock_Freq
      return
    )
    else if ("&clk_desired_freq"=="5.77536")
    (
      &clk_src_name="XO"
      &clk_src_sel=SRC_SEL TODO.
      &clk_src_div=2.
      &clk_m_val=188.
      &clk_n_val=625.
      &clk_2d_val=625.
      
      gosub Set_Clock_Freq
      return
    )
    else if ("&clk_desired_freq"=="6.32832")
    (
      &clk_src_name="XO"
      &clk_src_sel=SRC_SEL TODO.
      &clk_src_div=2.
      &clk_m_val=206.
      &clk_n_val=625.
      &clk_2d_val=625.
      
      gosub Set_Clock_Freq
      return
    )
    else if ("&clk_desired_freq"=="6.34368")
    (
      &clk_src_name="XO"
      &clk_src_sel=SRC_SEL TODO.
      &clk_src_div=2.
      &clk_m_val=413.
      &clk_n_val=1250.
      &clk_2d_val=1250.
      
      gosub Set_Clock_Freq
      return
    )
    else if ("&clk_desired_freq"=="6.4")
    (
      &clk_src_name="XO"
      &clk_src_sel=SRC_SEL TODO.
      &clk_src_div=2.
      &clk_m_val=1.
      &clk_n_val=3.
      &clk_2d_val=3.
      
      gosub Set_Clock_Freq
      return
    )
    else if ("&clk_desired_freq"=="6.6048")
    (
      &clk_src_name="XO"
      &clk_src_sel=SRC_SEL TODO.
      &clk_src_div=2.
      &clk_m_val=43.
      &clk_n_val=125.
      &clk_2d_val=125.
      
      gosub Set_Clock_Freq
      return
    )
    else if ("&clk_desired_freq"=="6.60608")
    (
      &clk_src_name="XO"
      &clk_src_sel=SRC_SEL TODO.
      &clk_src_div=2.
      &clk_m_val=5161.
      &clk_n_val=15000.
      &clk_2d_val=15000.
      
      gosub Set_Clock_Freq
      return
    )
    else if ("&clk_desired_freq"=="6.6064")
    (
      &clk_src_name="XO"
      &clk_src_sel=SRC_SEL TODO.
      &clk_src_div=2.
      &clk_m_val=4129.
      &clk_n_val=12000.
      &clk_2d_val=12000.
      
      gosub Set_Clock_Freq
      return
    )
    else if ("&clk_desired_freq"=="6.60672")
    (
      &clk_src_name="XO"
      &clk_src_sel=SRC_SEL TODO.
      &clk_src_div=2.
      &clk_m_val=3441.
      &clk_n_val=10000.
      &clk_2d_val=10000.
      
      gosub Set_Clock_Freq
      return
    )
    else if ("&clk_desired_freq"=="6.60736")
    (
      &clk_src_name="XO"
      &clk_src_sel=SRC_SEL TODO.
      &clk_src_div=2.
      &clk_m_val=2581.
      &clk_n_val=7500.
      &clk_2d_val=7500.
      
      gosub Set_Clock_Freq
      return
    )
    else if ("&clk_desired_freq"=="7.04512")
    (
      &clk_src_name="XO"
      &clk_src_sel=SRC_SEL TODO.
      &clk_src_div=2.
      &clk_m_val=688.
      &clk_n_val=1875.
      &clk_2d_val=1875.
      
      gosub Set_Clock_Freq
      return
    )
    else if ("&clk_desired_freq"=="7.0464")
    (
      &clk_src_name="XO"
      &clk_src_sel=SRC_SEL TODO.
      &clk_src_div=2.
      &clk_m_val=367.
      &clk_n_val=1000.
      &clk_2d_val=1000.
      
      gosub Set_Clock_Freq
      return
    )
    else if ("&clk_desired_freq"=="7.04688")
    (
      &clk_src_name="XO"
      &clk_src_sel=SRC_SEL TODO.
      &clk_src_div=2.
      &clk_m_val=14681.
      &clk_n_val=40000.
      &clk_2d_val=40000.
      
      gosub Set_Clock_Freq
      return
    )
    else if ("&clk_desired_freq"=="7.04704")
    (
      &clk_src_name="XO"
      &clk_src_sel=SRC_SEL TODO.
      &clk_src_div=2.
      &clk_m_val=11011.
      &clk_n_val=30000.
      &clk_2d_val=30000.
      
      gosub Set_Clock_Freq
      return
    )
    else if ("&clk_desired_freq"=="7.04768")
    (
      &clk_src_name="XO"
      &clk_src_sel=SRC_SEL TODO.
      &clk_src_div=2.
      &clk_m_val=2753.
      &clk_n_val=7500.
      &clk_2d_val=7500.
      
      gosub Set_Clock_Freq
      return
    )
    else if ("&clk_desired_freq"=="7.18848")
    (
      &clk_src_name="XO"
      &clk_src_sel=SRC_SEL TODO.
      &clk_src_div=2.
      &clk_m_val=234.
      &clk_n_val=625.
      &clk_2d_val=625.
      
      gosub Set_Clock_Freq
      return
    )
    else if ("&clk_desired_freq"=="7.2")
    (
      &clk_src_name="XO"
      &clk_src_sel=SRC_SEL TODO.
      &clk_src_div=2.
      &clk_m_val=3.
      &clk_n_val=8.
      &clk_2d_val=8.
      
      gosub Set_Clock_Freq
      return
    )
    else if ("&clk_desired_freq"=="7.20128")
    (
      &clk_src_name="XO"
      &clk_src_sel=SRC_SEL TODO.
      &clk_src_div=2.
      &clk_m_val=2813.
      &clk_n_val=7500.
      &clk_2d_val=7500.
      
      gosub Set_Clock_Freq
      return
    )
    else if ("&clk_desired_freq"=="7.20384")
    (
      &clk_src_name="XO"
      &clk_src_sel=SRC_SEL TODO.
      &clk_src_div=2.
      &clk_m_val=469.
      &clk_n_val=1250.
      &clk_2d_val=1250.
      
      gosub Set_Clock_Freq
      return
    )
    else if ("&clk_desired_freq"=="7.43232")
    (
      &clk_src_name="XO"
      &clk_src_sel=SRC_SEL TODO.
      &clk_src_div=2.
      &clk_m_val=3871.
      &clk_n_val=10000.
      &clk_2d_val=10000.
      
      gosub Set_Clock_Freq
      return
    )
    else if ("&clk_desired_freq"=="7.68")
    (
      &clk_src_name="XO"
      &clk_src_sel=SRC_SEL TODO.
      &clk_src_div=2.
      &clk_m_val=2.
      &clk_n_val=5.
      &clk_2d_val=5.
      
      gosub Set_Clock_Freq
      return
    )
    else if ("&clk_desired_freq"=="7.92576")
    (
      &clk_src_name="XO"
      &clk_src_sel=SRC_SEL TODO.
      &clk_src_div=2.
      &clk_m_val=258.
      &clk_n_val=625.
      &clk_2d_val=625.
      
      gosub Set_Clock_Freq
      return
    )
    else if ("&clk_desired_freq"=="7.92768")
    (
      &clk_src_name="XO"
      &clk_src_sel=SRC_SEL TODO.
      &clk_src_div=2.
      &clk_m_val=4129.
      &clk_n_val=10000.
      &clk_2d_val=10000.
      
      gosub Set_Clock_Freq
      return
    )
    else if ("&clk_desired_freq"=="7.92832")
    (
      &clk_src_name="XO"
      &clk_src_sel=SRC_SEL TODO.
      &clk_src_div=2.
      &clk_m_val=3097.
      &clk_n_val=7500.
      &clk_2d_val=7500.
      
      gosub Set_Clock_Freq
      return
    )
    else if ("&clk_desired_freq"=="7.9296")
    (
      &clk_src_name="XO"
      &clk_src_sel=SRC_SEL TODO.
      &clk_src_div=2.
      &clk_m_val=413.
      &clk_n_val=1000.
      &clk_2d_val=1000.
      
      gosub Set_Clock_Freq
      return
    )
    else if ("&clk_desired_freq"=="8.0")
    (
      &clk_src_name="XO"
      &clk_src_sel=SRC_SEL TODO.
      &clk_src_div=2.
      &clk_m_val=5.
      &clk_n_val=12.
      &clk_2d_val=12.
      
      gosub Set_Clock_Freq
      return
    )
    else if ("&clk_desired_freq"=="8.25792")
    (
      &clk_src_name="XO"
      &clk_src_sel=SRC_SEL TODO.
      &clk_src_div=2.
      &clk_m_val=4301.
      &clk_n_val=10000.
      &clk_2d_val=10000.
      
      gosub Set_Clock_Freq
      return
    )
    else if ("&clk_desired_freq"=="8.25856")
    (
      &clk_src_name="XO"
      &clk_src_sel=SRC_SEL TODO.
      &clk_src_div=2.
      &clk_m_val=1613.
      &clk_n_val=3750.
      &clk_2d_val=3750.
      
      gosub Set_Clock_Freq
      return
    )
    else if ("&clk_desired_freq"=="8.45568")
    (
      &clk_src_name="XO"
      &clk_src_sel=SRC_SEL TODO.
      &clk_src_div=2.
      &clk_m_val=1101.
      &clk_n_val=2500.
      &clk_2d_val=2500.
      
      gosub Set_Clock_Freq
      return
    )
    else if ("&clk_desired_freq"=="8.45632")
    (
      &clk_src_name="XO"
      &clk_src_sel=SRC_SEL TODO.
      &clk_src_div=2.
      &clk_m_val=13213.
      &clk_n_val=30000.
      &clk_2d_val=30000.
      
      gosub Set_Clock_Freq
      return
    )
    else if ("&clk_desired_freq"=="8.45824")
    (
      &clk_src_name="XO"
      &clk_src_sel=SRC_SEL TODO.
      &clk_src_div=2.
      &clk_m_val=826.
      &clk_n_val=1875.
      &clk_2d_val=1875.
      
      gosub Set_Clock_Freq
      return
    )
    else if ("&clk_desired_freq"=="8.64")
    (
      &clk_src_name="XO"
      &clk_src_sel=SRC_SEL TODO.
      &clk_src_div=2.
      &clk_m_val=9.
      &clk_n_val=20.
      &clk_2d_val=20.
      
      gosub Set_Clock_Freq
      return
    )
    else if ("&clk_desired_freq"=="8.8064")
    (
      &clk_src_name="XO"
      &clk_src_sel=SRC_SEL TODO.
      &clk_src_div=2.
      &clk_m_val=172.
      &clk_n_val=375.
      &clk_2d_val=375.
      
      gosub Set_Clock_Freq
      return
    )
    else if ("&clk_desired_freq"=="8.80832")
    (
      &clk_src_name="XO"
      &clk_src_sel=SRC_SEL TODO.
      &clk_src_div=2.
      &clk_m_val=13763.
      &clk_n_val=30000.
      &clk_2d_val=30000.
      
      gosub Set_Clock_Freq
      return
    )
    else if ("&clk_desired_freq"=="8.80864")
    (
      &clk_src_name="XO"
      &clk_src_sel=SRC_SEL TODO.
      &clk_src_div=2.
      &clk_m_val=27527.
      &clk_n_val=60000.
      &clk_2d_val=60000.
      
      gosub Set_Clock_Freq
      return
    )
    else if ("&clk_desired_freq"=="8.80896")
    (
      &clk_src_name="XO"
      &clk_src_sel=SRC_SEL TODO.
      &clk_src_div=2.
      &clk_m_val=1147.
      &clk_n_val=2500.
      &clk_2d_val=2500.
      
      gosub Set_Clock_Freq
      return
    )
    else if ("&clk_desired_freq"=="9.0")
    (
      &clk_src_name="XO"
      &clk_src_sel=SRC_SEL TODO.
      &clk_src_div=2.
      &clk_m_val=15.
      &clk_n_val=32.
      &clk_2d_val=32.
      
      gosub Set_Clock_Freq
      return
    )
    else if ("&clk_desired_freq"=="9.00096")
    (
      &clk_src_name="XO"
      &clk_src_sel=SRC_SEL TODO.
      &clk_src_div=2.
      &clk_m_val=293.
      &clk_n_val=625.
      &clk_2d_val=625.
      
      gosub Set_Clock_Freq
      return
    )
    else if ("&clk_desired_freq"=="9.51168")
    (
      &clk_src_name="XO"
      &clk_src_sel=SRC_SEL TODO.
      &clk_src_div=2.
      &clk_m_val=2477.
      &clk_n_val=5000.
      &clk_2d_val=5000.
      
      gosub Set_Clock_Freq
      return
    )
    else if ("&clk_desired_freq"=="9.6")
    (
      &clk_src_name="XO"
      &clk_src_sel=SRC_SEL TODO.
      &clk_src_div=2.
      &clk_m_val=1.
      &clk_n_val=2.
      &clk_2d_val=2.
      
      gosub Set_Clock_Freq
      return
    )
    else if ("&clk_desired_freq"=="r")
    (
      return
    )
    else
    (
      print "Invalid selection."
      goto Set_Clock_Freq_Enter
    )
  )

  if ("&clk"=="clk_src_uim2_mnd")||("&clk"=="clk_uart_bit_uim2")
  (
    gosub PRINT_SET_CLOCK_FREQ_WARNING

    &clk_cmd_rcgr_addr=&HWIO_MSS_UIM2_MND_CMD_RCGR_ADDR
    &clk_cfg_rcgr_addr=&HWIO_MSS_UIM2_MND_CFG_RCGR_ADDR

    print "Choose frequency (MHz) from list below: " 

    print "4.80768        4.9536         4.96128        " 
    print "5.12           5.28384        5.28512        " 
    print "5.76           5.77536        6.32832        " 
    print "6.34368        6.4            6.6048         " 
    print "6.60608        6.6064         6.60672        " 
    print "6.60736        7.04512        7.0464         " 
    print "7.04688        7.04704        7.04768        " 
    print "7.18848        7.2            7.20128        " 
    print "7.20384        7.43232        7.68           " 
    print "7.92576        7.92768        7.92832        " 
    print "7.9296         8.0            8.25792        " 
    print "8.25856        8.45568        8.45632        " 
    print "8.45824        8.64           8.8064         " 
    print "8.80832        8.80864        8.80896        " 
    print "9.0            9.00096        9.51168        " 
    print "9.6            " 

    print ""
    print "Enter desired frequency (r to return): "
    enter &clk_desired_freq
    print ""

    if ("&clk_desired_freq"=="4.80768")
    (
      &clk_src_name="XO"
      &clk_src_sel=SRC_SEL TODO.
      &clk_src_div=2.
      &clk_m_val=313.
      &clk_n_val=1250.
      &clk_2d_val=1250.
      
      gosub Set_Clock_Freq
      return
    )
    else if ("&clk_desired_freq"=="4.9536")
    (
      &clk_src_name="XO"
      &clk_src_sel=SRC_SEL TODO.
      &clk_src_div=2.
      &clk_m_val=129.
      &clk_n_val=500.
      &clk_2d_val=500.
      
      gosub Set_Clock_Freq
      return
    )
    else if ("&clk_desired_freq"=="4.96128")
    (
      &clk_src_name="XO"
      &clk_src_sel=SRC_SEL TODO.
      &clk_src_div=2.
      &clk_m_val=323.
      &clk_n_val=1250.
      &clk_2d_val=1250.
      
      gosub Set_Clock_Freq
      return
    )
    else if ("&clk_desired_freq"=="5.12")
    (
      &clk_src_name="XO"
      &clk_src_sel=SRC_SEL TODO.
      &clk_src_div=2.
      &clk_m_val=4.
      &clk_n_val=15.
      &clk_2d_val=15.
      
      gosub Set_Clock_Freq
      return
    )
    else if ("&clk_desired_freq"=="5.28384")
    (
      &clk_src_name="XO"
      &clk_src_sel=SRC_SEL TODO.
      &clk_src_div=2.
      &clk_m_val=172.
      &clk_n_val=625.
      &clk_2d_val=625.
      
      gosub Set_Clock_Freq
      return
    )
    else if ("&clk_desired_freq"=="5.28512")
    (
      &clk_src_name="XO"
      &clk_src_sel=SRC_SEL TODO.
      &clk_src_div=2.
      &clk_m_val=4129.
      &clk_n_val=15000.
      &clk_2d_val=15000.
      
      gosub Set_Clock_Freq
      return
    )
    else if ("&clk_desired_freq"=="5.76")
    (
      &clk_src_name="XO"
      &clk_src_sel=SRC_SEL TODO.
      &clk_src_div=2.
      &clk_m_val=3.
      &clk_n_val=10.
      &clk_2d_val=10.
      
      gosub Set_Clock_Freq
      return
    )
    else if ("&clk_desired_freq"=="5.77536")
    (
      &clk_src_name="XO"
      &clk_src_sel=SRC_SEL TODO.
      &clk_src_div=2.
      &clk_m_val=188.
      &clk_n_val=625.
      &clk_2d_val=625.
      
      gosub Set_Clock_Freq
      return
    )
    else if ("&clk_desired_freq"=="6.32832")
    (
      &clk_src_name="XO"
      &clk_src_sel=SRC_SEL TODO.
      &clk_src_div=2.
      &clk_m_val=206.
      &clk_n_val=625.
      &clk_2d_val=625.
      
      gosub Set_Clock_Freq
      return
    )
    else if ("&clk_desired_freq"=="6.34368")
    (
      &clk_src_name="XO"
      &clk_src_sel=SRC_SEL TODO.
      &clk_src_div=2.
      &clk_m_val=413.
      &clk_n_val=1250.
      &clk_2d_val=1250.
      
      gosub Set_Clock_Freq
      return
    )
    else if ("&clk_desired_freq"=="6.4")
    (
      &clk_src_name="XO"
      &clk_src_sel=SRC_SEL TODO.
      &clk_src_div=2.
      &clk_m_val=1.
      &clk_n_val=3.
      &clk_2d_val=3.
      
      gosub Set_Clock_Freq
      return
    )
    else if ("&clk_desired_freq"=="6.6048")
    (
      &clk_src_name="XO"
      &clk_src_sel=SRC_SEL TODO.
      &clk_src_div=2.
      &clk_m_val=43.
      &clk_n_val=125.
      &clk_2d_val=125.
      
      gosub Set_Clock_Freq
      return
    )
    else if ("&clk_desired_freq"=="6.60608")
    (
      &clk_src_name="XO"
      &clk_src_sel=SRC_SEL TODO.
      &clk_src_div=2.
      &clk_m_val=5161.
      &clk_n_val=15000.
      &clk_2d_val=15000.
      
      gosub Set_Clock_Freq
      return
    )
    else if ("&clk_desired_freq"=="6.6064")
    (
      &clk_src_name="XO"
      &clk_src_sel=SRC_SEL TODO.
      &clk_src_div=2.
      &clk_m_val=4129.
      &clk_n_val=12000.
      &clk_2d_val=12000.
      
      gosub Set_Clock_Freq
      return
    )
    else if ("&clk_desired_freq"=="6.60672")
    (
      &clk_src_name="XO"
      &clk_src_sel=SRC_SEL TODO.
      &clk_src_div=2.
      &clk_m_val=3441.
      &clk_n_val=10000.
      &clk_2d_val=10000.
      
      gosub Set_Clock_Freq
      return
    )
    else if ("&clk_desired_freq"=="6.60736")
    (
      &clk_src_name="XO"
      &clk_src_sel=SRC_SEL TODO.
      &clk_src_div=2.
      &clk_m_val=2581.
      &clk_n_val=7500.
      &clk_2d_val=7500.
      
      gosub Set_Clock_Freq
      return
    )
    else if ("&clk_desired_freq"=="7.04512")
    (
      &clk_src_name="XO"
      &clk_src_sel=SRC_SEL TODO.
      &clk_src_div=2.
      &clk_m_val=688.
      &clk_n_val=1875.
      &clk_2d_val=1875.
      
      gosub Set_Clock_Freq
      return
    )
    else if ("&clk_desired_freq"=="7.0464")
    (
      &clk_src_name="XO"
      &clk_src_sel=SRC_SEL TODO.
      &clk_src_div=2.
      &clk_m_val=367.
      &clk_n_val=1000.
      &clk_2d_val=1000.
      
      gosub Set_Clock_Freq
      return
    )
    else if ("&clk_desired_freq"=="7.04688")
    (
      &clk_src_name="XO"
      &clk_src_sel=SRC_SEL TODO.
      &clk_src_div=2.
      &clk_m_val=14681.
      &clk_n_val=40000.
      &clk_2d_val=40000.
      
      gosub Set_Clock_Freq
      return
    )
    else if ("&clk_desired_freq"=="7.04704")
    (
      &clk_src_name="XO"
      &clk_src_sel=SRC_SEL TODO.
      &clk_src_div=2.
      &clk_m_val=11011.
      &clk_n_val=30000.
      &clk_2d_val=30000.
      
      gosub Set_Clock_Freq
      return
    )
    else if ("&clk_desired_freq"=="7.04768")
    (
      &clk_src_name="XO"
      &clk_src_sel=SRC_SEL TODO.
      &clk_src_div=2.
      &clk_m_val=2753.
      &clk_n_val=7500.
      &clk_2d_val=7500.
      
      gosub Set_Clock_Freq
      return
    )
    else if ("&clk_desired_freq"=="7.18848")
    (
      &clk_src_name="XO"
      &clk_src_sel=SRC_SEL TODO.
      &clk_src_div=2.
      &clk_m_val=234.
      &clk_n_val=625.
      &clk_2d_val=625.
      
      gosub Set_Clock_Freq
      return
    )
    else if ("&clk_desired_freq"=="7.2")
    (
      &clk_src_name="XO"
      &clk_src_sel=SRC_SEL TODO.
      &clk_src_div=2.
      &clk_m_val=3.
      &clk_n_val=8.
      &clk_2d_val=8.
      
      gosub Set_Clock_Freq
      return
    )
    else if ("&clk_desired_freq"=="7.20128")
    (
      &clk_src_name="XO"
      &clk_src_sel=SRC_SEL TODO.
      &clk_src_div=2.
      &clk_m_val=2813.
      &clk_n_val=7500.
      &clk_2d_val=7500.
      
      gosub Set_Clock_Freq
      return
    )
    else if ("&clk_desired_freq"=="7.20384")
    (
      &clk_src_name="XO"
      &clk_src_sel=SRC_SEL TODO.
      &clk_src_div=2.
      &clk_m_val=469.
      &clk_n_val=1250.
      &clk_2d_val=1250.
      
      gosub Set_Clock_Freq
      return
    )
    else if ("&clk_desired_freq"=="7.43232")
    (
      &clk_src_name="XO"
      &clk_src_sel=SRC_SEL TODO.
      &clk_src_div=2.
      &clk_m_val=3871.
      &clk_n_val=10000.
      &clk_2d_val=10000.
      
      gosub Set_Clock_Freq
      return
    )
    else if ("&clk_desired_freq"=="7.68")
    (
      &clk_src_name="XO"
      &clk_src_sel=SRC_SEL TODO.
      &clk_src_div=2.
      &clk_m_val=2.
      &clk_n_val=5.
      &clk_2d_val=5.
      
      gosub Set_Clock_Freq
      return
    )
    else if ("&clk_desired_freq"=="7.92576")
    (
      &clk_src_name="XO"
      &clk_src_sel=SRC_SEL TODO.
      &clk_src_div=2.
      &clk_m_val=258.
      &clk_n_val=625.
      &clk_2d_val=625.
      
      gosub Set_Clock_Freq
      return
    )
    else if ("&clk_desired_freq"=="7.92768")
    (
      &clk_src_name="XO"
      &clk_src_sel=SRC_SEL TODO.
      &clk_src_div=2.
      &clk_m_val=4129.
      &clk_n_val=10000.
      &clk_2d_val=10000.
      
      gosub Set_Clock_Freq
      return
    )
    else if ("&clk_desired_freq"=="7.92832")
    (
      &clk_src_name="XO"
      &clk_src_sel=SRC_SEL TODO.
      &clk_src_div=2.
      &clk_m_val=3097.
      &clk_n_val=7500.
      &clk_2d_val=7500.
      
      gosub Set_Clock_Freq
      return
    )
    else if ("&clk_desired_freq"=="7.9296")
    (
      &clk_src_name="XO"
      &clk_src_sel=SRC_SEL TODO.
      &clk_src_div=2.
      &clk_m_val=413.
      &clk_n_val=1000.
      &clk_2d_val=1000.
      
      gosub Set_Clock_Freq
      return
    )
    else if ("&clk_desired_freq"=="8.0")
    (
      &clk_src_name="XO"
      &clk_src_sel=SRC_SEL TODO.
      &clk_src_div=2.
      &clk_m_val=5.
      &clk_n_val=12.
      &clk_2d_val=12.
      
      gosub Set_Clock_Freq
      return
    )
    else if ("&clk_desired_freq"=="8.25792")
    (
      &clk_src_name="XO"
      &clk_src_sel=SRC_SEL TODO.
      &clk_src_div=2.
      &clk_m_val=4301.
      &clk_n_val=10000.
      &clk_2d_val=10000.
      
      gosub Set_Clock_Freq
      return
    )
    else if ("&clk_desired_freq"=="8.25856")
    (
      &clk_src_name="XO"
      &clk_src_sel=SRC_SEL TODO.
      &clk_src_div=2.
      &clk_m_val=1613.
      &clk_n_val=3750.
      &clk_2d_val=3750.
      
      gosub Set_Clock_Freq
      return
    )
    else if ("&clk_desired_freq"=="8.45568")
    (
      &clk_src_name="XO"
      &clk_src_sel=SRC_SEL TODO.
      &clk_src_div=2.
      &clk_m_val=1101.
      &clk_n_val=2500.
      &clk_2d_val=2500.
      
      gosub Set_Clock_Freq
      return
    )
    else if ("&clk_desired_freq"=="8.45632")
    (
      &clk_src_name="XO"
      &clk_src_sel=SRC_SEL TODO.
      &clk_src_div=2.
      &clk_m_val=13213.
      &clk_n_val=30000.
      &clk_2d_val=30000.
      
      gosub Set_Clock_Freq
      return
    )
    else if ("&clk_desired_freq"=="8.45824")
    (
      &clk_src_name="XO"
      &clk_src_sel=SRC_SEL TODO.
      &clk_src_div=2.
      &clk_m_val=826.
      &clk_n_val=1875.
      &clk_2d_val=1875.
      
      gosub Set_Clock_Freq
      return
    )
    else if ("&clk_desired_freq"=="8.64")
    (
      &clk_src_name="XO"
      &clk_src_sel=SRC_SEL TODO.
      &clk_src_div=2.
      &clk_m_val=9.
      &clk_n_val=20.
      &clk_2d_val=20.
      
      gosub Set_Clock_Freq
      return
    )
    else if ("&clk_desired_freq"=="8.8064")
    (
      &clk_src_name="XO"
      &clk_src_sel=SRC_SEL TODO.
      &clk_src_div=2.
      &clk_m_val=172.
      &clk_n_val=375.
      &clk_2d_val=375.
      
      gosub Set_Clock_Freq
      return
    )
    else if ("&clk_desired_freq"=="8.80832")
    (
      &clk_src_name="XO"
      &clk_src_sel=SRC_SEL TODO.
      &clk_src_div=2.
      &clk_m_val=13763.
      &clk_n_val=30000.
      &clk_2d_val=30000.
      
      gosub Set_Clock_Freq
      return
    )
    else if ("&clk_desired_freq"=="8.80864")
    (
      &clk_src_name="XO"
      &clk_src_sel=SRC_SEL TODO.
      &clk_src_div=2.
      &clk_m_val=27527.
      &clk_n_val=60000.
      &clk_2d_val=60000.
      
      gosub Set_Clock_Freq
      return
    )
    else if ("&clk_desired_freq"=="8.80896")
    (
      &clk_src_name="XO"
      &clk_src_sel=SRC_SEL TODO.
      &clk_src_div=2.
      &clk_m_val=1147.
      &clk_n_val=2500.
      &clk_2d_val=2500.
      
      gosub Set_Clock_Freq
      return
    )
    else if ("&clk_desired_freq"=="9.0")
    (
      &clk_src_name="XO"
      &clk_src_sel=SRC_SEL TODO.
      &clk_src_div=2.
      &clk_m_val=15.
      &clk_n_val=32.
      &clk_2d_val=32.
      
      gosub Set_Clock_Freq
      return
    )
    else if ("&clk_desired_freq"=="9.00096")
    (
      &clk_src_name="XO"
      &clk_src_sel=SRC_SEL TODO.
      &clk_src_div=2.
      &clk_m_val=293.
      &clk_n_val=625.
      &clk_2d_val=625.
      
      gosub Set_Clock_Freq
      return
    )
    else if ("&clk_desired_freq"=="9.51168")
    (
      &clk_src_name="XO"
      &clk_src_sel=SRC_SEL TODO.
      &clk_src_div=2.
      &clk_m_val=2477.
      &clk_n_val=5000.
      &clk_2d_val=5000.
      
      gosub Set_Clock_Freq
      return
    )
    else if ("&clk_desired_freq"=="9.6")
    (
      &clk_src_name="XO"
      &clk_src_sel=SRC_SEL TODO.
      &clk_src_div=2.
      &clk_m_val=1.
      &clk_n_val=2.
      &clk_2d_val=2.
      
      gosub Set_Clock_Freq
      return
    )
    else if ("&clk_desired_freq"=="r")
    (
      return
    )
    else
    (
      print "Invalid selection."
      goto Set_Clock_Freq_Enter
    )
  )

  if ("&clk"=="clk_src_uim3_mnd")||("&clk"=="clk_uart_bit_uim3")
  (
    gosub PRINT_SET_CLOCK_FREQ_WARNING

    &clk_cmd_rcgr_addr=&HWIO_MSS_UIM3_MND_CMD_RCGR_ADDR
    &clk_cfg_rcgr_addr=&HWIO_MSS_UIM3_MND_CFG_RCGR_ADDR

    print "Choose frequency (MHz) from list below: " 

    print "4.80768        4.9536         4.96128        " 
    print "5.12           5.28384        5.28512        " 
    print "5.76           5.77536        6.32832        " 
    print "6.34368        6.4            6.6048         " 
    print "6.60608        6.6064         6.60672        " 
    print "6.60736        7.04512        7.0464         " 
    print "7.04688        7.04704        7.04768        " 
    print "7.18848        7.2            7.20128        " 
    print "7.20384        7.43232        7.68           " 
    print "7.92576        7.92768        7.92832        " 
    print "7.9296         8.0            8.25792        " 
    print "8.25856        8.45568        8.45632        " 
    print "8.45824        8.64           8.8064         " 
    print "8.80832        8.80864        8.80896        " 
    print "9.0            9.00096        9.51168        " 
    print "9.6            " 

    print ""
    print "Enter desired frequency (r to return): "
    enter &clk_desired_freq
    print ""

    if ("&clk_desired_freq"=="4.80768")
    (
      &clk_src_name="XO"
      &clk_src_sel=SRC_SEL TODO.
      &clk_src_div=2.
      &clk_m_val=313.
      &clk_n_val=1250.
      &clk_2d_val=1250.
      
      gosub Set_Clock_Freq
      return
    )
    else if ("&clk_desired_freq"=="4.9536")
    (
      &clk_src_name="XO"
      &clk_src_sel=SRC_SEL TODO.
      &clk_src_div=2.
      &clk_m_val=129.
      &clk_n_val=500.
      &clk_2d_val=500.
      
      gosub Set_Clock_Freq
      return
    )
    else if ("&clk_desired_freq"=="4.96128")
    (
      &clk_src_name="XO"
      &clk_src_sel=SRC_SEL TODO.
      &clk_src_div=2.
      &clk_m_val=323.
      &clk_n_val=1250.
      &clk_2d_val=1250.
      
      gosub Set_Clock_Freq
      return
    )
    else if ("&clk_desired_freq"=="5.12")
    (
      &clk_src_name="XO"
      &clk_src_sel=SRC_SEL TODO.
      &clk_src_div=2.
      &clk_m_val=4.
      &clk_n_val=15.
      &clk_2d_val=15.
      
      gosub Set_Clock_Freq
      return
    )
    else if ("&clk_desired_freq"=="5.28384")
    (
      &clk_src_name="XO"
      &clk_src_sel=SRC_SEL TODO.
      &clk_src_div=2.
      &clk_m_val=172.
      &clk_n_val=625.
      &clk_2d_val=625.
      
      gosub Set_Clock_Freq
      return
    )
    else if ("&clk_desired_freq"=="5.28512")
    (
      &clk_src_name="XO"
      &clk_src_sel=SRC_SEL TODO.
      &clk_src_div=2.
      &clk_m_val=4129.
      &clk_n_val=15000.
      &clk_2d_val=15000.
      
      gosub Set_Clock_Freq
      return
    )
    else if ("&clk_desired_freq"=="5.76")
    (
      &clk_src_name="XO"
      &clk_src_sel=SRC_SEL TODO.
      &clk_src_div=2.
      &clk_m_val=3.
      &clk_n_val=10.
      &clk_2d_val=10.
      
      gosub Set_Clock_Freq
      return
    )
    else if ("&clk_desired_freq"=="5.77536")
    (
      &clk_src_name="XO"
      &clk_src_sel=SRC_SEL TODO.
      &clk_src_div=2.
      &clk_m_val=188.
      &clk_n_val=625.
      &clk_2d_val=625.
      
      gosub Set_Clock_Freq
      return
    )
    else if ("&clk_desired_freq"=="6.32832")
    (
      &clk_src_name="XO"
      &clk_src_sel=SRC_SEL TODO.
      &clk_src_div=2.
      &clk_m_val=206.
      &clk_n_val=625.
      &clk_2d_val=625.
      
      gosub Set_Clock_Freq
      return
    )
    else if ("&clk_desired_freq"=="6.34368")
    (
      &clk_src_name="XO"
      &clk_src_sel=SRC_SEL TODO.
      &clk_src_div=2.
      &clk_m_val=413.
      &clk_n_val=1250.
      &clk_2d_val=1250.
      
      gosub Set_Clock_Freq
      return
    )
    else if ("&clk_desired_freq"=="6.4")
    (
      &clk_src_name="XO"
      &clk_src_sel=SRC_SEL TODO.
      &clk_src_div=2.
      &clk_m_val=1.
      &clk_n_val=3.
      &clk_2d_val=3.
      
      gosub Set_Clock_Freq
      return
    )
    else if ("&clk_desired_freq"=="6.6048")
    (
      &clk_src_name="XO"
      &clk_src_sel=SRC_SEL TODO.
      &clk_src_div=2.
      &clk_m_val=43.
      &clk_n_val=125.
      &clk_2d_val=125.
      
      gosub Set_Clock_Freq
      return
    )
    else if ("&clk_desired_freq"=="6.60608")
    (
      &clk_src_name="XO"
      &clk_src_sel=SRC_SEL TODO.
      &clk_src_div=2.
      &clk_m_val=5161.
      &clk_n_val=15000.
      &clk_2d_val=15000.
      
      gosub Set_Clock_Freq
      return
    )
    else if ("&clk_desired_freq"=="6.6064")
    (
      &clk_src_name="XO"
      &clk_src_sel=SRC_SEL TODO.
      &clk_src_div=2.
      &clk_m_val=4129.
      &clk_n_val=12000.
      &clk_2d_val=12000.
      
      gosub Set_Clock_Freq
      return
    )
    else if ("&clk_desired_freq"=="6.60672")
    (
      &clk_src_name="XO"
      &clk_src_sel=SRC_SEL TODO.
      &clk_src_div=2.
      &clk_m_val=3441.
      &clk_n_val=10000.
      &clk_2d_val=10000.
      
      gosub Set_Clock_Freq
      return
    )
    else if ("&clk_desired_freq"=="6.60736")
    (
      &clk_src_name="XO"
      &clk_src_sel=SRC_SEL TODO.
      &clk_src_div=2.
      &clk_m_val=2581.
      &clk_n_val=7500.
      &clk_2d_val=7500.
      
      gosub Set_Clock_Freq
      return
    )
    else if ("&clk_desired_freq"=="7.04512")
    (
      &clk_src_name="XO"
      &clk_src_sel=SRC_SEL TODO.
      &clk_src_div=2.
      &clk_m_val=688.
      &clk_n_val=1875.
      &clk_2d_val=1875.
      
      gosub Set_Clock_Freq
      return
    )
    else if ("&clk_desired_freq"=="7.0464")
    (
      &clk_src_name="XO"
      &clk_src_sel=SRC_SEL TODO.
      &clk_src_div=2.
      &clk_m_val=367.
      &clk_n_val=1000.
      &clk_2d_val=1000.
      
      gosub Set_Clock_Freq
      return
    )
    else if ("&clk_desired_freq"=="7.04688")
    (
      &clk_src_name="XO"
      &clk_src_sel=SRC_SEL TODO.
      &clk_src_div=2.
      &clk_m_val=14681.
      &clk_n_val=40000.
      &clk_2d_val=40000.
      
      gosub Set_Clock_Freq
      return
    )
    else if ("&clk_desired_freq"=="7.04704")
    (
      &clk_src_name="XO"
      &clk_src_sel=SRC_SEL TODO.
      &clk_src_div=2.
      &clk_m_val=11011.
      &clk_n_val=30000.
      &clk_2d_val=30000.
      
      gosub Set_Clock_Freq
      return
    )
    else if ("&clk_desired_freq"=="7.04768")
    (
      &clk_src_name="XO"
      &clk_src_sel=SRC_SEL TODO.
      &clk_src_div=2.
      &clk_m_val=2753.
      &clk_n_val=7500.
      &clk_2d_val=7500.
      
      gosub Set_Clock_Freq
      return
    )
    else if ("&clk_desired_freq"=="7.18848")
    (
      &clk_src_name="XO"
      &clk_src_sel=SRC_SEL TODO.
      &clk_src_div=2.
      &clk_m_val=234.
      &clk_n_val=625.
      &clk_2d_val=625.
      
      gosub Set_Clock_Freq
      return
    )
    else if ("&clk_desired_freq"=="7.2")
    (
      &clk_src_name="XO"
      &clk_src_sel=SRC_SEL TODO.
      &clk_src_div=2.
      &clk_m_val=3.
      &clk_n_val=8.
      &clk_2d_val=8.
      
      gosub Set_Clock_Freq
      return
    )
    else if ("&clk_desired_freq"=="7.20128")
    (
      &clk_src_name="XO"
      &clk_src_sel=SRC_SEL TODO.
      &clk_src_div=2.
      &clk_m_val=2813.
      &clk_n_val=7500.
      &clk_2d_val=7500.
      
      gosub Set_Clock_Freq
      return
    )
    else if ("&clk_desired_freq"=="7.20384")
    (
      &clk_src_name="XO"
      &clk_src_sel=SRC_SEL TODO.
      &clk_src_div=2.
      &clk_m_val=469.
      &clk_n_val=1250.
      &clk_2d_val=1250.
      
      gosub Set_Clock_Freq
      return
    )
    else if ("&clk_desired_freq"=="7.43232")
    (
      &clk_src_name="XO"
      &clk_src_sel=SRC_SEL TODO.
      &clk_src_div=2.
      &clk_m_val=3871.
      &clk_n_val=10000.
      &clk_2d_val=10000.
      
      gosub Set_Clock_Freq
      return
    )
    else if ("&clk_desired_freq"=="7.68")
    (
      &clk_src_name="XO"
      &clk_src_sel=SRC_SEL TODO.
      &clk_src_div=2.
      &clk_m_val=2.
      &clk_n_val=5.
      &clk_2d_val=5.
      
      gosub Set_Clock_Freq
      return
    )
    else if ("&clk_desired_freq"=="7.92576")
    (
      &clk_src_name="XO"
      &clk_src_sel=SRC_SEL TODO.
      &clk_src_div=2.
      &clk_m_val=258.
      &clk_n_val=625.
      &clk_2d_val=625.
      
      gosub Set_Clock_Freq
      return
    )
    else if ("&clk_desired_freq"=="7.92768")
    (
      &clk_src_name="XO"
      &clk_src_sel=SRC_SEL TODO.
      &clk_src_div=2.
      &clk_m_val=4129.
      &clk_n_val=10000.
      &clk_2d_val=10000.
      
      gosub Set_Clock_Freq
      return
    )
    else if ("&clk_desired_freq"=="7.92832")
    (
      &clk_src_name="XO"
      &clk_src_sel=SRC_SEL TODO.
      &clk_src_div=2.
      &clk_m_val=3097.
      &clk_n_val=7500.
      &clk_2d_val=7500.
      
      gosub Set_Clock_Freq
      return
    )
    else if ("&clk_desired_freq"=="7.9296")
    (
      &clk_src_name="XO"
      &clk_src_sel=SRC_SEL TODO.
      &clk_src_div=2.
      &clk_m_val=413.
      &clk_n_val=1000.
      &clk_2d_val=1000.
      
      gosub Set_Clock_Freq
      return
    )
    else if ("&clk_desired_freq"=="8.0")
    (
      &clk_src_name="XO"
      &clk_src_sel=SRC_SEL TODO.
      &clk_src_div=2.
      &clk_m_val=5.
      &clk_n_val=12.
      &clk_2d_val=12.
      
      gosub Set_Clock_Freq
      return
    )
    else if ("&clk_desired_freq"=="8.25792")
    (
      &clk_src_name="XO"
      &clk_src_sel=SRC_SEL TODO.
      &clk_src_div=2.
      &clk_m_val=4301.
      &clk_n_val=10000.
      &clk_2d_val=10000.
      
      gosub Set_Clock_Freq
      return
    )
    else if ("&clk_desired_freq"=="8.25856")
    (
      &clk_src_name="XO"
      &clk_src_sel=SRC_SEL TODO.
      &clk_src_div=2.
      &clk_m_val=1613.
      &clk_n_val=3750.
      &clk_2d_val=3750.
      
      gosub Set_Clock_Freq
      return
    )
    else if ("&clk_desired_freq"=="8.45568")
    (
      &clk_src_name="XO"
      &clk_src_sel=SRC_SEL TODO.
      &clk_src_div=2.
      &clk_m_val=1101.
      &clk_n_val=2500.
      &clk_2d_val=2500.
      
      gosub Set_Clock_Freq
      return
    )
    else if ("&clk_desired_freq"=="8.45632")
    (
      &clk_src_name="XO"
      &clk_src_sel=SRC_SEL TODO.
      &clk_src_div=2.
      &clk_m_val=13213.
      &clk_n_val=30000.
      &clk_2d_val=30000.
      
      gosub Set_Clock_Freq
      return
    )
    else if ("&clk_desired_freq"=="8.45824")
    (
      &clk_src_name="XO"
      &clk_src_sel=SRC_SEL TODO.
      &clk_src_div=2.
      &clk_m_val=826.
      &clk_n_val=1875.
      &clk_2d_val=1875.
      
      gosub Set_Clock_Freq
      return
    )
    else if ("&clk_desired_freq"=="8.64")
    (
      &clk_src_name="XO"
      &clk_src_sel=SRC_SEL TODO.
      &clk_src_div=2.
      &clk_m_val=9.
      &clk_n_val=20.
      &clk_2d_val=20.
      
      gosub Set_Clock_Freq
      return
    )
    else if ("&clk_desired_freq"=="8.8064")
    (
      &clk_src_name="XO"
      &clk_src_sel=SRC_SEL TODO.
      &clk_src_div=2.
      &clk_m_val=172.
      &clk_n_val=375.
      &clk_2d_val=375.
      
      gosub Set_Clock_Freq
      return
    )
    else if ("&clk_desired_freq"=="8.80832")
    (
      &clk_src_name="XO"
      &clk_src_sel=SRC_SEL TODO.
      &clk_src_div=2.
      &clk_m_val=13763.
      &clk_n_val=30000.
      &clk_2d_val=30000.
      
      gosub Set_Clock_Freq
      return
    )
    else if ("&clk_desired_freq"=="8.80864")
    (
      &clk_src_name="XO"
      &clk_src_sel=SRC_SEL TODO.
      &clk_src_div=2.
      &clk_m_val=27527.
      &clk_n_val=60000.
      &clk_2d_val=60000.
      
      gosub Set_Clock_Freq
      return
    )
    else if ("&clk_desired_freq"=="8.80896")
    (
      &clk_src_name="XO"
      &clk_src_sel=SRC_SEL TODO.
      &clk_src_div=2.
      &clk_m_val=1147.
      &clk_n_val=2500.
      &clk_2d_val=2500.
      
      gosub Set_Clock_Freq
      return
    )
    else if ("&clk_desired_freq"=="9.0")
    (
      &clk_src_name="XO"
      &clk_src_sel=SRC_SEL TODO.
      &clk_src_div=2.
      &clk_m_val=15.
      &clk_n_val=32.
      &clk_2d_val=32.
      
      gosub Set_Clock_Freq
      return
    )
    else if ("&clk_desired_freq"=="9.00096")
    (
      &clk_src_name="XO"
      &clk_src_sel=SRC_SEL TODO.
      &clk_src_div=2.
      &clk_m_val=293.
      &clk_n_val=625.
      &clk_2d_val=625.
      
      gosub Set_Clock_Freq
      return
    )
    else if ("&clk_desired_freq"=="9.51168")
    (
      &clk_src_name="XO"
      &clk_src_sel=SRC_SEL TODO.
      &clk_src_div=2.
      &clk_m_val=2477.
      &clk_n_val=5000.
      &clk_2d_val=5000.
      
      gosub Set_Clock_Freq
      return
    )
    else if ("&clk_desired_freq"=="9.6")
    (
      &clk_src_name="XO"
      &clk_src_sel=SRC_SEL TODO.
      &clk_src_div=2.
      &clk_m_val=1.
      &clk_n_val=2.
      &clk_2d_val=2.
      
      gosub Set_Clock_Freq
      return
    )
    else if ("&clk_desired_freq"=="r")
    (
      return
    )
    else
    (
      print "Invalid selection."
      goto Set_Clock_Freq_Enter
    )
  )

  if ("&clk"=="scc_ahb_timeout_clk")||("&clk"=="scc_at_clk")||("&clk"=="scc_blsp_h_clk")||("&clk"=="scc_cfg_ahb_clk")||("&clk"=="scc_crif_clk")||("&clk"=="scc_csr_h_clk")||("&clk"=="scc_data_h_clk")||("&clk"=="scc_dbg_tsctr_clk")||("&clk"=="scc_pclkdbg_clk")||("&clk"=="scc_q6_ahbm_clk")||("&clk"=="scc_q6_ahbs_clk")||("&clk"=="scc_q6_atbm_clk")||("&clk"=="scc_q6_spm_clk")||("&clk"=="scc_q6_xpu2_client_clk")||("&clk"=="scc_q6_xpu2_config_clk")||("&clk"=="scc_qup_i2c1_clk")||("&clk"=="scc_qup_i2c2_clk")||("&clk"=="scc_qup_i2c3_clk")||("&clk"=="scc_qup_spi1_clk")||("&clk"=="scc_qup_spi2_clk")||("&clk"=="scc_qup_spi3_clk")||("&clk"=="scc_smem_clk")||("&clk"=="scc_uart_dm_uart1_clk")||("&clk"=="scc_uart_dm_uart2_clk")||("&clk"=="scc_uart_dm_uart3_clk")
  (
    gosub PRINT_SET_CLOCK_FREQ_WARNING

    &clk_cmd_rcgr_addr=&HWIO_SSC_SCC_SCC_100M_CMD_RCGR_ADDR
    &clk_cfg_rcgr_addr=&HWIO_SSC_SCC_SCC_100M_CFG_RCGR_ADDR

    print "Choose frequency (MHz) from list below: " 

    print "19.2           92.798976      " 

    print ""
    print "Enter desired frequency (r to return): "
    enter &clk_desired_freq
    print ""

    if ("&clk_desired_freq"=="19.2")
    (
      &clk_src_name="SSC_BI_TCXO"
      &clk_src_sel=SRC_SEL TODO.
      &clk_src_div=2.
      &clk_m_val=0.
      &clk_n_val=0.
      &clk_2d_val=0.
      
      gosub Set_Clock_Freq
      return
    )
    else if ("&clk_desired_freq"=="92.798976")
    (
      &clk_src_name="SCC_PEEL_PLL_OUT_MAIN"
      &clk_src_sel=SRC_SEL TODO.
      &clk_src_div=5.
      &clk_m_val=0.
      &clk_n_val=0.
      &clk_2d_val=0.
      
      gosub Set_Clock_Freq
      return
    )
    else if ("&clk_desired_freq"=="r")
    (
      return
    )
    else
    (
      print "Invalid selection."
      goto Set_Clock_Freq_Enter
    )
  )


  return

