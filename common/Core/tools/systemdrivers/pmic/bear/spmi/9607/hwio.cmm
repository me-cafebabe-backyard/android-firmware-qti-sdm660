y.create.l HWIO_RBCPR_VERSION_ADDR A:0x48000
y.create.l HWIO_RBCPR_SENSOR_MASK0_ADDR A:0x48020
y.create.l HWIO_RBCPR_SENSOR_MASK1_ADDR A:0x48024
y.create.l HWIO_RBCPR_SENSOR_MASK2_ADDR A:0x48028
y.create.l HWIO_RBCPR_SENSOR_MASK3_ADDR A:0x4802c
y.create.l HWIO_RBCPR_SENSOR_BYPASS0_ADDR A:0x48030
y.create.l HWIO_RBCPR_SENSOR_BYPASS1_ADDR A:0x48034
y.create.l HWIO_RBCPR_SENSOR_BYPASS2_ADDR A:0x48038
y.create.l HWIO_RBCPR_SENSOR_BYPASS3_ADDR A:0x4803c
y.create.l HWIO_RBIF_PMIC_ADDR_ADDR A:0x48040
y.create.l HWIO_RBCPR_TIMER_INTERVAL_ADDR A:0x48044
y.create.l HWIO_RBIF_LIMIT_ADDR A:0x48048
y.create.l HWIO_RBIF_TIMER_ADJUST_ADDR A:0x4804c
y.create.l HWIO_RBCPR_GCNT_TARGET0_ADDR A:0x48060
y.create.l HWIO_RBCPR_GCNT_TARGET1_ADDR A:0x48064
y.create.l HWIO_RBCPR_GCNT_TARGET2_ADDR A:0x48068
y.create.l HWIO_RBCPR_GCNT_TARGET3_ADDR A:0x4806c
y.create.l HWIO_RBCPR_GCNT_TARGET4_ADDR A:0x48070
y.create.l HWIO_RBCPR_GCNT_TARGET5_ADDR A:0x48074
y.create.l HWIO_RBCPR_GCNT_TARGET6_ADDR A:0x48078
y.create.l HWIO_RBCPR_GCNT_TARGET7_ADDR A:0x4807c
y.create.l HWIO_RBCPR_STEP_QUOT_ADDR A:0x48080
y.create.l HWIO_RBCPR_CTL_ADDR A:0x48090
y.create.l HWIO_RBIF_SW_VLEVEL_ADDR A:0x48094
y.create.l HWIO_RBIF_CONT_ACK_CMD_ADDR A:0x48098
y.create.l HWIO_RBIF_CONT_NACK_CMD_ADDR A:0x4809c
y.create.l HWIO_RBCPR_RESULT_0_ADDR A:0x480a0
y.create.l HWIO_RBCPR_RESULT_1_ADDR A:0x480a4
y.create.l HWIO_RBIF_IRQ_EN_0_ADDR A:0x48100
y.create.l HWIO_RBIF_IRQ_EN_1_ADDR A:0x48104
y.create.l HWIO_RBIF_IRQ_EN_2_ADDR A:0x48108
y.create.l HWIO_RBIF_IRQ_CLEAR_ADDR A:0x48110
y.create.l HWIO_RBIF_IRQ_STATUS_ADDR A:0x48114
y.create.l HWIO_RBCPR_QUOT_AVG_ADDR A:0x48118
y.create.l HWIO_RBCPR_DEBUG0_ADDR A:0x4811c
y.create.l HWIO_RBCPR_DEBUG1_ADDR A:0x48120
y.create.l HWIO_RBCPR_DEBUG2_ADDR A:0x48124
y.create.l HWIO_RBCPR_BIST_MINMAX_ADDR A:0x48128
y.create.l HWIO_RBCPR_BIST_RESULT_ADDR A:0x4812c
y.create.l HWIO_RBCPR_BIST_FAIL_MAP0_ADDR A:0x48130
y.create.l HWIO_RBCPR_BIST_FAIL_MAP1_ADDR A:0x48134
y.create.l HWIO_RBCPR_BIST_FAIL_MAP2_ADDR A:0x48138
y.create.l HWIO_RBCPR_BIST_FAIL_MAP3_ADDR A:0x4813c
y.create.l HWIO_RBCPR_LOG_0_ADDR A:0x48140
y.create.l HWIO_RBCPR_LOG_1_ADDR A:0x48144
y.create.l HWIO_RBCPR_LOG_2_ADDR A:0x48148
y.create.l HWIO_RBCPR_LOG_3_ADDR A:0x4814c
y.create.l HWIO_RBCPR_LOG_4_ADDR A:0x48150
y.create.l HWIO_RBCPR_LOG_5_ADDR A:0x48154
y.create.l HWIO_RBCPR_LOG_6_ADDR A:0x48158
y.create.l HWIO_RBCPR_LOG_7_ADDR A:0x4815c
y.create.l HWIO_RBCPR_HTOL_AGE_ADDR A:0x48160
y.create.done
