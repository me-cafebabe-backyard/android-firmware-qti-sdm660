; ============================================================================
;
;  pmic.cmm
;
;  Script to configure pmic rails and also get rails status (supported only for new unified peripheral registers)
;
;  Execution:
;  Get status of all SMPS rails -> do pmic.cmm smps
;  Get status of all LDO rails -> do pmic.cmm ldo
;  Get SMPS1A status -> do pmic.cmm smps1a
;  Set LDO10A at 2704 milli volts -> do pmic.cmm ldo10a volt=2704.
;  Set LDO5A in NPM mode -> do pmic.cmm ldo5a mode=npm
;  Set SMPS3A to ON-> do pmic.cmm smps3a enable=1
;  ====================================================================
;
;  Copyright (c) 2016 QUALCOMM Technologies Incorporated.  All Rights Reserved.
;  QUALCOMM Proprietary and Confidential.
;
;  ====================================================================
;
;  $Header: //components/rel/core.glue/1.2.1/tools/tools/systemdrivers/pmic/bear/pmic.cmm#1 $
;  $DateTime: 2016/11/23 22:06:41 $
;  $Author: pwbldsvc $
;
; ============================================================================
;

entry &periph_name &periph_config

;-----------------------------------------------------------------------------
; PERIPHERAL TYPES AND BASE ADDRESSES
;-----------------------------------------------------------------------------
local &PM_SMPS_HF_PERIPH_TYPE &PM_SMPS_FTS_PERIPH_TYPE &PM_LDO_PERIPH_TYPE
local &PM_SMPS_ULT_PERIPH_TYPE &PM_LDO_ULT_PERIPH_TYPE &PM_VS_PERIPH_TYPE
local &PM_BOOST_PERIPH_TYPE &PM_BOOST_BYP_PERIPH_TYPE &PM_BOB_PERIPH_TYPE

&PM_SMPS_HF_PERIPH_TYPE=0x3
&PM_SMPS_FTS_PERIPH_TYPE=0x1C
&PM_LDO_PERIPH_TYPE=0x4
&PM_SMPS_ULT_PERIPH_TYPE=0x22
&PM_LDO_ULT_PERIPH_TYPE=0x21
&PM_VS_PERIPH_TYPE=0x5
&PM_BOOST_PERIPH_TYPE=0x1B
&PM_BOOST_BYP_PERIPH_TYPE=0x1F
&PM_BOB_PERIPH_TYPE=0x1F

local &PM_SMPS_PERIPH_BASE_ADDR &PM_LDO_PERIPH_BASE_ADDR &PM_VS_PERIPH_BASE_ADDR
local  &PM_BOOST_PERIPH_BASE_ADDR &PM_BOOST_BYP_PERIPH_BASE_ADDR &PM_BOB_PERIPH_BASE_ADDR

&PM_SMPS_PERIPH_BASE_ADDR=0x11400
&PM_LDO_PERIPH_BASE_ADDR=0x14000
&PM_VS_PERIPH_BASE_ADDR=0x18000
&PM_BOOST_PERIPH_BASE_ADDR=0x1A000
&PM_BOOST_BYP_PERIPH_BASE_ADDR=0x1A200
&PM_BOB_PERIPH_BASE_ADDR=0x1A200

;-----------------------------------------------------------------------------
; TYPES FOR INTERNAL SCRIPT USAGE
;-----------------------------------------------------------------------------
local &PM_SMPS_PERIPH_INTERNAL_TYPE &PM_LDO_PERIPH_INTERNAL_TYPE &PM_VS_PERIPH_INTERNAL_TYPE
local &PM_BOOST_PERIPH_INTERNAL_TYPE &PM_BOOST_BYP_PERIPH_INTERNAL_TYPE &PM_BOB_PERIPH_INTERNAL_TYPE
local &PM_RAIL_PERIPH_INTERNAL_MAX &PM_RAIL_PERIPH_UNKNOWN_TYPE

&PM_RAIL_PERIPH_UNKNOWN_TYPE=0.
&PM_SMPS_PERIPH_INTERNAL_TYPE=1.
&PM_LDO_PERIPH_INTERNAL_TYPE=2.
&PM_VS_PERIPH_INTERNAL_TYPE=3.
&PM_BOOST_PERIPH_INTERNAL_TYPE=4.
&PM_BOOST_BYP_PERIPH_INTERNAL_TYPE=5.
&PM_BOB_PERIPH_INTERNAL_TYPE=6.
&PM_RAIL_PERIPH_INTERNAL_MAX=7.

VAR.NEW int[&PM_RAIL_PERIPH_INTERNAL_MAX] \periph_base_addr_arr

VAR.SET \periph_base_addr_arr[&PM_RAIL_PERIPH_UNKNOWN_TYPE]=0
VAR.SET \periph_base_addr_arr[&PM_SMPS_PERIPH_INTERNAL_TYPE]=&PM_SMPS_PERIPH_BASE_ADDR
VAR.SET \periph_base_addr_arr[&PM_LDO_PERIPH_INTERNAL_TYPE]=&PM_LDO_PERIPH_BASE_ADDR
VAR.SET \periph_base_addr_arr[&PM_VS_PERIPH_INTERNAL_TYPE]=&PM_VS_PERIPH_BASE_ADDR
VAR.SET \periph_base_addr_arr[&PM_BOOST_PERIPH_INTERNAL_TYPE]=&PM_BOOST_PERIPH_BASE_ADDR
VAR.SET \periph_base_addr_arr[&PM_BOOST_BYP_PERIPH_INTERNAL_TYPE]=&PM_BOOST_BYP_PERIPH_BASE_ADDR
VAR.SET \periph_base_addr_arr[&PM_BOB_PERIPH_INTERNAL_TYPE]=&PM_BOB_PERIPH_BASE_ADDR

&PM_MAX_NUM_PMICS=7.
VAR.NEW char[&PM_MAX_NUM_PMICS][2] \pmic_index_name_arr

VAR.SET \pmic_index_name_arr[0]="A"
VAR.SET \pmic_index_name_arr[1]="B"
VAR.SET \pmic_index_name_arr[2]="C"
VAR.SET \pmic_index_name_arr[3]="D"
VAR.SET \pmic_index_name_arr[4]="E"
VAR.SET \pmic_index_name_arr[5]="F"
VAR.SET \pmic_index_name_arr[6]="G"

;-----------------------------------------------------------------------------
; Default bus access mode and owner
;-----------------------------------------------------------------------------

local &spmi_owner_channel
&spmi_owner_channel=3  ; LPASS Channel by default

local &bus_access_mode
&bus_access_mode="EZAXI"

local &CurrentDir
&CurrentDir=OS.PWD()

local &PmicIoScript
&PmicIoScript="&CurrentDir"+"\pmic_io.cmm"

area.clear

area.create pmic_status
area.view pmic_status
area.select pmic_status

print "*****************************************************************************************"

;-----------------------------------------------------------------------------
; Check for non-interactive mode.
;-----------------------------------------------------------------------------

&rail_target=string.trim("&rail_target")
&periph_name=string.trim("&periph_name")
&periph_config=string.trim("&periph_config")

local &internal_type &pmic_index &rail_id &rail_index

gosub parse_periph_str &periph_name
entry &internal_type &pmic_index &rail_id

local &error_status &periph_type &periph_subtype &periph_baseaddr

&error_status=1
&periph_type=0
&periph_subtype=0
&periph_baseaddr=0

if (("&periph_config"!="")&&(&internal_type!=0.))
(
  &rail_index=&rail_id-1.
  &periph_config=string.lower("&periph_config")
  gosub pwr_rail_config &internal_type &pmic_index &rail_index &periph_config
  entry &error_status
  if (&error_status!=0x1)
  (
    gosub Usage
  )
)
else if (&internal_type!=0)
(
  if (&rail_id!=0)
  (
    &rail_index=&rail_id-1.
    gosub pwr_rail_config &internal_type &pmic_index &rail_index &periph_config
    entry &error_status
  )
  else
  (
    &rail_id=1
    while (&rail_id>0)&&(&error_status==0x1)
    (
      &rail_index=&rail_id-1.
      gosub pwr_rail_config &internal_type &pmic_index &rail_index &periph_config
      entry &error_status
      &rail_id=&rail_id+1.
    )
  )
)
else
(
  gosub Usage
)
print "*****************************************************************************************"
enddo

;=============================================================================
; SUB: Usage
;=============================================================================
Usage:
  print "Usage examples"
  print "Get status of all SMPS rails -> do pmic.cmm smps"
  print "Get status of all LDO rails -> do pmic.cmm ldo"
  print "Get SMPS1A status -> do pmic.cmm smps1a"
  print "Set LDO10A at 2704mV -> do pmic.cmm ldo10a volt=2704."
  print "Set LDO5A in NPM mode -> do pmic.cmm ldo5a mode=npm"
  print "Set SMPS3A to ON -> do pmic.cmm smps3a enable=1"
  return

;=============================================================================
; sub: parse_periph_str
;=============================================================================
parse_periph_str:
  local &rail_str
  entry &rail_str

  local &internal_type
  local &pmic_index 
  local &rail_id 
  local &rail_id_str 
  local &index
  local &char_value
  local &dec_multiplier

  &internal_type=&PM_RAIL_PERIPH_UNKNOWN_TYPE
  &pmic_index=0.
  &rail_id=0.
  &rail_id_str=""
  &index=0.
  &char_value=0.
  &dec_multiplier=1.

  if ("&rail_str"!="")
  (
    &rail_str=string.lower("&rail_str")

    if (string.compare("&rail_str","ldo*")==TRUE())
    (
      &internal_type=&PM_LDO_PERIPH_INTERNAL_TYPE
      &rail_id_str=string.scanandextract("&rail_str","ldo","")
    )
    else if (string.compare("&rail_str","smps*")==TRUE())
    (
      &internal_type=&PM_SMPS_PERIPH_INTERNAL_TYPE 
      &rail_id_str=string.scanandextract("&rail_str","smps","")
    )

    if ("&rail_id_str"=="")
    (
      &pmic_index=0.
      &rail_id=0.
    )
    else if (&internal_type!=&PM_RAIL_PERIPH_UNKNOWN_TYPE)
    (
      &index=string.length("&rail_id_str")-1.
      &dec_multiplier=1.
      while (&index>=0.)
      (
        &char_value=string.char("&rail_id_str",&index)
        if ((&char_value>=97.)&&(&char_value<=122.))
        (
          &pmic_index=&char_value-97.
        )
        else if ((&char_value>=48.)&&(&char_value<=57.))
        (
          &rail_id=&rail_id+((&char_value-48.)*&dec_multiplier)
          &dec_multiplier=&dec_multiplier*10.
        )
        &index=&index-1.
      )
    )
  )
  return &internal_type &pmic_index &rail_id

;=============================================================================
; sub: periph_info_read
;=============================================================================

periph_info_read:

  entry &internal_type &pmic_index &periph_index

  local &read_status
  local &periph_type
  local &periph_subtype
  local &periph_baseaddr
  local &periph_type_addr
  local &periph_subtype_addr
  local &periph_offset

  &periph_type=0
  &periph_subtype=0
  &periph_baseaddr=0
  &periph_type_addr=0
  &periph_subtype_addr=0
  &periph_offset=0x100

  IF (&internal_type==&PM_SMPS_PERIPH_INTERNAL_TYPE)
  (
    &periph_offset=0x300
  )

  IF (&internal_type==&PM_RAIL_PERIPH_UNKNOWN_TYPE)
  (
    &read_status=0.
  )
  ELSE
  (
    &periph_baseaddr=VAR.VALUE(\periph_base_addr_arr[&internal_type])+(&periph_index*&periph_offset)
    &periph_type_addr=&periph_baseaddr+0x04

    gosub pmic_read &periph_type_addr &pmic_index 
    entry &read_status &periph_type
    if ((&read_status==1.)&&(&periph_type!=0.))
    (
      &periph_subtype_addr=&periph_baseaddr+0x05
      gosub pmic_read &periph_subtype_addr &pmic_index 
      entry &read_status &periph_subtype
    )
  )

  return &read_status &periph_type &periph_subtype &periph_baseaddr

;=============================================================================
; sub: pwr_rail_config
;=============================================================================
pwr_rail_config:
  entry &internal_type &pmic_index &periph_index &config_type_str
  local &read_status &periph_type &periph_subtype &periph_baseaddr
  &read_status=0
  &periph_type=0
  &periph_subtype=0
  &periph_baseaddr=0 

  local &periph_unified_reg &pwrrail_str &error_status &reg_data &reg_data1
  &periph_unified_reg=0
  &pwrrail_str=""
  &error_status=1
  &reg_data=0
  &reg_data1=0

  local &pmic_volt &pmic_mode &pmic_enable &pmic_pin &pmic_sec_mode
  &pmic_volt=0
  &pmic_mode=0
  &pmic_enable=0
  &pmic_pin=0
  &pmic_sec_mode=0

  gosub periph_info_read &internal_type &pmic_index &periph_index
  entry &read_status &periph_type &periph_subtype &periph_baseaddr

  if (&read_status==0)||(&periph_type==0)||(&periph_subtype==0)||(&periph_baseaddr==0)
  (
    &error_status=0
    return &error_status
  )

  local &status_addr &vset_lb_addr &vset_ub_addr &vset_valid_lb_addr &vset_valid_ub_addr 
  local &mode_ctl1_addr &en_ctl_addr &pin_ctl_addr &mode_ctl2_addr

  &status_addr=&periph_baseaddr+0x08
  &vset_lb_addr=&periph_baseaddr+0x40
  &vset_ub_addr=&periph_baseaddr+0x41
  &vset_valid_lb_addr=&periph_baseaddr+0x42
  &vset_valid_ub_addr=&periph_baseaddr+0x43
  &mode_ctl1_addr=&periph_baseaddr+0x45
  &en_ctl_addr=&periph_baseaddr+0x46
  &pin_ctl_addr=&periph_baseaddr+0x47
  &mode_ctl2_addr=&periph_baseaddr+0x49

  if ((&periph_type==&PM_LDO_PERIPH_TYPE)&&(&periph_subtype>=0x30))
  (
    &pwrrail_str="LDO"
    &periph_unified_reg=0x1
  )
  else if ((&periph_type==&PM_SMPS_HF_PERIPH_TYPE)&&(&periph_subtype>=0xA))
  (
    &pwrrail_str="SMPS"
    &periph_unified_reg=0x1
  )
  else if ((&periph_type==&PM_SMPS_FTS_PERIPH_TYPE)&&(&periph_subtype>=0xA))
  (
    &pwrrail_str="SMPS"
    &periph_unified_reg=0x1
  )
  else
  (
    &error_status=0
    return &error_status
  )
  &pwrrail_str="&pwrrail_str"+FORMAT.DECIMAL(0,&periph_index+1)+VAR.STRING(\pmic_index_name_arr[&pmic_index])

  if ("&config_type_str"!="")
  (
    local &mode
    &mode=string.scanandextract("&periph_config","mode=","")
    if ("&mode"!="")
    (
      if (&periph_unified_reg==0x1)
      (
        if (("&mode"=="npm")||("&mode"=="pwm"))
        (
          &reg_data=0x7
        )
        else if (("&mode"=="auto")&&(&periph_type!=&PM_LDO_PERIPH_TYPE))
        (
          &reg_data=0x6
        )
        else if (("&mode"=="lpm")||("&mode"=="pfm"))
        (
          &reg_data=0x5
        )
        else if (("&mode"=="retention")||("&mode"=="ret"))
        (
          &reg_data=0x4
        )
        else
        (
          print "Not supported mode: &mode!"
          print " "
          gosub Usage
          &error_status=0
          return &error_status
        )
      )

      gosub pmic_write &mode_ctl1_addr &pmic_index &reg_data
      entry &error_status

      if (&error_status==0x1)
      (
        print "&pwrrail_str mode configured to "+string.upper("&mode")
      )
      else
      (
        print "&pwrrail_str mode config error"
        return &error_status
      )
    )

    local &volt
    &volt=string.scanandextract("&periph_config","volt=","")
    if ("&volt"!="")
    (
      &reg_data=(&volt&0xFF)
      &reg_data1=((&volt>>8)&0xFF)
      gosub pmic_write &vset_lb_addr &pmic_index &reg_data
      entry &error_status
      gosub pmic_write &vset_ub_addr &pmic_index &reg_data1
      entry &error_status

      if (&error_status==0x1)
      (
        print "&pwrrail_str voltage configured to "+format.decimal(0,&volt)+"mV"
      )
      else
      (
        print "&pwrrail_str voltage config error"
        return &error_status
      )
    )

    local &enable
    &enable=string.scanandextract("&periph_config","enable=","")
    if ("&enable"!="")
    (
      &reg_data=0xFF
      if (("&enable"=="on")||(&enable==0x1))
      (
        &enable="ON"
        &reg_data=0x80
      )
      else if (("&enable"=="off")||(&enable==0x0))
      (
        &enable="OFF"
        &reg_data=0x0
      )
      else
      (
        print "Not supported enable: &enable!"
        print " "
        gosub Usage
        &error_status=0
        return &error_status
      )

      gosub pmic_write &en_ctl_addr &pmic_index &reg_data
      entry &error_status

      if (&error_status==0x1)
      (
        print "&pwrrail_str enable configured to &enable"
      )
      else
      (
        print "&pwrrail_str enable config error"
        return &error_status
      )
    )
  )

  gosub pmic_read &status_addr &pmic_index 
  entry &error_status &reg_data

  if ((&reg_data&0x80)==0x80)
  (
    &pmic_enable="ON"
    gosub pmic_read &vset_valid_lb_addr &pmic_index 
    entry &error_status &reg_data

    gosub pmic_read &vset_valid_ub_addr &pmic_index 
    entry &error_status &reg_data1
  )
  else
  (
    &pmic_enable="OFF"
    gosub pmic_read &vset_lb_addr &pmic_index 
    entry &error_status &reg_data

    gosub pmic_read &vset_ub_addr &pmic_index 
    entry &error_status &reg_data1
  )

  if (&periph_unified_reg==0x1)
  (
    &pmic_volt=(&reg_data1<<8)|(&reg_data)
  )

  gosub pmic_read &mode_ctl1_addr &pmic_index 
  entry &error_status &reg_data

  if (&periph_unified_reg==0x1)
  (
    if (&reg_data==0x7)
    (
      &pmic_mode="NPM"
    )
    else if ((&reg_data==0x6)&&(&periph_type!=&PM_LDO_PERIPH_TYPE))
    (
      &pmic_mode="AUTO"
    )
    else if (&reg_data==0x5)
    (
      &pmic_mode="LPM"
    )
    else if (&reg_data==0x4)
    (
      &pmic_mode="RETENTION"
    )
    else if ((&reg_data<=0x3)&&(&reg_data>=0x1)&&(&periph_type==&PM_LDO_PERIPH_TYPE))
    (
      &pmic_mode="BYPASS"
    )
    else
    (
      &pmic_mode="NPM(U)"
    )
  )

  print "&pwrrail_str: &pmic_enable &pmic_mode "+format.decimal(0,&pmic_volt)+"mV"

  return &error_status

;=============================================================================
; SUB: pmic_to_spmi
;=============================================================================

pmic_to_spmi:

  entry &addr &devid
  local &spmi_sid &spmi_addr

  &spmi_sid=2*&devid

  &pmic_sid=&addr>>16.
  if &pmic_sid==1
  (
    &spmi_sid=&spmi_sid+1
  )

  &spmi_addr=&addr&0xFFFF

  return &spmi_sid &spmi_addr


;=============================================================================
; SUB: pmic_read
;=============================================================================

pmic_read:
  local &pmic_addr &pmic_index
  entry &pmic_addr &pmic_index

  &read_status=0
  &read_data=0

  gosub pmic_to_spmi &pmic_addr &pmic_index
  entry &spmi_sid &spmi_addr

  do &PmicIoScript read &spmi_owner_channel &bus_access_mode &spmi_sid &spmi_addr
  entry &read_status &read_data

  return &read_status &read_data


;=============================================================================
; SUB: pmic_write
;=============================================================================

pmic_write:
  local &pmic_addr &pmic_index &pmic_data
  entry &pmic_addr &pmic_index &pmic_data

  &write_status=0

  gosub pmic_to_spmi &pmic_addr &pmic_index
  entry &spmi_sid &spmi_addr

  do &PmicIoScript write &spmi_owner_channel &bus_access_mode &spmi_sid &spmi_addr &pmic_data
  entry &write_status

  return &write_status

