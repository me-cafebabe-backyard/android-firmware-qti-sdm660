y.create.l HWIO_SPMI_GENI_CLK_CTRL_ADDR A:0x200a000
y.create.l HWIO_SPMI_GENI_HW_VERSION_ADDR A:0x200a004
y.create.l HWIO_SPMI_GENI_FW_REVISION_ADDR A:0x200a008
y.create.l HWIO_SPMI_GENI_S_FW_REVISION_ADDR A:0x200a00c
y.create.l HWIO_SPMI_GENI_FORCE_DEFAULT_REG_ADDR A:0x200a010
y.create.l HWIO_SPMI_GENI_OUTPUT_CTRL_ADDR A:0x200a014
y.create.l HWIO_SPMI_GENI_CGC_CTRL_ADDR A:0x200a018
y.create.l HWIO_SPMI_GENI_CHAR_CFG_ADDR A:0x200a01c
y.create.l HWIO_SPMI_GENI_CHAR_DATA_0_ADDR A:0x200a020
y.create.l HWIO_SPMI_GENI_CHAR_DATA_1_ADDR A:0x200a024
y.create.l HWIO_SPMI_GENI_CTRL_ADDR A:0x200a028
y.create.l HWIO_SPMI_GENI_STATUS_ADDR A:0x200a02c
y.create.l HWIO_SPMI_GENI_TEST_BUS_CTRL_ADDR A:0x200a030
y.create.l HWIO_SPMI_GENI_SER_CLK_CFG_ADDR A:0x200a034
y.create.l HWIO_SPMI_GENI_TX_WATERMARK_REG_ADDR A:0x200a038
y.create.l HWIO_SPMI_GENI_RX_WATERMARK_REG_ADDR A:0x200a03c
y.create.l HWIO_SPMI_GENI_STOP_REG_ADDR A:0x200a040
y.create.l HWIO_SPMI_GENI_SW_COMP_REG_ADDR A:0x200a044
y.create.l HWIO_SPMI_GENI_PROG_ROM_CTRL_REG_ADDR A:0x200a048
y.create.l HWIO_SPMI_GENI_CFG_REG0_ADDR A:0x200a100
y.create.l HWIO_SPMI_GENI_CFG_REG1_ADDR A:0x200a104
y.create.l HWIO_SPMI_GENI_CFG_REG2_ADDR A:0x200a108
y.create.l HWIO_SPMI_GENI_CFG_REG3_ADDR A:0x200a10c
y.create.l HWIO_SPMI_GENI_CFG_REG4_ADDR A:0x200a110
y.create.l HWIO_SPMI_GENI_CFG_REG5_ADDR A:0x200a114
y.create.l HWIO_SPMI_GENI_CFG_REG6_ADDR A:0x200a118
y.create.l HWIO_SPMI_GENI_CFG_REG7_ADDR A:0x200a11c
y.create.l HWIO_SPMI_GENI_CFG_REG8_ADDR A:0x200a120
y.create.l HWIO_SPMI_GENI_CFG_REG9_ADDR A:0x200a124
y.create.l HWIO_SPMI_GENI_CFG_REG10_ADDR A:0x200a128
y.create.l HWIO_SPMI_GENI_CFG_REG11_ADDR A:0x200a12c
y.create.l HWIO_SPMI_GENI_CFG_REG12_ADDR A:0x200a130
y.create.l HWIO_SPMI_GENI_CFG_REG13_ADDR A:0x200a134
y.create.l HWIO_SPMI_GENI_CFG_REG14_ADDR A:0x200a138
y.create.l HWIO_SPMI_GENI_CFG_REG15_ADDR A:0x200a13c
y.create.l HWIO_SPMI_GENI_CFG_REG16_ADDR A:0x200a140
y.create.l HWIO_SPMI_GENI_CFG_REG17_ADDR A:0x200a144
y.create.l HWIO_SPMI_GENI_CFG_REG18_ADDR A:0x200a148
y.create.l HWIO_SPMI_GENI_CFG_REG19_ADDR A:0x200a14c
y.create.l HWIO_SPMI_GENI_CFG_REG20_ADDR A:0x200a150
y.create.l HWIO_SPMI_GENI_CFG_REG21_ADDR A:0x200a154
y.create.l HWIO_SPMI_GENI_CFG_REG22_ADDR A:0x200a158
y.create.l HWIO_SPMI_GENI_CFG_REG23_ADDR A:0x200a15c
y.create.l HWIO_SPMI_GENI_CFG_REG24_ADDR A:0x200a160
y.create.l HWIO_SPMI_GENI_CFG_REG25_ADDR A:0x200a164
y.create.l HWIO_SPMI_GENI_CFG_REG26_ADDR A:0x200a168
y.create.l HWIO_SPMI_GENI_CFG_REG27_ADDR A:0x200a16c
y.create.l HWIO_SPMI_GENI_CFG_REG28_ADDR A:0x200a170
y.create.l HWIO_SPMI_GENI_CFG_REG29_ADDR A:0x200a174
y.create.l HWIO_SPMI_GENI_CFG_REG30_ADDR A:0x200a178
y.create.l HWIO_SPMI_GENI_CFG_RAM0_ADDR A:0x200a200
y.create.l HWIO_SPMI_GENI_CFG_RAM1_ADDR A:0x200a204
y.create.l HWIO_SPMI_GENI_CFG_RAM2_ADDR A:0x200a208
y.create.l HWIO_SPMI_GENI_CFG_RAM3_ADDR A:0x200a20c
y.create.l HWIO_SPMI_GENI_CFG_RAM4_ADDR A:0x200a210
y.create.l HWIO_SPMI_GENI_CFG_RAM5_ADDR A:0x200a214
y.create.l HWIO_SPMI_GENI_CFG_RAM6_ADDR A:0x200a218
y.create.l HWIO_SPMI_GENI_CFG_RAM7_ADDR A:0x200a21c
y.create.l HWIO_SPMI_GENI_CFG_RAM8_ADDR A:0x200a220
y.create.l HWIO_SPMI_GENI_CFG_RAM9_ADDR A:0x200a224
y.create.l HWIO_SPMI_GENI_CFG_RAM10_ADDR A:0x200a228
y.create.l HWIO_SPMI_GENI_CFG_RAM11_ADDR A:0x200a22c
y.create.l HWIO_SPMI_GENI_CFG_RAM12_ADDR A:0x200a230
y.create.l HWIO_SPMI_GENI_CFG_RAM13_ADDR A:0x200a234
y.create.l HWIO_SPMI_GENI_CFG_RAM14_ADDR A:0x200a238
y.create.l HWIO_SPMI_GENI_CFG_RAM15_ADDR A:0x200a23c
y.create.l HWIO_SPMI_GENI_CFG_RAM16_ADDR A:0x200a240
y.create.l HWIO_SPMI_GENI_CFG_RAM17_ADDR A:0x200a244
y.create.l HWIO_SPMI_GENI_CFG_RAM18_ADDR A:0x200a248
y.create.l HWIO_SPMI_GENI_CFG_RAM19_ADDR A:0x200a24c
y.create.l HWIO_SPMI_GENI_CFG_RAM20_ADDR A:0x200a250
y.create.l HWIO_SPMI_GENI_CFG_RAM21_ADDR A:0x200a254
y.create.l HWIO_SPMI_GENI_CFG_RAM22_ADDR A:0x200a258
y.create.l HWIO_SPMI_GENI_CFG_RAM23_ADDR A:0x200a25c
y.create.l HWIO_SPMI_GENI_CFG_RAM24_ADDR A:0x200a260
y.create.l HWIO_SPMI_GENI_CFG_RAM25_ADDR A:0x200a264
y.create.l HWIO_SPMI_GENI_CFG_RAM26_ADDR A:0x200a268
y.create.l HWIO_SPMI_GENI_CFG_RAM27_ADDR A:0x200a26c
y.create.l HWIO_SPMI_GENI_CFG_RAM28_ADDR A:0x200a270
y.create.l HWIO_SPMI_GENI_CFG_RAM29_ADDR A:0x200a274
y.create.l HWIO_SPMI_GENI_CFG_RAM30_ADDR A:0x200a278
y.create.l HWIO_SPMI_GENI_CFG_RAM31_ADDR A:0x200a27c
y.create.l HWIO_SPMI_GENI_CFG_RAM32_ADDR A:0x200a280
y.create.l HWIO_SPMI_GENI_CFG_RAM33_ADDR A:0x200a284
y.create.l HWIO_SPMI_GENI_CFG_RAM34_ADDR A:0x200a288
y.create.l HWIO_SPMI_GENI_CFG_RAM35_ADDR A:0x200a28c
y.create.l HWIO_SPMI_GENI_CFG_RAM36_ADDR A:0x200a290
y.create.l HWIO_SPMI_GENI_CFG_RAM37_ADDR A:0x200a294
y.create.l HWIO_SPMI_GENI_CFG_RAM38_ADDR A:0x200a298
y.create.l HWIO_SPMI_GENI_CFG_RAM39_ADDR A:0x200a29c
y.create.l HWIO_SPMI_GENI_CFG_RAM40_ADDR A:0x200a2a0
y.create.l HWIO_SPMI_GENI_CFG_RAM41_ADDR A:0x200a2a4
y.create.l HWIO_SPMI_GENI_CFG_RAM42_ADDR A:0x200a2a8
y.create.l HWIO_SPMI_GENI_CFG_RAM43_ADDR A:0x200a2ac
y.create.l HWIO_SPMI_GENI_CFG_RAM44_ADDR A:0x200a2b0
y.create.l HWIO_SPMI_GENI_CFG_RAM45_ADDR A:0x200a2b4
y.create.l HWIO_SPMI_GENI_CFG_RAM46_ADDR A:0x200a2b8
y.create.l HWIO_SPMI_GENI_CFG_RAM47_ADDR A:0x200a2bc
y.create.l HWIO_SPMI_GENI_CFG_RAM48_ADDR A:0x200a2c0
y.create.l HWIO_SPMI_GENI_CFG_RAM49_ADDR A:0x200a2c4
y.create.l HWIO_SPMI_GENI_CFG_RAM50_ADDR A:0x200a2c8
y.create.l HWIO_SPMI_GENI_CFG_RAM51_ADDR A:0x200a2cc
y.create.l HWIO_SPMI_GENI_CFG_RAM52_ADDR A:0x200a2d0
y.create.l HWIO_SPMI_GENI_CFG_RAM53_ADDR A:0x200a2d4
y.create.l HWIO_SPMI_GENI_CFG_RAM54_ADDR A:0x200a2d8
y.create.l HWIO_SPMI_GENI_CFG_RAM55_ADDR A:0x200a2dc
y.create.l HWIO_SPMI_GENI_CFG_RAM56_ADDR A:0x200a2e0
y.create.l HWIO_SPMI_GENI_CFG_RAM57_ADDR A:0x200a2e4
y.create.l HWIO_SPMI_GENI_CFG_RAM58_ADDR A:0x200a2e8
y.create.l HWIO_SPMI_GENI_CFG_RAM59_ADDR A:0x200a2ec
y.create.l HWIO_SPMI_GENI_CFG_RAM60_ADDR A:0x200a2f0
y.create.l HWIO_SPMI_GENI_CFG_RAM61_ADDR A:0x200a2f4
y.create.l HWIO_SPMI_GENI_CFG_RAM62_ADDR A:0x200a2f8
y.create.l HWIO_SPMI_GENI_CFG_RAM63_ADDR A:0x200a2fc
y.create.l HWIO_SPMI_GENI_CFG_RAM64_ADDR A:0x200a300
y.create.l HWIO_SPMI_GENI_CFG_RAM65_ADDR A:0x200a304
y.create.l HWIO_SPMI_GENI_CFG_RAM66_ADDR A:0x200a308
y.create.l HWIO_SPMI_GENI_CFG_RAM67_ADDR A:0x200a30c
y.create.l HWIO_SPMI_GENI_CFG_RAM68_ADDR A:0x200a310
y.create.l HWIO_SPMI_GENI_CFG_RAM69_ADDR A:0x200a314
y.create.l HWIO_SPMI_GENI_CFG_RAM70_ADDR A:0x200a318
y.create.l HWIO_SPMI_GENI_CFG_RAM71_ADDR A:0x200a31c
y.create.l HWIO_SPMI_GENI_CFG_RAM72_ADDR A:0x200a320
y.create.l HWIO_SPMI_GENI_CFG_RAM73_ADDR A:0x200a324
y.create.l HWIO_SPMI_GENI_CFG_RAM74_ADDR A:0x200a328
y.create.l HWIO_SPMI_GENI_CFG_RAM75_ADDR A:0x200a32c
y.create.l HWIO_SPMI_GENI_CFG_RAM76_ADDR A:0x200a330
y.create.l HWIO_SPMI_GENI_CFG_RAM77_ADDR A:0x200a334
y.create.l HWIO_SPMI_GENI_CFG_RAM78_ADDR A:0x200a338
y.create.l HWIO_SPMI_GENI_CFG_RAM79_ADDR A:0x200a33c
y.create.l HWIO_SPMI_GENI_CFG_RAM80_ADDR A:0x200a340
y.create.l HWIO_SPMI_GENI_CFG_RAM81_ADDR A:0x200a344
y.create.l HWIO_SPMI_GENI_CFG_RAM82_ADDR A:0x200a348
y.create.l HWIO_SPMI_GENI_CFG_RAM83_ADDR A:0x200a34c
y.create.l HWIO_SPMI_GENI_CFG_RAM84_ADDR A:0x200a350
y.create.l HWIO_SPMI_GENI_CFG_RAM85_ADDR A:0x200a354
y.create.l HWIO_SPMI_GENI_CFG_RAM86_ADDR A:0x200a358
y.create.l HWIO_SPMI_GENI_CFG_RAM87_ADDR A:0x200a35c
y.create.l HWIO_SPMI_GENI_CFG_RAM88_ADDR A:0x200a360
y.create.l HWIO_SPMI_GENI_CFG_RAM89_ADDR A:0x200a364
y.create.l HWIO_SPMI_GENI_CFG_RAM90_ADDR A:0x200a368
y.create.l HWIO_SPMI_GENI_CFG_RAM91_ADDR A:0x200a36c
y.create.l HWIO_SPMI_GENI_CFG_RAM92_ADDR A:0x200a370
y.create.l HWIO_SPMI_GENI_CFG_RAM93_ADDR A:0x200a374
y.create.l HWIO_SPMI_GENI_CFG_RAM94_ADDR A:0x200a378
y.create.l HWIO_SPMI_GENI_CFG_RAM95_ADDR A:0x200a37c
y.create.l HWIO_SPMI_GENI_CFG_RAM96_ADDR A:0x200a380
y.create.l HWIO_SPMI_GENI_CFG_RAM97_ADDR A:0x200a384
y.create.l HWIO_SPMI_GENI_CFG_RAM98_ADDR A:0x200a388
y.create.l HWIO_SPMI_GENI_CFG_RAM99_ADDR A:0x200a38c
y.create.l HWIO_SPMI_GENI_CFG_RAM100_ADDR A:0x200a390
y.create.l HWIO_SPMI_GENI_CFG_RAM101_ADDR A:0x200a394
y.create.l HWIO_SPMI_GENI_CFG_RAM102_ADDR A:0x200a398
y.create.l HWIO_SPMI_GENI_CFG_RAM103_ADDR A:0x200a39c
y.create.l HWIO_SPMI_GENI_CFG_RAM104_ADDR A:0x200a3a0
y.create.l HWIO_SPMI_GENI_CFG_RAM105_ADDR A:0x200a3a4
y.create.l HWIO_SPMI_GENI_CFG_RAM106_ADDR A:0x200a3a8
y.create.l HWIO_SPMI_GENI_CFG_RAM107_ADDR A:0x200a3ac
y.create.l HWIO_SPMI_GENI_CFG_RAM108_ADDR A:0x200a3b0
y.create.l HWIO_SPMI_GENI_CFG_RAM109_ADDR A:0x200a3b4
y.create.l HWIO_SPMI_GENI_CFG_RAM110_ADDR A:0x200a3b8
y.create.l HWIO_SPMI_GENI_CFG_RAM111_ADDR A:0x200a3bc
y.create.l HWIO_SPMI_GENI_CFG_RAM112_ADDR A:0x200a3c0
y.create.l HWIO_SPMI_GENI_CFG_RAM113_ADDR A:0x200a3c4
y.create.l HWIO_SPMI_GENI_CFG_RAM114_ADDR A:0x200a3c8
y.create.l HWIO_SPMI_GENI_CFG_RAM115_ADDR A:0x200a3cc
y.create.l HWIO_SPMI_GENI_CFG_RAM116_ADDR A:0x200a3d0
y.create.l HWIO_SPMI_GENI_CFG_RAM117_ADDR A:0x200a3d4
y.create.l HWIO_SPMI_GENI_CFG_RAM118_ADDR A:0x200a3d8
y.create.l HWIO_SPMI_GENI_CFG_RAM119_ADDR A:0x200a3dc
y.create.l HWIO_SPMI_GENI_CFG_RAM120_ADDR A:0x200a3e0
y.create.l HWIO_SPMI_GENI_CFG_RAM121_ADDR A:0x200a3e4
y.create.l HWIO_SPMI_GENI_CFG_RAM122_ADDR A:0x200a3e8
y.create.l HWIO_SPMI_GENI_CFG_RAM123_ADDR A:0x200a3ec
y.create.l HWIO_SPMI_GENI_CFG_RAM124_ADDR A:0x200a3f0
y.create.l HWIO_SPMI_GENI_CFG_RAM125_ADDR A:0x200a3f4
y.create.l HWIO_SPMI_GENI_CFG_RAM126_ADDR A:0x200a3f8
y.create.l HWIO_SPMI_GENI_CFG_RAM127_ADDR A:0x200a3fc
y.create.l HWIO_SPMI_GENI_CFG_RAM128_ADDR A:0x200a400
y.create.l HWIO_SPMI_GENI_CFG_RAM129_ADDR A:0x200a404
y.create.l HWIO_SPMI_GENI_CFG_RAM130_ADDR A:0x200a408
y.create.l HWIO_SPMI_GENI_CFG_RAM131_ADDR A:0x200a40c
y.create.l HWIO_SPMI_GENI_CFG_RAM132_ADDR A:0x200a410
y.create.l HWIO_SPMI_GENI_CFG_RAM133_ADDR A:0x200a414
y.create.l HWIO_SPMI_GENI_CFG_RAM134_ADDR A:0x200a418
y.create.l HWIO_SPMI_GENI_CFG_RAM135_ADDR A:0x200a41c
y.create.l HWIO_SPMI_GENI_CFG_RAM136_ADDR A:0x200a420
y.create.l HWIO_SPMI_GENI_CFG_RAM137_ADDR A:0x200a424
y.create.l HWIO_SPMI_GENI_CFG_RAM138_ADDR A:0x200a428
y.create.l HWIO_SPMI_GENI_CFG_RAM139_ADDR A:0x200a42c
y.create.l HWIO_SPMI_GENI_CFG_RAM140_ADDR A:0x200a430
y.create.l HWIO_SPMI_GENI_CFG_RAM141_ADDR A:0x200a434
y.create.l HWIO_SPMI_GENI_CFG_RAM142_ADDR A:0x200a438
y.create.l HWIO_SPMI_GENI_CFG_RAM143_ADDR A:0x200a43c
y.create.l HWIO_SPMI_GENI_CFG_RAM144_ADDR A:0x200a440
y.create.l HWIO_SPMI_GENI_CFG_RAM145_ADDR A:0x200a444
y.create.l HWIO_SPMI_GENI_CFG_RAM146_ADDR A:0x200a448
y.create.l HWIO_SPMI_GENI_CFG_RAM147_ADDR A:0x200a44c
y.create.l HWIO_SPMI_GENI_CFG_RAM148_ADDR A:0x200a450
y.create.l HWIO_SPMI_GENI_CFG_RAM149_ADDR A:0x200a454
y.create.l HWIO_SPMI_GENI_CFG_RAM150_ADDR A:0x200a458
y.create.l HWIO_SPMI_GENI_CFG_RAM151_ADDR A:0x200a45c
y.create.l HWIO_SPMI_GENI_CFG_RAM152_ADDR A:0x200a460
y.create.l HWIO_SPMI_GENI_CFG_RAM153_ADDR A:0x200a464
y.create.l HWIO_SPMI_GENI_CFG_RAM154_ADDR A:0x200a468
y.create.l HWIO_SPMI_GENI_CFG_RAM155_ADDR A:0x200a46c
y.create.l HWIO_SPMI_GENI_CFG_RAM156_ADDR A:0x200a470
y.create.l HWIO_SPMI_GENI_CFG_RAM157_ADDR A:0x200a474
y.create.l HWIO_SPMI_GENI_CFG_RAM158_ADDR A:0x200a478
y.create.l HWIO_SPMI_GENI_CFG_RAM159_ADDR A:0x200a47c
y.create.l HWIO_SPMI_GENI_CFG_RAM160_ADDR A:0x200a480
y.create.l HWIO_SPMI_GENI_CFG_RAM161_ADDR A:0x200a484
y.create.l HWIO_SPMI_GENI_CFG_RAM162_ADDR A:0x200a488
y.create.l HWIO_SPMI_GENI_CFG_RAM163_ADDR A:0x200a48c
y.create.l HWIO_SPMI_GENI_CFG_RAM164_ADDR A:0x200a490
y.create.l HWIO_SPMI_GENI_CFG_RAM165_ADDR A:0x200a494
y.create.l HWIO_SPMI_GENI_CFG_RAM166_ADDR A:0x200a498
y.create.l HWIO_SPMI_GENI_CFG_RAM167_ADDR A:0x200a49c
y.create.l HWIO_SPMI_GENI_CFG_RAM168_ADDR A:0x200a4a0
y.create.l HWIO_SPMI_GENI_CFG_RAM169_ADDR A:0x200a4a4
y.create.l HWIO_SPMI_GENI_CFG_RAM170_ADDR A:0x200a4a8
y.create.l HWIO_SPMI_GENI_CFG_RAM171_ADDR A:0x200a4ac
y.create.l HWIO_SPMI_GENI_CFG_RAM172_ADDR A:0x200a4b0
y.create.l HWIO_SPMI_GENI_CFG_RAM173_ADDR A:0x200a4b4
y.create.l HWIO_SPMI_GENI_CFG_RAM174_ADDR A:0x200a4b8
y.create.l HWIO_SPMI_GENI_CFG_RAM175_ADDR A:0x200a4bc
y.create.l HWIO_SPMI_GENI_CFG_RAM176_ADDR A:0x200a4c0
y.create.l HWIO_SPMI_GENI_CFG_RAM177_ADDR A:0x200a4c4
y.create.l HWIO_SPMI_GENI_CFG_RAM178_ADDR A:0x200a4c8
y.create.l HWIO_SPMI_GENI_CFG_RAM179_ADDR A:0x200a4cc
y.create.l HWIO_SPMI_GENI_CFG_RAM180_ADDR A:0x200a4d0
y.create.l HWIO_SPMI_GENI_CFG_RAM181_ADDR A:0x200a4d4
y.create.l HWIO_SPMI_GENI_CFG_RAM182_ADDR A:0x200a4d8
y.create.l HWIO_SPMI_GENI_CFG_RAM183_ADDR A:0x200a4dc
y.create.l HWIO_SPMI_GENI_CFG_RAM184_ADDR A:0x200a4e0
y.create.l HWIO_SPMI_GENI_CFG_RAM185_ADDR A:0x200a4e4
y.create.l HWIO_SPMI_GENI_CFG_RAM186_ADDR A:0x200a4e8
y.create.l HWIO_SPMI_GENI_CFG_RAM187_ADDR A:0x200a4ec
y.create.l HWIO_SPMI_GENI_CFG_RAM188_ADDR A:0x200a4f0
y.create.l HWIO_SPMI_GENI_CFG_RAM189_ADDR A:0x200a4f4
y.create.l HWIO_SPMI_GENI_CFG_RAM190_ADDR A:0x200a4f8
y.create.l HWIO_SPMI_GENI_CFG_RAM191_ADDR A:0x200a4fc
y.create.l HWIO_SPMI_GENI_CFG_RAM192_ADDR A:0x200a500
y.create.l HWIO_SPMI_GENI_CFG_RAM193_ADDR A:0x200a504
y.create.l HWIO_SPMI_GENI_CFG_RAM194_ADDR A:0x200a508
y.create.l HWIO_SPMI_GENI_CFG_RAM195_ADDR A:0x200a50c
y.create.l HWIO_SPMI_GENI_CFG_RAM196_ADDR A:0x200a510
y.create.l HWIO_SPMI_GENI_CFG_RAM197_ADDR A:0x200a514
y.create.l HWIO_SPMI_GENI_CFG_RAM198_ADDR A:0x200a518
y.create.l HWIO_SPMI_GENI_CFG_RAM199_ADDR A:0x200a51c
y.create.l HWIO_SPMI_GENI_CFG_RAM200_ADDR A:0x200a520
y.create.l HWIO_SPMI_GENI_CFG_RAM201_ADDR A:0x200a524
y.create.l HWIO_SPMI_GENI_CFG_RAM202_ADDR A:0x200a528
y.create.l HWIO_SPMI_GENI_CFG_RAM203_ADDR A:0x200a52c
y.create.l HWIO_SPMI_GENI_CFG_RAM204_ADDR A:0x200a530
y.create.l HWIO_SPMI_GENI_CFG_RAM205_ADDR A:0x200a534
y.create.l HWIO_SPMI_GENI_CFG_RAM206_ADDR A:0x200a538
y.create.l HWIO_SPMI_GENI_CFG_RAM207_ADDR A:0x200a53c
y.create.l HWIO_SPMI_GENI_CFG_RAM208_ADDR A:0x200a540
y.create.l HWIO_SPMI_GENI_CFG_RAM209_ADDR A:0x200a544
y.create.l HWIO_SPMI_GENI_CFG_RAM210_ADDR A:0x200a548
y.create.l HWIO_SPMI_GENI_CFG_RAM211_ADDR A:0x200a54c
y.create.l HWIO_SPMI_GENI_CFG_RAM212_ADDR A:0x200a550
y.create.l HWIO_SPMI_GENI_CFG_RAM213_ADDR A:0x200a554
y.create.l HWIO_SPMI_GENI_CFG_RAM214_ADDR A:0x200a558
y.create.l HWIO_SPMI_GENI_CFG_RAM215_ADDR A:0x200a55c
y.create.l HWIO_SPMI_GENI_CFG_RAM216_ADDR A:0x200a560
y.create.l HWIO_SPMI_GENI_CFG_RAM217_ADDR A:0x200a564
y.create.l HWIO_SPMI_GENI_CFG_RAM218_ADDR A:0x200a568
y.create.l HWIO_SPMI_GENI_CFG_RAM219_ADDR A:0x200a56c
y.create.l HWIO_SPMI_GENI_CFG_RAM220_ADDR A:0x200a570
y.create.l HWIO_SPMI_GENI_CFG_RAM221_ADDR A:0x200a574
y.create.l HWIO_SPMI_GENI_CFG_RAM222_ADDR A:0x200a578
y.create.l HWIO_SPMI_GENI_CFG_RAM223_ADDR A:0x200a57c
y.create.l HWIO_SPMI_GENI_CFG_RAM224_ADDR A:0x200a580
y.create.l HWIO_SPMI_GENI_CFG_RAM225_ADDR A:0x200a584
y.create.l HWIO_SPMI_GENI_CFG_RAM226_ADDR A:0x200a588
y.create.l HWIO_SPMI_GENI_CFG_RAM227_ADDR A:0x200a58c
y.create.l HWIO_SPMI_GENI_CFG_RAM228_ADDR A:0x200a590
y.create.l HWIO_SPMI_GENI_CFG_RAM229_ADDR A:0x200a594
y.create.l HWIO_SPMI_GENI_CFG_RAM230_ADDR A:0x200a598
y.create.l HWIO_SPMI_GENI_CFG_RAM231_ADDR A:0x200a59c
y.create.l HWIO_SPMI_GENI_CFG_RAM232_ADDR A:0x200a5a0
y.create.l HWIO_SPMI_GENI_CFG_RAM233_ADDR A:0x200a5a4
y.create.l HWIO_SPMI_GENI_CFG_RAM234_ADDR A:0x200a5a8
y.create.l HWIO_SPMI_GENI_CFG_RAM235_ADDR A:0x200a5ac
y.create.l HWIO_SPMI_GENI_CFG_RAM236_ADDR A:0x200a5b0
y.create.l HWIO_SPMI_GENI_CFG_RAM237_ADDR A:0x200a5b4
y.create.l HWIO_SPMI_GENI_CFG_RAM238_ADDR A:0x200a5b8
y.create.l HWIO_SPMI_GENI_CFG_RAM239_ADDR A:0x200a5bc
y.create.l HWIO_SPMI_GENI_CFG_RAM240_ADDR A:0x200a5c0
y.create.l HWIO_SPMI_GENI_CFG_RAM241_ADDR A:0x200a5c4
y.create.l HWIO_SPMI_GENI_CFG_RAM242_ADDR A:0x200a5c8
y.create.l HWIO_SPMI_GENI_CFG_RAM243_ADDR A:0x200a5cc
y.create.l HWIO_SPMI_GENI_CFG_RAM244_ADDR A:0x200a5d0
y.create.l HWIO_SPMI_GENI_CFG_RAM245_ADDR A:0x200a5d4
y.create.l HWIO_SPMI_GENI_CFG_RAM246_ADDR A:0x200a5d8
y.create.l HWIO_SPMI_GENI_CFG_RAM247_ADDR A:0x200a5dc
y.create.l HWIO_SPMI_GENI_CFG_RAM248_ADDR A:0x200a5e0
y.create.l HWIO_SPMI_GENI_CFG_RAM249_ADDR A:0x200a5e4
y.create.l HWIO_SPMI_GENI_CFG_RAM250_ADDR A:0x200a5e8
y.create.l HWIO_SPMI_GENI_CFG_RAM251_ADDR A:0x200a5ec
y.create.l HWIO_SPMI_GENI_CFG_RAM252_ADDR A:0x200a5f0
y.create.l HWIO_SPMI_GENI_CFG_RAM253_ADDR A:0x200a5f4
y.create.l HWIO_SPMI_GENI_CFG_RAM254_ADDR A:0x200a5f8
y.create.l HWIO_SPMI_GENI_CFG_RAM255_ADDR A:0x200a5fc
y.create.l HWIO_SPMI_PERIPH0_2OWNER_TABLE_REG_ADDR A:0x200a700
y.create.l HWIO_SPMI_PERIPH1_2OWNER_TABLE_REG_ADDR A:0x200a704
y.create.l HWIO_SPMI_PERIPH2_2OWNER_TABLE_REG_ADDR A:0x200a708
y.create.l HWIO_SPMI_PERIPH3_2OWNER_TABLE_REG_ADDR A:0x200a70c
y.create.l HWIO_SPMI_PERIPH4_2OWNER_TABLE_REG_ADDR A:0x200a710
y.create.l HWIO_SPMI_PERIPH5_2OWNER_TABLE_REG_ADDR A:0x200a714
y.create.l HWIO_SPMI_PERIPH6_2OWNER_TABLE_REG_ADDR A:0x200a718
y.create.l HWIO_SPMI_PERIPH7_2OWNER_TABLE_REG_ADDR A:0x200a71c
y.create.l HWIO_SPMI_PERIPH8_2OWNER_TABLE_REG_ADDR A:0x200a720
y.create.l HWIO_SPMI_PERIPH9_2OWNER_TABLE_REG_ADDR A:0x200a724
y.create.l HWIO_SPMI_PERIPH10_2OWNER_TABLE_REG_ADDR A:0x200a728
y.create.l HWIO_SPMI_PERIPH11_2OWNER_TABLE_REG_ADDR A:0x200a72c
y.create.l HWIO_SPMI_PERIPH12_2OWNER_TABLE_REG_ADDR A:0x200a730
y.create.l HWIO_SPMI_PERIPH13_2OWNER_TABLE_REG_ADDR A:0x200a734
y.create.l HWIO_SPMI_PERIPH14_2OWNER_TABLE_REG_ADDR A:0x200a738
y.create.l HWIO_SPMI_PERIPH15_2OWNER_TABLE_REG_ADDR A:0x200a73c
y.create.l HWIO_SPMI_PERIPH16_2OWNER_TABLE_REG_ADDR A:0x200a740
y.create.l HWIO_SPMI_PERIPH17_2OWNER_TABLE_REG_ADDR A:0x200a744
y.create.l HWIO_SPMI_PERIPH18_2OWNER_TABLE_REG_ADDR A:0x200a748
y.create.l HWIO_SPMI_PERIPH19_2OWNER_TABLE_REG_ADDR A:0x200a74c
y.create.l HWIO_SPMI_PERIPH20_2OWNER_TABLE_REG_ADDR A:0x200a750
y.create.l HWIO_SPMI_PERIPH21_2OWNER_TABLE_REG_ADDR A:0x200a754
y.create.l HWIO_SPMI_PERIPH22_2OWNER_TABLE_REG_ADDR A:0x200a758
y.create.l HWIO_SPMI_PERIPH23_2OWNER_TABLE_REG_ADDR A:0x200a75c
y.create.l HWIO_SPMI_PERIPH24_2OWNER_TABLE_REG_ADDR A:0x200a760
y.create.l HWIO_SPMI_PERIPH25_2OWNER_TABLE_REG_ADDR A:0x200a764
y.create.l HWIO_SPMI_PERIPH26_2OWNER_TABLE_REG_ADDR A:0x200a768
y.create.l HWIO_SPMI_PERIPH27_2OWNER_TABLE_REG_ADDR A:0x200a76c
y.create.l HWIO_SPMI_PERIPH28_2OWNER_TABLE_REG_ADDR A:0x200a770
y.create.l HWIO_SPMI_PERIPH29_2OWNER_TABLE_REG_ADDR A:0x200a774
y.create.l HWIO_SPMI_PERIPH30_2OWNER_TABLE_REG_ADDR A:0x200a778
y.create.l HWIO_SPMI_PERIPH31_2OWNER_TABLE_REG_ADDR A:0x200a77c
y.create.l HWIO_SPMI_PERIPH32_2OWNER_TABLE_REG_ADDR A:0x200a780
y.create.l HWIO_SPMI_PERIPH33_2OWNER_TABLE_REG_ADDR A:0x200a784
y.create.l HWIO_SPMI_PERIPH34_2OWNER_TABLE_REG_ADDR A:0x200a788
y.create.l HWIO_SPMI_PERIPH35_2OWNER_TABLE_REG_ADDR A:0x200a78c
y.create.l HWIO_SPMI_PERIPH36_2OWNER_TABLE_REG_ADDR A:0x200a790
y.create.l HWIO_SPMI_PERIPH37_2OWNER_TABLE_REG_ADDR A:0x200a794
y.create.l HWIO_SPMI_PERIPH38_2OWNER_TABLE_REG_ADDR A:0x200a798
y.create.l HWIO_SPMI_PERIPH39_2OWNER_TABLE_REG_ADDR A:0x200a79c
y.create.l HWIO_SPMI_PERIPH40_2OWNER_TABLE_REG_ADDR A:0x200a7a0
y.create.l HWIO_SPMI_PERIPH41_2OWNER_TABLE_REG_ADDR A:0x200a7a4
y.create.l HWIO_SPMI_PERIPH42_2OWNER_TABLE_REG_ADDR A:0x200a7a8
y.create.l HWIO_SPMI_PERIPH43_2OWNER_TABLE_REG_ADDR A:0x200a7ac
y.create.l HWIO_SPMI_PERIPH44_2OWNER_TABLE_REG_ADDR A:0x200a7b0
y.create.l HWIO_SPMI_PERIPH45_2OWNER_TABLE_REG_ADDR A:0x200a7b4
y.create.l HWIO_SPMI_PERIPH46_2OWNER_TABLE_REG_ADDR A:0x200a7b8
y.create.l HWIO_SPMI_PERIPH47_2OWNER_TABLE_REG_ADDR A:0x200a7bc
y.create.l HWIO_SPMI_PERIPH48_2OWNER_TABLE_REG_ADDR A:0x200a7c0
y.create.l HWIO_SPMI_PERIPH49_2OWNER_TABLE_REG_ADDR A:0x200a7c4
y.create.l HWIO_SPMI_PERIPH50_2OWNER_TABLE_REG_ADDR A:0x200a7c8
y.create.l HWIO_SPMI_PERIPH51_2OWNER_TABLE_REG_ADDR A:0x200a7cc
y.create.l HWIO_SPMI_PERIPH52_2OWNER_TABLE_REG_ADDR A:0x200a7d0
y.create.l HWIO_SPMI_PERIPH53_2OWNER_TABLE_REG_ADDR A:0x200a7d4
y.create.l HWIO_SPMI_PERIPH54_2OWNER_TABLE_REG_ADDR A:0x200a7d8
y.create.l HWIO_SPMI_PERIPH55_2OWNER_TABLE_REG_ADDR A:0x200a7dc
y.create.l HWIO_SPMI_PERIPH56_2OWNER_TABLE_REG_ADDR A:0x200a7e0
y.create.l HWIO_SPMI_PERIPH57_2OWNER_TABLE_REG_ADDR A:0x200a7e4
y.create.l HWIO_SPMI_PERIPH58_2OWNER_TABLE_REG_ADDR A:0x200a7e8
y.create.l HWIO_SPMI_PERIPH59_2OWNER_TABLE_REG_ADDR A:0x200a7ec
y.create.l HWIO_SPMI_PERIPH60_2OWNER_TABLE_REG_ADDR A:0x200a7f0
y.create.l HWIO_SPMI_PERIPH61_2OWNER_TABLE_REG_ADDR A:0x200a7f4
y.create.l HWIO_SPMI_PERIPH62_2OWNER_TABLE_REG_ADDR A:0x200a7f8
y.create.l HWIO_SPMI_PERIPH63_2OWNER_TABLE_REG_ADDR A:0x200a7fc
y.create.l HWIO_SPMI_PERIPH64_2OWNER_TABLE_REG_ADDR A:0x200a800
y.create.l HWIO_SPMI_PERIPH65_2OWNER_TABLE_REG_ADDR A:0x200a804
y.create.l HWIO_SPMI_PERIPH66_2OWNER_TABLE_REG_ADDR A:0x200a808
y.create.l HWIO_SPMI_PERIPH67_2OWNER_TABLE_REG_ADDR A:0x200a80c
y.create.l HWIO_SPMI_PERIPH68_2OWNER_TABLE_REG_ADDR A:0x200a810
y.create.l HWIO_SPMI_PERIPH69_2OWNER_TABLE_REG_ADDR A:0x200a814
y.create.l HWIO_SPMI_PERIPH70_2OWNER_TABLE_REG_ADDR A:0x200a818
y.create.l HWIO_SPMI_PERIPH71_2OWNER_TABLE_REG_ADDR A:0x200a81c
y.create.l HWIO_SPMI_PERIPH72_2OWNER_TABLE_REG_ADDR A:0x200a820
y.create.l HWIO_SPMI_PERIPH73_2OWNER_TABLE_REG_ADDR A:0x200a824
y.create.l HWIO_SPMI_PERIPH74_2OWNER_TABLE_REG_ADDR A:0x200a828
y.create.l HWIO_SPMI_PERIPH75_2OWNER_TABLE_REG_ADDR A:0x200a82c
y.create.l HWIO_SPMI_PERIPH76_2OWNER_TABLE_REG_ADDR A:0x200a830
y.create.l HWIO_SPMI_PERIPH77_2OWNER_TABLE_REG_ADDR A:0x200a834
y.create.l HWIO_SPMI_PERIPH78_2OWNER_TABLE_REG_ADDR A:0x200a838
y.create.l HWIO_SPMI_PERIPH79_2OWNER_TABLE_REG_ADDR A:0x200a83c
y.create.l HWIO_SPMI_PERIPH80_2OWNER_TABLE_REG_ADDR A:0x200a840
y.create.l HWIO_SPMI_PERIPH81_2OWNER_TABLE_REG_ADDR A:0x200a844
y.create.l HWIO_SPMI_PERIPH82_2OWNER_TABLE_REG_ADDR A:0x200a848
y.create.l HWIO_SPMI_PERIPH83_2OWNER_TABLE_REG_ADDR A:0x200a84c
y.create.l HWIO_SPMI_PERIPH84_2OWNER_TABLE_REG_ADDR A:0x200a850
y.create.l HWIO_SPMI_PERIPH85_2OWNER_TABLE_REG_ADDR A:0x200a854
y.create.l HWIO_SPMI_PERIPH86_2OWNER_TABLE_REG_ADDR A:0x200a858
y.create.l HWIO_SPMI_PERIPH87_2OWNER_TABLE_REG_ADDR A:0x200a85c
y.create.l HWIO_SPMI_PERIPH88_2OWNER_TABLE_REG_ADDR A:0x200a860
y.create.l HWIO_SPMI_PERIPH89_2OWNER_TABLE_REG_ADDR A:0x200a864
y.create.l HWIO_SPMI_PERIPH90_2OWNER_TABLE_REG_ADDR A:0x200a868
y.create.l HWIO_SPMI_PERIPH91_2OWNER_TABLE_REG_ADDR A:0x200a86c
y.create.l HWIO_SPMI_PERIPH92_2OWNER_TABLE_REG_ADDR A:0x200a870
y.create.l HWIO_SPMI_PERIPH93_2OWNER_TABLE_REG_ADDR A:0x200a874
y.create.l HWIO_SPMI_PERIPH94_2OWNER_TABLE_REG_ADDR A:0x200a878
y.create.l HWIO_SPMI_PERIPH95_2OWNER_TABLE_REG_ADDR A:0x200a87c
y.create.l HWIO_SPMI_PERIPH96_2OWNER_TABLE_REG_ADDR A:0x200a880
y.create.l HWIO_SPMI_PERIPH97_2OWNER_TABLE_REG_ADDR A:0x200a884
y.create.l HWIO_SPMI_PERIPH98_2OWNER_TABLE_REG_ADDR A:0x200a888
y.create.l HWIO_SPMI_PERIPH99_2OWNER_TABLE_REG_ADDR A:0x200a88c
y.create.l HWIO_SPMI_PERIPH100_2OWNER_TABLE_REG_ADDR A:0x200a890
y.create.l HWIO_SPMI_PERIPH101_2OWNER_TABLE_REG_ADDR A:0x200a894
y.create.l HWIO_SPMI_PERIPH102_2OWNER_TABLE_REG_ADDR A:0x200a898
y.create.l HWIO_SPMI_PERIPH103_2OWNER_TABLE_REG_ADDR A:0x200a89c
y.create.l HWIO_SPMI_PERIPH104_2OWNER_TABLE_REG_ADDR A:0x200a8a0
y.create.l HWIO_SPMI_PERIPH105_2OWNER_TABLE_REG_ADDR A:0x200a8a4
y.create.l HWIO_SPMI_PERIPH106_2OWNER_TABLE_REG_ADDR A:0x200a8a8
y.create.l HWIO_SPMI_PERIPH107_2OWNER_TABLE_REG_ADDR A:0x200a8ac
y.create.l HWIO_SPMI_PERIPH108_2OWNER_TABLE_REG_ADDR A:0x200a8b0
y.create.l HWIO_SPMI_PERIPH109_2OWNER_TABLE_REG_ADDR A:0x200a8b4
y.create.l HWIO_SPMI_PERIPH110_2OWNER_TABLE_REG_ADDR A:0x200a8b8
y.create.l HWIO_SPMI_PERIPH111_2OWNER_TABLE_REG_ADDR A:0x200a8bc
y.create.l HWIO_SPMI_PERIPH112_2OWNER_TABLE_REG_ADDR A:0x200a8c0
y.create.l HWIO_SPMI_PERIPH113_2OWNER_TABLE_REG_ADDR A:0x200a8c4
y.create.l HWIO_SPMI_PERIPH114_2OWNER_TABLE_REG_ADDR A:0x200a8c8
y.create.l HWIO_SPMI_PERIPH115_2OWNER_TABLE_REG_ADDR A:0x200a8cc
y.create.l HWIO_SPMI_PERIPH116_2OWNER_TABLE_REG_ADDR A:0x200a8d0
y.create.l HWIO_SPMI_PERIPH117_2OWNER_TABLE_REG_ADDR A:0x200a8d4
y.create.l HWIO_SPMI_PERIPH118_2OWNER_TABLE_REG_ADDR A:0x200a8d8
y.create.l HWIO_SPMI_PERIPH119_2OWNER_TABLE_REG_ADDR A:0x200a8dc
y.create.l HWIO_SPMI_PERIPH120_2OWNER_TABLE_REG_ADDR A:0x200a8e0
y.create.l HWIO_SPMI_PERIPH121_2OWNER_TABLE_REG_ADDR A:0x200a8e4
y.create.l HWIO_SPMI_PERIPH122_2OWNER_TABLE_REG_ADDR A:0x200a8e8
y.create.l HWIO_SPMI_PERIPH123_2OWNER_TABLE_REG_ADDR A:0x200a8ec
y.create.l HWIO_SPMI_PERIPH124_2OWNER_TABLE_REG_ADDR A:0x200a8f0
y.create.l HWIO_SPMI_PERIPH125_2OWNER_TABLE_REG_ADDR A:0x200a8f4
y.create.l HWIO_SPMI_PERIPH126_2OWNER_TABLE_REG_ADDR A:0x200a8f8
y.create.l HWIO_SPMI_PERIPH127_2OWNER_TABLE_REG_ADDR A:0x200a8fc
y.create.l HWIO_SPMI_PERIPH128_2OWNER_TABLE_REG_ADDR A:0x200a900
y.create.l HWIO_SPMI_PERIPH129_2OWNER_TABLE_REG_ADDR A:0x200a904
y.create.l HWIO_SPMI_PERIPH130_2OWNER_TABLE_REG_ADDR A:0x200a908
y.create.l HWIO_SPMI_PERIPH131_2OWNER_TABLE_REG_ADDR A:0x200a90c
y.create.l HWIO_SPMI_PERIPH132_2OWNER_TABLE_REG_ADDR A:0x200a910
y.create.l HWIO_SPMI_PERIPH133_2OWNER_TABLE_REG_ADDR A:0x200a914
y.create.l HWIO_SPMI_PERIPH134_2OWNER_TABLE_REG_ADDR A:0x200a918
y.create.l HWIO_SPMI_PERIPH135_2OWNER_TABLE_REG_ADDR A:0x200a91c
y.create.l HWIO_SPMI_PERIPH136_2OWNER_TABLE_REG_ADDR A:0x200a920
y.create.l HWIO_SPMI_PERIPH137_2OWNER_TABLE_REG_ADDR A:0x200a924
y.create.l HWIO_SPMI_PERIPH138_2OWNER_TABLE_REG_ADDR A:0x200a928
y.create.l HWIO_SPMI_PERIPH139_2OWNER_TABLE_REG_ADDR A:0x200a92c
y.create.l HWIO_SPMI_PERIPH140_2OWNER_TABLE_REG_ADDR A:0x200a930
y.create.l HWIO_SPMI_PERIPH141_2OWNER_TABLE_REG_ADDR A:0x200a934
y.create.l HWIO_SPMI_PERIPH142_2OWNER_TABLE_REG_ADDR A:0x200a938
y.create.l HWIO_SPMI_PERIPH143_2OWNER_TABLE_REG_ADDR A:0x200a93c
y.create.l HWIO_SPMI_PERIPH144_2OWNER_TABLE_REG_ADDR A:0x200a940
y.create.l HWIO_SPMI_PERIPH145_2OWNER_TABLE_REG_ADDR A:0x200a944
y.create.l HWIO_SPMI_PERIPH146_2OWNER_TABLE_REG_ADDR A:0x200a948
y.create.l HWIO_SPMI_PERIPH147_2OWNER_TABLE_REG_ADDR A:0x200a94c
y.create.l HWIO_SPMI_PERIPH148_2OWNER_TABLE_REG_ADDR A:0x200a950
y.create.l HWIO_SPMI_PERIPH149_2OWNER_TABLE_REG_ADDR A:0x200a954
y.create.l HWIO_SPMI_PERIPH150_2OWNER_TABLE_REG_ADDR A:0x200a958
y.create.l HWIO_SPMI_PERIPH151_2OWNER_TABLE_REG_ADDR A:0x200a95c
y.create.l HWIO_SPMI_PERIPH152_2OWNER_TABLE_REG_ADDR A:0x200a960
y.create.l HWIO_SPMI_PERIPH153_2OWNER_TABLE_REG_ADDR A:0x200a964
y.create.l HWIO_SPMI_PERIPH154_2OWNER_TABLE_REG_ADDR A:0x200a968
y.create.l HWIO_SPMI_PERIPH155_2OWNER_TABLE_REG_ADDR A:0x200a96c
y.create.l HWIO_SPMI_PERIPH156_2OWNER_TABLE_REG_ADDR A:0x200a970
y.create.l HWIO_SPMI_PERIPH157_2OWNER_TABLE_REG_ADDR A:0x200a974
y.create.l HWIO_SPMI_PERIPH158_2OWNER_TABLE_REG_ADDR A:0x200a978
y.create.l HWIO_SPMI_PERIPH159_2OWNER_TABLE_REG_ADDR A:0x200a97c
y.create.l HWIO_SPMI_PERIPH160_2OWNER_TABLE_REG_ADDR A:0x200a980
y.create.l HWIO_SPMI_PERIPH161_2OWNER_TABLE_REG_ADDR A:0x200a984
y.create.l HWIO_SPMI_PERIPH162_2OWNER_TABLE_REG_ADDR A:0x200a988
y.create.l HWIO_SPMI_PERIPH163_2OWNER_TABLE_REG_ADDR A:0x200a98c
y.create.l HWIO_SPMI_PERIPH164_2OWNER_TABLE_REG_ADDR A:0x200a990
y.create.l HWIO_SPMI_PERIPH165_2OWNER_TABLE_REG_ADDR A:0x200a994
y.create.l HWIO_SPMI_PERIPH166_2OWNER_TABLE_REG_ADDR A:0x200a998
y.create.l HWIO_SPMI_PERIPH167_2OWNER_TABLE_REG_ADDR A:0x200a99c
y.create.l HWIO_SPMI_PERIPH168_2OWNER_TABLE_REG_ADDR A:0x200a9a0
y.create.l HWIO_SPMI_PERIPH169_2OWNER_TABLE_REG_ADDR A:0x200a9a4
y.create.l HWIO_SPMI_PERIPH170_2OWNER_TABLE_REG_ADDR A:0x200a9a8
y.create.l HWIO_SPMI_PERIPH171_2OWNER_TABLE_REG_ADDR A:0x200a9ac
y.create.l HWIO_SPMI_PERIPH172_2OWNER_TABLE_REG_ADDR A:0x200a9b0
y.create.l HWIO_SPMI_PERIPH173_2OWNER_TABLE_REG_ADDR A:0x200a9b4
y.create.l HWIO_SPMI_PERIPH174_2OWNER_TABLE_REG_ADDR A:0x200a9b8
y.create.l HWIO_SPMI_PERIPH175_2OWNER_TABLE_REG_ADDR A:0x200a9bc
y.create.l HWIO_SPMI_PERIPH176_2OWNER_TABLE_REG_ADDR A:0x200a9c0
y.create.l HWIO_SPMI_PERIPH177_2OWNER_TABLE_REG_ADDR A:0x200a9c4
y.create.l HWIO_SPMI_PERIPH178_2OWNER_TABLE_REG_ADDR A:0x200a9c8
y.create.l HWIO_SPMI_PERIPH179_2OWNER_TABLE_REG_ADDR A:0x200a9cc
y.create.l HWIO_SPMI_PERIPH180_2OWNER_TABLE_REG_ADDR A:0x200a9d0
y.create.l HWIO_SPMI_PERIPH181_2OWNER_TABLE_REG_ADDR A:0x200a9d4
y.create.l HWIO_SPMI_PERIPH182_2OWNER_TABLE_REG_ADDR A:0x200a9d8
y.create.l HWIO_SPMI_PERIPH183_2OWNER_TABLE_REG_ADDR A:0x200a9dc
y.create.l HWIO_SPMI_PERIPH184_2OWNER_TABLE_REG_ADDR A:0x200a9e0
y.create.l HWIO_SPMI_PERIPH185_2OWNER_TABLE_REG_ADDR A:0x200a9e4
y.create.l HWIO_SPMI_PERIPH186_2OWNER_TABLE_REG_ADDR A:0x200a9e8
y.create.l HWIO_SPMI_PERIPH187_2OWNER_TABLE_REG_ADDR A:0x200a9ec
y.create.l HWIO_SPMI_PERIPH188_2OWNER_TABLE_REG_ADDR A:0x200a9f0
y.create.l HWIO_SPMI_PERIPH189_2OWNER_TABLE_REG_ADDR A:0x200a9f4
y.create.l HWIO_SPMI_PERIPH190_2OWNER_TABLE_REG_ADDR A:0x200a9f8
y.create.l HWIO_SPMI_PERIPH191_2OWNER_TABLE_REG_ADDR A:0x200a9fc
y.create.l HWIO_SPMI_PERIPH192_2OWNER_TABLE_REG_ADDR A:0x200aa00
y.create.l HWIO_SPMI_PERIPH193_2OWNER_TABLE_REG_ADDR A:0x200aa04
y.create.l HWIO_SPMI_PERIPH194_2OWNER_TABLE_REG_ADDR A:0x200aa08
y.create.l HWIO_SPMI_PERIPH195_2OWNER_TABLE_REG_ADDR A:0x200aa0c
y.create.l HWIO_SPMI_PERIPH196_2OWNER_TABLE_REG_ADDR A:0x200aa10
y.create.l HWIO_SPMI_PERIPH197_2OWNER_TABLE_REG_ADDR A:0x200aa14
y.create.l HWIO_SPMI_PERIPH198_2OWNER_TABLE_REG_ADDR A:0x200aa18
y.create.l HWIO_SPMI_PERIPH199_2OWNER_TABLE_REG_ADDR A:0x200aa1c
y.create.l HWIO_SPMI_PERIPH200_2OWNER_TABLE_REG_ADDR A:0x200aa20
y.create.l HWIO_SPMI_PERIPH201_2OWNER_TABLE_REG_ADDR A:0x200aa24
y.create.l HWIO_SPMI_PERIPH202_2OWNER_TABLE_REG_ADDR A:0x200aa28
y.create.l HWIO_SPMI_PERIPH203_2OWNER_TABLE_REG_ADDR A:0x200aa2c
y.create.l HWIO_SPMI_PERIPH204_2OWNER_TABLE_REG_ADDR A:0x200aa30
y.create.l HWIO_SPMI_PERIPH205_2OWNER_TABLE_REG_ADDR A:0x200aa34
y.create.l HWIO_SPMI_PERIPH206_2OWNER_TABLE_REG_ADDR A:0x200aa38
y.create.l HWIO_SPMI_PERIPH207_2OWNER_TABLE_REG_ADDR A:0x200aa3c
y.create.l HWIO_SPMI_PERIPH208_2OWNER_TABLE_REG_ADDR A:0x200aa40
y.create.l HWIO_SPMI_PERIPH209_2OWNER_TABLE_REG_ADDR A:0x200aa44
y.create.l HWIO_SPMI_PERIPH210_2OWNER_TABLE_REG_ADDR A:0x200aa48
y.create.l HWIO_SPMI_PERIPH211_2OWNER_TABLE_REG_ADDR A:0x200aa4c
y.create.l HWIO_SPMI_PERIPH212_2OWNER_TABLE_REG_ADDR A:0x200aa50
y.create.l HWIO_SPMI_PERIPH213_2OWNER_TABLE_REG_ADDR A:0x200aa54
y.create.l HWIO_SPMI_PERIPH214_2OWNER_TABLE_REG_ADDR A:0x200aa58
y.create.l HWIO_SPMI_PERIPH215_2OWNER_TABLE_REG_ADDR A:0x200aa5c
y.create.l HWIO_SPMI_PERIPH216_2OWNER_TABLE_REG_ADDR A:0x200aa60
y.create.l HWIO_SPMI_PERIPH217_2OWNER_TABLE_REG_ADDR A:0x200aa64
y.create.l HWIO_SPMI_PERIPH218_2OWNER_TABLE_REG_ADDR A:0x200aa68
y.create.l HWIO_SPMI_PERIPH219_2OWNER_TABLE_REG_ADDR A:0x200aa6c
y.create.l HWIO_SPMI_PERIPH220_2OWNER_TABLE_REG_ADDR A:0x200aa70
y.create.l HWIO_SPMI_PERIPH221_2OWNER_TABLE_REG_ADDR A:0x200aa74
y.create.l HWIO_SPMI_PERIPH222_2OWNER_TABLE_REG_ADDR A:0x200aa78
y.create.l HWIO_SPMI_PERIPH223_2OWNER_TABLE_REG_ADDR A:0x200aa7c
y.create.l HWIO_SPMI_PERIPH224_2OWNER_TABLE_REG_ADDR A:0x200aa80
y.create.l HWIO_SPMI_PERIPH225_2OWNER_TABLE_REG_ADDR A:0x200aa84
y.create.l HWIO_SPMI_PERIPH226_2OWNER_TABLE_REG_ADDR A:0x200aa88
y.create.l HWIO_SPMI_PERIPH227_2OWNER_TABLE_REG_ADDR A:0x200aa8c
y.create.l HWIO_SPMI_PERIPH228_2OWNER_TABLE_REG_ADDR A:0x200aa90
y.create.l HWIO_SPMI_PERIPH229_2OWNER_TABLE_REG_ADDR A:0x200aa94
y.create.l HWIO_SPMI_PERIPH230_2OWNER_TABLE_REG_ADDR A:0x200aa98
y.create.l HWIO_SPMI_PERIPH231_2OWNER_TABLE_REG_ADDR A:0x200aa9c
y.create.l HWIO_SPMI_PERIPH232_2OWNER_TABLE_REG_ADDR A:0x200aaa0
y.create.l HWIO_SPMI_PERIPH233_2OWNER_TABLE_REG_ADDR A:0x200aaa4
y.create.l HWIO_SPMI_PERIPH234_2OWNER_TABLE_REG_ADDR A:0x200aaa8
y.create.l HWIO_SPMI_PERIPH235_2OWNER_TABLE_REG_ADDR A:0x200aaac
y.create.l HWIO_SPMI_PERIPH236_2OWNER_TABLE_REG_ADDR A:0x200aab0
y.create.l HWIO_SPMI_PERIPH237_2OWNER_TABLE_REG_ADDR A:0x200aab4
y.create.l HWIO_SPMI_PERIPH238_2OWNER_TABLE_REG_ADDR A:0x200aab8
y.create.l HWIO_SPMI_PERIPH239_2OWNER_TABLE_REG_ADDR A:0x200aabc
y.create.l HWIO_SPMI_PERIPH240_2OWNER_TABLE_REG_ADDR A:0x200aac0
y.create.l HWIO_SPMI_PERIPH241_2OWNER_TABLE_REG_ADDR A:0x200aac4
y.create.l HWIO_SPMI_PERIPH242_2OWNER_TABLE_REG_ADDR A:0x200aac8
y.create.l HWIO_SPMI_PERIPH243_2OWNER_TABLE_REG_ADDR A:0x200aacc
y.create.l HWIO_SPMI_PERIPH244_2OWNER_TABLE_REG_ADDR A:0x200aad0
y.create.l HWIO_SPMI_PERIPH245_2OWNER_TABLE_REG_ADDR A:0x200aad4
y.create.l HWIO_SPMI_PERIPH246_2OWNER_TABLE_REG_ADDR A:0x200aad8
y.create.l HWIO_SPMI_PERIPH247_2OWNER_TABLE_REG_ADDR A:0x200aadc
y.create.l HWIO_SPMI_PERIPH248_2OWNER_TABLE_REG_ADDR A:0x200aae0
y.create.l HWIO_SPMI_PERIPH249_2OWNER_TABLE_REG_ADDR A:0x200aae4
y.create.l HWIO_SPMI_PERIPH250_2OWNER_TABLE_REG_ADDR A:0x200aae8
y.create.l HWIO_SPMI_PERIPH251_2OWNER_TABLE_REG_ADDR A:0x200aaec
y.create.l HWIO_SPMI_PERIPH252_2OWNER_TABLE_REG_ADDR A:0x200aaf0
y.create.l HWIO_SPMI_PERIPH253_2OWNER_TABLE_REG_ADDR A:0x200aaf4
y.create.l HWIO_SPMI_PERIPH254_2OWNER_TABLE_REG_ADDR A:0x200aaf8
y.create.l HWIO_SPMI_PERIPH255_2OWNER_TABLE_REG_ADDR A:0x200aafc
y.create.l HWIO_SPMI_MAPPING_TABLE_REG0_ADDR A:0x200ab00
y.create.l HWIO_SPMI_MAPPING_TABLE_REG1_ADDR A:0x200ab04
y.create.l HWIO_SPMI_MAPPING_TABLE_REG2_ADDR A:0x200ab08
y.create.l HWIO_SPMI_MAPPING_TABLE_REG3_ADDR A:0x200ab0c
y.create.l HWIO_SPMI_MAPPING_TABLE_REG4_ADDR A:0x200ab10
y.create.l HWIO_SPMI_MAPPING_TABLE_REG5_ADDR A:0x200ab14
y.create.l HWIO_SPMI_MAPPING_TABLE_REG6_ADDR A:0x200ab18
y.create.l HWIO_SPMI_MAPPING_TABLE_REG7_ADDR A:0x200ab1c
y.create.l HWIO_SPMI_MAPPING_TABLE_REG8_ADDR A:0x200ab20
y.create.l HWIO_SPMI_MAPPING_TABLE_REG9_ADDR A:0x200ab24
y.create.l HWIO_SPMI_MAPPING_TABLE_REG10_ADDR A:0x200ab28
y.create.l HWIO_SPMI_MAPPING_TABLE_REG11_ADDR A:0x200ab2c
y.create.l HWIO_SPMI_MAPPING_TABLE_REG12_ADDR A:0x200ab30
y.create.l HWIO_SPMI_MAPPING_TABLE_REG13_ADDR A:0x200ab34
y.create.l HWIO_SPMI_MAPPING_TABLE_REG14_ADDR A:0x200ab38
y.create.l HWIO_SPMI_MAPPING_TABLE_REG15_ADDR A:0x200ab3c
y.create.l HWIO_SPMI_MAPPING_TABLE_REG16_ADDR A:0x200ab40
y.create.l HWIO_SPMI_MAPPING_TABLE_REG17_ADDR A:0x200ab44
y.create.l HWIO_SPMI_MAPPING_TABLE_REG18_ADDR A:0x200ab48
y.create.l HWIO_SPMI_MAPPING_TABLE_REG19_ADDR A:0x200ab4c
y.create.l HWIO_SPMI_MAPPING_TABLE_REG20_ADDR A:0x200ab50
y.create.l HWIO_SPMI_MAPPING_TABLE_REG21_ADDR A:0x200ab54
y.create.l HWIO_SPMI_MAPPING_TABLE_REG22_ADDR A:0x200ab58
y.create.l HWIO_SPMI_MAPPING_TABLE_REG23_ADDR A:0x200ab5c
y.create.l HWIO_SPMI_MAPPING_TABLE_REG24_ADDR A:0x200ab60
y.create.l HWIO_SPMI_MAPPING_TABLE_REG25_ADDR A:0x200ab64
y.create.l HWIO_SPMI_MAPPING_TABLE_REG26_ADDR A:0x200ab68
y.create.l HWIO_SPMI_MAPPING_TABLE_REG27_ADDR A:0x200ab6c
y.create.l HWIO_SPMI_MAPPING_TABLE_REG28_ADDR A:0x200ab70
y.create.l HWIO_SPMI_MAPPING_TABLE_REG29_ADDR A:0x200ab74
y.create.l HWIO_SPMI_MAPPING_TABLE_REG30_ADDR A:0x200ab78
y.create.l HWIO_SPMI_MAPPING_TABLE_REG31_ADDR A:0x200ab7c
y.create.l HWIO_SPMI_MAPPING_TABLE_REG32_ADDR A:0x200ab80
y.create.l HWIO_SPMI_MAPPING_TABLE_REG33_ADDR A:0x200ab84
y.create.l HWIO_SPMI_MAPPING_TABLE_REG34_ADDR A:0x200ab88
y.create.l HWIO_SPMI_MAPPING_TABLE_REG35_ADDR A:0x200ab8c
y.create.l HWIO_SPMI_MAPPING_TABLE_REG36_ADDR A:0x200ab90
y.create.l HWIO_SPMI_MAPPING_TABLE_REG37_ADDR A:0x200ab94
y.create.l HWIO_SPMI_MAPPING_TABLE_REG38_ADDR A:0x200ab98
y.create.l HWIO_SPMI_MAPPING_TABLE_REG39_ADDR A:0x200ab9c
y.create.l HWIO_SPMI_MAPPING_TABLE_REG40_ADDR A:0x200aba0
y.create.l HWIO_SPMI_MAPPING_TABLE_REG41_ADDR A:0x200aba4
y.create.l HWIO_SPMI_MAPPING_TABLE_REG42_ADDR A:0x200aba8
y.create.l HWIO_SPMI_MAPPING_TABLE_REG43_ADDR A:0x200abac
y.create.l HWIO_SPMI_MAPPING_TABLE_REG44_ADDR A:0x200abb0
y.create.l HWIO_SPMI_MAPPING_TABLE_REG45_ADDR A:0x200abb4
y.create.l HWIO_SPMI_MAPPING_TABLE_REG46_ADDR A:0x200abb8
y.create.l HWIO_SPMI_MAPPING_TABLE_REG47_ADDR A:0x200abbc
y.create.l HWIO_SPMI_MAPPING_TABLE_REG48_ADDR A:0x200abc0
y.create.l HWIO_SPMI_MAPPING_TABLE_REG49_ADDR A:0x200abc4
y.create.l HWIO_SPMI_MAPPING_TABLE_REG50_ADDR A:0x200abc8
y.create.l HWIO_SPMI_MAPPING_TABLE_REG51_ADDR A:0x200abcc
y.create.l HWIO_SPMI_MAPPING_TABLE_REG52_ADDR A:0x200abd0
y.create.l HWIO_SPMI_MAPPING_TABLE_REG53_ADDR A:0x200abd4
y.create.l HWIO_SPMI_MAPPING_TABLE_REG54_ADDR A:0x200abd8
y.create.l HWIO_SPMI_MAPPING_TABLE_REG55_ADDR A:0x200abdc
y.create.l HWIO_SPMI_MAPPING_TABLE_REG56_ADDR A:0x200abe0
y.create.l HWIO_SPMI_MAPPING_TABLE_REG57_ADDR A:0x200abe4
y.create.l HWIO_SPMI_MAPPING_TABLE_REG58_ADDR A:0x200abe8
y.create.l HWIO_SPMI_MAPPING_TABLE_REG59_ADDR A:0x200abec
y.create.l HWIO_SPMI_MAPPING_TABLE_REG60_ADDR A:0x200abf0
y.create.l HWIO_SPMI_MAPPING_TABLE_REG61_ADDR A:0x200abf4
y.create.l HWIO_SPMI_MAPPING_TABLE_REG62_ADDR A:0x200abf8
y.create.l HWIO_SPMI_MAPPING_TABLE_REG63_ADDR A:0x200abfc
y.create.l HWIO_SPMI_MAPPING_TABLE_REG64_ADDR A:0x200ac00
y.create.l HWIO_SPMI_MAPPING_TABLE_REG65_ADDR A:0x200ac04
y.create.l HWIO_SPMI_MAPPING_TABLE_REG66_ADDR A:0x200ac08
y.create.l HWIO_SPMI_MAPPING_TABLE_REG67_ADDR A:0x200ac0c
y.create.l HWIO_SPMI_MAPPING_TABLE_REG68_ADDR A:0x200ac10
y.create.l HWIO_SPMI_MAPPING_TABLE_REG69_ADDR A:0x200ac14
y.create.l HWIO_SPMI_MAPPING_TABLE_REG70_ADDR A:0x200ac18
y.create.l HWIO_SPMI_MAPPING_TABLE_REG71_ADDR A:0x200ac1c
y.create.l HWIO_SPMI_MAPPING_TABLE_REG72_ADDR A:0x200ac20
y.create.l HWIO_SPMI_MAPPING_TABLE_REG73_ADDR A:0x200ac24
y.create.l HWIO_SPMI_MAPPING_TABLE_REG74_ADDR A:0x200ac28
y.create.l HWIO_SPMI_MAPPING_TABLE_REG75_ADDR A:0x200ac2c
y.create.l HWIO_SPMI_MAPPING_TABLE_REG76_ADDR A:0x200ac30
y.create.l HWIO_SPMI_MAPPING_TABLE_REG77_ADDR A:0x200ac34
y.create.l HWIO_SPMI_MAPPING_TABLE_REG78_ADDR A:0x200ac38
y.create.l HWIO_SPMI_MAPPING_TABLE_REG79_ADDR A:0x200ac3c
y.create.l HWIO_SPMI_MAPPING_TABLE_REG80_ADDR A:0x200ac40
y.create.l HWIO_SPMI_MAPPING_TABLE_REG81_ADDR A:0x200ac44
y.create.l HWIO_SPMI_MAPPING_TABLE_REG82_ADDR A:0x200ac48
y.create.l HWIO_SPMI_MAPPING_TABLE_REG83_ADDR A:0x200ac4c
y.create.l HWIO_SPMI_MAPPING_TABLE_REG84_ADDR A:0x200ac50
y.create.l HWIO_SPMI_MAPPING_TABLE_REG85_ADDR A:0x200ac54
y.create.l HWIO_SPMI_MAPPING_TABLE_REG86_ADDR A:0x200ac58
y.create.l HWIO_SPMI_MAPPING_TABLE_REG87_ADDR A:0x200ac5c
y.create.l HWIO_SPMI_MAPPING_TABLE_REG88_ADDR A:0x200ac60
y.create.l HWIO_SPMI_MAPPING_TABLE_REG89_ADDR A:0x200ac64
y.create.l HWIO_SPMI_MAPPING_TABLE_REG90_ADDR A:0x200ac68
y.create.l HWIO_SPMI_MAPPING_TABLE_REG91_ADDR A:0x200ac6c
y.create.l HWIO_SPMI_MAPPING_TABLE_REG92_ADDR A:0x200ac70
y.create.l HWIO_SPMI_MAPPING_TABLE_REG93_ADDR A:0x200ac74
y.create.l HWIO_SPMI_MAPPING_TABLE_REG94_ADDR A:0x200ac78
y.create.l HWIO_SPMI_MAPPING_TABLE_REG95_ADDR A:0x200ac7c
y.create.l HWIO_SPMI_MAPPING_TABLE_REG96_ADDR A:0x200ac80
y.create.l HWIO_SPMI_MAPPING_TABLE_REG97_ADDR A:0x200ac84
y.create.l HWIO_SPMI_MAPPING_TABLE_REG98_ADDR A:0x200ac88
y.create.l HWIO_SPMI_MAPPING_TABLE_REG99_ADDR A:0x200ac8c
y.create.l HWIO_SPMI_MAPPING_TABLE_REG100_ADDR A:0x200ac90
y.create.l HWIO_SPMI_MAPPING_TABLE_REG101_ADDR A:0x200ac94
y.create.l HWIO_SPMI_MAPPING_TABLE_REG102_ADDR A:0x200ac98
y.create.l HWIO_SPMI_MAPPING_TABLE_REG103_ADDR A:0x200ac9c
y.create.l HWIO_SPMI_MAPPING_TABLE_REG104_ADDR A:0x200aca0
y.create.l HWIO_SPMI_MAPPING_TABLE_REG105_ADDR A:0x200aca4
y.create.l HWIO_SPMI_MAPPING_TABLE_REG106_ADDR A:0x200aca8
y.create.l HWIO_SPMI_MAPPING_TABLE_REG107_ADDR A:0x200acac
y.create.l HWIO_SPMI_MAPPING_TABLE_REG108_ADDR A:0x200acb0
y.create.l HWIO_SPMI_MAPPING_TABLE_REG109_ADDR A:0x200acb4
y.create.l HWIO_SPMI_MAPPING_TABLE_REG110_ADDR A:0x200acb8
y.create.l HWIO_SPMI_MAPPING_TABLE_REG111_ADDR A:0x200acbc
y.create.l HWIO_SPMI_MAPPING_TABLE_REG112_ADDR A:0x200acc0
y.create.l HWIO_SPMI_MAPPING_TABLE_REG113_ADDR A:0x200acc4
y.create.l HWIO_SPMI_MAPPING_TABLE_REG114_ADDR A:0x200acc8
y.create.l HWIO_SPMI_MAPPING_TABLE_REG115_ADDR A:0x200accc
y.create.l HWIO_SPMI_MAPPING_TABLE_REG116_ADDR A:0x200acd0
y.create.l HWIO_SPMI_MAPPING_TABLE_REG117_ADDR A:0x200acd4
y.create.l HWIO_SPMI_MAPPING_TABLE_REG118_ADDR A:0x200acd8
y.create.l HWIO_SPMI_MAPPING_TABLE_REG119_ADDR A:0x200acdc
y.create.l HWIO_SPMI_MAPPING_TABLE_REG120_ADDR A:0x200ace0
y.create.l HWIO_SPMI_MAPPING_TABLE_REG121_ADDR A:0x200ace4
y.create.l HWIO_SPMI_MAPPING_TABLE_REG122_ADDR A:0x200ace8
y.create.l HWIO_SPMI_MAPPING_TABLE_REG123_ADDR A:0x200acec
y.create.l HWIO_SPMI_MAPPING_TABLE_REG124_ADDR A:0x200acf0
y.create.l HWIO_SPMI_MAPPING_TABLE_REG125_ADDR A:0x200acf4
y.create.l HWIO_SPMI_MAPPING_TABLE_REG126_ADDR A:0x200acf8
y.create.l HWIO_SPMI_MAPPING_TABLE_REG127_ADDR A:0x200acfc
y.create.l HWIO_SPMI_MAPPING_TABLE_REG128_ADDR A:0x200ad00
y.create.l HWIO_SPMI_MAPPING_TABLE_REG129_ADDR A:0x200ad04
y.create.l HWIO_SPMI_MAPPING_TABLE_REG130_ADDR A:0x200ad08
y.create.l HWIO_SPMI_MAPPING_TABLE_REG131_ADDR A:0x200ad0c
y.create.l HWIO_SPMI_MAPPING_TABLE_REG132_ADDR A:0x200ad10
y.create.l HWIO_SPMI_MAPPING_TABLE_REG133_ADDR A:0x200ad14
y.create.l HWIO_SPMI_MAPPING_TABLE_REG134_ADDR A:0x200ad18
y.create.l HWIO_SPMI_MAPPING_TABLE_REG135_ADDR A:0x200ad1c
y.create.l HWIO_SPMI_MAPPING_TABLE_REG136_ADDR A:0x200ad20
y.create.l HWIO_SPMI_MAPPING_TABLE_REG137_ADDR A:0x200ad24
y.create.l HWIO_SPMI_MAPPING_TABLE_REG138_ADDR A:0x200ad28
y.create.l HWIO_SPMI_MAPPING_TABLE_REG139_ADDR A:0x200ad2c
y.create.l HWIO_SPMI_MAPPING_TABLE_REG140_ADDR A:0x200ad30
y.create.l HWIO_SPMI_MAPPING_TABLE_REG141_ADDR A:0x200ad34
y.create.l HWIO_SPMI_MAPPING_TABLE_REG142_ADDR A:0x200ad38
y.create.l HWIO_SPMI_MAPPING_TABLE_REG143_ADDR A:0x200ad3c
y.create.l HWIO_SPMI_MAPPING_TABLE_REG144_ADDR A:0x200ad40
y.create.l HWIO_SPMI_MAPPING_TABLE_REG145_ADDR A:0x200ad44
y.create.l HWIO_SPMI_MAPPING_TABLE_REG146_ADDR A:0x200ad48
y.create.l HWIO_SPMI_MAPPING_TABLE_REG147_ADDR A:0x200ad4c
y.create.l HWIO_SPMI_MAPPING_TABLE_REG148_ADDR A:0x200ad50
y.create.l HWIO_SPMI_MAPPING_TABLE_REG149_ADDR A:0x200ad54
y.create.l HWIO_SPMI_MAPPING_TABLE_REG150_ADDR A:0x200ad58
y.create.l HWIO_SPMI_MAPPING_TABLE_REG151_ADDR A:0x200ad5c
y.create.l HWIO_SPMI_MAPPING_TABLE_REG152_ADDR A:0x200ad60
y.create.l HWIO_SPMI_MAPPING_TABLE_REG153_ADDR A:0x200ad64
y.create.l HWIO_SPMI_MAPPING_TABLE_REG154_ADDR A:0x200ad68
y.create.l HWIO_SPMI_MAPPING_TABLE_REG155_ADDR A:0x200ad6c
y.create.l HWIO_SPMI_MAPPING_TABLE_REG156_ADDR A:0x200ad70
y.create.l HWIO_SPMI_MAPPING_TABLE_REG157_ADDR A:0x200ad74
y.create.l HWIO_SPMI_MAPPING_TABLE_REG158_ADDR A:0x200ad78
y.create.l HWIO_SPMI_MAPPING_TABLE_REG159_ADDR A:0x200ad7c
y.create.l HWIO_SPMI_MAPPING_TABLE_REG160_ADDR A:0x200ad80
y.create.l HWIO_SPMI_MAPPING_TABLE_REG161_ADDR A:0x200ad84
y.create.l HWIO_SPMI_MAPPING_TABLE_REG162_ADDR A:0x200ad88
y.create.l HWIO_SPMI_MAPPING_TABLE_REG163_ADDR A:0x200ad8c
y.create.l HWIO_SPMI_MAPPING_TABLE_REG164_ADDR A:0x200ad90
y.create.l HWIO_SPMI_MAPPING_TABLE_REG165_ADDR A:0x200ad94
y.create.l HWIO_SPMI_MAPPING_TABLE_REG166_ADDR A:0x200ad98
y.create.l HWIO_SPMI_MAPPING_TABLE_REG167_ADDR A:0x200ad9c
y.create.l HWIO_SPMI_MAPPING_TABLE_REG168_ADDR A:0x200ada0
y.create.l HWIO_SPMI_MAPPING_TABLE_REG169_ADDR A:0x200ada4
y.create.l HWIO_SPMI_MAPPING_TABLE_REG170_ADDR A:0x200ada8
y.create.l HWIO_SPMI_MAPPING_TABLE_REG171_ADDR A:0x200adac
y.create.l HWIO_SPMI_MAPPING_TABLE_REG172_ADDR A:0x200adb0
y.create.l HWIO_SPMI_MAPPING_TABLE_REG173_ADDR A:0x200adb4
y.create.l HWIO_SPMI_MAPPING_TABLE_REG174_ADDR A:0x200adb8
y.create.l HWIO_SPMI_MAPPING_TABLE_REG175_ADDR A:0x200adbc
y.create.l HWIO_SPMI_MAPPING_TABLE_REG176_ADDR A:0x200adc0
y.create.l HWIO_SPMI_MAPPING_TABLE_REG177_ADDR A:0x200adc4
y.create.l HWIO_SPMI_MAPPING_TABLE_REG178_ADDR A:0x200adc8
y.create.l HWIO_SPMI_MAPPING_TABLE_REG179_ADDR A:0x200adcc
y.create.l HWIO_SPMI_MAPPING_TABLE_REG180_ADDR A:0x200add0
y.create.l HWIO_SPMI_MAPPING_TABLE_REG181_ADDR A:0x200add4
y.create.l HWIO_SPMI_MAPPING_TABLE_REG182_ADDR A:0x200add8
y.create.l HWIO_SPMI_MAPPING_TABLE_REG183_ADDR A:0x200addc
y.create.l HWIO_SPMI_MAPPING_TABLE_REG184_ADDR A:0x200ade0
y.create.l HWIO_SPMI_MAPPING_TABLE_REG185_ADDR A:0x200ade4
y.create.l HWIO_SPMI_MAPPING_TABLE_REG186_ADDR A:0x200ade8
y.create.l HWIO_SPMI_MAPPING_TABLE_REG187_ADDR A:0x200adec
y.create.l HWIO_SPMI_MAPPING_TABLE_REG188_ADDR A:0x200adf0
y.create.l HWIO_SPMI_MAPPING_TABLE_REG189_ADDR A:0x200adf4
y.create.l HWIO_SPMI_MAPPING_TABLE_REG190_ADDR A:0x200adf8
y.create.l HWIO_SPMI_MAPPING_TABLE_REG191_ADDR A:0x200adfc
y.create.l HWIO_SPMI_MAPPING_TABLE_REG192_ADDR A:0x200ae00
y.create.l HWIO_SPMI_MAPPING_TABLE_REG193_ADDR A:0x200ae04
y.create.l HWIO_SPMI_MAPPING_TABLE_REG194_ADDR A:0x200ae08
y.create.l HWIO_SPMI_MAPPING_TABLE_REG195_ADDR A:0x200ae0c
y.create.l HWIO_SPMI_MAPPING_TABLE_REG196_ADDR A:0x200ae10
y.create.l HWIO_SPMI_MAPPING_TABLE_REG197_ADDR A:0x200ae14
y.create.l HWIO_SPMI_MAPPING_TABLE_REG198_ADDR A:0x200ae18
y.create.l HWIO_SPMI_MAPPING_TABLE_REG199_ADDR A:0x200ae1c
y.create.l HWIO_SPMI_MAPPING_TABLE_REG200_ADDR A:0x200ae20
y.create.l HWIO_SPMI_MAPPING_TABLE_REG201_ADDR A:0x200ae24
y.create.l HWIO_SPMI_MAPPING_TABLE_REG202_ADDR A:0x200ae28
y.create.l HWIO_SPMI_MAPPING_TABLE_REG203_ADDR A:0x200ae2c
y.create.l HWIO_SPMI_MAPPING_TABLE_REG204_ADDR A:0x200ae30
y.create.l HWIO_SPMI_MAPPING_TABLE_REG205_ADDR A:0x200ae34
y.create.l HWIO_SPMI_MAPPING_TABLE_REG206_ADDR A:0x200ae38
y.create.l HWIO_SPMI_MAPPING_TABLE_REG207_ADDR A:0x200ae3c
y.create.l HWIO_SPMI_MAPPING_TABLE_REG208_ADDR A:0x200ae40
y.create.l HWIO_SPMI_MAPPING_TABLE_REG209_ADDR A:0x200ae44
y.create.l HWIO_SPMI_MAPPING_TABLE_REG210_ADDR A:0x200ae48
y.create.l HWIO_SPMI_MAPPING_TABLE_REG211_ADDR A:0x200ae4c
y.create.l HWIO_SPMI_MAPPING_TABLE_REG212_ADDR A:0x200ae50
y.create.l HWIO_SPMI_MAPPING_TABLE_REG213_ADDR A:0x200ae54
y.create.l HWIO_SPMI_MAPPING_TABLE_REG214_ADDR A:0x200ae58
y.create.l HWIO_SPMI_MAPPING_TABLE_REG215_ADDR A:0x200ae5c
y.create.l HWIO_SPMI_MAPPING_TABLE_REG216_ADDR A:0x200ae60
y.create.l HWIO_SPMI_MAPPING_TABLE_REG217_ADDR A:0x200ae64
y.create.l HWIO_SPMI_MAPPING_TABLE_REG218_ADDR A:0x200ae68
y.create.l HWIO_SPMI_MAPPING_TABLE_REG219_ADDR A:0x200ae6c
y.create.l HWIO_SPMI_MAPPING_TABLE_REG220_ADDR A:0x200ae70
y.create.l HWIO_SPMI_MAPPING_TABLE_REG221_ADDR A:0x200ae74
y.create.l HWIO_SPMI_MAPPING_TABLE_REG222_ADDR A:0x200ae78
y.create.l HWIO_SPMI_MAPPING_TABLE_REG223_ADDR A:0x200ae7c
y.create.l HWIO_SPMI_MAPPING_TABLE_REG224_ADDR A:0x200ae80
y.create.l HWIO_SPMI_MAPPING_TABLE_REG225_ADDR A:0x200ae84
y.create.l HWIO_SPMI_MAPPING_TABLE_REG226_ADDR A:0x200ae88
y.create.l HWIO_SPMI_MAPPING_TABLE_REG227_ADDR A:0x200ae8c
y.create.l HWIO_SPMI_MAPPING_TABLE_REG228_ADDR A:0x200ae90
y.create.l HWIO_SPMI_MAPPING_TABLE_REG229_ADDR A:0x200ae94
y.create.l HWIO_SPMI_MAPPING_TABLE_REG230_ADDR A:0x200ae98
y.create.l HWIO_SPMI_MAPPING_TABLE_REG231_ADDR A:0x200ae9c
y.create.l HWIO_SPMI_MAPPING_TABLE_REG232_ADDR A:0x200aea0
y.create.l HWIO_SPMI_MAPPING_TABLE_REG233_ADDR A:0x200aea4
y.create.l HWIO_SPMI_MAPPING_TABLE_REG234_ADDR A:0x200aea8
y.create.l HWIO_SPMI_MAPPING_TABLE_REG235_ADDR A:0x200aeac
y.create.l HWIO_SPMI_MAPPING_TABLE_REG236_ADDR A:0x200aeb0
y.create.l HWIO_SPMI_MAPPING_TABLE_REG237_ADDR A:0x200aeb4
y.create.l HWIO_SPMI_MAPPING_TABLE_REG238_ADDR A:0x200aeb8
y.create.l HWIO_SPMI_MAPPING_TABLE_REG239_ADDR A:0x200aebc
y.create.l HWIO_SPMI_MAPPING_TABLE_REG240_ADDR A:0x200aec0
y.create.l HWIO_SPMI_MAPPING_TABLE_REG241_ADDR A:0x200aec4
y.create.l HWIO_SPMI_MAPPING_TABLE_REG242_ADDR A:0x200aec8
y.create.l HWIO_SPMI_MAPPING_TABLE_REG243_ADDR A:0x200aecc
y.create.l HWIO_SPMI_MAPPING_TABLE_REG244_ADDR A:0x200aed0
y.create.l HWIO_SPMI_MAPPING_TABLE_REG245_ADDR A:0x200aed4
y.create.l HWIO_SPMI_MAPPING_TABLE_REG246_ADDR A:0x200aed8
y.create.l HWIO_SPMI_MAPPING_TABLE_REG247_ADDR A:0x200aedc
y.create.l HWIO_SPMI_MAPPING_TABLE_REG248_ADDR A:0x200aee0
y.create.l HWIO_SPMI_MAPPING_TABLE_REG249_ADDR A:0x200aee4
y.create.l HWIO_SPMI_MAPPING_TABLE_REG250_ADDR A:0x200aee8
y.create.l HWIO_SPMI_MAPPING_TABLE_REG251_ADDR A:0x200aeec
y.create.l HWIO_SPMI_MAPPING_TABLE_REG252_ADDR A:0x200aef0
y.create.l HWIO_SPMI_MAPPING_TABLE_REG253_ADDR A:0x200aef4
y.create.l HWIO_SPMI_MAPPING_TABLE_REG254_ADDR A:0x200aef8
y.create.l HWIO_SPMI_MID_REG_ADDR A:0x200af00
y.create.l HWIO_SPMI_CFG_REG_ADDR A:0x200af04
y.create.l HWIO_SPMI_SEC_DISABLE_REG_ADDR A:0x200af08
y.create.l HWIO_SPMI_HW_VERSION_ADDR A:0x200af0c
y.create.l HWIO_SPMI_CGC_CTRL_ADDR A:0x200af10
y.create.l HWIO_SPMI_MWB_ENABLE_REG_ADDR A:0x200af14
y.create.l HWIO_SPMI_CHAR_CFG_ADDR A:0x200af40
y.create.l HWIO_SPMI_CHAR_DATA_0_ADDR A:0x200af44
y.create.l HWIO_SPMI_CHAR_DATA_1_ADDR A:0x200af48
y.create.l HWIO_SPMI_CMPR_EN_REG_ADDR A:0x200af54
y.create.l HWIO_SPMI_PROTOCOL_IRQ_STATUS_ADDR A:0x200b000
y.create.l HWIO_SPMI_PROTOCOL_IRQ_ENABLE_ADDR A:0x200b004
y.create.l HWIO_SPMI_PROTOCOL_IRQ_CLEAR_ADDR A:0x200b008
y.create.l HWIO_SPMI_PROTOCOL_IRQ_EN_SET_ADDR A:0x200b00c
y.create.l HWIO_SPMI_PROTOCOL_IRQ_EN_CLEAR_ADDR A:0x200b010
y.create.l HWIO_SPMI_TEST_BUS_CTRL_ADDR A:0x200c000
y.create.l HWIO_SPMI_HW_SW_EVENTS_CTRL_ADDR A:0x200c004
y.create.l HWIO_SPMI_HW_SW_EVENTS_BITWISE_REG0_ADDR A:0x200c008
y.create.l HWIO_SPMI_HW_SW_EVENTS_BITWISE_REG1_ADDR A:0x200c00c
y.create.l HWIO_SPMI_HW_SW_EVENTS_BITWISE_REG2_ADDR A:0x200c010
y.create.l HWIO_SPMI_HW_SW_EVENTS_BITWISE_REG3_ADDR A:0x200c014
y.create.l HWIO_SPMI_HW_SW_EVENTS_BITWISE_REG4_ADDR A:0x200c018
y.create.l HWIO_SPMI_HW_SW_EVENTS_BITWISE_REG5_ADDR A:0x200c01c
y.create.l HWIO_SPMI_HW_SW_EVENTS_BITWISE_REG6_ADDR A:0x200c020
y.create.l HWIO_SPMI_HW_SW_EVENTS_BITWISE_REG7_ADDR A:0x200c024
y.create.l HWIO_SPMI_PIC_OWNER0_ACC_STATUS0_ADDR A:0x3900000
y.create.l HWIO_SPMI_PIC_OWNER0_ACC_STATUS1_ADDR A:0x3900004
y.create.l HWIO_SPMI_PIC_OWNER0_ACC_STATUS2_ADDR A:0x3900008
y.create.l HWIO_SPMI_PIC_OWNER0_ACC_STATUS3_ADDR A:0x390000c
y.create.l HWIO_SPMI_PIC_OWNER0_ACC_STATUS4_ADDR A:0x3900010
y.create.l HWIO_SPMI_PIC_OWNER0_ACC_STATUS5_ADDR A:0x3900014
y.create.l HWIO_SPMI_PIC_OWNER0_ACC_STATUS6_ADDR A:0x3900018
y.create.l HWIO_SPMI_PIC_OWNER0_ACC_STATUS7_ADDR A:0x390001c
y.create.l HWIO_SPMI_PIC_OWNER1_ACC_STATUS0_ADDR A:0x3901000
y.create.l HWIO_SPMI_PIC_OWNER1_ACC_STATUS1_ADDR A:0x3901004
y.create.l HWIO_SPMI_PIC_OWNER1_ACC_STATUS2_ADDR A:0x3901008
y.create.l HWIO_SPMI_PIC_OWNER1_ACC_STATUS3_ADDR A:0x390100c
y.create.l HWIO_SPMI_PIC_OWNER1_ACC_STATUS4_ADDR A:0x3901010
y.create.l HWIO_SPMI_PIC_OWNER1_ACC_STATUS5_ADDR A:0x3901014
y.create.l HWIO_SPMI_PIC_OWNER1_ACC_STATUS6_ADDR A:0x3901018
y.create.l HWIO_SPMI_PIC_OWNER1_ACC_STATUS7_ADDR A:0x390101c
y.create.l HWIO_SPMI_PIC_OWNER2_ACC_STATUS0_ADDR A:0x3902000
y.create.l HWIO_SPMI_PIC_OWNER2_ACC_STATUS1_ADDR A:0x3902004
y.create.l HWIO_SPMI_PIC_OWNER2_ACC_STATUS2_ADDR A:0x3902008
y.create.l HWIO_SPMI_PIC_OWNER2_ACC_STATUS3_ADDR A:0x390200c
y.create.l HWIO_SPMI_PIC_OWNER2_ACC_STATUS4_ADDR A:0x3902010
y.create.l HWIO_SPMI_PIC_OWNER2_ACC_STATUS5_ADDR A:0x3902014
y.create.l HWIO_SPMI_PIC_OWNER2_ACC_STATUS6_ADDR A:0x3902018
y.create.l HWIO_SPMI_PIC_OWNER2_ACC_STATUS7_ADDR A:0x390201c
y.create.l HWIO_SPMI_PIC_OWNER3_ACC_STATUS0_ADDR A:0x3903000
y.create.l HWIO_SPMI_PIC_OWNER3_ACC_STATUS1_ADDR A:0x3903004
y.create.l HWIO_SPMI_PIC_OWNER3_ACC_STATUS2_ADDR A:0x3903008
y.create.l HWIO_SPMI_PIC_OWNER3_ACC_STATUS3_ADDR A:0x390300c
y.create.l HWIO_SPMI_PIC_OWNER3_ACC_STATUS4_ADDR A:0x3903010
y.create.l HWIO_SPMI_PIC_OWNER3_ACC_STATUS5_ADDR A:0x3903014
y.create.l HWIO_SPMI_PIC_OWNER3_ACC_STATUS6_ADDR A:0x3903018
y.create.l HWIO_SPMI_PIC_OWNER3_ACC_STATUS7_ADDR A:0x390301c
y.create.l HWIO_SPMI_PIC_OWNER4_ACC_STATUS0_ADDR A:0x3904000
y.create.l HWIO_SPMI_PIC_OWNER4_ACC_STATUS1_ADDR A:0x3904004
y.create.l HWIO_SPMI_PIC_OWNER4_ACC_STATUS2_ADDR A:0x3904008
y.create.l HWIO_SPMI_PIC_OWNER4_ACC_STATUS3_ADDR A:0x390400c
y.create.l HWIO_SPMI_PIC_OWNER4_ACC_STATUS4_ADDR A:0x3904010
y.create.l HWIO_SPMI_PIC_OWNER4_ACC_STATUS5_ADDR A:0x3904014
y.create.l HWIO_SPMI_PIC_OWNER4_ACC_STATUS6_ADDR A:0x3904018
y.create.l HWIO_SPMI_PIC_OWNER4_ACC_STATUS7_ADDR A:0x390401c
y.create.l HWIO_SPMI_PIC_OWNER5_ACC_STATUS0_ADDR A:0x3905000
y.create.l HWIO_SPMI_PIC_OWNER5_ACC_STATUS1_ADDR A:0x3905004
y.create.l HWIO_SPMI_PIC_OWNER5_ACC_STATUS2_ADDR A:0x3905008
y.create.l HWIO_SPMI_PIC_OWNER5_ACC_STATUS3_ADDR A:0x390500c
y.create.l HWIO_SPMI_PIC_OWNER5_ACC_STATUS4_ADDR A:0x3905010
y.create.l HWIO_SPMI_PIC_OWNER5_ACC_STATUS5_ADDR A:0x3905014
y.create.l HWIO_SPMI_PIC_OWNER5_ACC_STATUS6_ADDR A:0x3905018
y.create.l HWIO_SPMI_PIC_OWNER5_ACC_STATUS7_ADDR A:0x390501c
y.create.l HWIO_SPMI_PIC_OWNER6_ACC_STATUS0_ADDR A:0x3906000
y.create.l HWIO_SPMI_PIC_OWNER6_ACC_STATUS1_ADDR A:0x3906004
y.create.l HWIO_SPMI_PIC_OWNER6_ACC_STATUS2_ADDR A:0x3906008
y.create.l HWIO_SPMI_PIC_OWNER6_ACC_STATUS3_ADDR A:0x390600c
y.create.l HWIO_SPMI_PIC_OWNER6_ACC_STATUS4_ADDR A:0x3906010
y.create.l HWIO_SPMI_PIC_OWNER6_ACC_STATUS5_ADDR A:0x3906014
y.create.l HWIO_SPMI_PIC_OWNER6_ACC_STATUS6_ADDR A:0x3906018
y.create.l HWIO_SPMI_PIC_OWNER6_ACC_STATUS7_ADDR A:0x390601c
y.create.l HWIO_SPMI_PIC_OWNER7_ACC_STATUS0_ADDR A:0x3907000
y.create.l HWIO_SPMI_PIC_OWNER7_ACC_STATUS1_ADDR A:0x3907004
y.create.l HWIO_SPMI_PIC_OWNER7_ACC_STATUS2_ADDR A:0x3907008
y.create.l HWIO_SPMI_PIC_OWNER7_ACC_STATUS3_ADDR A:0x390700c
y.create.l HWIO_SPMI_PIC_OWNER7_ACC_STATUS4_ADDR A:0x3907010
y.create.l HWIO_SPMI_PIC_OWNER7_ACC_STATUS5_ADDR A:0x3907014
y.create.l HWIO_SPMI_PIC_OWNER7_ACC_STATUS6_ADDR A:0x3907018
y.create.l HWIO_SPMI_PIC_OWNER7_ACC_STATUS7_ADDR A:0x390701c
y.create.l HWIO_SPMI_PIC_ACC_ENABLE0_ADDR A:0x3800000
y.create.l HWIO_SPMI_PIC_ACC_ENABLE1_ADDR A:0x3801000
y.create.l HWIO_SPMI_PIC_ACC_ENABLE2_ADDR A:0x3802000
y.create.l HWIO_SPMI_PIC_ACC_ENABLE3_ADDR A:0x3803000
y.create.l HWIO_SPMI_PIC_ACC_ENABLE4_ADDR A:0x3804000
y.create.l HWIO_SPMI_PIC_ACC_ENABLE5_ADDR A:0x3805000
y.create.l HWIO_SPMI_PIC_ACC_ENABLE6_ADDR A:0x3806000
y.create.l HWIO_SPMI_PIC_ACC_ENABLE7_ADDR A:0x3807000
y.create.l HWIO_SPMI_PIC_ACC_ENABLE8_ADDR A:0x3808000
y.create.l HWIO_SPMI_PIC_ACC_ENABLE9_ADDR A:0x3809000
y.create.l HWIO_SPMI_PIC_ACC_ENABLE10_ADDR A:0x380a000
y.create.l HWIO_SPMI_PIC_ACC_ENABLE11_ADDR A:0x380b000
y.create.l HWIO_SPMI_PIC_ACC_ENABLE12_ADDR A:0x380c000
y.create.l HWIO_SPMI_PIC_ACC_ENABLE13_ADDR A:0x380d000
y.create.l HWIO_SPMI_PIC_ACC_ENABLE14_ADDR A:0x380e000
y.create.l HWIO_SPMI_PIC_ACC_ENABLE15_ADDR A:0x380f000
y.create.l HWIO_SPMI_PIC_ACC_ENABLE16_ADDR A:0x3810000
y.create.l HWIO_SPMI_PIC_ACC_ENABLE17_ADDR A:0x3811000
y.create.l HWIO_SPMI_PIC_ACC_ENABLE18_ADDR A:0x3812000
y.create.l HWIO_SPMI_PIC_ACC_ENABLE19_ADDR A:0x3813000
y.create.l HWIO_SPMI_PIC_ACC_ENABLE20_ADDR A:0x3814000
y.create.l HWIO_SPMI_PIC_ACC_ENABLE21_ADDR A:0x3815000
y.create.l HWIO_SPMI_PIC_ACC_ENABLE22_ADDR A:0x3816000
y.create.l HWIO_SPMI_PIC_ACC_ENABLE23_ADDR A:0x3817000
y.create.l HWIO_SPMI_PIC_ACC_ENABLE24_ADDR A:0x3818000
y.create.l HWIO_SPMI_PIC_ACC_ENABLE25_ADDR A:0x3819000
y.create.l HWIO_SPMI_PIC_ACC_ENABLE26_ADDR A:0x381a000
y.create.l HWIO_SPMI_PIC_ACC_ENABLE27_ADDR A:0x381b000
y.create.l HWIO_SPMI_PIC_ACC_ENABLE28_ADDR A:0x381c000
y.create.l HWIO_SPMI_PIC_ACC_ENABLE29_ADDR A:0x381d000
y.create.l HWIO_SPMI_PIC_ACC_ENABLE30_ADDR A:0x381e000
y.create.l HWIO_SPMI_PIC_ACC_ENABLE31_ADDR A:0x381f000
y.create.l HWIO_SPMI_PIC_ACC_ENABLE32_ADDR A:0x3820000
y.create.l HWIO_SPMI_PIC_ACC_ENABLE33_ADDR A:0x3821000
y.create.l HWIO_SPMI_PIC_ACC_ENABLE34_ADDR A:0x3822000
y.create.l HWIO_SPMI_PIC_ACC_ENABLE35_ADDR A:0x3823000
y.create.l HWIO_SPMI_PIC_ACC_ENABLE36_ADDR A:0x3824000
y.create.l HWIO_SPMI_PIC_ACC_ENABLE37_ADDR A:0x3825000
y.create.l HWIO_SPMI_PIC_ACC_ENABLE38_ADDR A:0x3826000
y.create.l HWIO_SPMI_PIC_ACC_ENABLE39_ADDR A:0x3827000
y.create.l HWIO_SPMI_PIC_ACC_ENABLE40_ADDR A:0x3828000
y.create.l HWIO_SPMI_PIC_ACC_ENABLE41_ADDR A:0x3829000
y.create.l HWIO_SPMI_PIC_ACC_ENABLE42_ADDR A:0x382a000
y.create.l HWIO_SPMI_PIC_ACC_ENABLE43_ADDR A:0x382b000
y.create.l HWIO_SPMI_PIC_ACC_ENABLE44_ADDR A:0x382c000
y.create.l HWIO_SPMI_PIC_ACC_ENABLE45_ADDR A:0x382d000
y.create.l HWIO_SPMI_PIC_ACC_ENABLE46_ADDR A:0x382e000
y.create.l HWIO_SPMI_PIC_ACC_ENABLE47_ADDR A:0x382f000
y.create.l HWIO_SPMI_PIC_ACC_ENABLE48_ADDR A:0x3830000
y.create.l HWIO_SPMI_PIC_ACC_ENABLE49_ADDR A:0x3831000
y.create.l HWIO_SPMI_PIC_ACC_ENABLE50_ADDR A:0x3832000
y.create.l HWIO_SPMI_PIC_ACC_ENABLE51_ADDR A:0x3833000
y.create.l HWIO_SPMI_PIC_ACC_ENABLE52_ADDR A:0x3834000
y.create.l HWIO_SPMI_PIC_ACC_ENABLE53_ADDR A:0x3835000
y.create.l HWIO_SPMI_PIC_ACC_ENABLE54_ADDR A:0x3836000
y.create.l HWIO_SPMI_PIC_ACC_ENABLE55_ADDR A:0x3837000
y.create.l HWIO_SPMI_PIC_ACC_ENABLE56_ADDR A:0x3838000
y.create.l HWIO_SPMI_PIC_ACC_ENABLE57_ADDR A:0x3839000
y.create.l HWIO_SPMI_PIC_ACC_ENABLE58_ADDR A:0x383a000
y.create.l HWIO_SPMI_PIC_ACC_ENABLE59_ADDR A:0x383b000
y.create.l HWIO_SPMI_PIC_ACC_ENABLE60_ADDR A:0x383c000
y.create.l HWIO_SPMI_PIC_ACC_ENABLE61_ADDR A:0x383d000
y.create.l HWIO_SPMI_PIC_ACC_ENABLE62_ADDR A:0x383e000
y.create.l HWIO_SPMI_PIC_ACC_ENABLE63_ADDR A:0x383f000
y.create.l HWIO_SPMI_PIC_ACC_ENABLE64_ADDR A:0x3840000
y.create.l HWIO_SPMI_PIC_ACC_ENABLE65_ADDR A:0x3841000
y.create.l HWIO_SPMI_PIC_ACC_ENABLE66_ADDR A:0x3842000
y.create.l HWIO_SPMI_PIC_ACC_ENABLE67_ADDR A:0x3843000
y.create.l HWIO_SPMI_PIC_ACC_ENABLE68_ADDR A:0x3844000
y.create.l HWIO_SPMI_PIC_ACC_ENABLE69_ADDR A:0x3845000
y.create.l HWIO_SPMI_PIC_ACC_ENABLE70_ADDR A:0x3846000
y.create.l HWIO_SPMI_PIC_ACC_ENABLE71_ADDR A:0x3847000
y.create.l HWIO_SPMI_PIC_ACC_ENABLE72_ADDR A:0x3848000
y.create.l HWIO_SPMI_PIC_ACC_ENABLE73_ADDR A:0x3849000
y.create.l HWIO_SPMI_PIC_ACC_ENABLE74_ADDR A:0x384a000
y.create.l HWIO_SPMI_PIC_ACC_ENABLE75_ADDR A:0x384b000
y.create.l HWIO_SPMI_PIC_ACC_ENABLE76_ADDR A:0x384c000
y.create.l HWIO_SPMI_PIC_ACC_ENABLE77_ADDR A:0x384d000
y.create.l HWIO_SPMI_PIC_ACC_ENABLE78_ADDR A:0x384e000
y.create.l HWIO_SPMI_PIC_ACC_ENABLE79_ADDR A:0x384f000
y.create.l HWIO_SPMI_PIC_ACC_ENABLE80_ADDR A:0x3850000
y.create.l HWIO_SPMI_PIC_ACC_ENABLE81_ADDR A:0x3851000
y.create.l HWIO_SPMI_PIC_ACC_ENABLE82_ADDR A:0x3852000
y.create.l HWIO_SPMI_PIC_ACC_ENABLE83_ADDR A:0x3853000
y.create.l HWIO_SPMI_PIC_ACC_ENABLE84_ADDR A:0x3854000
y.create.l HWIO_SPMI_PIC_ACC_ENABLE85_ADDR A:0x3855000
y.create.l HWIO_SPMI_PIC_ACC_ENABLE86_ADDR A:0x3856000
y.create.l HWIO_SPMI_PIC_ACC_ENABLE87_ADDR A:0x3857000
y.create.l HWIO_SPMI_PIC_ACC_ENABLE88_ADDR A:0x3858000
y.create.l HWIO_SPMI_PIC_ACC_ENABLE89_ADDR A:0x3859000
y.create.l HWIO_SPMI_PIC_ACC_ENABLE90_ADDR A:0x385a000
y.create.l HWIO_SPMI_PIC_ACC_ENABLE91_ADDR A:0x385b000
y.create.l HWIO_SPMI_PIC_ACC_ENABLE92_ADDR A:0x385c000
y.create.l HWIO_SPMI_PIC_ACC_ENABLE93_ADDR A:0x385d000
y.create.l HWIO_SPMI_PIC_ACC_ENABLE94_ADDR A:0x385e000
y.create.l HWIO_SPMI_PIC_ACC_ENABLE95_ADDR A:0x385f000
y.create.l HWIO_SPMI_PIC_ACC_ENABLE96_ADDR A:0x3860000
y.create.l HWIO_SPMI_PIC_ACC_ENABLE97_ADDR A:0x3861000
y.create.l HWIO_SPMI_PIC_ACC_ENABLE98_ADDR A:0x3862000
y.create.l HWIO_SPMI_PIC_ACC_ENABLE99_ADDR A:0x3863000
y.create.l HWIO_SPMI_PIC_ACC_ENABLE100_ADDR A:0x3864000
y.create.l HWIO_SPMI_PIC_ACC_ENABLE101_ADDR A:0x3865000
y.create.l HWIO_SPMI_PIC_ACC_ENABLE102_ADDR A:0x3866000
y.create.l HWIO_SPMI_PIC_ACC_ENABLE103_ADDR A:0x3867000
y.create.l HWIO_SPMI_PIC_ACC_ENABLE104_ADDR A:0x3868000
y.create.l HWIO_SPMI_PIC_ACC_ENABLE105_ADDR A:0x3869000
y.create.l HWIO_SPMI_PIC_ACC_ENABLE106_ADDR A:0x386a000
y.create.l HWIO_SPMI_PIC_ACC_ENABLE107_ADDR A:0x386b000
y.create.l HWIO_SPMI_PIC_ACC_ENABLE108_ADDR A:0x386c000
y.create.l HWIO_SPMI_PIC_ACC_ENABLE109_ADDR A:0x386d000
y.create.l HWIO_SPMI_PIC_ACC_ENABLE110_ADDR A:0x386e000
y.create.l HWIO_SPMI_PIC_ACC_ENABLE111_ADDR A:0x386f000
y.create.l HWIO_SPMI_PIC_ACC_ENABLE112_ADDR A:0x3870000
y.create.l HWIO_SPMI_PIC_ACC_ENABLE113_ADDR A:0x3871000
y.create.l HWIO_SPMI_PIC_ACC_ENABLE114_ADDR A:0x3872000
y.create.l HWIO_SPMI_PIC_ACC_ENABLE115_ADDR A:0x3873000
y.create.l HWIO_SPMI_PIC_ACC_ENABLE116_ADDR A:0x3874000
y.create.l HWIO_SPMI_PIC_ACC_ENABLE117_ADDR A:0x3875000
y.create.l HWIO_SPMI_PIC_ACC_ENABLE118_ADDR A:0x3876000
y.create.l HWIO_SPMI_PIC_ACC_ENABLE119_ADDR A:0x3877000
y.create.l HWIO_SPMI_PIC_ACC_ENABLE120_ADDR A:0x3878000
y.create.l HWIO_SPMI_PIC_ACC_ENABLE121_ADDR A:0x3879000
y.create.l HWIO_SPMI_PIC_ACC_ENABLE122_ADDR A:0x387a000
y.create.l HWIO_SPMI_PIC_ACC_ENABLE123_ADDR A:0x387b000
y.create.l HWIO_SPMI_PIC_ACC_ENABLE124_ADDR A:0x387c000
y.create.l HWIO_SPMI_PIC_ACC_ENABLE125_ADDR A:0x387d000
y.create.l HWIO_SPMI_PIC_ACC_ENABLE126_ADDR A:0x387e000
y.create.l HWIO_SPMI_PIC_ACC_ENABLE127_ADDR A:0x387f000
y.create.l HWIO_SPMI_PIC_ACC_ENABLE128_ADDR A:0x3880000
y.create.l HWIO_SPMI_PIC_ACC_ENABLE129_ADDR A:0x3881000
y.create.l HWIO_SPMI_PIC_ACC_ENABLE130_ADDR A:0x3882000
y.create.l HWIO_SPMI_PIC_ACC_ENABLE131_ADDR A:0x3883000
y.create.l HWIO_SPMI_PIC_ACC_ENABLE132_ADDR A:0x3884000
y.create.l HWIO_SPMI_PIC_ACC_ENABLE133_ADDR A:0x3885000
y.create.l HWIO_SPMI_PIC_ACC_ENABLE134_ADDR A:0x3886000
y.create.l HWIO_SPMI_PIC_ACC_ENABLE135_ADDR A:0x3887000
y.create.l HWIO_SPMI_PIC_ACC_ENABLE136_ADDR A:0x3888000
y.create.l HWIO_SPMI_PIC_ACC_ENABLE137_ADDR A:0x3889000
y.create.l HWIO_SPMI_PIC_ACC_ENABLE138_ADDR A:0x388a000
y.create.l HWIO_SPMI_PIC_ACC_ENABLE139_ADDR A:0x388b000
y.create.l HWIO_SPMI_PIC_ACC_ENABLE140_ADDR A:0x388c000
y.create.l HWIO_SPMI_PIC_ACC_ENABLE141_ADDR A:0x388d000
y.create.l HWIO_SPMI_PIC_ACC_ENABLE142_ADDR A:0x388e000
y.create.l HWIO_SPMI_PIC_ACC_ENABLE143_ADDR A:0x388f000
y.create.l HWIO_SPMI_PIC_ACC_ENABLE144_ADDR A:0x3890000
y.create.l HWIO_SPMI_PIC_ACC_ENABLE145_ADDR A:0x3891000
y.create.l HWIO_SPMI_PIC_ACC_ENABLE146_ADDR A:0x3892000
y.create.l HWIO_SPMI_PIC_ACC_ENABLE147_ADDR A:0x3893000
y.create.l HWIO_SPMI_PIC_ACC_ENABLE148_ADDR A:0x3894000
y.create.l HWIO_SPMI_PIC_ACC_ENABLE149_ADDR A:0x3895000
y.create.l HWIO_SPMI_PIC_ACC_ENABLE150_ADDR A:0x3896000
y.create.l HWIO_SPMI_PIC_ACC_ENABLE151_ADDR A:0x3897000
y.create.l HWIO_SPMI_PIC_ACC_ENABLE152_ADDR A:0x3898000
y.create.l HWIO_SPMI_PIC_ACC_ENABLE153_ADDR A:0x3899000
y.create.l HWIO_SPMI_PIC_ACC_ENABLE154_ADDR A:0x389a000
y.create.l HWIO_SPMI_PIC_ACC_ENABLE155_ADDR A:0x389b000
y.create.l HWIO_SPMI_PIC_ACC_ENABLE156_ADDR A:0x389c000
y.create.l HWIO_SPMI_PIC_ACC_ENABLE157_ADDR A:0x389d000
y.create.l HWIO_SPMI_PIC_ACC_ENABLE158_ADDR A:0x389e000
y.create.l HWIO_SPMI_PIC_ACC_ENABLE159_ADDR A:0x389f000
y.create.l HWIO_SPMI_PIC_ACC_ENABLE160_ADDR A:0x38a0000
y.create.l HWIO_SPMI_PIC_ACC_ENABLE161_ADDR A:0x38a1000
y.create.l HWIO_SPMI_PIC_ACC_ENABLE162_ADDR A:0x38a2000
y.create.l HWIO_SPMI_PIC_ACC_ENABLE163_ADDR A:0x38a3000
y.create.l HWIO_SPMI_PIC_ACC_ENABLE164_ADDR A:0x38a4000
y.create.l HWIO_SPMI_PIC_ACC_ENABLE165_ADDR A:0x38a5000
y.create.l HWIO_SPMI_PIC_ACC_ENABLE166_ADDR A:0x38a6000
y.create.l HWIO_SPMI_PIC_ACC_ENABLE167_ADDR A:0x38a7000
y.create.l HWIO_SPMI_PIC_ACC_ENABLE168_ADDR A:0x38a8000
y.create.l HWIO_SPMI_PIC_ACC_ENABLE169_ADDR A:0x38a9000
y.create.l HWIO_SPMI_PIC_ACC_ENABLE170_ADDR A:0x38aa000
y.create.l HWIO_SPMI_PIC_ACC_ENABLE171_ADDR A:0x38ab000
y.create.l HWIO_SPMI_PIC_ACC_ENABLE172_ADDR A:0x38ac000
y.create.l HWIO_SPMI_PIC_ACC_ENABLE173_ADDR A:0x38ad000
y.create.l HWIO_SPMI_PIC_ACC_ENABLE174_ADDR A:0x38ae000
y.create.l HWIO_SPMI_PIC_ACC_ENABLE175_ADDR A:0x38af000
y.create.l HWIO_SPMI_PIC_ACC_ENABLE176_ADDR A:0x38b0000
y.create.l HWIO_SPMI_PIC_ACC_ENABLE177_ADDR A:0x38b1000
y.create.l HWIO_SPMI_PIC_ACC_ENABLE178_ADDR A:0x38b2000
y.create.l HWIO_SPMI_PIC_ACC_ENABLE179_ADDR A:0x38b3000
y.create.l HWIO_SPMI_PIC_ACC_ENABLE180_ADDR A:0x38b4000
y.create.l HWIO_SPMI_PIC_ACC_ENABLE181_ADDR A:0x38b5000
y.create.l HWIO_SPMI_PIC_ACC_ENABLE182_ADDR A:0x38b6000
y.create.l HWIO_SPMI_PIC_ACC_ENABLE183_ADDR A:0x38b7000
y.create.l HWIO_SPMI_PIC_ACC_ENABLE184_ADDR A:0x38b8000
y.create.l HWIO_SPMI_PIC_ACC_ENABLE185_ADDR A:0x38b9000
y.create.l HWIO_SPMI_PIC_ACC_ENABLE186_ADDR A:0x38ba000
y.create.l HWIO_SPMI_PIC_ACC_ENABLE187_ADDR A:0x38bb000
y.create.l HWIO_SPMI_PIC_ACC_ENABLE188_ADDR A:0x38bc000
y.create.l HWIO_SPMI_PIC_ACC_ENABLE189_ADDR A:0x38bd000
y.create.l HWIO_SPMI_PIC_ACC_ENABLE190_ADDR A:0x38be000
y.create.l HWIO_SPMI_PIC_ACC_ENABLE191_ADDR A:0x38bf000
y.create.l HWIO_SPMI_PIC_ACC_ENABLE192_ADDR A:0x38c0000
y.create.l HWIO_SPMI_PIC_ACC_ENABLE193_ADDR A:0x38c1000
y.create.l HWIO_SPMI_PIC_ACC_ENABLE194_ADDR A:0x38c2000
y.create.l HWIO_SPMI_PIC_ACC_ENABLE195_ADDR A:0x38c3000
y.create.l HWIO_SPMI_PIC_ACC_ENABLE196_ADDR A:0x38c4000
y.create.l HWIO_SPMI_PIC_ACC_ENABLE197_ADDR A:0x38c5000
y.create.l HWIO_SPMI_PIC_ACC_ENABLE198_ADDR A:0x38c6000
y.create.l HWIO_SPMI_PIC_ACC_ENABLE199_ADDR A:0x38c7000
y.create.l HWIO_SPMI_PIC_ACC_ENABLE200_ADDR A:0x38c8000
y.create.l HWIO_SPMI_PIC_ACC_ENABLE201_ADDR A:0x38c9000
y.create.l HWIO_SPMI_PIC_ACC_ENABLE202_ADDR A:0x38ca000
y.create.l HWIO_SPMI_PIC_ACC_ENABLE203_ADDR A:0x38cb000
y.create.l HWIO_SPMI_PIC_ACC_ENABLE204_ADDR A:0x38cc000
y.create.l HWIO_SPMI_PIC_ACC_ENABLE205_ADDR A:0x38cd000
y.create.l HWIO_SPMI_PIC_ACC_ENABLE206_ADDR A:0x38ce000
y.create.l HWIO_SPMI_PIC_ACC_ENABLE207_ADDR A:0x38cf000
y.create.l HWIO_SPMI_PIC_ACC_ENABLE208_ADDR A:0x38d0000
y.create.l HWIO_SPMI_PIC_ACC_ENABLE209_ADDR A:0x38d1000
y.create.l HWIO_SPMI_PIC_ACC_ENABLE210_ADDR A:0x38d2000
y.create.l HWIO_SPMI_PIC_ACC_ENABLE211_ADDR A:0x38d3000
y.create.l HWIO_SPMI_PIC_ACC_ENABLE212_ADDR A:0x38d4000
y.create.l HWIO_SPMI_PIC_ACC_ENABLE213_ADDR A:0x38d5000
y.create.l HWIO_SPMI_PIC_ACC_ENABLE214_ADDR A:0x38d6000
y.create.l HWIO_SPMI_PIC_ACC_ENABLE215_ADDR A:0x38d7000
y.create.l HWIO_SPMI_PIC_ACC_ENABLE216_ADDR A:0x38d8000
y.create.l HWIO_SPMI_PIC_ACC_ENABLE217_ADDR A:0x38d9000
y.create.l HWIO_SPMI_PIC_ACC_ENABLE218_ADDR A:0x38da000
y.create.l HWIO_SPMI_PIC_ACC_ENABLE219_ADDR A:0x38db000
y.create.l HWIO_SPMI_PIC_ACC_ENABLE220_ADDR A:0x38dc000
y.create.l HWIO_SPMI_PIC_ACC_ENABLE221_ADDR A:0x38dd000
y.create.l HWIO_SPMI_PIC_ACC_ENABLE222_ADDR A:0x38de000
y.create.l HWIO_SPMI_PIC_ACC_ENABLE223_ADDR A:0x38df000
y.create.l HWIO_SPMI_PIC_ACC_ENABLE224_ADDR A:0x38e0000
y.create.l HWIO_SPMI_PIC_ACC_ENABLE225_ADDR A:0x38e1000
y.create.l HWIO_SPMI_PIC_ACC_ENABLE226_ADDR A:0x38e2000
y.create.l HWIO_SPMI_PIC_ACC_ENABLE227_ADDR A:0x38e3000
y.create.l HWIO_SPMI_PIC_ACC_ENABLE228_ADDR A:0x38e4000
y.create.l HWIO_SPMI_PIC_ACC_ENABLE229_ADDR A:0x38e5000
y.create.l HWIO_SPMI_PIC_ACC_ENABLE230_ADDR A:0x38e6000
y.create.l HWIO_SPMI_PIC_ACC_ENABLE231_ADDR A:0x38e7000
y.create.l HWIO_SPMI_PIC_ACC_ENABLE232_ADDR A:0x38e8000
y.create.l HWIO_SPMI_PIC_ACC_ENABLE233_ADDR A:0x38e9000
y.create.l HWIO_SPMI_PIC_ACC_ENABLE234_ADDR A:0x38ea000
y.create.l HWIO_SPMI_PIC_ACC_ENABLE235_ADDR A:0x38eb000
y.create.l HWIO_SPMI_PIC_ACC_ENABLE236_ADDR A:0x38ec000
y.create.l HWIO_SPMI_PIC_ACC_ENABLE237_ADDR A:0x38ed000
y.create.l HWIO_SPMI_PIC_ACC_ENABLE238_ADDR A:0x38ee000
y.create.l HWIO_SPMI_PIC_ACC_ENABLE239_ADDR A:0x38ef000
y.create.l HWIO_SPMI_PIC_ACC_ENABLE240_ADDR A:0x38f0000
y.create.l HWIO_SPMI_PIC_ACC_ENABLE241_ADDR A:0x38f1000
y.create.l HWIO_SPMI_PIC_ACC_ENABLE242_ADDR A:0x38f2000
y.create.l HWIO_SPMI_PIC_ACC_ENABLE243_ADDR A:0x38f3000
y.create.l HWIO_SPMI_PIC_ACC_ENABLE244_ADDR A:0x38f4000
y.create.l HWIO_SPMI_PIC_ACC_ENABLE245_ADDR A:0x38f5000
y.create.l HWIO_SPMI_PIC_ACC_ENABLE246_ADDR A:0x38f6000
y.create.l HWIO_SPMI_PIC_ACC_ENABLE247_ADDR A:0x38f7000
y.create.l HWIO_SPMI_PIC_ACC_ENABLE248_ADDR A:0x38f8000
y.create.l HWIO_SPMI_PIC_ACC_ENABLE249_ADDR A:0x38f9000
y.create.l HWIO_SPMI_PIC_ACC_ENABLE250_ADDR A:0x38fa000
y.create.l HWIO_SPMI_PIC_ACC_ENABLE251_ADDR A:0x38fb000
y.create.l HWIO_SPMI_PIC_ACC_ENABLE252_ADDR A:0x38fc000
y.create.l HWIO_SPMI_PIC_ACC_ENABLE253_ADDR A:0x38fd000
y.create.l HWIO_SPMI_PIC_ACC_ENABLE254_ADDR A:0x38fe000
y.create.l HWIO_SPMI_PIC_ACC_ENABLE255_ADDR A:0x38ff000
y.create.l HWIO_SPMI_PIC_IRQ_STATUS0_ADDR A:0x3800004
y.create.l HWIO_SPMI_PIC_IRQ_STATUS1_ADDR A:0x3801004
y.create.l HWIO_SPMI_PIC_IRQ_STATUS2_ADDR A:0x3802004
y.create.l HWIO_SPMI_PIC_IRQ_STATUS3_ADDR A:0x3803004
y.create.l HWIO_SPMI_PIC_IRQ_STATUS4_ADDR A:0x3804004
y.create.l HWIO_SPMI_PIC_IRQ_STATUS5_ADDR A:0x3805004
y.create.l HWIO_SPMI_PIC_IRQ_STATUS6_ADDR A:0x3806004
y.create.l HWIO_SPMI_PIC_IRQ_STATUS7_ADDR A:0x3807004
y.create.l HWIO_SPMI_PIC_IRQ_STATUS8_ADDR A:0x3808004
y.create.l HWIO_SPMI_PIC_IRQ_STATUS9_ADDR A:0x3809004
y.create.l HWIO_SPMI_PIC_IRQ_STATUS10_ADDR A:0x380a004
y.create.l HWIO_SPMI_PIC_IRQ_STATUS11_ADDR A:0x380b004
y.create.l HWIO_SPMI_PIC_IRQ_STATUS12_ADDR A:0x380c004
y.create.l HWIO_SPMI_PIC_IRQ_STATUS13_ADDR A:0x380d004
y.create.l HWIO_SPMI_PIC_IRQ_STATUS14_ADDR A:0x380e004
y.create.l HWIO_SPMI_PIC_IRQ_STATUS15_ADDR A:0x380f004
y.create.l HWIO_SPMI_PIC_IRQ_STATUS16_ADDR A:0x3810004
y.create.l HWIO_SPMI_PIC_IRQ_STATUS17_ADDR A:0x3811004
y.create.l HWIO_SPMI_PIC_IRQ_STATUS18_ADDR A:0x3812004
y.create.l HWIO_SPMI_PIC_IRQ_STATUS19_ADDR A:0x3813004
y.create.l HWIO_SPMI_PIC_IRQ_STATUS20_ADDR A:0x3814004
y.create.l HWIO_SPMI_PIC_IRQ_STATUS21_ADDR A:0x3815004
y.create.l HWIO_SPMI_PIC_IRQ_STATUS22_ADDR A:0x3816004
y.create.l HWIO_SPMI_PIC_IRQ_STATUS23_ADDR A:0x3817004
y.create.l HWIO_SPMI_PIC_IRQ_STATUS24_ADDR A:0x3818004
y.create.l HWIO_SPMI_PIC_IRQ_STATUS25_ADDR A:0x3819004
y.create.l HWIO_SPMI_PIC_IRQ_STATUS26_ADDR A:0x381a004
y.create.l HWIO_SPMI_PIC_IRQ_STATUS27_ADDR A:0x381b004
y.create.l HWIO_SPMI_PIC_IRQ_STATUS28_ADDR A:0x381c004
y.create.l HWIO_SPMI_PIC_IRQ_STATUS29_ADDR A:0x381d004
y.create.l HWIO_SPMI_PIC_IRQ_STATUS30_ADDR A:0x381e004
y.create.l HWIO_SPMI_PIC_IRQ_STATUS31_ADDR A:0x381f004
y.create.l HWIO_SPMI_PIC_IRQ_STATUS32_ADDR A:0x3820004
y.create.l HWIO_SPMI_PIC_IRQ_STATUS33_ADDR A:0x3821004
y.create.l HWIO_SPMI_PIC_IRQ_STATUS34_ADDR A:0x3822004
y.create.l HWIO_SPMI_PIC_IRQ_STATUS35_ADDR A:0x3823004
y.create.l HWIO_SPMI_PIC_IRQ_STATUS36_ADDR A:0x3824004
y.create.l HWIO_SPMI_PIC_IRQ_STATUS37_ADDR A:0x3825004
y.create.l HWIO_SPMI_PIC_IRQ_STATUS38_ADDR A:0x3826004
y.create.l HWIO_SPMI_PIC_IRQ_STATUS39_ADDR A:0x3827004
y.create.l HWIO_SPMI_PIC_IRQ_STATUS40_ADDR A:0x3828004
y.create.l HWIO_SPMI_PIC_IRQ_STATUS41_ADDR A:0x3829004
y.create.l HWIO_SPMI_PIC_IRQ_STATUS42_ADDR A:0x382a004
y.create.l HWIO_SPMI_PIC_IRQ_STATUS43_ADDR A:0x382b004
y.create.l HWIO_SPMI_PIC_IRQ_STATUS44_ADDR A:0x382c004
y.create.l HWIO_SPMI_PIC_IRQ_STATUS45_ADDR A:0x382d004
y.create.l HWIO_SPMI_PIC_IRQ_STATUS46_ADDR A:0x382e004
y.create.l HWIO_SPMI_PIC_IRQ_STATUS47_ADDR A:0x382f004
y.create.l HWIO_SPMI_PIC_IRQ_STATUS48_ADDR A:0x3830004
y.create.l HWIO_SPMI_PIC_IRQ_STATUS49_ADDR A:0x3831004
y.create.l HWIO_SPMI_PIC_IRQ_STATUS50_ADDR A:0x3832004
y.create.l HWIO_SPMI_PIC_IRQ_STATUS51_ADDR A:0x3833004
y.create.l HWIO_SPMI_PIC_IRQ_STATUS52_ADDR A:0x3834004
y.create.l HWIO_SPMI_PIC_IRQ_STATUS53_ADDR A:0x3835004
y.create.l HWIO_SPMI_PIC_IRQ_STATUS54_ADDR A:0x3836004
y.create.l HWIO_SPMI_PIC_IRQ_STATUS55_ADDR A:0x3837004
y.create.l HWIO_SPMI_PIC_IRQ_STATUS56_ADDR A:0x3838004
y.create.l HWIO_SPMI_PIC_IRQ_STATUS57_ADDR A:0x3839004
y.create.l HWIO_SPMI_PIC_IRQ_STATUS58_ADDR A:0x383a004
y.create.l HWIO_SPMI_PIC_IRQ_STATUS59_ADDR A:0x383b004
y.create.l HWIO_SPMI_PIC_IRQ_STATUS60_ADDR A:0x383c004
y.create.l HWIO_SPMI_PIC_IRQ_STATUS61_ADDR A:0x383d004
y.create.l HWIO_SPMI_PIC_IRQ_STATUS62_ADDR A:0x383e004
y.create.l HWIO_SPMI_PIC_IRQ_STATUS63_ADDR A:0x383f004
y.create.l HWIO_SPMI_PIC_IRQ_STATUS64_ADDR A:0x3840004
y.create.l HWIO_SPMI_PIC_IRQ_STATUS65_ADDR A:0x3841004
y.create.l HWIO_SPMI_PIC_IRQ_STATUS66_ADDR A:0x3842004
y.create.l HWIO_SPMI_PIC_IRQ_STATUS67_ADDR A:0x3843004
y.create.l HWIO_SPMI_PIC_IRQ_STATUS68_ADDR A:0x3844004
y.create.l HWIO_SPMI_PIC_IRQ_STATUS69_ADDR A:0x3845004
y.create.l HWIO_SPMI_PIC_IRQ_STATUS70_ADDR A:0x3846004
y.create.l HWIO_SPMI_PIC_IRQ_STATUS71_ADDR A:0x3847004
y.create.l HWIO_SPMI_PIC_IRQ_STATUS72_ADDR A:0x3848004
y.create.l HWIO_SPMI_PIC_IRQ_STATUS73_ADDR A:0x3849004
y.create.l HWIO_SPMI_PIC_IRQ_STATUS74_ADDR A:0x384a004
y.create.l HWIO_SPMI_PIC_IRQ_STATUS75_ADDR A:0x384b004
y.create.l HWIO_SPMI_PIC_IRQ_STATUS76_ADDR A:0x384c004
y.create.l HWIO_SPMI_PIC_IRQ_STATUS77_ADDR A:0x384d004
y.create.l HWIO_SPMI_PIC_IRQ_STATUS78_ADDR A:0x384e004
y.create.l HWIO_SPMI_PIC_IRQ_STATUS79_ADDR A:0x384f004
y.create.l HWIO_SPMI_PIC_IRQ_STATUS80_ADDR A:0x3850004
y.create.l HWIO_SPMI_PIC_IRQ_STATUS81_ADDR A:0x3851004
y.create.l HWIO_SPMI_PIC_IRQ_STATUS82_ADDR A:0x3852004
y.create.l HWIO_SPMI_PIC_IRQ_STATUS83_ADDR A:0x3853004
y.create.l HWIO_SPMI_PIC_IRQ_STATUS84_ADDR A:0x3854004
y.create.l HWIO_SPMI_PIC_IRQ_STATUS85_ADDR A:0x3855004
y.create.l HWIO_SPMI_PIC_IRQ_STATUS86_ADDR A:0x3856004
y.create.l HWIO_SPMI_PIC_IRQ_STATUS87_ADDR A:0x3857004
y.create.l HWIO_SPMI_PIC_IRQ_STATUS88_ADDR A:0x3858004
y.create.l HWIO_SPMI_PIC_IRQ_STATUS89_ADDR A:0x3859004
y.create.l HWIO_SPMI_PIC_IRQ_STATUS90_ADDR A:0x385a004
y.create.l HWIO_SPMI_PIC_IRQ_STATUS91_ADDR A:0x385b004
y.create.l HWIO_SPMI_PIC_IRQ_STATUS92_ADDR A:0x385c004
y.create.l HWIO_SPMI_PIC_IRQ_STATUS93_ADDR A:0x385d004
y.create.l HWIO_SPMI_PIC_IRQ_STATUS94_ADDR A:0x385e004
y.create.l HWIO_SPMI_PIC_IRQ_STATUS95_ADDR A:0x385f004
y.create.l HWIO_SPMI_PIC_IRQ_STATUS96_ADDR A:0x3860004
y.create.l HWIO_SPMI_PIC_IRQ_STATUS97_ADDR A:0x3861004
y.create.l HWIO_SPMI_PIC_IRQ_STATUS98_ADDR A:0x3862004
y.create.l HWIO_SPMI_PIC_IRQ_STATUS99_ADDR A:0x3863004
y.create.l HWIO_SPMI_PIC_IRQ_STATUS100_ADDR A:0x3864004
y.create.l HWIO_SPMI_PIC_IRQ_STATUS101_ADDR A:0x3865004
y.create.l HWIO_SPMI_PIC_IRQ_STATUS102_ADDR A:0x3866004
y.create.l HWIO_SPMI_PIC_IRQ_STATUS103_ADDR A:0x3867004
y.create.l HWIO_SPMI_PIC_IRQ_STATUS104_ADDR A:0x3868004
y.create.l HWIO_SPMI_PIC_IRQ_STATUS105_ADDR A:0x3869004
y.create.l HWIO_SPMI_PIC_IRQ_STATUS106_ADDR A:0x386a004
y.create.l HWIO_SPMI_PIC_IRQ_STATUS107_ADDR A:0x386b004
y.create.l HWIO_SPMI_PIC_IRQ_STATUS108_ADDR A:0x386c004
y.create.l HWIO_SPMI_PIC_IRQ_STATUS109_ADDR A:0x386d004
y.create.l HWIO_SPMI_PIC_IRQ_STATUS110_ADDR A:0x386e004
y.create.l HWIO_SPMI_PIC_IRQ_STATUS111_ADDR A:0x386f004
y.create.l HWIO_SPMI_PIC_IRQ_STATUS112_ADDR A:0x3870004
y.create.l HWIO_SPMI_PIC_IRQ_STATUS113_ADDR A:0x3871004
y.create.l HWIO_SPMI_PIC_IRQ_STATUS114_ADDR A:0x3872004
y.create.l HWIO_SPMI_PIC_IRQ_STATUS115_ADDR A:0x3873004
y.create.l HWIO_SPMI_PIC_IRQ_STATUS116_ADDR A:0x3874004
y.create.l HWIO_SPMI_PIC_IRQ_STATUS117_ADDR A:0x3875004
y.create.l HWIO_SPMI_PIC_IRQ_STATUS118_ADDR A:0x3876004
y.create.l HWIO_SPMI_PIC_IRQ_STATUS119_ADDR A:0x3877004
y.create.l HWIO_SPMI_PIC_IRQ_STATUS120_ADDR A:0x3878004
y.create.l HWIO_SPMI_PIC_IRQ_STATUS121_ADDR A:0x3879004
y.create.l HWIO_SPMI_PIC_IRQ_STATUS122_ADDR A:0x387a004
y.create.l HWIO_SPMI_PIC_IRQ_STATUS123_ADDR A:0x387b004
y.create.l HWIO_SPMI_PIC_IRQ_STATUS124_ADDR A:0x387c004
y.create.l HWIO_SPMI_PIC_IRQ_STATUS125_ADDR A:0x387d004
y.create.l HWIO_SPMI_PIC_IRQ_STATUS126_ADDR A:0x387e004
y.create.l HWIO_SPMI_PIC_IRQ_STATUS127_ADDR A:0x387f004
y.create.l HWIO_SPMI_PIC_IRQ_STATUS128_ADDR A:0x3880004
y.create.l HWIO_SPMI_PIC_IRQ_STATUS129_ADDR A:0x3881004
y.create.l HWIO_SPMI_PIC_IRQ_STATUS130_ADDR A:0x3882004
y.create.l HWIO_SPMI_PIC_IRQ_STATUS131_ADDR A:0x3883004
y.create.l HWIO_SPMI_PIC_IRQ_STATUS132_ADDR A:0x3884004
y.create.l HWIO_SPMI_PIC_IRQ_STATUS133_ADDR A:0x3885004
y.create.l HWIO_SPMI_PIC_IRQ_STATUS134_ADDR A:0x3886004
y.create.l HWIO_SPMI_PIC_IRQ_STATUS135_ADDR A:0x3887004
y.create.l HWIO_SPMI_PIC_IRQ_STATUS136_ADDR A:0x3888004
y.create.l HWIO_SPMI_PIC_IRQ_STATUS137_ADDR A:0x3889004
y.create.l HWIO_SPMI_PIC_IRQ_STATUS138_ADDR A:0x388a004
y.create.l HWIO_SPMI_PIC_IRQ_STATUS139_ADDR A:0x388b004
y.create.l HWIO_SPMI_PIC_IRQ_STATUS140_ADDR A:0x388c004
y.create.l HWIO_SPMI_PIC_IRQ_STATUS141_ADDR A:0x388d004
y.create.l HWIO_SPMI_PIC_IRQ_STATUS142_ADDR A:0x388e004
y.create.l HWIO_SPMI_PIC_IRQ_STATUS143_ADDR A:0x388f004
y.create.l HWIO_SPMI_PIC_IRQ_STATUS144_ADDR A:0x3890004
y.create.l HWIO_SPMI_PIC_IRQ_STATUS145_ADDR A:0x3891004
y.create.l HWIO_SPMI_PIC_IRQ_STATUS146_ADDR A:0x3892004
y.create.l HWIO_SPMI_PIC_IRQ_STATUS147_ADDR A:0x3893004
y.create.l HWIO_SPMI_PIC_IRQ_STATUS148_ADDR A:0x3894004
y.create.l HWIO_SPMI_PIC_IRQ_STATUS149_ADDR A:0x3895004
y.create.l HWIO_SPMI_PIC_IRQ_STATUS150_ADDR A:0x3896004
y.create.l HWIO_SPMI_PIC_IRQ_STATUS151_ADDR A:0x3897004
y.create.l HWIO_SPMI_PIC_IRQ_STATUS152_ADDR A:0x3898004
y.create.l HWIO_SPMI_PIC_IRQ_STATUS153_ADDR A:0x3899004
y.create.l HWIO_SPMI_PIC_IRQ_STATUS154_ADDR A:0x389a004
y.create.l HWIO_SPMI_PIC_IRQ_STATUS155_ADDR A:0x389b004
y.create.l HWIO_SPMI_PIC_IRQ_STATUS156_ADDR A:0x389c004
y.create.l HWIO_SPMI_PIC_IRQ_STATUS157_ADDR A:0x389d004
y.create.l HWIO_SPMI_PIC_IRQ_STATUS158_ADDR A:0x389e004
y.create.l HWIO_SPMI_PIC_IRQ_STATUS159_ADDR A:0x389f004
y.create.l HWIO_SPMI_PIC_IRQ_STATUS160_ADDR A:0x38a0004
y.create.l HWIO_SPMI_PIC_IRQ_STATUS161_ADDR A:0x38a1004
y.create.l HWIO_SPMI_PIC_IRQ_STATUS162_ADDR A:0x38a2004
y.create.l HWIO_SPMI_PIC_IRQ_STATUS163_ADDR A:0x38a3004
y.create.l HWIO_SPMI_PIC_IRQ_STATUS164_ADDR A:0x38a4004
y.create.l HWIO_SPMI_PIC_IRQ_STATUS165_ADDR A:0x38a5004
y.create.l HWIO_SPMI_PIC_IRQ_STATUS166_ADDR A:0x38a6004
y.create.l HWIO_SPMI_PIC_IRQ_STATUS167_ADDR A:0x38a7004
y.create.l HWIO_SPMI_PIC_IRQ_STATUS168_ADDR A:0x38a8004
y.create.l HWIO_SPMI_PIC_IRQ_STATUS169_ADDR A:0x38a9004
y.create.l HWIO_SPMI_PIC_IRQ_STATUS170_ADDR A:0x38aa004
y.create.l HWIO_SPMI_PIC_IRQ_STATUS171_ADDR A:0x38ab004
y.create.l HWIO_SPMI_PIC_IRQ_STATUS172_ADDR A:0x38ac004
y.create.l HWIO_SPMI_PIC_IRQ_STATUS173_ADDR A:0x38ad004
y.create.l HWIO_SPMI_PIC_IRQ_STATUS174_ADDR A:0x38ae004
y.create.l HWIO_SPMI_PIC_IRQ_STATUS175_ADDR A:0x38af004
y.create.l HWIO_SPMI_PIC_IRQ_STATUS176_ADDR A:0x38b0004
y.create.l HWIO_SPMI_PIC_IRQ_STATUS177_ADDR A:0x38b1004
y.create.l HWIO_SPMI_PIC_IRQ_STATUS178_ADDR A:0x38b2004
y.create.l HWIO_SPMI_PIC_IRQ_STATUS179_ADDR A:0x38b3004
y.create.l HWIO_SPMI_PIC_IRQ_STATUS180_ADDR A:0x38b4004
y.create.l HWIO_SPMI_PIC_IRQ_STATUS181_ADDR A:0x38b5004
y.create.l HWIO_SPMI_PIC_IRQ_STATUS182_ADDR A:0x38b6004
y.create.l HWIO_SPMI_PIC_IRQ_STATUS183_ADDR A:0x38b7004
y.create.l HWIO_SPMI_PIC_IRQ_STATUS184_ADDR A:0x38b8004
y.create.l HWIO_SPMI_PIC_IRQ_STATUS185_ADDR A:0x38b9004
y.create.l HWIO_SPMI_PIC_IRQ_STATUS186_ADDR A:0x38ba004
y.create.l HWIO_SPMI_PIC_IRQ_STATUS187_ADDR A:0x38bb004
y.create.l HWIO_SPMI_PIC_IRQ_STATUS188_ADDR A:0x38bc004
y.create.l HWIO_SPMI_PIC_IRQ_STATUS189_ADDR A:0x38bd004
y.create.l HWIO_SPMI_PIC_IRQ_STATUS190_ADDR A:0x38be004
y.create.l HWIO_SPMI_PIC_IRQ_STATUS191_ADDR A:0x38bf004
y.create.l HWIO_SPMI_PIC_IRQ_STATUS192_ADDR A:0x38c0004
y.create.l HWIO_SPMI_PIC_IRQ_STATUS193_ADDR A:0x38c1004
y.create.l HWIO_SPMI_PIC_IRQ_STATUS194_ADDR A:0x38c2004
y.create.l HWIO_SPMI_PIC_IRQ_STATUS195_ADDR A:0x38c3004
y.create.l HWIO_SPMI_PIC_IRQ_STATUS196_ADDR A:0x38c4004
y.create.l HWIO_SPMI_PIC_IRQ_STATUS197_ADDR A:0x38c5004
y.create.l HWIO_SPMI_PIC_IRQ_STATUS198_ADDR A:0x38c6004
y.create.l HWIO_SPMI_PIC_IRQ_STATUS199_ADDR A:0x38c7004
y.create.l HWIO_SPMI_PIC_IRQ_STATUS200_ADDR A:0x38c8004
y.create.l HWIO_SPMI_PIC_IRQ_STATUS201_ADDR A:0x38c9004
y.create.l HWIO_SPMI_PIC_IRQ_STATUS202_ADDR A:0x38ca004
y.create.l HWIO_SPMI_PIC_IRQ_STATUS203_ADDR A:0x38cb004
y.create.l HWIO_SPMI_PIC_IRQ_STATUS204_ADDR A:0x38cc004
y.create.l HWIO_SPMI_PIC_IRQ_STATUS205_ADDR A:0x38cd004
y.create.l HWIO_SPMI_PIC_IRQ_STATUS206_ADDR A:0x38ce004
y.create.l HWIO_SPMI_PIC_IRQ_STATUS207_ADDR A:0x38cf004
y.create.l HWIO_SPMI_PIC_IRQ_STATUS208_ADDR A:0x38d0004
y.create.l HWIO_SPMI_PIC_IRQ_STATUS209_ADDR A:0x38d1004
y.create.l HWIO_SPMI_PIC_IRQ_STATUS210_ADDR A:0x38d2004
y.create.l HWIO_SPMI_PIC_IRQ_STATUS211_ADDR A:0x38d3004
y.create.l HWIO_SPMI_PIC_IRQ_STATUS212_ADDR A:0x38d4004
y.create.l HWIO_SPMI_PIC_IRQ_STATUS213_ADDR A:0x38d5004
y.create.l HWIO_SPMI_PIC_IRQ_STATUS214_ADDR A:0x38d6004
y.create.l HWIO_SPMI_PIC_IRQ_STATUS215_ADDR A:0x38d7004
y.create.l HWIO_SPMI_PIC_IRQ_STATUS216_ADDR A:0x38d8004
y.create.l HWIO_SPMI_PIC_IRQ_STATUS217_ADDR A:0x38d9004
y.create.l HWIO_SPMI_PIC_IRQ_STATUS218_ADDR A:0x38da004
y.create.l HWIO_SPMI_PIC_IRQ_STATUS219_ADDR A:0x38db004
y.create.l HWIO_SPMI_PIC_IRQ_STATUS220_ADDR A:0x38dc004
y.create.l HWIO_SPMI_PIC_IRQ_STATUS221_ADDR A:0x38dd004
y.create.l HWIO_SPMI_PIC_IRQ_STATUS222_ADDR A:0x38de004
y.create.l HWIO_SPMI_PIC_IRQ_STATUS223_ADDR A:0x38df004
y.create.l HWIO_SPMI_PIC_IRQ_STATUS224_ADDR A:0x38e0004
y.create.l HWIO_SPMI_PIC_IRQ_STATUS225_ADDR A:0x38e1004
y.create.l HWIO_SPMI_PIC_IRQ_STATUS226_ADDR A:0x38e2004
y.create.l HWIO_SPMI_PIC_IRQ_STATUS227_ADDR A:0x38e3004
y.create.l HWIO_SPMI_PIC_IRQ_STATUS228_ADDR A:0x38e4004
y.create.l HWIO_SPMI_PIC_IRQ_STATUS229_ADDR A:0x38e5004
y.create.l HWIO_SPMI_PIC_IRQ_STATUS230_ADDR A:0x38e6004
y.create.l HWIO_SPMI_PIC_IRQ_STATUS231_ADDR A:0x38e7004
y.create.l HWIO_SPMI_PIC_IRQ_STATUS232_ADDR A:0x38e8004
y.create.l HWIO_SPMI_PIC_IRQ_STATUS233_ADDR A:0x38e9004
y.create.l HWIO_SPMI_PIC_IRQ_STATUS234_ADDR A:0x38ea004
y.create.l HWIO_SPMI_PIC_IRQ_STATUS235_ADDR A:0x38eb004
y.create.l HWIO_SPMI_PIC_IRQ_STATUS236_ADDR A:0x38ec004
y.create.l HWIO_SPMI_PIC_IRQ_STATUS237_ADDR A:0x38ed004
y.create.l HWIO_SPMI_PIC_IRQ_STATUS238_ADDR A:0x38ee004
y.create.l HWIO_SPMI_PIC_IRQ_STATUS239_ADDR A:0x38ef004
y.create.l HWIO_SPMI_PIC_IRQ_STATUS240_ADDR A:0x38f0004
y.create.l HWIO_SPMI_PIC_IRQ_STATUS241_ADDR A:0x38f1004
y.create.l HWIO_SPMI_PIC_IRQ_STATUS242_ADDR A:0x38f2004
y.create.l HWIO_SPMI_PIC_IRQ_STATUS243_ADDR A:0x38f3004
y.create.l HWIO_SPMI_PIC_IRQ_STATUS244_ADDR A:0x38f4004
y.create.l HWIO_SPMI_PIC_IRQ_STATUS245_ADDR A:0x38f5004
y.create.l HWIO_SPMI_PIC_IRQ_STATUS246_ADDR A:0x38f6004
y.create.l HWIO_SPMI_PIC_IRQ_STATUS247_ADDR A:0x38f7004
y.create.l HWIO_SPMI_PIC_IRQ_STATUS248_ADDR A:0x38f8004
y.create.l HWIO_SPMI_PIC_IRQ_STATUS249_ADDR A:0x38f9004
y.create.l HWIO_SPMI_PIC_IRQ_STATUS250_ADDR A:0x38fa004
y.create.l HWIO_SPMI_PIC_IRQ_STATUS251_ADDR A:0x38fb004
y.create.l HWIO_SPMI_PIC_IRQ_STATUS252_ADDR A:0x38fc004
y.create.l HWIO_SPMI_PIC_IRQ_STATUS253_ADDR A:0x38fd004
y.create.l HWIO_SPMI_PIC_IRQ_STATUS254_ADDR A:0x38fe004
y.create.l HWIO_SPMI_PIC_IRQ_STATUS255_ADDR A:0x38ff004
y.create.l HWIO_SPMI_PIC_IRQ_CLEAR0_ADDR A:0x3800008
y.create.l HWIO_SPMI_PIC_IRQ_CLEAR1_ADDR A:0x3801008
y.create.l HWIO_SPMI_PIC_IRQ_CLEAR2_ADDR A:0x3802008
y.create.l HWIO_SPMI_PIC_IRQ_CLEAR3_ADDR A:0x3803008
y.create.l HWIO_SPMI_PIC_IRQ_CLEAR4_ADDR A:0x3804008
y.create.l HWIO_SPMI_PIC_IRQ_CLEAR5_ADDR A:0x3805008
y.create.l HWIO_SPMI_PIC_IRQ_CLEAR6_ADDR A:0x3806008
y.create.l HWIO_SPMI_PIC_IRQ_CLEAR7_ADDR A:0x3807008
y.create.l HWIO_SPMI_PIC_IRQ_CLEAR8_ADDR A:0x3808008
y.create.l HWIO_SPMI_PIC_IRQ_CLEAR9_ADDR A:0x3809008
y.create.l HWIO_SPMI_PIC_IRQ_CLEAR10_ADDR A:0x380a008
y.create.l HWIO_SPMI_PIC_IRQ_CLEAR11_ADDR A:0x380b008
y.create.l HWIO_SPMI_PIC_IRQ_CLEAR12_ADDR A:0x380c008
y.create.l HWIO_SPMI_PIC_IRQ_CLEAR13_ADDR A:0x380d008
y.create.l HWIO_SPMI_PIC_IRQ_CLEAR14_ADDR A:0x380e008
y.create.l HWIO_SPMI_PIC_IRQ_CLEAR15_ADDR A:0x380f008
y.create.l HWIO_SPMI_PIC_IRQ_CLEAR16_ADDR A:0x3810008
y.create.l HWIO_SPMI_PIC_IRQ_CLEAR17_ADDR A:0x3811008
y.create.l HWIO_SPMI_PIC_IRQ_CLEAR18_ADDR A:0x3812008
y.create.l HWIO_SPMI_PIC_IRQ_CLEAR19_ADDR A:0x3813008
y.create.l HWIO_SPMI_PIC_IRQ_CLEAR20_ADDR A:0x3814008
y.create.l HWIO_SPMI_PIC_IRQ_CLEAR21_ADDR A:0x3815008
y.create.l HWIO_SPMI_PIC_IRQ_CLEAR22_ADDR A:0x3816008
y.create.l HWIO_SPMI_PIC_IRQ_CLEAR23_ADDR A:0x3817008
y.create.l HWIO_SPMI_PIC_IRQ_CLEAR24_ADDR A:0x3818008
y.create.l HWIO_SPMI_PIC_IRQ_CLEAR25_ADDR A:0x3819008
y.create.l HWIO_SPMI_PIC_IRQ_CLEAR26_ADDR A:0x381a008
y.create.l HWIO_SPMI_PIC_IRQ_CLEAR27_ADDR A:0x381b008
y.create.l HWIO_SPMI_PIC_IRQ_CLEAR28_ADDR A:0x381c008
y.create.l HWIO_SPMI_PIC_IRQ_CLEAR29_ADDR A:0x381d008
y.create.l HWIO_SPMI_PIC_IRQ_CLEAR30_ADDR A:0x381e008
y.create.l HWIO_SPMI_PIC_IRQ_CLEAR31_ADDR A:0x381f008
y.create.l HWIO_SPMI_PIC_IRQ_CLEAR32_ADDR A:0x3820008
y.create.l HWIO_SPMI_PIC_IRQ_CLEAR33_ADDR A:0x3821008
y.create.l HWIO_SPMI_PIC_IRQ_CLEAR34_ADDR A:0x3822008
y.create.l HWIO_SPMI_PIC_IRQ_CLEAR35_ADDR A:0x3823008
y.create.l HWIO_SPMI_PIC_IRQ_CLEAR36_ADDR A:0x3824008
y.create.l HWIO_SPMI_PIC_IRQ_CLEAR37_ADDR A:0x3825008
y.create.l HWIO_SPMI_PIC_IRQ_CLEAR38_ADDR A:0x3826008
y.create.l HWIO_SPMI_PIC_IRQ_CLEAR39_ADDR A:0x3827008
y.create.l HWIO_SPMI_PIC_IRQ_CLEAR40_ADDR A:0x3828008
y.create.l HWIO_SPMI_PIC_IRQ_CLEAR41_ADDR A:0x3829008
y.create.l HWIO_SPMI_PIC_IRQ_CLEAR42_ADDR A:0x382a008
y.create.l HWIO_SPMI_PIC_IRQ_CLEAR43_ADDR A:0x382b008
y.create.l HWIO_SPMI_PIC_IRQ_CLEAR44_ADDR A:0x382c008
y.create.l HWIO_SPMI_PIC_IRQ_CLEAR45_ADDR A:0x382d008
y.create.l HWIO_SPMI_PIC_IRQ_CLEAR46_ADDR A:0x382e008
y.create.l HWIO_SPMI_PIC_IRQ_CLEAR47_ADDR A:0x382f008
y.create.l HWIO_SPMI_PIC_IRQ_CLEAR48_ADDR A:0x3830008
y.create.l HWIO_SPMI_PIC_IRQ_CLEAR49_ADDR A:0x3831008
y.create.l HWIO_SPMI_PIC_IRQ_CLEAR50_ADDR A:0x3832008
y.create.l HWIO_SPMI_PIC_IRQ_CLEAR51_ADDR A:0x3833008
y.create.l HWIO_SPMI_PIC_IRQ_CLEAR52_ADDR A:0x3834008
y.create.l HWIO_SPMI_PIC_IRQ_CLEAR53_ADDR A:0x3835008
y.create.l HWIO_SPMI_PIC_IRQ_CLEAR54_ADDR A:0x3836008
y.create.l HWIO_SPMI_PIC_IRQ_CLEAR55_ADDR A:0x3837008
y.create.l HWIO_SPMI_PIC_IRQ_CLEAR56_ADDR A:0x3838008
y.create.l HWIO_SPMI_PIC_IRQ_CLEAR57_ADDR A:0x3839008
y.create.l HWIO_SPMI_PIC_IRQ_CLEAR58_ADDR A:0x383a008
y.create.l HWIO_SPMI_PIC_IRQ_CLEAR59_ADDR A:0x383b008
y.create.l HWIO_SPMI_PIC_IRQ_CLEAR60_ADDR A:0x383c008
y.create.l HWIO_SPMI_PIC_IRQ_CLEAR61_ADDR A:0x383d008
y.create.l HWIO_SPMI_PIC_IRQ_CLEAR62_ADDR A:0x383e008
y.create.l HWIO_SPMI_PIC_IRQ_CLEAR63_ADDR A:0x383f008
y.create.l HWIO_SPMI_PIC_IRQ_CLEAR64_ADDR A:0x3840008
y.create.l HWIO_SPMI_PIC_IRQ_CLEAR65_ADDR A:0x3841008
y.create.l HWIO_SPMI_PIC_IRQ_CLEAR66_ADDR A:0x3842008
y.create.l HWIO_SPMI_PIC_IRQ_CLEAR67_ADDR A:0x3843008
y.create.l HWIO_SPMI_PIC_IRQ_CLEAR68_ADDR A:0x3844008
y.create.l HWIO_SPMI_PIC_IRQ_CLEAR69_ADDR A:0x3845008
y.create.l HWIO_SPMI_PIC_IRQ_CLEAR70_ADDR A:0x3846008
y.create.l HWIO_SPMI_PIC_IRQ_CLEAR71_ADDR A:0x3847008
y.create.l HWIO_SPMI_PIC_IRQ_CLEAR72_ADDR A:0x3848008
y.create.l HWIO_SPMI_PIC_IRQ_CLEAR73_ADDR A:0x3849008
y.create.l HWIO_SPMI_PIC_IRQ_CLEAR74_ADDR A:0x384a008
y.create.l HWIO_SPMI_PIC_IRQ_CLEAR75_ADDR A:0x384b008
y.create.l HWIO_SPMI_PIC_IRQ_CLEAR76_ADDR A:0x384c008
y.create.l HWIO_SPMI_PIC_IRQ_CLEAR77_ADDR A:0x384d008
y.create.l HWIO_SPMI_PIC_IRQ_CLEAR78_ADDR A:0x384e008
y.create.l HWIO_SPMI_PIC_IRQ_CLEAR79_ADDR A:0x384f008
y.create.l HWIO_SPMI_PIC_IRQ_CLEAR80_ADDR A:0x3850008
y.create.l HWIO_SPMI_PIC_IRQ_CLEAR81_ADDR A:0x3851008
y.create.l HWIO_SPMI_PIC_IRQ_CLEAR82_ADDR A:0x3852008
y.create.l HWIO_SPMI_PIC_IRQ_CLEAR83_ADDR A:0x3853008
y.create.l HWIO_SPMI_PIC_IRQ_CLEAR84_ADDR A:0x3854008
y.create.l HWIO_SPMI_PIC_IRQ_CLEAR85_ADDR A:0x3855008
y.create.l HWIO_SPMI_PIC_IRQ_CLEAR86_ADDR A:0x3856008
y.create.l HWIO_SPMI_PIC_IRQ_CLEAR87_ADDR A:0x3857008
y.create.l HWIO_SPMI_PIC_IRQ_CLEAR88_ADDR A:0x3858008
y.create.l HWIO_SPMI_PIC_IRQ_CLEAR89_ADDR A:0x3859008
y.create.l HWIO_SPMI_PIC_IRQ_CLEAR90_ADDR A:0x385a008
y.create.l HWIO_SPMI_PIC_IRQ_CLEAR91_ADDR A:0x385b008
y.create.l HWIO_SPMI_PIC_IRQ_CLEAR92_ADDR A:0x385c008
y.create.l HWIO_SPMI_PIC_IRQ_CLEAR93_ADDR A:0x385d008
y.create.l HWIO_SPMI_PIC_IRQ_CLEAR94_ADDR A:0x385e008
y.create.l HWIO_SPMI_PIC_IRQ_CLEAR95_ADDR A:0x385f008
y.create.l HWIO_SPMI_PIC_IRQ_CLEAR96_ADDR A:0x3860008
y.create.l HWIO_SPMI_PIC_IRQ_CLEAR97_ADDR A:0x3861008
y.create.l HWIO_SPMI_PIC_IRQ_CLEAR98_ADDR A:0x3862008
y.create.l HWIO_SPMI_PIC_IRQ_CLEAR99_ADDR A:0x3863008
y.create.l HWIO_SPMI_PIC_IRQ_CLEAR100_ADDR A:0x3864008
y.create.l HWIO_SPMI_PIC_IRQ_CLEAR101_ADDR A:0x3865008
y.create.l HWIO_SPMI_PIC_IRQ_CLEAR102_ADDR A:0x3866008
y.create.l HWIO_SPMI_PIC_IRQ_CLEAR103_ADDR A:0x3867008
y.create.l HWIO_SPMI_PIC_IRQ_CLEAR104_ADDR A:0x3868008
y.create.l HWIO_SPMI_PIC_IRQ_CLEAR105_ADDR A:0x3869008
y.create.l HWIO_SPMI_PIC_IRQ_CLEAR106_ADDR A:0x386a008
y.create.l HWIO_SPMI_PIC_IRQ_CLEAR107_ADDR A:0x386b008
y.create.l HWIO_SPMI_PIC_IRQ_CLEAR108_ADDR A:0x386c008
y.create.l HWIO_SPMI_PIC_IRQ_CLEAR109_ADDR A:0x386d008
y.create.l HWIO_SPMI_PIC_IRQ_CLEAR110_ADDR A:0x386e008
y.create.l HWIO_SPMI_PIC_IRQ_CLEAR111_ADDR A:0x386f008
y.create.l HWIO_SPMI_PIC_IRQ_CLEAR112_ADDR A:0x3870008
y.create.l HWIO_SPMI_PIC_IRQ_CLEAR113_ADDR A:0x3871008
y.create.l HWIO_SPMI_PIC_IRQ_CLEAR114_ADDR A:0x3872008
y.create.l HWIO_SPMI_PIC_IRQ_CLEAR115_ADDR A:0x3873008
y.create.l HWIO_SPMI_PIC_IRQ_CLEAR116_ADDR A:0x3874008
y.create.l HWIO_SPMI_PIC_IRQ_CLEAR117_ADDR A:0x3875008
y.create.l HWIO_SPMI_PIC_IRQ_CLEAR118_ADDR A:0x3876008
y.create.l HWIO_SPMI_PIC_IRQ_CLEAR119_ADDR A:0x3877008
y.create.l HWIO_SPMI_PIC_IRQ_CLEAR120_ADDR A:0x3878008
y.create.l HWIO_SPMI_PIC_IRQ_CLEAR121_ADDR A:0x3879008
y.create.l HWIO_SPMI_PIC_IRQ_CLEAR122_ADDR A:0x387a008
y.create.l HWIO_SPMI_PIC_IRQ_CLEAR123_ADDR A:0x387b008
y.create.l HWIO_SPMI_PIC_IRQ_CLEAR124_ADDR A:0x387c008
y.create.l HWIO_SPMI_PIC_IRQ_CLEAR125_ADDR A:0x387d008
y.create.l HWIO_SPMI_PIC_IRQ_CLEAR126_ADDR A:0x387e008
y.create.l HWIO_SPMI_PIC_IRQ_CLEAR127_ADDR A:0x387f008
y.create.l HWIO_SPMI_PIC_IRQ_CLEAR128_ADDR A:0x3880008
y.create.l HWIO_SPMI_PIC_IRQ_CLEAR129_ADDR A:0x3881008
y.create.l HWIO_SPMI_PIC_IRQ_CLEAR130_ADDR A:0x3882008
y.create.l HWIO_SPMI_PIC_IRQ_CLEAR131_ADDR A:0x3883008
y.create.l HWIO_SPMI_PIC_IRQ_CLEAR132_ADDR A:0x3884008
y.create.l HWIO_SPMI_PIC_IRQ_CLEAR133_ADDR A:0x3885008
y.create.l HWIO_SPMI_PIC_IRQ_CLEAR134_ADDR A:0x3886008
y.create.l HWIO_SPMI_PIC_IRQ_CLEAR135_ADDR A:0x3887008
y.create.l HWIO_SPMI_PIC_IRQ_CLEAR136_ADDR A:0x3888008
y.create.l HWIO_SPMI_PIC_IRQ_CLEAR137_ADDR A:0x3889008
y.create.l HWIO_SPMI_PIC_IRQ_CLEAR138_ADDR A:0x388a008
y.create.l HWIO_SPMI_PIC_IRQ_CLEAR139_ADDR A:0x388b008
y.create.l HWIO_SPMI_PIC_IRQ_CLEAR140_ADDR A:0x388c008
y.create.l HWIO_SPMI_PIC_IRQ_CLEAR141_ADDR A:0x388d008
y.create.l HWIO_SPMI_PIC_IRQ_CLEAR142_ADDR A:0x388e008
y.create.l HWIO_SPMI_PIC_IRQ_CLEAR143_ADDR A:0x388f008
y.create.l HWIO_SPMI_PIC_IRQ_CLEAR144_ADDR A:0x3890008
y.create.l HWIO_SPMI_PIC_IRQ_CLEAR145_ADDR A:0x3891008
y.create.l HWIO_SPMI_PIC_IRQ_CLEAR146_ADDR A:0x3892008
y.create.l HWIO_SPMI_PIC_IRQ_CLEAR147_ADDR A:0x3893008
y.create.l HWIO_SPMI_PIC_IRQ_CLEAR148_ADDR A:0x3894008
y.create.l HWIO_SPMI_PIC_IRQ_CLEAR149_ADDR A:0x3895008
y.create.l HWIO_SPMI_PIC_IRQ_CLEAR150_ADDR A:0x3896008
y.create.l HWIO_SPMI_PIC_IRQ_CLEAR151_ADDR A:0x3897008
y.create.l HWIO_SPMI_PIC_IRQ_CLEAR152_ADDR A:0x3898008
y.create.l HWIO_SPMI_PIC_IRQ_CLEAR153_ADDR A:0x3899008
y.create.l HWIO_SPMI_PIC_IRQ_CLEAR154_ADDR A:0x389a008
y.create.l HWIO_SPMI_PIC_IRQ_CLEAR155_ADDR A:0x389b008
y.create.l HWIO_SPMI_PIC_IRQ_CLEAR156_ADDR A:0x389c008
y.create.l HWIO_SPMI_PIC_IRQ_CLEAR157_ADDR A:0x389d008
y.create.l HWIO_SPMI_PIC_IRQ_CLEAR158_ADDR A:0x389e008
y.create.l HWIO_SPMI_PIC_IRQ_CLEAR159_ADDR A:0x389f008
y.create.l HWIO_SPMI_PIC_IRQ_CLEAR160_ADDR A:0x38a0008
y.create.l HWIO_SPMI_PIC_IRQ_CLEAR161_ADDR A:0x38a1008
y.create.l HWIO_SPMI_PIC_IRQ_CLEAR162_ADDR A:0x38a2008
y.create.l HWIO_SPMI_PIC_IRQ_CLEAR163_ADDR A:0x38a3008
y.create.l HWIO_SPMI_PIC_IRQ_CLEAR164_ADDR A:0x38a4008
y.create.l HWIO_SPMI_PIC_IRQ_CLEAR165_ADDR A:0x38a5008
y.create.l HWIO_SPMI_PIC_IRQ_CLEAR166_ADDR A:0x38a6008
y.create.l HWIO_SPMI_PIC_IRQ_CLEAR167_ADDR A:0x38a7008
y.create.l HWIO_SPMI_PIC_IRQ_CLEAR168_ADDR A:0x38a8008
y.create.l HWIO_SPMI_PIC_IRQ_CLEAR169_ADDR A:0x38a9008
y.create.l HWIO_SPMI_PIC_IRQ_CLEAR170_ADDR A:0x38aa008
y.create.l HWIO_SPMI_PIC_IRQ_CLEAR171_ADDR A:0x38ab008
y.create.l HWIO_SPMI_PIC_IRQ_CLEAR172_ADDR A:0x38ac008
y.create.l HWIO_SPMI_PIC_IRQ_CLEAR173_ADDR A:0x38ad008
y.create.l HWIO_SPMI_PIC_IRQ_CLEAR174_ADDR A:0x38ae008
y.create.l HWIO_SPMI_PIC_IRQ_CLEAR175_ADDR A:0x38af008
y.create.l HWIO_SPMI_PIC_IRQ_CLEAR176_ADDR A:0x38b0008
y.create.l HWIO_SPMI_PIC_IRQ_CLEAR177_ADDR A:0x38b1008
y.create.l HWIO_SPMI_PIC_IRQ_CLEAR178_ADDR A:0x38b2008
y.create.l HWIO_SPMI_PIC_IRQ_CLEAR179_ADDR A:0x38b3008
y.create.l HWIO_SPMI_PIC_IRQ_CLEAR180_ADDR A:0x38b4008
y.create.l HWIO_SPMI_PIC_IRQ_CLEAR181_ADDR A:0x38b5008
y.create.l HWIO_SPMI_PIC_IRQ_CLEAR182_ADDR A:0x38b6008
y.create.l HWIO_SPMI_PIC_IRQ_CLEAR183_ADDR A:0x38b7008
y.create.l HWIO_SPMI_PIC_IRQ_CLEAR184_ADDR A:0x38b8008
y.create.l HWIO_SPMI_PIC_IRQ_CLEAR185_ADDR A:0x38b9008
y.create.l HWIO_SPMI_PIC_IRQ_CLEAR186_ADDR A:0x38ba008
y.create.l HWIO_SPMI_PIC_IRQ_CLEAR187_ADDR A:0x38bb008
y.create.l HWIO_SPMI_PIC_IRQ_CLEAR188_ADDR A:0x38bc008
y.create.l HWIO_SPMI_PIC_IRQ_CLEAR189_ADDR A:0x38bd008
y.create.l HWIO_SPMI_PIC_IRQ_CLEAR190_ADDR A:0x38be008
y.create.l HWIO_SPMI_PIC_IRQ_CLEAR191_ADDR A:0x38bf008
y.create.l HWIO_SPMI_PIC_IRQ_CLEAR192_ADDR A:0x38c0008
y.create.l HWIO_SPMI_PIC_IRQ_CLEAR193_ADDR A:0x38c1008
y.create.l HWIO_SPMI_PIC_IRQ_CLEAR194_ADDR A:0x38c2008
y.create.l HWIO_SPMI_PIC_IRQ_CLEAR195_ADDR A:0x38c3008
y.create.l HWIO_SPMI_PIC_IRQ_CLEAR196_ADDR A:0x38c4008
y.create.l HWIO_SPMI_PIC_IRQ_CLEAR197_ADDR A:0x38c5008
y.create.l HWIO_SPMI_PIC_IRQ_CLEAR198_ADDR A:0x38c6008
y.create.l HWIO_SPMI_PIC_IRQ_CLEAR199_ADDR A:0x38c7008
y.create.l HWIO_SPMI_PIC_IRQ_CLEAR200_ADDR A:0x38c8008
y.create.l HWIO_SPMI_PIC_IRQ_CLEAR201_ADDR A:0x38c9008
y.create.l HWIO_SPMI_PIC_IRQ_CLEAR202_ADDR A:0x38ca008
y.create.l HWIO_SPMI_PIC_IRQ_CLEAR203_ADDR A:0x38cb008
y.create.l HWIO_SPMI_PIC_IRQ_CLEAR204_ADDR A:0x38cc008
y.create.l HWIO_SPMI_PIC_IRQ_CLEAR205_ADDR A:0x38cd008
y.create.l HWIO_SPMI_PIC_IRQ_CLEAR206_ADDR A:0x38ce008
y.create.l HWIO_SPMI_PIC_IRQ_CLEAR207_ADDR A:0x38cf008
y.create.l HWIO_SPMI_PIC_IRQ_CLEAR208_ADDR A:0x38d0008
y.create.l HWIO_SPMI_PIC_IRQ_CLEAR209_ADDR A:0x38d1008
y.create.l HWIO_SPMI_PIC_IRQ_CLEAR210_ADDR A:0x38d2008
y.create.l HWIO_SPMI_PIC_IRQ_CLEAR211_ADDR A:0x38d3008
y.create.l HWIO_SPMI_PIC_IRQ_CLEAR212_ADDR A:0x38d4008
y.create.l HWIO_SPMI_PIC_IRQ_CLEAR213_ADDR A:0x38d5008
y.create.l HWIO_SPMI_PIC_IRQ_CLEAR214_ADDR A:0x38d6008
y.create.l HWIO_SPMI_PIC_IRQ_CLEAR215_ADDR A:0x38d7008
y.create.l HWIO_SPMI_PIC_IRQ_CLEAR216_ADDR A:0x38d8008
y.create.l HWIO_SPMI_PIC_IRQ_CLEAR217_ADDR A:0x38d9008
y.create.l HWIO_SPMI_PIC_IRQ_CLEAR218_ADDR A:0x38da008
y.create.l HWIO_SPMI_PIC_IRQ_CLEAR219_ADDR A:0x38db008
y.create.l HWIO_SPMI_PIC_IRQ_CLEAR220_ADDR A:0x38dc008
y.create.l HWIO_SPMI_PIC_IRQ_CLEAR221_ADDR A:0x38dd008
y.create.l HWIO_SPMI_PIC_IRQ_CLEAR222_ADDR A:0x38de008
y.create.l HWIO_SPMI_PIC_IRQ_CLEAR223_ADDR A:0x38df008
y.create.l HWIO_SPMI_PIC_IRQ_CLEAR224_ADDR A:0x38e0008
y.create.l HWIO_SPMI_PIC_IRQ_CLEAR225_ADDR A:0x38e1008
y.create.l HWIO_SPMI_PIC_IRQ_CLEAR226_ADDR A:0x38e2008
y.create.l HWIO_SPMI_PIC_IRQ_CLEAR227_ADDR A:0x38e3008
y.create.l HWIO_SPMI_PIC_IRQ_CLEAR228_ADDR A:0x38e4008
y.create.l HWIO_SPMI_PIC_IRQ_CLEAR229_ADDR A:0x38e5008
y.create.l HWIO_SPMI_PIC_IRQ_CLEAR230_ADDR A:0x38e6008
y.create.l HWIO_SPMI_PIC_IRQ_CLEAR231_ADDR A:0x38e7008
y.create.l HWIO_SPMI_PIC_IRQ_CLEAR232_ADDR A:0x38e8008
y.create.l HWIO_SPMI_PIC_IRQ_CLEAR233_ADDR A:0x38e9008
y.create.l HWIO_SPMI_PIC_IRQ_CLEAR234_ADDR A:0x38ea008
y.create.l HWIO_SPMI_PIC_IRQ_CLEAR235_ADDR A:0x38eb008
y.create.l HWIO_SPMI_PIC_IRQ_CLEAR236_ADDR A:0x38ec008
y.create.l HWIO_SPMI_PIC_IRQ_CLEAR237_ADDR A:0x38ed008
y.create.l HWIO_SPMI_PIC_IRQ_CLEAR238_ADDR A:0x38ee008
y.create.l HWIO_SPMI_PIC_IRQ_CLEAR239_ADDR A:0x38ef008
y.create.l HWIO_SPMI_PIC_IRQ_CLEAR240_ADDR A:0x38f0008
y.create.l HWIO_SPMI_PIC_IRQ_CLEAR241_ADDR A:0x38f1008
y.create.l HWIO_SPMI_PIC_IRQ_CLEAR242_ADDR A:0x38f2008
y.create.l HWIO_SPMI_PIC_IRQ_CLEAR243_ADDR A:0x38f3008
y.create.l HWIO_SPMI_PIC_IRQ_CLEAR244_ADDR A:0x38f4008
y.create.l HWIO_SPMI_PIC_IRQ_CLEAR245_ADDR A:0x38f5008
y.create.l HWIO_SPMI_PIC_IRQ_CLEAR246_ADDR A:0x38f6008
y.create.l HWIO_SPMI_PIC_IRQ_CLEAR247_ADDR A:0x38f7008
y.create.l HWIO_SPMI_PIC_IRQ_CLEAR248_ADDR A:0x38f8008
y.create.l HWIO_SPMI_PIC_IRQ_CLEAR249_ADDR A:0x38f9008
y.create.l HWIO_SPMI_PIC_IRQ_CLEAR250_ADDR A:0x38fa008
y.create.l HWIO_SPMI_PIC_IRQ_CLEAR251_ADDR A:0x38fb008
y.create.l HWIO_SPMI_PIC_IRQ_CLEAR252_ADDR A:0x38fc008
y.create.l HWIO_SPMI_PIC_IRQ_CLEAR253_ADDR A:0x38fd008
y.create.l HWIO_SPMI_PIC_IRQ_CLEAR254_ADDR A:0x38fe008
y.create.l HWIO_SPMI_PIC_IRQ_CLEAR255_ADDR A:0x38ff008
y.create.l HWIO_PMIC_ARB_XPU_SCR_ADDR A:0x200e000
y.create.l HWIO_PMIC_ARB_XPU_SWDR_ADDR A:0x200e004
y.create.l HWIO_PMIC_ARB_XPU_PRTN_RACR_SSHADOW_ADDR A:0x200e008
y.create.l HWIO_PMIC_ARB_XPU_PRTN_WACR_SSHADOW_ADDR A:0x200e00c
y.create.l HWIO_PMIC_ARB_XPU_PRTN_START_SSHADOW0_ADDR A:0x200e010
y.create.l HWIO_PMIC_ARB_XPU_PRTN_END_SSHADOW0_ADDR A:0x200e018
y.create.l HWIO_PMIC_ARB_XPU_SEAR0_ADDR A:0x200e040
y.create.l HWIO_PMIC_ARB_XPU_SESR_ADDR A:0x200e048
y.create.l HWIO_PMIC_ARB_XPU_SESRRESTORE_ADDR A:0x200e04c
y.create.l HWIO_PMIC_ARB_XPU_SESYNR0_ADDR A:0x200e050
y.create.l HWIO_PMIC_ARB_XPU_SESYNR1_ADDR A:0x200e054
y.create.l HWIO_PMIC_ARB_XPU_SESYNR2_ADDR A:0x200e058
y.create.l HWIO_PMIC_ARB_XPU_MCR_ADDR A:0x200e100
y.create.l HWIO_PMIC_ARB_XPU_MEAR0_ADDR A:0x200e140
y.create.l HWIO_PMIC_ARB_XPU_MESR_ADDR A:0x200e148
y.create.l HWIO_PMIC_ARB_XPU_MESRRESTORE_ADDR A:0x200e14c
y.create.l HWIO_PMIC_ARB_XPU_MESYNR0_ADDR A:0x200e150
y.create.l HWIO_PMIC_ARB_XPU_MESYNR1_ADDR A:0x200e154
y.create.l HWIO_PMIC_ARB_XPU_MESYNR2_ADDR A:0x200e158
y.create.l HWIO_PMIC_ARB_XPU_CR_ADDR A:0x200e080
y.create.l HWIO_PMIC_ARB_XPU_PRTN_RACR_SHADOW_ADDR A:0x200e088
y.create.l HWIO_PMIC_ARB_XPU_PRTN_WACR_SHADOW_ADDR A:0x200e08c
y.create.l HWIO_PMIC_ARB_XPU_PRTN_START_SHADOW0_ADDR A:0x200e090
y.create.l HWIO_PMIC_ARB_XPU_PRTN_END_SHADOW0_ADDR A:0x200e098
y.create.l HWIO_PMIC_ARB_XPU_RPU_ACR0_ADDR A:0x200e0a0
y.create.l HWIO_PMIC_ARB_XPU_EAR0_ADDR A:0x200e0c0
y.create.l HWIO_PMIC_ARB_XPU_ESR_ADDR A:0x200e0c8
y.create.l HWIO_PMIC_ARB_XPU_ESRRESTORE_ADDR A:0x200e0cc
y.create.l HWIO_PMIC_ARB_XPU_ESYNR0_ADDR A:0x200e0d0
y.create.l HWIO_PMIC_ARB_XPU_ESYNR1_ADDR A:0x200e0d4
y.create.l HWIO_PMIC_ARB_XPU_ESYNR2_ADDR A:0x200e0d8
y.create.l HWIO_PMIC_ARB_XPU_UMR_RACR_ADDR A:0x200e0e0
y.create.l HWIO_PMIC_ARB_XPU_UMR_WACR_ADDR A:0x200e0e4
y.create.l HWIO_PMIC_ARB_XPU_UMR_CNTL_ADDR A:0x200e0f0
y.create.l HWIO_PMIC_ARB_XPU_IDR0_ADDR A:0x200e074
y.create.l HWIO_PMIC_ARB_XPU_IDR1_ADDR A:0x200e078
y.create.l HWIO_PMIC_ARB_XPU_REV_ADDR A:0x200e07c
y.create.l HWIO_PMIC_ARB_XPU_PRT0_RACR0_ADDR A:0x200e200
y.create.l HWIO_PMIC_ARB_XPU_PRT1_RACR0_ADDR A:0x200e280
y.create.l HWIO_PMIC_ARB_XPU_PRT2_RACR0_ADDR A:0x200e300
y.create.l HWIO_PMIC_ARB_XPU_PRT3_RACR0_ADDR A:0x200e380
y.create.l HWIO_PMIC_ARB_XPU_PRT4_RACR0_ADDR A:0x200e400
y.create.l HWIO_PMIC_ARB_XPU_PRT5_RACR0_ADDR A:0x200e480
y.create.l HWIO_PMIC_ARB_XPU_PRT6_RACR0_ADDR A:0x200e500
y.create.l HWIO_PMIC_ARB_XPU_PRT7_RACR0_ADDR A:0x200e580
y.create.l HWIO_PMIC_ARB_XPU_PRT8_RACR0_ADDR A:0x200e600
y.create.l HWIO_PMIC_ARB_XPU_PRT9_RACR0_ADDR A:0x200e680
y.create.l HWIO_PMIC_ARB_XPU_PRT10_RACR0_ADDR A:0x200e700
y.create.l HWIO_PMIC_ARB_XPU_PRT11_RACR0_ADDR A:0x200e780
y.create.l HWIO_PMIC_ARB_XPU_PRT12_RACR0_ADDR A:0x200e800
y.create.l HWIO_PMIC_ARB_XPU_PRT13_RACR0_ADDR A:0x200e880
y.create.l HWIO_PMIC_ARB_XPU_PRT14_RACR0_ADDR A:0x200e900
y.create.l HWIO_PMIC_ARB_XPU_PRT15_RACR0_ADDR A:0x200e980
y.create.l HWIO_PMIC_ARB_XPU_PRT16_RACR0_ADDR A:0x200ea00
y.create.l HWIO_PMIC_ARB_XPU_PRT17_RACR0_ADDR A:0x200ea80
y.create.l HWIO_PMIC_ARB_XPU_PRT18_RACR0_ADDR A:0x200eb00
y.create.l HWIO_PMIC_ARB_XPU_PRT19_RACR0_ADDR A:0x200eb80
y.create.l HWIO_PMIC_ARB_XPU_PRT20_RACR0_ADDR A:0x200ec00
y.create.l HWIO_PMIC_ARB_XPU_PRT21_RACR0_ADDR A:0x200ec80
y.create.l HWIO_PMIC_ARB_XPU_PRT22_RACR0_ADDR A:0x200ed00
y.create.l HWIO_PMIC_ARB_XPU_PRT23_RACR0_ADDR A:0x200ed80
y.create.l HWIO_PMIC_ARB_XPU_PRT24_RACR0_ADDR A:0x200ee00
y.create.l HWIO_PMIC_ARB_XPU_PRT0_WACR0_ADDR A:0x200e220
y.create.l HWIO_PMIC_ARB_XPU_PRT1_WACR0_ADDR A:0x200e2a0
y.create.l HWIO_PMIC_ARB_XPU_PRT2_WACR0_ADDR A:0x200e320
y.create.l HWIO_PMIC_ARB_XPU_PRT3_WACR0_ADDR A:0x200e3a0
y.create.l HWIO_PMIC_ARB_XPU_PRT4_WACR0_ADDR A:0x200e420
y.create.l HWIO_PMIC_ARB_XPU_PRT5_WACR0_ADDR A:0x200e4a0
y.create.l HWIO_PMIC_ARB_XPU_PRT6_WACR0_ADDR A:0x200e520
y.create.l HWIO_PMIC_ARB_XPU_PRT7_WACR0_ADDR A:0x200e5a0
y.create.l HWIO_PMIC_ARB_XPU_PRT8_WACR0_ADDR A:0x200e620
y.create.l HWIO_PMIC_ARB_XPU_PRT9_WACR0_ADDR A:0x200e6a0
y.create.l HWIO_PMIC_ARB_XPU_PRT10_WACR0_ADDR A:0x200e720
y.create.l HWIO_PMIC_ARB_XPU_PRT11_WACR0_ADDR A:0x200e7a0
y.create.l HWIO_PMIC_ARB_XPU_PRT12_WACR0_ADDR A:0x200e820
y.create.l HWIO_PMIC_ARB_XPU_PRT13_WACR0_ADDR A:0x200e8a0
y.create.l HWIO_PMIC_ARB_XPU_PRT14_WACR0_ADDR A:0x200e920
y.create.l HWIO_PMIC_ARB_XPU_PRT15_WACR0_ADDR A:0x200e9a0
y.create.l HWIO_PMIC_ARB_XPU_PRT16_WACR0_ADDR A:0x200ea20
y.create.l HWIO_PMIC_ARB_XPU_PRT17_WACR0_ADDR A:0x200eaa0
y.create.l HWIO_PMIC_ARB_XPU_PRT18_WACR0_ADDR A:0x200eb20
y.create.l HWIO_PMIC_ARB_XPU_PRT19_WACR0_ADDR A:0x200eba0
y.create.l HWIO_PMIC_ARB_XPU_PRT20_WACR0_ADDR A:0x200ec20
y.create.l HWIO_PMIC_ARB_XPU_PRT21_WACR0_ADDR A:0x200eca0
y.create.l HWIO_PMIC_ARB_XPU_PRT22_WACR0_ADDR A:0x200ed20
y.create.l HWIO_PMIC_ARB_XPU_PRT23_WACR0_ADDR A:0x200eda0
y.create.l HWIO_PMIC_ARB_XPU_PRT24_WACR0_ADDR A:0x200ee20
y.create.l HWIO_PMIC_ARB_XPU_PRT0_START0_ADDR A:0x200e240
y.create.l HWIO_PMIC_ARB_XPU_PRT1_START0_ADDR A:0x200e2c0
y.create.l HWIO_PMIC_ARB_XPU_PRT2_START0_ADDR A:0x200e340
y.create.l HWIO_PMIC_ARB_XPU_PRT3_START0_ADDR A:0x200e3c0
y.create.l HWIO_PMIC_ARB_XPU_PRT4_START0_ADDR A:0x200e440
y.create.l HWIO_PMIC_ARB_XPU_PRT5_START0_ADDR A:0x200e4c0
y.create.l HWIO_PMIC_ARB_XPU_PRT6_START0_ADDR A:0x200e540
y.create.l HWIO_PMIC_ARB_XPU_PRT7_START0_ADDR A:0x200e5c0
y.create.l HWIO_PMIC_ARB_XPU_PRT8_START0_ADDR A:0x200e640
y.create.l HWIO_PMIC_ARB_XPU_PRT9_START0_ADDR A:0x200e6c0
y.create.l HWIO_PMIC_ARB_XPU_PRT10_START0_ADDR A:0x200e740
y.create.l HWIO_PMIC_ARB_XPU_PRT11_START0_ADDR A:0x200e7c0
y.create.l HWIO_PMIC_ARB_XPU_PRT12_START0_ADDR A:0x200e840
y.create.l HWIO_PMIC_ARB_XPU_PRT13_START0_ADDR A:0x200e8c0
y.create.l HWIO_PMIC_ARB_XPU_PRT14_START0_ADDR A:0x200e940
y.create.l HWIO_PMIC_ARB_XPU_PRT15_START0_ADDR A:0x200e9c0
y.create.l HWIO_PMIC_ARB_XPU_PRT16_START0_ADDR A:0x200ea40
y.create.l HWIO_PMIC_ARB_XPU_PRT17_START0_ADDR A:0x200eac0
y.create.l HWIO_PMIC_ARB_XPU_PRT18_START0_ADDR A:0x200eb40
y.create.l HWIO_PMIC_ARB_XPU_PRT19_START0_ADDR A:0x200ebc0
y.create.l HWIO_PMIC_ARB_XPU_PRT20_START0_ADDR A:0x200ec40
y.create.l HWIO_PMIC_ARB_XPU_PRT21_START0_ADDR A:0x200ecc0
y.create.l HWIO_PMIC_ARB_XPU_PRT22_START0_ADDR A:0x200ed40
y.create.l HWIO_PMIC_ARB_XPU_PRT23_START0_ADDR A:0x200edc0
y.create.l HWIO_PMIC_ARB_XPU_PRT24_START0_ADDR A:0x200ee40
y.create.l HWIO_PMIC_ARB_XPU_PRT0_END0_ADDR A:0x200e248
y.create.l HWIO_PMIC_ARB_XPU_PRT1_END0_ADDR A:0x200e2c8
y.create.l HWIO_PMIC_ARB_XPU_PRT2_END0_ADDR A:0x200e348
y.create.l HWIO_PMIC_ARB_XPU_PRT3_END0_ADDR A:0x200e3c8
y.create.l HWIO_PMIC_ARB_XPU_PRT4_END0_ADDR A:0x200e448
y.create.l HWIO_PMIC_ARB_XPU_PRT5_END0_ADDR A:0x200e4c8
y.create.l HWIO_PMIC_ARB_XPU_PRT6_END0_ADDR A:0x200e548
y.create.l HWIO_PMIC_ARB_XPU_PRT7_END0_ADDR A:0x200e5c8
y.create.l HWIO_PMIC_ARB_XPU_PRT8_END0_ADDR A:0x200e648
y.create.l HWIO_PMIC_ARB_XPU_PRT9_END0_ADDR A:0x200e6c8
y.create.l HWIO_PMIC_ARB_XPU_PRT10_END0_ADDR A:0x200e748
y.create.l HWIO_PMIC_ARB_XPU_PRT11_END0_ADDR A:0x200e7c8
y.create.l HWIO_PMIC_ARB_XPU_PRT12_END0_ADDR A:0x200e848
y.create.l HWIO_PMIC_ARB_XPU_PRT13_END0_ADDR A:0x200e8c8
y.create.l HWIO_PMIC_ARB_XPU_PRT14_END0_ADDR A:0x200e948
y.create.l HWIO_PMIC_ARB_XPU_PRT15_END0_ADDR A:0x200e9c8
y.create.l HWIO_PMIC_ARB_XPU_PRT16_END0_ADDR A:0x200ea48
y.create.l HWIO_PMIC_ARB_XPU_PRT17_END0_ADDR A:0x200eac8
y.create.l HWIO_PMIC_ARB_XPU_PRT18_END0_ADDR A:0x200eb48
y.create.l HWIO_PMIC_ARB_XPU_PRT19_END0_ADDR A:0x200ebc8
y.create.l HWIO_PMIC_ARB_XPU_PRT20_END0_ADDR A:0x200ec48
y.create.l HWIO_PMIC_ARB_XPU_PRT21_END0_ADDR A:0x200ecc8
y.create.l HWIO_PMIC_ARB_XPU_PRT22_END0_ADDR A:0x200ed48
y.create.l HWIO_PMIC_ARB_XPU_PRT23_END0_ADDR A:0x200edc8
y.create.l HWIO_PMIC_ARB_XPU_PRT24_END0_ADDR A:0x200ee48
y.create.l HWIO_PMIC_ARB_XPU_PRT0_SCR_ADDR A:0x200e250
y.create.l HWIO_PMIC_ARB_XPU_PRT1_SCR_ADDR A:0x200e2d0
y.create.l HWIO_PMIC_ARB_XPU_PRT2_SCR_ADDR A:0x200e350
y.create.l HWIO_PMIC_ARB_XPU_PRT3_SCR_ADDR A:0x200e3d0
y.create.l HWIO_PMIC_ARB_XPU_PRT4_SCR_ADDR A:0x200e450
y.create.l HWIO_PMIC_ARB_XPU_PRT5_SCR_ADDR A:0x200e4d0
y.create.l HWIO_PMIC_ARB_XPU_PRT6_SCR_ADDR A:0x200e550
y.create.l HWIO_PMIC_ARB_XPU_PRT7_SCR_ADDR A:0x200e5d0
y.create.l HWIO_PMIC_ARB_XPU_PRT8_SCR_ADDR A:0x200e650
y.create.l HWIO_PMIC_ARB_XPU_PRT9_SCR_ADDR A:0x200e6d0
y.create.l HWIO_PMIC_ARB_XPU_PRT10_SCR_ADDR A:0x200e750
y.create.l HWIO_PMIC_ARB_XPU_PRT11_SCR_ADDR A:0x200e7d0
y.create.l HWIO_PMIC_ARB_XPU_PRT12_SCR_ADDR A:0x200e850
y.create.l HWIO_PMIC_ARB_XPU_PRT13_SCR_ADDR A:0x200e8d0
y.create.l HWIO_PMIC_ARB_XPU_PRT14_SCR_ADDR A:0x200e950
y.create.l HWIO_PMIC_ARB_XPU_PRT15_SCR_ADDR A:0x200e9d0
y.create.l HWIO_PMIC_ARB_XPU_PRT16_SCR_ADDR A:0x200ea50
y.create.l HWIO_PMIC_ARB_XPU_PRT17_SCR_ADDR A:0x200ead0
y.create.l HWIO_PMIC_ARB_XPU_PRT18_SCR_ADDR A:0x200eb50
y.create.l HWIO_PMIC_ARB_XPU_PRT19_SCR_ADDR A:0x200ebd0
y.create.l HWIO_PMIC_ARB_XPU_PRT20_SCR_ADDR A:0x200ec50
y.create.l HWIO_PMIC_ARB_XPU_PRT21_SCR_ADDR A:0x200ecd0
y.create.l HWIO_PMIC_ARB_XPU_PRT22_SCR_ADDR A:0x200ed50
y.create.l HWIO_PMIC_ARB_XPU_PRT23_SCR_ADDR A:0x200edd0
y.create.l HWIO_PMIC_ARB_XPU_PRT24_SCR_ADDR A:0x200ee50
y.create.l HWIO_PMIC_ARB_XPU_PRT0_MCR_ADDR A:0x200e254
y.create.l HWIO_PMIC_ARB_XPU_PRT1_MCR_ADDR A:0x200e2d4
y.create.l HWIO_PMIC_ARB_XPU_PRT2_MCR_ADDR A:0x200e354
y.create.l HWIO_PMIC_ARB_XPU_PRT3_MCR_ADDR A:0x200e3d4
y.create.l HWIO_PMIC_ARB_XPU_PRT4_MCR_ADDR A:0x200e454
y.create.l HWIO_PMIC_ARB_XPU_PRT5_MCR_ADDR A:0x200e4d4
y.create.l HWIO_PMIC_ARB_XPU_PRT6_MCR_ADDR A:0x200e554
y.create.l HWIO_PMIC_ARB_XPU_PRT7_MCR_ADDR A:0x200e5d4
y.create.l HWIO_PMIC_ARB_XPU_PRT8_MCR_ADDR A:0x200e654
y.create.l HWIO_PMIC_ARB_XPU_PRT9_MCR_ADDR A:0x200e6d4
y.create.l HWIO_PMIC_ARB_XPU_PRT10_MCR_ADDR A:0x200e754
y.create.l HWIO_PMIC_ARB_XPU_PRT11_MCR_ADDR A:0x200e7d4
y.create.l HWIO_PMIC_ARB_XPU_PRT12_MCR_ADDR A:0x200e854
y.create.l HWIO_PMIC_ARB_XPU_PRT13_MCR_ADDR A:0x200e8d4
y.create.l HWIO_PMIC_ARB_XPU_PRT14_MCR_ADDR A:0x200e954
y.create.l HWIO_PMIC_ARB_XPU_PRT15_MCR_ADDR A:0x200e9d4
y.create.l HWIO_PMIC_ARB_XPU_PRT16_MCR_ADDR A:0x200ea54
y.create.l HWIO_PMIC_ARB_XPU_PRT17_MCR_ADDR A:0x200ead4
y.create.l HWIO_PMIC_ARB_XPU_PRT18_MCR_ADDR A:0x200eb54
y.create.l HWIO_PMIC_ARB_XPU_PRT19_MCR_ADDR A:0x200ebd4
y.create.l HWIO_PMIC_ARB_XPU_PRT20_MCR_ADDR A:0x200ec54
y.create.l HWIO_PMIC_ARB_XPU_PRT21_MCR_ADDR A:0x200ecd4
y.create.l HWIO_PMIC_ARB_XPU_PRT22_MCR_ADDR A:0x200ed54
y.create.l HWIO_PMIC_ARB_XPU_PRT23_MCR_ADDR A:0x200edd4
y.create.l HWIO_PMIC_ARB_XPU_PRT24_MCR_ADDR A:0x200ee54
y.create.l HWIO_PMIC_ARB_XPU_PRT0_CNTL0_ADDR A:0x200e258
y.create.l HWIO_PMIC_ARB_XPU_PRT1_CNTL0_ADDR A:0x200e2d8
y.create.l HWIO_PMIC_ARB_XPU_PRT2_CNTL0_ADDR A:0x200e358
y.create.l HWIO_PMIC_ARB_XPU_PRT3_CNTL0_ADDR A:0x200e3d8
y.create.l HWIO_PMIC_ARB_XPU_PRT4_CNTL0_ADDR A:0x200e458
y.create.l HWIO_PMIC_ARB_XPU_PRT5_CNTL0_ADDR A:0x200e4d8
y.create.l HWIO_PMIC_ARB_XPU_PRT6_CNTL0_ADDR A:0x200e558
y.create.l HWIO_PMIC_ARB_XPU_PRT7_CNTL0_ADDR A:0x200e5d8
y.create.l HWIO_PMIC_ARB_XPU_PRT8_CNTL0_ADDR A:0x200e658
y.create.l HWIO_PMIC_ARB_XPU_PRT9_CNTL0_ADDR A:0x200e6d8
y.create.l HWIO_PMIC_ARB_XPU_PRT10_CNTL0_ADDR A:0x200e758
y.create.l HWIO_PMIC_ARB_XPU_PRT11_CNTL0_ADDR A:0x200e7d8
y.create.l HWIO_PMIC_ARB_XPU_PRT12_CNTL0_ADDR A:0x200e858
y.create.l HWIO_PMIC_ARB_XPU_PRT13_CNTL0_ADDR A:0x200e8d8
y.create.l HWIO_PMIC_ARB_XPU_PRT14_CNTL0_ADDR A:0x200e958
y.create.l HWIO_PMIC_ARB_XPU_PRT15_CNTL0_ADDR A:0x200e9d8
y.create.l HWIO_PMIC_ARB_XPU_PRT16_CNTL0_ADDR A:0x200ea58
y.create.l HWIO_PMIC_ARB_XPU_PRT17_CNTL0_ADDR A:0x200ead8
y.create.l HWIO_PMIC_ARB_XPU_PRT18_CNTL0_ADDR A:0x200eb58
y.create.l HWIO_PMIC_ARB_XPU_PRT19_CNTL0_ADDR A:0x200ebd8
y.create.l HWIO_PMIC_ARB_XPU_PRT20_CNTL0_ADDR A:0x200ec58
y.create.l HWIO_PMIC_ARB_XPU_PRT21_CNTL0_ADDR A:0x200ecd8
y.create.l HWIO_PMIC_ARB_XPU_PRT22_CNTL0_ADDR A:0x200ed58
y.create.l HWIO_PMIC_ARB_XPU_PRT23_CNTL0_ADDR A:0x200edd8
y.create.l HWIO_PMIC_ARB_XPU_PRT24_CNTL0_ADDR A:0x200ee58
y.create.l HWIO_PMIC_ARB_XPU_PRT0_CNTL1_ADDR A:0x200e25c
y.create.l HWIO_PMIC_ARB_XPU_PRT1_CNTL1_ADDR A:0x200e2dc
y.create.l HWIO_PMIC_ARB_XPU_PRT2_CNTL1_ADDR A:0x200e35c
y.create.l HWIO_PMIC_ARB_XPU_PRT3_CNTL1_ADDR A:0x200e3dc
y.create.l HWIO_PMIC_ARB_XPU_PRT4_CNTL1_ADDR A:0x200e45c
y.create.l HWIO_PMIC_ARB_XPU_PRT5_CNTL1_ADDR A:0x200e4dc
y.create.l HWIO_PMIC_ARB_XPU_PRT6_CNTL1_ADDR A:0x200e55c
y.create.l HWIO_PMIC_ARB_XPU_PRT7_CNTL1_ADDR A:0x200e5dc
y.create.l HWIO_PMIC_ARB_XPU_PRT8_CNTL1_ADDR A:0x200e65c
y.create.l HWIO_PMIC_ARB_XPU_PRT9_CNTL1_ADDR A:0x200e6dc
y.create.l HWIO_PMIC_ARB_XPU_PRT10_CNTL1_ADDR A:0x200e75c
y.create.l HWIO_PMIC_ARB_XPU_PRT11_CNTL1_ADDR A:0x200e7dc
y.create.l HWIO_PMIC_ARB_XPU_PRT12_CNTL1_ADDR A:0x200e85c
y.create.l HWIO_PMIC_ARB_XPU_PRT13_CNTL1_ADDR A:0x200e8dc
y.create.l HWIO_PMIC_ARB_XPU_PRT14_CNTL1_ADDR A:0x200e95c
y.create.l HWIO_PMIC_ARB_XPU_PRT15_CNTL1_ADDR A:0x200e9dc
y.create.l HWIO_PMIC_ARB_XPU_PRT16_CNTL1_ADDR A:0x200ea5c
y.create.l HWIO_PMIC_ARB_XPU_PRT17_CNTL1_ADDR A:0x200eadc
y.create.l HWIO_PMIC_ARB_XPU_PRT18_CNTL1_ADDR A:0x200eb5c
y.create.l HWIO_PMIC_ARB_XPU_PRT19_CNTL1_ADDR A:0x200ebdc
y.create.l HWIO_PMIC_ARB_XPU_PRT20_CNTL1_ADDR A:0x200ec5c
y.create.l HWIO_PMIC_ARB_XPU_PRT21_CNTL1_ADDR A:0x200ecdc
y.create.l HWIO_PMIC_ARB_XPU_PRT22_CNTL1_ADDR A:0x200ed5c
y.create.l HWIO_PMIC_ARB_XPU_PRT23_CNTL1_ADDR A:0x200eddc
y.create.l HWIO_PMIC_ARB_XPU_PRT24_CNTL1_ADDR A:0x200ee5c
y.create.l HWIO_PMIC_ARB_HW_VERSION_ADDR A:0x200f000
y.create.l HWIO_PMIC_ARB_MISC_CONFIG_ADDR A:0x200f004
y.create.l HWIO_PMIC_ARB_PVC_INTF_CTL_ADDR A:0x200f008
y.create.l HWIO_PMIC_ARB_PVC_INTF_STATUS_ADDR A:0x200f00c
y.create.l HWIO_PMIC_ARB_PRIORITIES0_ADDR A:0x200f100
y.create.l HWIO_PMIC_ARB_PRIORITIES1_ADDR A:0x200f104
y.create.l HWIO_PMIC_ARB_PRIORITIES2_ADDR A:0x200f108
y.create.l HWIO_PMIC_ARB_PRIORITIES3_ADDR A:0x200f10c
y.create.l HWIO_PMIC_ARB_PRIORITIES4_ADDR A:0x200f110
y.create.l HWIO_PMIC_ARB_PRIORITIES5_ADDR A:0x200f114
y.create.l HWIO_PMIC_ARB_PRIORITIES6_ADDR A:0x200f118
y.create.l HWIO_PMIC_ARB_PVC_PORT0_CTL_ADDR A:0x200f200
y.create.l HWIO_PMIC_ARB_PVC_PORT1_CTL_ADDR A:0x200f204
y.create.l HWIO_PMIC_ARB_PVC_PORT2_CTL_ADDR A:0x200f208
y.create.l HWIO_PMIC_ARB_PVC_PORT3_CTL_ADDR A:0x200f20c
y.create.l HWIO_PMIC_ARB_PVC_PORT4_CTL_ADDR A:0x200f210
y.create.l HWIO_PMIC_ARB_PVC_PORT5_CTL_ADDR A:0x200f214
y.create.l HWIO_PMIC_ARB_PVC_PORT0_STATUS_ADDR A:0x200f280
y.create.l HWIO_PMIC_ARB_PVC_PORT1_STATUS_ADDR A:0x200f284
y.create.l HWIO_PMIC_ARB_PVC_PORT2_STATUS_ADDR A:0x200f288
y.create.l HWIO_PMIC_ARB_PVC_PORT3_STATUS_ADDR A:0x200f28c
y.create.l HWIO_PMIC_ARB_PVC_PORT4_STATUS_ADDR A:0x200f290
y.create.l HWIO_PMIC_ARB_PVC_PORT5_STATUS_ADDR A:0x200f294
y.create.l HWIO_PMIC_ARB_PVC0_ADDR0_ADDR A:0x200f400
y.create.l HWIO_PMIC_ARB_PVC0_ADDR1_ADDR A:0x200f404
y.create.l HWIO_PMIC_ARB_PVC0_ADDR2_ADDR A:0x200f408
y.create.l HWIO_PMIC_ARB_PVC0_ADDR3_ADDR A:0x200f40c
y.create.l HWIO_PMIC_ARB_PVC1_ADDR0_ADDR A:0x200f420
y.create.l HWIO_PMIC_ARB_PVC1_ADDR1_ADDR A:0x200f424
y.create.l HWIO_PMIC_ARB_PVC1_ADDR2_ADDR A:0x200f428
y.create.l HWIO_PMIC_ARB_PVC1_ADDR3_ADDR A:0x200f42c
y.create.l HWIO_PMIC_ARB_PVC2_ADDR0_ADDR A:0x200f440
y.create.l HWIO_PMIC_ARB_PVC2_ADDR1_ADDR A:0x200f444
y.create.l HWIO_PMIC_ARB_PVC2_ADDR2_ADDR A:0x200f448
y.create.l HWIO_PMIC_ARB_PVC2_ADDR3_ADDR A:0x200f44c
y.create.l HWIO_PMIC_ARB_PVC3_ADDR0_ADDR A:0x200f460
y.create.l HWIO_PMIC_ARB_PVC3_ADDR1_ADDR A:0x200f464
y.create.l HWIO_PMIC_ARB_PVC3_ADDR2_ADDR A:0x200f468
y.create.l HWIO_PMIC_ARB_PVC3_ADDR3_ADDR A:0x200f46c
y.create.l HWIO_PMIC_ARB_PVC4_ADDR0_ADDR A:0x200f480
y.create.l HWIO_PMIC_ARB_PVC4_ADDR1_ADDR A:0x200f484
y.create.l HWIO_PMIC_ARB_PVC4_ADDR2_ADDR A:0x200f488
y.create.l HWIO_PMIC_ARB_PVC4_ADDR3_ADDR A:0x200f48c
y.create.l HWIO_PMIC_ARB_PVC5_ADDR0_ADDR A:0x200f4a0
y.create.l HWIO_PMIC_ARB_PVC5_ADDR1_ADDR A:0x200f4a4
y.create.l HWIO_PMIC_ARB_PVC5_ADDR2_ADDR A:0x200f4a8
y.create.l HWIO_PMIC_ARB_PVC5_ADDR3_ADDR A:0x200f4ac
y.create.l HWIO_PMIC_ARB_REG_CHNL0_ADDR A:0x200f800
y.create.l HWIO_PMIC_ARB_REG_CHNL1_ADDR A:0x200f804
y.create.l HWIO_PMIC_ARB_REG_CHNL2_ADDR A:0x200f808
y.create.l HWIO_PMIC_ARB_REG_CHNL3_ADDR A:0x200f80c
y.create.l HWIO_PMIC_ARB_REG_CHNL4_ADDR A:0x200f810
y.create.l HWIO_PMIC_ARB_REG_CHNL5_ADDR A:0x200f814
y.create.l HWIO_PMIC_ARB_REG_CHNL6_ADDR A:0x200f818
y.create.l HWIO_PMIC_ARB_REG_CHNL7_ADDR A:0x200f81c
y.create.l HWIO_PMIC_ARB_REG_CHNL8_ADDR A:0x200f820
y.create.l HWIO_PMIC_ARB_REG_CHNL9_ADDR A:0x200f824
y.create.l HWIO_PMIC_ARB_REG_CHNL10_ADDR A:0x200f828
y.create.l HWIO_PMIC_ARB_REG_CHNL11_ADDR A:0x200f82c
y.create.l HWIO_PMIC_ARB_REG_CHNL12_ADDR A:0x200f830
y.create.l HWIO_PMIC_ARB_REG_CHNL13_ADDR A:0x200f834
y.create.l HWIO_PMIC_ARB_REG_CHNL14_ADDR A:0x200f838
y.create.l HWIO_PMIC_ARB_REG_CHNL15_ADDR A:0x200f83c
y.create.l HWIO_PMIC_ARB_REG_CHNL16_ADDR A:0x200f840
y.create.l HWIO_PMIC_ARB_REG_CHNL17_ADDR A:0x200f844
y.create.l HWIO_PMIC_ARB_REG_CHNL18_ADDR A:0x200f848
y.create.l HWIO_PMIC_ARB_REG_CHNL19_ADDR A:0x200f84c
y.create.l HWIO_PMIC_ARB_REG_CHNL20_ADDR A:0x200f850
y.create.l HWIO_PMIC_ARB_REG_CHNL21_ADDR A:0x200f854
y.create.l HWIO_PMIC_ARB_REG_CHNL22_ADDR A:0x200f858
y.create.l HWIO_PMIC_ARB_REG_CHNL23_ADDR A:0x200f85c
y.create.l HWIO_PMIC_ARB_REG_CHNL24_ADDR A:0x200f860
y.create.l HWIO_PMIC_ARB_REG_CHNL25_ADDR A:0x200f864
y.create.l HWIO_PMIC_ARB_REG_CHNL26_ADDR A:0x200f868
y.create.l HWIO_PMIC_ARB_REG_CHNL27_ADDR A:0x200f86c
y.create.l HWIO_PMIC_ARB_REG_CHNL28_ADDR A:0x200f870
y.create.l HWIO_PMIC_ARB_REG_CHNL29_ADDR A:0x200f874
y.create.l HWIO_PMIC_ARB_REG_CHNL30_ADDR A:0x200f878
y.create.l HWIO_PMIC_ARB_REG_CHNL31_ADDR A:0x200f87c
y.create.l HWIO_PMIC_ARB_REG_CHNL32_ADDR A:0x200f880
y.create.l HWIO_PMIC_ARB_REG_CHNL33_ADDR A:0x200f884
y.create.l HWIO_PMIC_ARB_REG_CHNL34_ADDR A:0x200f888
y.create.l HWIO_PMIC_ARB_REG_CHNL35_ADDR A:0x200f88c
y.create.l HWIO_PMIC_ARB_REG_CHNL36_ADDR A:0x200f890
y.create.l HWIO_PMIC_ARB_REG_CHNL37_ADDR A:0x200f894
y.create.l HWIO_PMIC_ARB_REG_CHNL38_ADDR A:0x200f898
y.create.l HWIO_PMIC_ARB_REG_CHNL39_ADDR A:0x200f89c
y.create.l HWIO_PMIC_ARB_REG_CHNL40_ADDR A:0x200f8a0
y.create.l HWIO_PMIC_ARB_REG_CHNL41_ADDR A:0x200f8a4
y.create.l HWIO_PMIC_ARB_REG_CHNL42_ADDR A:0x200f8a8
y.create.l HWIO_PMIC_ARB_REG_CHNL43_ADDR A:0x200f8ac
y.create.l HWIO_PMIC_ARB_REG_CHNL44_ADDR A:0x200f8b0
y.create.l HWIO_PMIC_ARB_REG_CHNL45_ADDR A:0x200f8b4
y.create.l HWIO_PMIC_ARB_REG_CHNL46_ADDR A:0x200f8b8
y.create.l HWIO_PMIC_ARB_REG_CHNL47_ADDR A:0x200f8bc
y.create.l HWIO_PMIC_ARB_REG_CHNL48_ADDR A:0x200f8c0
y.create.l HWIO_PMIC_ARB_REG_CHNL49_ADDR A:0x200f8c4
y.create.l HWIO_PMIC_ARB_REG_CHNL50_ADDR A:0x200f8c8
y.create.l HWIO_PMIC_ARB_REG_CHNL51_ADDR A:0x200f8cc
y.create.l HWIO_PMIC_ARB_REG_CHNL52_ADDR A:0x200f8d0
y.create.l HWIO_PMIC_ARB_REG_CHNL53_ADDR A:0x200f8d4
y.create.l HWIO_PMIC_ARB_REG_CHNL54_ADDR A:0x200f8d8
y.create.l HWIO_PMIC_ARB_REG_CHNL55_ADDR A:0x200f8dc
y.create.l HWIO_PMIC_ARB_REG_CHNL56_ADDR A:0x200f8e0
y.create.l HWIO_PMIC_ARB_REG_CHNL57_ADDR A:0x200f8e4
y.create.l HWIO_PMIC_ARB_REG_CHNL58_ADDR A:0x200f8e8
y.create.l HWIO_PMIC_ARB_REG_CHNL59_ADDR A:0x200f8ec
y.create.l HWIO_PMIC_ARB_REG_CHNL60_ADDR A:0x200f8f0
y.create.l HWIO_PMIC_ARB_REG_CHNL61_ADDR A:0x200f8f4
y.create.l HWIO_PMIC_ARB_REG_CHNL62_ADDR A:0x200f8f8
y.create.l HWIO_PMIC_ARB_REG_CHNL63_ADDR A:0x200f8fc
y.create.l HWIO_PMIC_ARB_REG_CHNL64_ADDR A:0x200f900
y.create.l HWIO_PMIC_ARB_REG_CHNL65_ADDR A:0x200f904
y.create.l HWIO_PMIC_ARB_REG_CHNL66_ADDR A:0x200f908
y.create.l HWIO_PMIC_ARB_REG_CHNL67_ADDR A:0x200f90c
y.create.l HWIO_PMIC_ARB_REG_CHNL68_ADDR A:0x200f910
y.create.l HWIO_PMIC_ARB_REG_CHNL69_ADDR A:0x200f914
y.create.l HWIO_PMIC_ARB_REG_CHNL70_ADDR A:0x200f918
y.create.l HWIO_PMIC_ARB_REG_CHNL71_ADDR A:0x200f91c
y.create.l HWIO_PMIC_ARB_REG_CHNL72_ADDR A:0x200f920
y.create.l HWIO_PMIC_ARB_REG_CHNL73_ADDR A:0x200f924
y.create.l HWIO_PMIC_ARB_REG_CHNL74_ADDR A:0x200f928
y.create.l HWIO_PMIC_ARB_REG_CHNL75_ADDR A:0x200f92c
y.create.l HWIO_PMIC_ARB_REG_CHNL76_ADDR A:0x200f930
y.create.l HWIO_PMIC_ARB_REG_CHNL77_ADDR A:0x200f934
y.create.l HWIO_PMIC_ARB_REG_CHNL78_ADDR A:0x200f938
y.create.l HWIO_PMIC_ARB_REG_CHNL79_ADDR A:0x200f93c
y.create.l HWIO_PMIC_ARB_REG_CHNL80_ADDR A:0x200f940
y.create.l HWIO_PMIC_ARB_REG_CHNL81_ADDR A:0x200f944
y.create.l HWIO_PMIC_ARB_REG_CHNL82_ADDR A:0x200f948
y.create.l HWIO_PMIC_ARB_REG_CHNL83_ADDR A:0x200f94c
y.create.l HWIO_PMIC_ARB_REG_CHNL84_ADDR A:0x200f950
y.create.l HWIO_PMIC_ARB_REG_CHNL85_ADDR A:0x200f954
y.create.l HWIO_PMIC_ARB_REG_CHNL86_ADDR A:0x200f958
y.create.l HWIO_PMIC_ARB_REG_CHNL87_ADDR A:0x200f95c
y.create.l HWIO_PMIC_ARB_REG_CHNL88_ADDR A:0x200f960
y.create.l HWIO_PMIC_ARB_REG_CHNL89_ADDR A:0x200f964
y.create.l HWIO_PMIC_ARB_REG_CHNL90_ADDR A:0x200f968
y.create.l HWIO_PMIC_ARB_REG_CHNL91_ADDR A:0x200f96c
y.create.l HWIO_PMIC_ARB_REG_CHNL92_ADDR A:0x200f970
y.create.l HWIO_PMIC_ARB_REG_CHNL93_ADDR A:0x200f974
y.create.l HWIO_PMIC_ARB_REG_CHNL94_ADDR A:0x200f978
y.create.l HWIO_PMIC_ARB_REG_CHNL95_ADDR A:0x200f97c
y.create.l HWIO_PMIC_ARB_REG_CHNL96_ADDR A:0x200f980
y.create.l HWIO_PMIC_ARB_REG_CHNL97_ADDR A:0x200f984
y.create.l HWIO_PMIC_ARB_REG_CHNL98_ADDR A:0x200f988
y.create.l HWIO_PMIC_ARB_REG_CHNL99_ADDR A:0x200f98c
y.create.l HWIO_PMIC_ARB_REG_CHNL100_ADDR A:0x200f990
y.create.l HWIO_PMIC_ARB_REG_CHNL101_ADDR A:0x200f994
y.create.l HWIO_PMIC_ARB_REG_CHNL102_ADDR A:0x200f998
y.create.l HWIO_PMIC_ARB_REG_CHNL103_ADDR A:0x200f99c
y.create.l HWIO_PMIC_ARB_REG_CHNL104_ADDR A:0x200f9a0
y.create.l HWIO_PMIC_ARB_REG_CHNL105_ADDR A:0x200f9a4
y.create.l HWIO_PMIC_ARB_REG_CHNL106_ADDR A:0x200f9a8
y.create.l HWIO_PMIC_ARB_REG_CHNL107_ADDR A:0x200f9ac
y.create.l HWIO_PMIC_ARB_REG_CHNL108_ADDR A:0x200f9b0
y.create.l HWIO_PMIC_ARB_REG_CHNL109_ADDR A:0x200f9b4
y.create.l HWIO_PMIC_ARB_REG_CHNL110_ADDR A:0x200f9b8
y.create.l HWIO_PMIC_ARB_REG_CHNL111_ADDR A:0x200f9bc
y.create.l HWIO_PMIC_ARB_REG_CHNL112_ADDR A:0x200f9c0
y.create.l HWIO_PMIC_ARB_REG_CHNL113_ADDR A:0x200f9c4
y.create.l HWIO_PMIC_ARB_REG_CHNL114_ADDR A:0x200f9c8
y.create.l HWIO_PMIC_ARB_REG_CHNL115_ADDR A:0x200f9cc
y.create.l HWIO_PMIC_ARB_REG_CHNL116_ADDR A:0x200f9d0
y.create.l HWIO_PMIC_ARB_REG_CHNL117_ADDR A:0x200f9d4
y.create.l HWIO_PMIC_ARB_REG_CHNL118_ADDR A:0x200f9d8
y.create.l HWIO_PMIC_ARB_REG_CHNL119_ADDR A:0x200f9dc
y.create.l HWIO_PMIC_ARB_REG_CHNL120_ADDR A:0x200f9e0
y.create.l HWIO_PMIC_ARB_REG_CHNL121_ADDR A:0x200f9e4
y.create.l HWIO_PMIC_ARB_REG_CHNL122_ADDR A:0x200f9e8
y.create.l HWIO_PMIC_ARB_REG_CHNL123_ADDR A:0x200f9ec
y.create.l HWIO_PMIC_ARB_REG_CHNL124_ADDR A:0x200f9f0
y.create.l HWIO_PMIC_ARB_REG_CHNL125_ADDR A:0x200f9f4
y.create.l HWIO_PMIC_ARB_REG_CHNL126_ADDR A:0x200f9f8
y.create.l HWIO_PMIC_ARB_REG_CHNL127_ADDR A:0x200f9fc
y.create.l HWIO_PMIC_ARB_REG_CHNL128_ADDR A:0x200fa00
y.create.l HWIO_PMIC_ARB_REG_CHNL129_ADDR A:0x200fa04
y.create.l HWIO_PMIC_ARB_REG_CHNL130_ADDR A:0x200fa08
y.create.l HWIO_PMIC_ARB_REG_CHNL131_ADDR A:0x200fa0c
y.create.l HWIO_PMIC_ARB_REG_CHNL132_ADDR A:0x200fa10
y.create.l HWIO_PMIC_ARB_REG_CHNL133_ADDR A:0x200fa14
y.create.l HWIO_PMIC_ARB_REG_CHNL134_ADDR A:0x200fa18
y.create.l HWIO_PMIC_ARB_REG_CHNL135_ADDR A:0x200fa1c
y.create.l HWIO_PMIC_ARB_REG_CHNL136_ADDR A:0x200fa20
y.create.l HWIO_PMIC_ARB_REG_CHNL137_ADDR A:0x200fa24
y.create.l HWIO_PMIC_ARB_REG_CHNL138_ADDR A:0x200fa28
y.create.l HWIO_PMIC_ARB_REG_CHNL139_ADDR A:0x200fa2c
y.create.l HWIO_PMIC_ARB_REG_CHNL140_ADDR A:0x200fa30
y.create.l HWIO_PMIC_ARB_REG_CHNL141_ADDR A:0x200fa34
y.create.l HWIO_PMIC_ARB_REG_CHNL142_ADDR A:0x200fa38
y.create.l HWIO_PMIC_ARB_REG_CHNL143_ADDR A:0x200fa3c
y.create.l HWIO_PMIC_ARB_REG_CHNL144_ADDR A:0x200fa40
y.create.l HWIO_PMIC_ARB_REG_CHNL145_ADDR A:0x200fa44
y.create.l HWIO_PMIC_ARB_REG_CHNL146_ADDR A:0x200fa48
y.create.l HWIO_PMIC_ARB_REG_CHNL147_ADDR A:0x200fa4c
y.create.l HWIO_PMIC_ARB_REG_CHNL148_ADDR A:0x200fa50
y.create.l HWIO_PMIC_ARB_REG_CHNL149_ADDR A:0x200fa54
y.create.l HWIO_PMIC_ARB_REG_CHNL150_ADDR A:0x200fa58
y.create.l HWIO_PMIC_ARB_REG_CHNL151_ADDR A:0x200fa5c
y.create.l HWIO_PMIC_ARB_REG_CHNL152_ADDR A:0x200fa60
y.create.l HWIO_PMIC_ARB_REG_CHNL153_ADDR A:0x200fa64
y.create.l HWIO_PMIC_ARB_REG_CHNL154_ADDR A:0x200fa68
y.create.l HWIO_PMIC_ARB_REG_CHNL155_ADDR A:0x200fa6c
y.create.l HWIO_PMIC_ARB_REG_CHNL156_ADDR A:0x200fa70
y.create.l HWIO_PMIC_ARB_REG_CHNL157_ADDR A:0x200fa74
y.create.l HWIO_PMIC_ARB_REG_CHNL158_ADDR A:0x200fa78
y.create.l HWIO_PMIC_ARB_REG_CHNL159_ADDR A:0x200fa7c
y.create.l HWIO_PMIC_ARB_REG_CHNL160_ADDR A:0x200fa80
y.create.l HWIO_PMIC_ARB_REG_CHNL161_ADDR A:0x200fa84
y.create.l HWIO_PMIC_ARB_REG_CHNL162_ADDR A:0x200fa88
y.create.l HWIO_PMIC_ARB_REG_CHNL163_ADDR A:0x200fa8c
y.create.l HWIO_PMIC_ARB_REG_CHNL164_ADDR A:0x200fa90
y.create.l HWIO_PMIC_ARB_REG_CHNL165_ADDR A:0x200fa94
y.create.l HWIO_PMIC_ARB_REG_CHNL166_ADDR A:0x200fa98
y.create.l HWIO_PMIC_ARB_REG_CHNL167_ADDR A:0x200fa9c
y.create.l HWIO_PMIC_ARB_REG_CHNL168_ADDR A:0x200faa0
y.create.l HWIO_PMIC_ARB_REG_CHNL169_ADDR A:0x200faa4
y.create.l HWIO_PMIC_ARB_REG_CHNL170_ADDR A:0x200faa8
y.create.l HWIO_PMIC_ARB_REG_CHNL171_ADDR A:0x200faac
y.create.l HWIO_PMIC_ARB_REG_CHNL172_ADDR A:0x200fab0
y.create.l HWIO_PMIC_ARB_REG_CHNL173_ADDR A:0x200fab4
y.create.l HWIO_PMIC_ARB_REG_CHNL174_ADDR A:0x200fab8
y.create.l HWIO_PMIC_ARB_REG_CHNL175_ADDR A:0x200fabc
y.create.l HWIO_PMIC_ARB_REG_CHNL176_ADDR A:0x200fac0
y.create.l HWIO_PMIC_ARB_REG_CHNL177_ADDR A:0x200fac4
y.create.l HWIO_PMIC_ARB_REG_CHNL178_ADDR A:0x200fac8
y.create.l HWIO_PMIC_ARB_REG_CHNL179_ADDR A:0x200facc
y.create.l HWIO_PMIC_ARB_REG_CHNL180_ADDR A:0x200fad0
y.create.l HWIO_PMIC_ARB_REG_CHNL181_ADDR A:0x200fad4
y.create.l HWIO_PMIC_ARB_REG_CHNL182_ADDR A:0x200fad8
y.create.l HWIO_PMIC_ARB_REG_CHNL183_ADDR A:0x200fadc
y.create.l HWIO_PMIC_ARB_REG_CHNL184_ADDR A:0x200fae0
y.create.l HWIO_PMIC_ARB_REG_CHNL185_ADDR A:0x200fae4
y.create.l HWIO_PMIC_ARB_REG_CHNL186_ADDR A:0x200fae8
y.create.l HWIO_PMIC_ARB_REG_CHNL187_ADDR A:0x200faec
y.create.l HWIO_PMIC_ARB_REG_CHNL188_ADDR A:0x200faf0
y.create.l HWIO_PMIC_ARB_REG_CHNL189_ADDR A:0x200faf4
y.create.l HWIO_PMIC_ARB_REG_CHNL190_ADDR A:0x200faf8
y.create.l HWIO_PMIC_ARB_REG_CHNL191_ADDR A:0x200fafc
y.create.l HWIO_PMIC_ARB_REG_CHNL192_ADDR A:0x200fb00
y.create.l HWIO_PMIC_ARB_REG_CHNL193_ADDR A:0x200fb04
y.create.l HWIO_PMIC_ARB_REG_CHNL194_ADDR A:0x200fb08
y.create.l HWIO_PMIC_ARB_REG_CHNL195_ADDR A:0x200fb0c
y.create.l HWIO_PMIC_ARB_REG_CHNL196_ADDR A:0x200fb10
y.create.l HWIO_PMIC_ARB_REG_CHNL197_ADDR A:0x200fb14
y.create.l HWIO_PMIC_ARB_REG_CHNL198_ADDR A:0x200fb18
y.create.l HWIO_PMIC_ARB_REG_CHNL199_ADDR A:0x200fb1c
y.create.l HWIO_PMIC_ARB_REG_CHNL200_ADDR A:0x200fb20
y.create.l HWIO_PMIC_ARB_REG_CHNL201_ADDR A:0x200fb24
y.create.l HWIO_PMIC_ARB_REG_CHNL202_ADDR A:0x200fb28
y.create.l HWIO_PMIC_ARB_REG_CHNL203_ADDR A:0x200fb2c
y.create.l HWIO_PMIC_ARB_REG_CHNL204_ADDR A:0x200fb30
y.create.l HWIO_PMIC_ARB_REG_CHNL205_ADDR A:0x200fb34
y.create.l HWIO_PMIC_ARB_REG_CHNL206_ADDR A:0x200fb38
y.create.l HWIO_PMIC_ARB_REG_CHNL207_ADDR A:0x200fb3c
y.create.l HWIO_PMIC_ARB_REG_CHNL208_ADDR A:0x200fb40
y.create.l HWIO_PMIC_ARB_REG_CHNL209_ADDR A:0x200fb44
y.create.l HWIO_PMIC_ARB_REG_CHNL210_ADDR A:0x200fb48
y.create.l HWIO_PMIC_ARB_REG_CHNL211_ADDR A:0x200fb4c
y.create.l HWIO_PMIC_ARB_REG_CHNL212_ADDR A:0x200fb50
y.create.l HWIO_PMIC_ARB_REG_CHNL213_ADDR A:0x200fb54
y.create.l HWIO_PMIC_ARB_REG_CHNL214_ADDR A:0x200fb58
y.create.l HWIO_PMIC_ARB_REG_CHNL215_ADDR A:0x200fb5c
y.create.l HWIO_PMIC_ARB_REG_CHNL216_ADDR A:0x200fb60
y.create.l HWIO_PMIC_ARB_REG_CHNL217_ADDR A:0x200fb64
y.create.l HWIO_PMIC_ARB_REG_CHNL218_ADDR A:0x200fb68
y.create.l HWIO_PMIC_ARB_REG_CHNL219_ADDR A:0x200fb6c
y.create.l HWIO_PMIC_ARB_REG_CHNL220_ADDR A:0x200fb70
y.create.l HWIO_PMIC_ARB_REG_CHNL221_ADDR A:0x200fb74
y.create.l HWIO_PMIC_ARB_REG_CHNL222_ADDR A:0x200fb78
y.create.l HWIO_PMIC_ARB_REG_CHNL223_ADDR A:0x200fb7c
y.create.l HWIO_PMIC_ARB_REG_CHNL224_ADDR A:0x200fb80
y.create.l HWIO_PMIC_ARB_REG_CHNL225_ADDR A:0x200fb84
y.create.l HWIO_PMIC_ARB_REG_CHNL226_ADDR A:0x200fb88
y.create.l HWIO_PMIC_ARB_REG_CHNL227_ADDR A:0x200fb8c
y.create.l HWIO_PMIC_ARB_REG_CHNL228_ADDR A:0x200fb90
y.create.l HWIO_PMIC_ARB_REG_CHNL229_ADDR A:0x200fb94
y.create.l HWIO_PMIC_ARB_REG_CHNL230_ADDR A:0x200fb98
y.create.l HWIO_PMIC_ARB_REG_CHNL231_ADDR A:0x200fb9c
y.create.l HWIO_PMIC_ARB_REG_CHNL232_ADDR A:0x200fba0
y.create.l HWIO_PMIC_ARB_REG_CHNL233_ADDR A:0x200fba4
y.create.l HWIO_PMIC_ARB_REG_CHNL234_ADDR A:0x200fba8
y.create.l HWIO_PMIC_ARB_REG_CHNL235_ADDR A:0x200fbac
y.create.l HWIO_PMIC_ARB_REG_CHNL236_ADDR A:0x200fbb0
y.create.l HWIO_PMIC_ARB_REG_CHNL237_ADDR A:0x200fbb4
y.create.l HWIO_PMIC_ARB_REG_CHNL238_ADDR A:0x200fbb8
y.create.l HWIO_PMIC_ARB_REG_CHNL239_ADDR A:0x200fbbc
y.create.l HWIO_PMIC_ARB_REG_CHNL240_ADDR A:0x200fbc0
y.create.l HWIO_PMIC_ARB_REG_CHNL241_ADDR A:0x200fbc4
y.create.l HWIO_PMIC_ARB_REG_CHNL242_ADDR A:0x200fbc8
y.create.l HWIO_PMIC_ARB_REG_CHNL243_ADDR A:0x200fbcc
y.create.l HWIO_PMIC_ARB_REG_CHNL244_ADDR A:0x200fbd0
y.create.l HWIO_PMIC_ARB_REG_CHNL245_ADDR A:0x200fbd4
y.create.l HWIO_PMIC_ARB_REG_CHNL246_ADDR A:0x200fbd8
y.create.l HWIO_PMIC_ARB_REG_CHNL247_ADDR A:0x200fbdc
y.create.l HWIO_PMIC_ARB_REG_CHNL248_ADDR A:0x200fbe0
y.create.l HWIO_PMIC_ARB_REG_CHNL249_ADDR A:0x200fbe4
y.create.l HWIO_PMIC_ARB_REG_CHNL250_ADDR A:0x200fbe8
y.create.l HWIO_PMIC_ARB_REG_CHNL251_ADDR A:0x200fbec
y.create.l HWIO_PMIC_ARB_REG_CHNL252_ADDR A:0x200fbf0
y.create.l HWIO_PMIC_ARB_REG_CHNL253_ADDR A:0x200fbf4
y.create.l HWIO_PMIC_ARB_REG_CHNL254_ADDR A:0x200fbf8
y.create.l HWIO_PMIC_ARB_REG_CHNL255_ADDR A:0x200fbfc
y.create.l HWIO_PMIC_ARB0_CHNL0_CMD_ADDR A:0x2400000
y.create.l HWIO_PMIC_ARB0_CHNL1_CMD_ADDR A:0x2408000
y.create.l HWIO_PMIC_ARB0_CHNL2_CMD_ADDR A:0x2410000
y.create.l HWIO_PMIC_ARB0_CHNL3_CMD_ADDR A:0x2418000
y.create.l HWIO_PMIC_ARB0_CHNL4_CMD_ADDR A:0x2420000
y.create.l HWIO_PMIC_ARB0_CHNL5_CMD_ADDR A:0x2428000
y.create.l HWIO_PMIC_ARB0_CHNL6_CMD_ADDR A:0x2430000
y.create.l HWIO_PMIC_ARB0_CHNL7_CMD_ADDR A:0x2438000
y.create.l HWIO_PMIC_ARB0_CHNL8_CMD_ADDR A:0x2440000
y.create.l HWIO_PMIC_ARB0_CHNL9_CMD_ADDR A:0x2448000
y.create.l HWIO_PMIC_ARB0_CHNL10_CMD_ADDR A:0x2450000
y.create.l HWIO_PMIC_ARB0_CHNL11_CMD_ADDR A:0x2458000
y.create.l HWIO_PMIC_ARB0_CHNL12_CMD_ADDR A:0x2460000
y.create.l HWIO_PMIC_ARB0_CHNL13_CMD_ADDR A:0x2468000
y.create.l HWIO_PMIC_ARB0_CHNL14_CMD_ADDR A:0x2470000
y.create.l HWIO_PMIC_ARB0_CHNL15_CMD_ADDR A:0x2478000
y.create.l HWIO_PMIC_ARB0_CHNL16_CMD_ADDR A:0x2480000
y.create.l HWIO_PMIC_ARB0_CHNL17_CMD_ADDR A:0x2488000
y.create.l HWIO_PMIC_ARB0_CHNL18_CMD_ADDR A:0x2490000
y.create.l HWIO_PMIC_ARB0_CHNL19_CMD_ADDR A:0x2498000
y.create.l HWIO_PMIC_ARB0_CHNL20_CMD_ADDR A:0x24a0000
y.create.l HWIO_PMIC_ARB0_CHNL21_CMD_ADDR A:0x24a8000
y.create.l HWIO_PMIC_ARB0_CHNL22_CMD_ADDR A:0x24b0000
y.create.l HWIO_PMIC_ARB0_CHNL23_CMD_ADDR A:0x24b8000
y.create.l HWIO_PMIC_ARB0_CHNL24_CMD_ADDR A:0x24c0000
y.create.l HWIO_PMIC_ARB0_CHNL25_CMD_ADDR A:0x24c8000
y.create.l HWIO_PMIC_ARB0_CHNL26_CMD_ADDR A:0x24d0000
y.create.l HWIO_PMIC_ARB0_CHNL27_CMD_ADDR A:0x24d8000
y.create.l HWIO_PMIC_ARB0_CHNL28_CMD_ADDR A:0x24e0000
y.create.l HWIO_PMIC_ARB0_CHNL29_CMD_ADDR A:0x24e8000
y.create.l HWIO_PMIC_ARB0_CHNL30_CMD_ADDR A:0x24f0000
y.create.l HWIO_PMIC_ARB0_CHNL31_CMD_ADDR A:0x24f8000
y.create.l HWIO_PMIC_ARB0_CHNL32_CMD_ADDR A:0x2500000
y.create.l HWIO_PMIC_ARB0_CHNL33_CMD_ADDR A:0x2508000
y.create.l HWIO_PMIC_ARB0_CHNL34_CMD_ADDR A:0x2510000
y.create.l HWIO_PMIC_ARB0_CHNL35_CMD_ADDR A:0x2518000
y.create.l HWIO_PMIC_ARB0_CHNL36_CMD_ADDR A:0x2520000
y.create.l HWIO_PMIC_ARB0_CHNL37_CMD_ADDR A:0x2528000
y.create.l HWIO_PMIC_ARB0_CHNL38_CMD_ADDR A:0x2530000
y.create.l HWIO_PMIC_ARB0_CHNL39_CMD_ADDR A:0x2538000
y.create.l HWIO_PMIC_ARB0_CHNL40_CMD_ADDR A:0x2540000
y.create.l HWIO_PMIC_ARB0_CHNL41_CMD_ADDR A:0x2548000
y.create.l HWIO_PMIC_ARB0_CHNL42_CMD_ADDR A:0x2550000
y.create.l HWIO_PMIC_ARB0_CHNL43_CMD_ADDR A:0x2558000
y.create.l HWIO_PMIC_ARB0_CHNL44_CMD_ADDR A:0x2560000
y.create.l HWIO_PMIC_ARB0_CHNL45_CMD_ADDR A:0x2568000
y.create.l HWIO_PMIC_ARB0_CHNL46_CMD_ADDR A:0x2570000
y.create.l HWIO_PMIC_ARB0_CHNL47_CMD_ADDR A:0x2578000
y.create.l HWIO_PMIC_ARB0_CHNL48_CMD_ADDR A:0x2580000
y.create.l HWIO_PMIC_ARB0_CHNL49_CMD_ADDR A:0x2588000
y.create.l HWIO_PMIC_ARB0_CHNL50_CMD_ADDR A:0x2590000
y.create.l HWIO_PMIC_ARB0_CHNL51_CMD_ADDR A:0x2598000
y.create.l HWIO_PMIC_ARB0_CHNL52_CMD_ADDR A:0x25a0000
y.create.l HWIO_PMIC_ARB0_CHNL53_CMD_ADDR A:0x25a8000
y.create.l HWIO_PMIC_ARB0_CHNL54_CMD_ADDR A:0x25b0000
y.create.l HWIO_PMIC_ARB0_CHNL55_CMD_ADDR A:0x25b8000
y.create.l HWIO_PMIC_ARB0_CHNL56_CMD_ADDR A:0x25c0000
y.create.l HWIO_PMIC_ARB0_CHNL57_CMD_ADDR A:0x25c8000
y.create.l HWIO_PMIC_ARB0_CHNL58_CMD_ADDR A:0x25d0000
y.create.l HWIO_PMIC_ARB0_CHNL59_CMD_ADDR A:0x25d8000
y.create.l HWIO_PMIC_ARB0_CHNL60_CMD_ADDR A:0x25e0000
y.create.l HWIO_PMIC_ARB0_CHNL61_CMD_ADDR A:0x25e8000
y.create.l HWIO_PMIC_ARB0_CHNL62_CMD_ADDR A:0x25f0000
y.create.l HWIO_PMIC_ARB0_CHNL63_CMD_ADDR A:0x25f8000
y.create.l HWIO_PMIC_ARB0_CHNL64_CMD_ADDR A:0x2600000
y.create.l HWIO_PMIC_ARB0_CHNL65_CMD_ADDR A:0x2608000
y.create.l HWIO_PMIC_ARB0_CHNL66_CMD_ADDR A:0x2610000
y.create.l HWIO_PMIC_ARB0_CHNL67_CMD_ADDR A:0x2618000
y.create.l HWIO_PMIC_ARB0_CHNL68_CMD_ADDR A:0x2620000
y.create.l HWIO_PMIC_ARB0_CHNL69_CMD_ADDR A:0x2628000
y.create.l HWIO_PMIC_ARB0_CHNL70_CMD_ADDR A:0x2630000
y.create.l HWIO_PMIC_ARB0_CHNL71_CMD_ADDR A:0x2638000
y.create.l HWIO_PMIC_ARB0_CHNL72_CMD_ADDR A:0x2640000
y.create.l HWIO_PMIC_ARB0_CHNL73_CMD_ADDR A:0x2648000
y.create.l HWIO_PMIC_ARB0_CHNL74_CMD_ADDR A:0x2650000
y.create.l HWIO_PMIC_ARB0_CHNL75_CMD_ADDR A:0x2658000
y.create.l HWIO_PMIC_ARB0_CHNL76_CMD_ADDR A:0x2660000
y.create.l HWIO_PMIC_ARB0_CHNL77_CMD_ADDR A:0x2668000
y.create.l HWIO_PMIC_ARB0_CHNL78_CMD_ADDR A:0x2670000
y.create.l HWIO_PMIC_ARB0_CHNL79_CMD_ADDR A:0x2678000
y.create.l HWIO_PMIC_ARB0_CHNL80_CMD_ADDR A:0x2680000
y.create.l HWIO_PMIC_ARB0_CHNL81_CMD_ADDR A:0x2688000
y.create.l HWIO_PMIC_ARB0_CHNL82_CMD_ADDR A:0x2690000
y.create.l HWIO_PMIC_ARB0_CHNL83_CMD_ADDR A:0x2698000
y.create.l HWIO_PMIC_ARB0_CHNL84_CMD_ADDR A:0x26a0000
y.create.l HWIO_PMIC_ARB0_CHNL85_CMD_ADDR A:0x26a8000
y.create.l HWIO_PMIC_ARB0_CHNL86_CMD_ADDR A:0x26b0000
y.create.l HWIO_PMIC_ARB0_CHNL87_CMD_ADDR A:0x26b8000
y.create.l HWIO_PMIC_ARB0_CHNL88_CMD_ADDR A:0x26c0000
y.create.l HWIO_PMIC_ARB0_CHNL89_CMD_ADDR A:0x26c8000
y.create.l HWIO_PMIC_ARB0_CHNL90_CMD_ADDR A:0x26d0000
y.create.l HWIO_PMIC_ARB0_CHNL91_CMD_ADDR A:0x26d8000
y.create.l HWIO_PMIC_ARB0_CHNL92_CMD_ADDR A:0x26e0000
y.create.l HWIO_PMIC_ARB0_CHNL93_CMD_ADDR A:0x26e8000
y.create.l HWIO_PMIC_ARB0_CHNL94_CMD_ADDR A:0x26f0000
y.create.l HWIO_PMIC_ARB0_CHNL95_CMD_ADDR A:0x26f8000
y.create.l HWIO_PMIC_ARB0_CHNL96_CMD_ADDR A:0x2700000
y.create.l HWIO_PMIC_ARB0_CHNL97_CMD_ADDR A:0x2708000
y.create.l HWIO_PMIC_ARB0_CHNL98_CMD_ADDR A:0x2710000
y.create.l HWIO_PMIC_ARB0_CHNL99_CMD_ADDR A:0x2718000
y.create.l HWIO_PMIC_ARB0_CHNL100_CMD_ADDR A:0x2720000
y.create.l HWIO_PMIC_ARB0_CHNL101_CMD_ADDR A:0x2728000
y.create.l HWIO_PMIC_ARB0_CHNL102_CMD_ADDR A:0x2730000
y.create.l HWIO_PMIC_ARB0_CHNL103_CMD_ADDR A:0x2738000
y.create.l HWIO_PMIC_ARB0_CHNL104_CMD_ADDR A:0x2740000
y.create.l HWIO_PMIC_ARB0_CHNL105_CMD_ADDR A:0x2748000
y.create.l HWIO_PMIC_ARB0_CHNL106_CMD_ADDR A:0x2750000
y.create.l HWIO_PMIC_ARB0_CHNL107_CMD_ADDR A:0x2758000
y.create.l HWIO_PMIC_ARB0_CHNL108_CMD_ADDR A:0x2760000
y.create.l HWIO_PMIC_ARB0_CHNL109_CMD_ADDR A:0x2768000
y.create.l HWIO_PMIC_ARB0_CHNL110_CMD_ADDR A:0x2770000
y.create.l HWIO_PMIC_ARB0_CHNL111_CMD_ADDR A:0x2778000
y.create.l HWIO_PMIC_ARB0_CHNL112_CMD_ADDR A:0x2780000
y.create.l HWIO_PMIC_ARB0_CHNL113_CMD_ADDR A:0x2788000
y.create.l HWIO_PMIC_ARB0_CHNL114_CMD_ADDR A:0x2790000
y.create.l HWIO_PMIC_ARB0_CHNL115_CMD_ADDR A:0x2798000
y.create.l HWIO_PMIC_ARB0_CHNL116_CMD_ADDR A:0x27a0000
y.create.l HWIO_PMIC_ARB0_CHNL117_CMD_ADDR A:0x27a8000
y.create.l HWIO_PMIC_ARB0_CHNL118_CMD_ADDR A:0x27b0000
y.create.l HWIO_PMIC_ARB0_CHNL119_CMD_ADDR A:0x27b8000
y.create.l HWIO_PMIC_ARB0_CHNL120_CMD_ADDR A:0x27c0000
y.create.l HWIO_PMIC_ARB0_CHNL121_CMD_ADDR A:0x27c8000
y.create.l HWIO_PMIC_ARB0_CHNL122_CMD_ADDR A:0x27d0000
y.create.l HWIO_PMIC_ARB0_CHNL123_CMD_ADDR A:0x27d8000
y.create.l HWIO_PMIC_ARB0_CHNL124_CMD_ADDR A:0x27e0000
y.create.l HWIO_PMIC_ARB0_CHNL125_CMD_ADDR A:0x27e8000
y.create.l HWIO_PMIC_ARB0_CHNL126_CMD_ADDR A:0x27f0000
y.create.l HWIO_PMIC_ARB0_CHNL127_CMD_ADDR A:0x27f8000
y.create.l HWIO_PMIC_ARB0_CHNL128_CMD_ADDR A:0x2800000
y.create.l HWIO_PMIC_ARB0_CHNL129_CMD_ADDR A:0x2808000
y.create.l HWIO_PMIC_ARB0_CHNL130_CMD_ADDR A:0x2810000
y.create.l HWIO_PMIC_ARB0_CHNL131_CMD_ADDR A:0x2818000
y.create.l HWIO_PMIC_ARB0_CHNL132_CMD_ADDR A:0x2820000
y.create.l HWIO_PMIC_ARB0_CHNL133_CMD_ADDR A:0x2828000
y.create.l HWIO_PMIC_ARB0_CHNL134_CMD_ADDR A:0x2830000
y.create.l HWIO_PMIC_ARB0_CHNL135_CMD_ADDR A:0x2838000
y.create.l HWIO_PMIC_ARB0_CHNL136_CMD_ADDR A:0x2840000
y.create.l HWIO_PMIC_ARB0_CHNL137_CMD_ADDR A:0x2848000
y.create.l HWIO_PMIC_ARB0_CHNL138_CMD_ADDR A:0x2850000
y.create.l HWIO_PMIC_ARB0_CHNL139_CMD_ADDR A:0x2858000
y.create.l HWIO_PMIC_ARB0_CHNL140_CMD_ADDR A:0x2860000
y.create.l HWIO_PMIC_ARB0_CHNL141_CMD_ADDR A:0x2868000
y.create.l HWIO_PMIC_ARB0_CHNL142_CMD_ADDR A:0x2870000
y.create.l HWIO_PMIC_ARB0_CHNL143_CMD_ADDR A:0x2878000
y.create.l HWIO_PMIC_ARB0_CHNL144_CMD_ADDR A:0x2880000
y.create.l HWIO_PMIC_ARB0_CHNL145_CMD_ADDR A:0x2888000
y.create.l HWIO_PMIC_ARB0_CHNL146_CMD_ADDR A:0x2890000
y.create.l HWIO_PMIC_ARB0_CHNL147_CMD_ADDR A:0x2898000
y.create.l HWIO_PMIC_ARB0_CHNL148_CMD_ADDR A:0x28a0000
y.create.l HWIO_PMIC_ARB0_CHNL149_CMD_ADDR A:0x28a8000
y.create.l HWIO_PMIC_ARB0_CHNL150_CMD_ADDR A:0x28b0000
y.create.l HWIO_PMIC_ARB0_CHNL151_CMD_ADDR A:0x28b8000
y.create.l HWIO_PMIC_ARB0_CHNL152_CMD_ADDR A:0x28c0000
y.create.l HWIO_PMIC_ARB0_CHNL153_CMD_ADDR A:0x28c8000
y.create.l HWIO_PMIC_ARB0_CHNL154_CMD_ADDR A:0x28d0000
y.create.l HWIO_PMIC_ARB0_CHNL155_CMD_ADDR A:0x28d8000
y.create.l HWIO_PMIC_ARB0_CHNL156_CMD_ADDR A:0x28e0000
y.create.l HWIO_PMIC_ARB0_CHNL157_CMD_ADDR A:0x28e8000
y.create.l HWIO_PMIC_ARB0_CHNL158_CMD_ADDR A:0x28f0000
y.create.l HWIO_PMIC_ARB0_CHNL159_CMD_ADDR A:0x28f8000
y.create.l HWIO_PMIC_ARB0_CHNL160_CMD_ADDR A:0x2900000
y.create.l HWIO_PMIC_ARB0_CHNL161_CMD_ADDR A:0x2908000
y.create.l HWIO_PMIC_ARB0_CHNL162_CMD_ADDR A:0x2910000
y.create.l HWIO_PMIC_ARB0_CHNL163_CMD_ADDR A:0x2918000
y.create.l HWIO_PMIC_ARB0_CHNL164_CMD_ADDR A:0x2920000
y.create.l HWIO_PMIC_ARB0_CHNL165_CMD_ADDR A:0x2928000
y.create.l HWIO_PMIC_ARB0_CHNL166_CMD_ADDR A:0x2930000
y.create.l HWIO_PMIC_ARB0_CHNL167_CMD_ADDR A:0x2938000
y.create.l HWIO_PMIC_ARB0_CHNL168_CMD_ADDR A:0x2940000
y.create.l HWIO_PMIC_ARB0_CHNL169_CMD_ADDR A:0x2948000
y.create.l HWIO_PMIC_ARB0_CHNL170_CMD_ADDR A:0x2950000
y.create.l HWIO_PMIC_ARB0_CHNL171_CMD_ADDR A:0x2958000
y.create.l HWIO_PMIC_ARB0_CHNL172_CMD_ADDR A:0x2960000
y.create.l HWIO_PMIC_ARB0_CHNL173_CMD_ADDR A:0x2968000
y.create.l HWIO_PMIC_ARB0_CHNL174_CMD_ADDR A:0x2970000
y.create.l HWIO_PMIC_ARB0_CHNL175_CMD_ADDR A:0x2978000
y.create.l HWIO_PMIC_ARB0_CHNL176_CMD_ADDR A:0x2980000
y.create.l HWIO_PMIC_ARB0_CHNL177_CMD_ADDR A:0x2988000
y.create.l HWIO_PMIC_ARB0_CHNL178_CMD_ADDR A:0x2990000
y.create.l HWIO_PMIC_ARB0_CHNL179_CMD_ADDR A:0x2998000
y.create.l HWIO_PMIC_ARB0_CHNL180_CMD_ADDR A:0x29a0000
y.create.l HWIO_PMIC_ARB0_CHNL181_CMD_ADDR A:0x29a8000
y.create.l HWIO_PMIC_ARB0_CHNL182_CMD_ADDR A:0x29b0000
y.create.l HWIO_PMIC_ARB0_CHNL183_CMD_ADDR A:0x29b8000
y.create.l HWIO_PMIC_ARB0_CHNL184_CMD_ADDR A:0x29c0000
y.create.l HWIO_PMIC_ARB0_CHNL185_CMD_ADDR A:0x29c8000
y.create.l HWIO_PMIC_ARB0_CHNL186_CMD_ADDR A:0x29d0000
y.create.l HWIO_PMIC_ARB0_CHNL187_CMD_ADDR A:0x29d8000
y.create.l HWIO_PMIC_ARB0_CHNL188_CMD_ADDR A:0x29e0000
y.create.l HWIO_PMIC_ARB0_CHNL189_CMD_ADDR A:0x29e8000
y.create.l HWIO_PMIC_ARB0_CHNL190_CMD_ADDR A:0x29f0000
y.create.l HWIO_PMIC_ARB0_CHNL191_CMD_ADDR A:0x29f8000
y.create.l HWIO_PMIC_ARB0_CHNL192_CMD_ADDR A:0x2a00000
y.create.l HWIO_PMIC_ARB0_CHNL193_CMD_ADDR A:0x2a08000
y.create.l HWIO_PMIC_ARB0_CHNL194_CMD_ADDR A:0x2a10000
y.create.l HWIO_PMIC_ARB0_CHNL195_CMD_ADDR A:0x2a18000
y.create.l HWIO_PMIC_ARB0_CHNL196_CMD_ADDR A:0x2a20000
y.create.l HWIO_PMIC_ARB0_CHNL197_CMD_ADDR A:0x2a28000
y.create.l HWIO_PMIC_ARB0_CHNL198_CMD_ADDR A:0x2a30000
y.create.l HWIO_PMIC_ARB0_CHNL199_CMD_ADDR A:0x2a38000
y.create.l HWIO_PMIC_ARB0_CHNL200_CMD_ADDR A:0x2a40000
y.create.l HWIO_PMIC_ARB0_CHNL201_CMD_ADDR A:0x2a48000
y.create.l HWIO_PMIC_ARB0_CHNL202_CMD_ADDR A:0x2a50000
y.create.l HWIO_PMIC_ARB0_CHNL203_CMD_ADDR A:0x2a58000
y.create.l HWIO_PMIC_ARB0_CHNL204_CMD_ADDR A:0x2a60000
y.create.l HWIO_PMIC_ARB0_CHNL205_CMD_ADDR A:0x2a68000
y.create.l HWIO_PMIC_ARB0_CHNL206_CMD_ADDR A:0x2a70000
y.create.l HWIO_PMIC_ARB0_CHNL207_CMD_ADDR A:0x2a78000
y.create.l HWIO_PMIC_ARB0_CHNL208_CMD_ADDR A:0x2a80000
y.create.l HWIO_PMIC_ARB0_CHNL209_CMD_ADDR A:0x2a88000
y.create.l HWIO_PMIC_ARB0_CHNL210_CMD_ADDR A:0x2a90000
y.create.l HWIO_PMIC_ARB0_CHNL211_CMD_ADDR A:0x2a98000
y.create.l HWIO_PMIC_ARB0_CHNL212_CMD_ADDR A:0x2aa0000
y.create.l HWIO_PMIC_ARB0_CHNL213_CMD_ADDR A:0x2aa8000
y.create.l HWIO_PMIC_ARB0_CHNL214_CMD_ADDR A:0x2ab0000
y.create.l HWIO_PMIC_ARB0_CHNL215_CMD_ADDR A:0x2ab8000
y.create.l HWIO_PMIC_ARB0_CHNL216_CMD_ADDR A:0x2ac0000
y.create.l HWIO_PMIC_ARB0_CHNL217_CMD_ADDR A:0x2ac8000
y.create.l HWIO_PMIC_ARB0_CHNL218_CMD_ADDR A:0x2ad0000
y.create.l HWIO_PMIC_ARB0_CHNL219_CMD_ADDR A:0x2ad8000
y.create.l HWIO_PMIC_ARB0_CHNL220_CMD_ADDR A:0x2ae0000
y.create.l HWIO_PMIC_ARB0_CHNL221_CMD_ADDR A:0x2ae8000
y.create.l HWIO_PMIC_ARB0_CHNL222_CMD_ADDR A:0x2af0000
y.create.l HWIO_PMIC_ARB0_CHNL223_CMD_ADDR A:0x2af8000
y.create.l HWIO_PMIC_ARB0_CHNL224_CMD_ADDR A:0x2b00000
y.create.l HWIO_PMIC_ARB0_CHNL225_CMD_ADDR A:0x2b08000
y.create.l HWIO_PMIC_ARB0_CHNL226_CMD_ADDR A:0x2b10000
y.create.l HWIO_PMIC_ARB0_CHNL227_CMD_ADDR A:0x2b18000
y.create.l HWIO_PMIC_ARB0_CHNL228_CMD_ADDR A:0x2b20000
y.create.l HWIO_PMIC_ARB0_CHNL229_CMD_ADDR A:0x2b28000
y.create.l HWIO_PMIC_ARB0_CHNL230_CMD_ADDR A:0x2b30000
y.create.l HWIO_PMIC_ARB0_CHNL231_CMD_ADDR A:0x2b38000
y.create.l HWIO_PMIC_ARB0_CHNL232_CMD_ADDR A:0x2b40000
y.create.l HWIO_PMIC_ARB0_CHNL233_CMD_ADDR A:0x2b48000
y.create.l HWIO_PMIC_ARB0_CHNL234_CMD_ADDR A:0x2b50000
y.create.l HWIO_PMIC_ARB0_CHNL235_CMD_ADDR A:0x2b58000
y.create.l HWIO_PMIC_ARB0_CHNL236_CMD_ADDR A:0x2b60000
y.create.l HWIO_PMIC_ARB0_CHNL237_CMD_ADDR A:0x2b68000
y.create.l HWIO_PMIC_ARB0_CHNL238_CMD_ADDR A:0x2b70000
y.create.l HWIO_PMIC_ARB0_CHNL239_CMD_ADDR A:0x2b78000
y.create.l HWIO_PMIC_ARB0_CHNL240_CMD_ADDR A:0x2b80000
y.create.l HWIO_PMIC_ARB0_CHNL241_CMD_ADDR A:0x2b88000
y.create.l HWIO_PMIC_ARB0_CHNL242_CMD_ADDR A:0x2b90000
y.create.l HWIO_PMIC_ARB0_CHNL243_CMD_ADDR A:0x2b98000
y.create.l HWIO_PMIC_ARB0_CHNL244_CMD_ADDR A:0x2ba0000
y.create.l HWIO_PMIC_ARB0_CHNL245_CMD_ADDR A:0x2ba8000
y.create.l HWIO_PMIC_ARB0_CHNL246_CMD_ADDR A:0x2bb0000
y.create.l HWIO_PMIC_ARB0_CHNL247_CMD_ADDR A:0x2bb8000
y.create.l HWIO_PMIC_ARB0_CHNL248_CMD_ADDR A:0x2bc0000
y.create.l HWIO_PMIC_ARB0_CHNL249_CMD_ADDR A:0x2bc8000
y.create.l HWIO_PMIC_ARB0_CHNL250_CMD_ADDR A:0x2bd0000
y.create.l HWIO_PMIC_ARB0_CHNL251_CMD_ADDR A:0x2bd8000
y.create.l HWIO_PMIC_ARB0_CHNL252_CMD_ADDR A:0x2be0000
y.create.l HWIO_PMIC_ARB0_CHNL253_CMD_ADDR A:0x2be8000
y.create.l HWIO_PMIC_ARB0_CHNL254_CMD_ADDR A:0x2bf0000
y.create.l HWIO_PMIC_ARB0_CHNL255_CMD_ADDR A:0x2bf8000
y.create.l HWIO_PMIC_ARB1_CHNL0_CMD_ADDR A:0x2401000
y.create.l HWIO_PMIC_ARB1_CHNL1_CMD_ADDR A:0x2409000
y.create.l HWIO_PMIC_ARB1_CHNL2_CMD_ADDR A:0x2411000
y.create.l HWIO_PMIC_ARB1_CHNL3_CMD_ADDR A:0x2419000
y.create.l HWIO_PMIC_ARB1_CHNL4_CMD_ADDR A:0x2421000
y.create.l HWIO_PMIC_ARB1_CHNL5_CMD_ADDR A:0x2429000
y.create.l HWIO_PMIC_ARB1_CHNL6_CMD_ADDR A:0x2431000
y.create.l HWIO_PMIC_ARB1_CHNL7_CMD_ADDR A:0x2439000
y.create.l HWIO_PMIC_ARB1_CHNL8_CMD_ADDR A:0x2441000
y.create.l HWIO_PMIC_ARB1_CHNL9_CMD_ADDR A:0x2449000
y.create.l HWIO_PMIC_ARB1_CHNL10_CMD_ADDR A:0x2451000
y.create.l HWIO_PMIC_ARB1_CHNL11_CMD_ADDR A:0x2459000
y.create.l HWIO_PMIC_ARB1_CHNL12_CMD_ADDR A:0x2461000
y.create.l HWIO_PMIC_ARB1_CHNL13_CMD_ADDR A:0x2469000
y.create.l HWIO_PMIC_ARB1_CHNL14_CMD_ADDR A:0x2471000
y.create.l HWIO_PMIC_ARB1_CHNL15_CMD_ADDR A:0x2479000
y.create.l HWIO_PMIC_ARB1_CHNL16_CMD_ADDR A:0x2481000
y.create.l HWIO_PMIC_ARB1_CHNL17_CMD_ADDR A:0x2489000
y.create.l HWIO_PMIC_ARB1_CHNL18_CMD_ADDR A:0x2491000
y.create.l HWIO_PMIC_ARB1_CHNL19_CMD_ADDR A:0x2499000
y.create.l HWIO_PMIC_ARB1_CHNL20_CMD_ADDR A:0x24a1000
y.create.l HWIO_PMIC_ARB1_CHNL21_CMD_ADDR A:0x24a9000
y.create.l HWIO_PMIC_ARB1_CHNL22_CMD_ADDR A:0x24b1000
y.create.l HWIO_PMIC_ARB1_CHNL23_CMD_ADDR A:0x24b9000
y.create.l HWIO_PMIC_ARB1_CHNL24_CMD_ADDR A:0x24c1000
y.create.l HWIO_PMIC_ARB1_CHNL25_CMD_ADDR A:0x24c9000
y.create.l HWIO_PMIC_ARB1_CHNL26_CMD_ADDR A:0x24d1000
y.create.l HWIO_PMIC_ARB1_CHNL27_CMD_ADDR A:0x24d9000
y.create.l HWIO_PMIC_ARB1_CHNL28_CMD_ADDR A:0x24e1000
y.create.l HWIO_PMIC_ARB1_CHNL29_CMD_ADDR A:0x24e9000
y.create.l HWIO_PMIC_ARB1_CHNL30_CMD_ADDR A:0x24f1000
y.create.l HWIO_PMIC_ARB1_CHNL31_CMD_ADDR A:0x24f9000
y.create.l HWIO_PMIC_ARB1_CHNL32_CMD_ADDR A:0x2501000
y.create.l HWIO_PMIC_ARB1_CHNL33_CMD_ADDR A:0x2509000
y.create.l HWIO_PMIC_ARB1_CHNL34_CMD_ADDR A:0x2511000
y.create.l HWIO_PMIC_ARB1_CHNL35_CMD_ADDR A:0x2519000
y.create.l HWIO_PMIC_ARB1_CHNL36_CMD_ADDR A:0x2521000
y.create.l HWIO_PMIC_ARB1_CHNL37_CMD_ADDR A:0x2529000
y.create.l HWIO_PMIC_ARB1_CHNL38_CMD_ADDR A:0x2531000
y.create.l HWIO_PMIC_ARB1_CHNL39_CMD_ADDR A:0x2539000
y.create.l HWIO_PMIC_ARB1_CHNL40_CMD_ADDR A:0x2541000
y.create.l HWIO_PMIC_ARB1_CHNL41_CMD_ADDR A:0x2549000
y.create.l HWIO_PMIC_ARB1_CHNL42_CMD_ADDR A:0x2551000
y.create.l HWIO_PMIC_ARB1_CHNL43_CMD_ADDR A:0x2559000
y.create.l HWIO_PMIC_ARB1_CHNL44_CMD_ADDR A:0x2561000
y.create.l HWIO_PMIC_ARB1_CHNL45_CMD_ADDR A:0x2569000
y.create.l HWIO_PMIC_ARB1_CHNL46_CMD_ADDR A:0x2571000
y.create.l HWIO_PMIC_ARB1_CHNL47_CMD_ADDR A:0x2579000
y.create.l HWIO_PMIC_ARB1_CHNL48_CMD_ADDR A:0x2581000
y.create.l HWIO_PMIC_ARB1_CHNL49_CMD_ADDR A:0x2589000
y.create.l HWIO_PMIC_ARB1_CHNL50_CMD_ADDR A:0x2591000
y.create.l HWIO_PMIC_ARB1_CHNL51_CMD_ADDR A:0x2599000
y.create.l HWIO_PMIC_ARB1_CHNL52_CMD_ADDR A:0x25a1000
y.create.l HWIO_PMIC_ARB1_CHNL53_CMD_ADDR A:0x25a9000
y.create.l HWIO_PMIC_ARB1_CHNL54_CMD_ADDR A:0x25b1000
y.create.l HWIO_PMIC_ARB1_CHNL55_CMD_ADDR A:0x25b9000
y.create.l HWIO_PMIC_ARB1_CHNL56_CMD_ADDR A:0x25c1000
y.create.l HWIO_PMIC_ARB1_CHNL57_CMD_ADDR A:0x25c9000
y.create.l HWIO_PMIC_ARB1_CHNL58_CMD_ADDR A:0x25d1000
y.create.l HWIO_PMIC_ARB1_CHNL59_CMD_ADDR A:0x25d9000
y.create.l HWIO_PMIC_ARB1_CHNL60_CMD_ADDR A:0x25e1000
y.create.l HWIO_PMIC_ARB1_CHNL61_CMD_ADDR A:0x25e9000
y.create.l HWIO_PMIC_ARB1_CHNL62_CMD_ADDR A:0x25f1000
y.create.l HWIO_PMIC_ARB1_CHNL63_CMD_ADDR A:0x25f9000
y.create.l HWIO_PMIC_ARB1_CHNL64_CMD_ADDR A:0x2601000
y.create.l HWIO_PMIC_ARB1_CHNL65_CMD_ADDR A:0x2609000
y.create.l HWIO_PMIC_ARB1_CHNL66_CMD_ADDR A:0x2611000
y.create.l HWIO_PMIC_ARB1_CHNL67_CMD_ADDR A:0x2619000
y.create.l HWIO_PMIC_ARB1_CHNL68_CMD_ADDR A:0x2621000
y.create.l HWIO_PMIC_ARB1_CHNL69_CMD_ADDR A:0x2629000
y.create.l HWIO_PMIC_ARB1_CHNL70_CMD_ADDR A:0x2631000
y.create.l HWIO_PMIC_ARB1_CHNL71_CMD_ADDR A:0x2639000
y.create.l HWIO_PMIC_ARB1_CHNL72_CMD_ADDR A:0x2641000
y.create.l HWIO_PMIC_ARB1_CHNL73_CMD_ADDR A:0x2649000
y.create.l HWIO_PMIC_ARB1_CHNL74_CMD_ADDR A:0x2651000
y.create.l HWIO_PMIC_ARB1_CHNL75_CMD_ADDR A:0x2659000
y.create.l HWIO_PMIC_ARB1_CHNL76_CMD_ADDR A:0x2661000
y.create.l HWIO_PMIC_ARB1_CHNL77_CMD_ADDR A:0x2669000
y.create.l HWIO_PMIC_ARB1_CHNL78_CMD_ADDR A:0x2671000
y.create.l HWIO_PMIC_ARB1_CHNL79_CMD_ADDR A:0x2679000
y.create.l HWIO_PMIC_ARB1_CHNL80_CMD_ADDR A:0x2681000
y.create.l HWIO_PMIC_ARB1_CHNL81_CMD_ADDR A:0x2689000
y.create.l HWIO_PMIC_ARB1_CHNL82_CMD_ADDR A:0x2691000
y.create.l HWIO_PMIC_ARB1_CHNL83_CMD_ADDR A:0x2699000
y.create.l HWIO_PMIC_ARB1_CHNL84_CMD_ADDR A:0x26a1000
y.create.l HWIO_PMIC_ARB1_CHNL85_CMD_ADDR A:0x26a9000
y.create.l HWIO_PMIC_ARB1_CHNL86_CMD_ADDR A:0x26b1000
y.create.l HWIO_PMIC_ARB1_CHNL87_CMD_ADDR A:0x26b9000
y.create.l HWIO_PMIC_ARB1_CHNL88_CMD_ADDR A:0x26c1000
y.create.l HWIO_PMIC_ARB1_CHNL89_CMD_ADDR A:0x26c9000
y.create.l HWIO_PMIC_ARB1_CHNL90_CMD_ADDR A:0x26d1000
y.create.l HWIO_PMIC_ARB1_CHNL91_CMD_ADDR A:0x26d9000
y.create.l HWIO_PMIC_ARB1_CHNL92_CMD_ADDR A:0x26e1000
y.create.l HWIO_PMIC_ARB1_CHNL93_CMD_ADDR A:0x26e9000
y.create.l HWIO_PMIC_ARB1_CHNL94_CMD_ADDR A:0x26f1000
y.create.l HWIO_PMIC_ARB1_CHNL95_CMD_ADDR A:0x26f9000
y.create.l HWIO_PMIC_ARB1_CHNL96_CMD_ADDR A:0x2701000
y.create.l HWIO_PMIC_ARB1_CHNL97_CMD_ADDR A:0x2709000
y.create.l HWIO_PMIC_ARB1_CHNL98_CMD_ADDR A:0x2711000
y.create.l HWIO_PMIC_ARB1_CHNL99_CMD_ADDR A:0x2719000
y.create.l HWIO_PMIC_ARB1_CHNL100_CMD_ADDR A:0x2721000
y.create.l HWIO_PMIC_ARB1_CHNL101_CMD_ADDR A:0x2729000
y.create.l HWIO_PMIC_ARB1_CHNL102_CMD_ADDR A:0x2731000
y.create.l HWIO_PMIC_ARB1_CHNL103_CMD_ADDR A:0x2739000
y.create.l HWIO_PMIC_ARB1_CHNL104_CMD_ADDR A:0x2741000
y.create.l HWIO_PMIC_ARB1_CHNL105_CMD_ADDR A:0x2749000
y.create.l HWIO_PMIC_ARB1_CHNL106_CMD_ADDR A:0x2751000
y.create.l HWIO_PMIC_ARB1_CHNL107_CMD_ADDR A:0x2759000
y.create.l HWIO_PMIC_ARB1_CHNL108_CMD_ADDR A:0x2761000
y.create.l HWIO_PMIC_ARB1_CHNL109_CMD_ADDR A:0x2769000
y.create.l HWIO_PMIC_ARB1_CHNL110_CMD_ADDR A:0x2771000
y.create.l HWIO_PMIC_ARB1_CHNL111_CMD_ADDR A:0x2779000
y.create.l HWIO_PMIC_ARB1_CHNL112_CMD_ADDR A:0x2781000
y.create.l HWIO_PMIC_ARB1_CHNL113_CMD_ADDR A:0x2789000
y.create.l HWIO_PMIC_ARB1_CHNL114_CMD_ADDR A:0x2791000
y.create.l HWIO_PMIC_ARB1_CHNL115_CMD_ADDR A:0x2799000
y.create.l HWIO_PMIC_ARB1_CHNL116_CMD_ADDR A:0x27a1000
y.create.l HWIO_PMIC_ARB1_CHNL117_CMD_ADDR A:0x27a9000
y.create.l HWIO_PMIC_ARB1_CHNL118_CMD_ADDR A:0x27b1000
y.create.l HWIO_PMIC_ARB1_CHNL119_CMD_ADDR A:0x27b9000
y.create.l HWIO_PMIC_ARB1_CHNL120_CMD_ADDR A:0x27c1000
y.create.l HWIO_PMIC_ARB1_CHNL121_CMD_ADDR A:0x27c9000
y.create.l HWIO_PMIC_ARB1_CHNL122_CMD_ADDR A:0x27d1000
y.create.l HWIO_PMIC_ARB1_CHNL123_CMD_ADDR A:0x27d9000
y.create.l HWIO_PMIC_ARB1_CHNL124_CMD_ADDR A:0x27e1000
y.create.l HWIO_PMIC_ARB1_CHNL125_CMD_ADDR A:0x27e9000
y.create.l HWIO_PMIC_ARB1_CHNL126_CMD_ADDR A:0x27f1000
y.create.l HWIO_PMIC_ARB1_CHNL127_CMD_ADDR A:0x27f9000
y.create.l HWIO_PMIC_ARB1_CHNL128_CMD_ADDR A:0x2801000
y.create.l HWIO_PMIC_ARB1_CHNL129_CMD_ADDR A:0x2809000
y.create.l HWIO_PMIC_ARB1_CHNL130_CMD_ADDR A:0x2811000
y.create.l HWIO_PMIC_ARB1_CHNL131_CMD_ADDR A:0x2819000
y.create.l HWIO_PMIC_ARB1_CHNL132_CMD_ADDR A:0x2821000
y.create.l HWIO_PMIC_ARB1_CHNL133_CMD_ADDR A:0x2829000
y.create.l HWIO_PMIC_ARB1_CHNL134_CMD_ADDR A:0x2831000
y.create.l HWIO_PMIC_ARB1_CHNL135_CMD_ADDR A:0x2839000
y.create.l HWIO_PMIC_ARB1_CHNL136_CMD_ADDR A:0x2841000
y.create.l HWIO_PMIC_ARB1_CHNL137_CMD_ADDR A:0x2849000
y.create.l HWIO_PMIC_ARB1_CHNL138_CMD_ADDR A:0x2851000
y.create.l HWIO_PMIC_ARB1_CHNL139_CMD_ADDR A:0x2859000
y.create.l HWIO_PMIC_ARB1_CHNL140_CMD_ADDR A:0x2861000
y.create.l HWIO_PMIC_ARB1_CHNL141_CMD_ADDR A:0x2869000
y.create.l HWIO_PMIC_ARB1_CHNL142_CMD_ADDR A:0x2871000
y.create.l HWIO_PMIC_ARB1_CHNL143_CMD_ADDR A:0x2879000
y.create.l HWIO_PMIC_ARB1_CHNL144_CMD_ADDR A:0x2881000
y.create.l HWIO_PMIC_ARB1_CHNL145_CMD_ADDR A:0x2889000
y.create.l HWIO_PMIC_ARB1_CHNL146_CMD_ADDR A:0x2891000
y.create.l HWIO_PMIC_ARB1_CHNL147_CMD_ADDR A:0x2899000
y.create.l HWIO_PMIC_ARB1_CHNL148_CMD_ADDR A:0x28a1000
y.create.l HWIO_PMIC_ARB1_CHNL149_CMD_ADDR A:0x28a9000
y.create.l HWIO_PMIC_ARB1_CHNL150_CMD_ADDR A:0x28b1000
y.create.l HWIO_PMIC_ARB1_CHNL151_CMD_ADDR A:0x28b9000
y.create.l HWIO_PMIC_ARB1_CHNL152_CMD_ADDR A:0x28c1000
y.create.l HWIO_PMIC_ARB1_CHNL153_CMD_ADDR A:0x28c9000
y.create.l HWIO_PMIC_ARB1_CHNL154_CMD_ADDR A:0x28d1000
y.create.l HWIO_PMIC_ARB1_CHNL155_CMD_ADDR A:0x28d9000
y.create.l HWIO_PMIC_ARB1_CHNL156_CMD_ADDR A:0x28e1000
y.create.l HWIO_PMIC_ARB1_CHNL157_CMD_ADDR A:0x28e9000
y.create.l HWIO_PMIC_ARB1_CHNL158_CMD_ADDR A:0x28f1000
y.create.l HWIO_PMIC_ARB1_CHNL159_CMD_ADDR A:0x28f9000
y.create.l HWIO_PMIC_ARB1_CHNL160_CMD_ADDR A:0x2901000
y.create.l HWIO_PMIC_ARB1_CHNL161_CMD_ADDR A:0x2909000
y.create.l HWIO_PMIC_ARB1_CHNL162_CMD_ADDR A:0x2911000
y.create.l HWIO_PMIC_ARB1_CHNL163_CMD_ADDR A:0x2919000
y.create.l HWIO_PMIC_ARB1_CHNL164_CMD_ADDR A:0x2921000
y.create.l HWIO_PMIC_ARB1_CHNL165_CMD_ADDR A:0x2929000
y.create.l HWIO_PMIC_ARB1_CHNL166_CMD_ADDR A:0x2931000
y.create.l HWIO_PMIC_ARB1_CHNL167_CMD_ADDR A:0x2939000
y.create.l HWIO_PMIC_ARB1_CHNL168_CMD_ADDR A:0x2941000
y.create.l HWIO_PMIC_ARB1_CHNL169_CMD_ADDR A:0x2949000
y.create.l HWIO_PMIC_ARB1_CHNL170_CMD_ADDR A:0x2951000
y.create.l HWIO_PMIC_ARB1_CHNL171_CMD_ADDR A:0x2959000
y.create.l HWIO_PMIC_ARB1_CHNL172_CMD_ADDR A:0x2961000
y.create.l HWIO_PMIC_ARB1_CHNL173_CMD_ADDR A:0x2969000
y.create.l HWIO_PMIC_ARB1_CHNL174_CMD_ADDR A:0x2971000
y.create.l HWIO_PMIC_ARB1_CHNL175_CMD_ADDR A:0x2979000
y.create.l HWIO_PMIC_ARB1_CHNL176_CMD_ADDR A:0x2981000
y.create.l HWIO_PMIC_ARB1_CHNL177_CMD_ADDR A:0x2989000
y.create.l HWIO_PMIC_ARB1_CHNL178_CMD_ADDR A:0x2991000
y.create.l HWIO_PMIC_ARB1_CHNL179_CMD_ADDR A:0x2999000
y.create.l HWIO_PMIC_ARB1_CHNL180_CMD_ADDR A:0x29a1000
y.create.l HWIO_PMIC_ARB1_CHNL181_CMD_ADDR A:0x29a9000
y.create.l HWIO_PMIC_ARB1_CHNL182_CMD_ADDR A:0x29b1000
y.create.l HWIO_PMIC_ARB1_CHNL183_CMD_ADDR A:0x29b9000
y.create.l HWIO_PMIC_ARB1_CHNL184_CMD_ADDR A:0x29c1000
y.create.l HWIO_PMIC_ARB1_CHNL185_CMD_ADDR A:0x29c9000
y.create.l HWIO_PMIC_ARB1_CHNL186_CMD_ADDR A:0x29d1000
y.create.l HWIO_PMIC_ARB1_CHNL187_CMD_ADDR A:0x29d9000
y.create.l HWIO_PMIC_ARB1_CHNL188_CMD_ADDR A:0x29e1000
y.create.l HWIO_PMIC_ARB1_CHNL189_CMD_ADDR A:0x29e9000
y.create.l HWIO_PMIC_ARB1_CHNL190_CMD_ADDR A:0x29f1000
y.create.l HWIO_PMIC_ARB1_CHNL191_CMD_ADDR A:0x29f9000
y.create.l HWIO_PMIC_ARB1_CHNL192_CMD_ADDR A:0x2a01000
y.create.l HWIO_PMIC_ARB1_CHNL193_CMD_ADDR A:0x2a09000
y.create.l HWIO_PMIC_ARB1_CHNL194_CMD_ADDR A:0x2a11000
y.create.l HWIO_PMIC_ARB1_CHNL195_CMD_ADDR A:0x2a19000
y.create.l HWIO_PMIC_ARB1_CHNL196_CMD_ADDR A:0x2a21000
y.create.l HWIO_PMIC_ARB1_CHNL197_CMD_ADDR A:0x2a29000
y.create.l HWIO_PMIC_ARB1_CHNL198_CMD_ADDR A:0x2a31000
y.create.l HWIO_PMIC_ARB1_CHNL199_CMD_ADDR A:0x2a39000
y.create.l HWIO_PMIC_ARB1_CHNL200_CMD_ADDR A:0x2a41000
y.create.l HWIO_PMIC_ARB1_CHNL201_CMD_ADDR A:0x2a49000
y.create.l HWIO_PMIC_ARB1_CHNL202_CMD_ADDR A:0x2a51000
y.create.l HWIO_PMIC_ARB1_CHNL203_CMD_ADDR A:0x2a59000
y.create.l HWIO_PMIC_ARB1_CHNL204_CMD_ADDR A:0x2a61000
y.create.l HWIO_PMIC_ARB1_CHNL205_CMD_ADDR A:0x2a69000
y.create.l HWIO_PMIC_ARB1_CHNL206_CMD_ADDR A:0x2a71000
y.create.l HWIO_PMIC_ARB1_CHNL207_CMD_ADDR A:0x2a79000
y.create.l HWIO_PMIC_ARB1_CHNL208_CMD_ADDR A:0x2a81000
y.create.l HWIO_PMIC_ARB1_CHNL209_CMD_ADDR A:0x2a89000
y.create.l HWIO_PMIC_ARB1_CHNL210_CMD_ADDR A:0x2a91000
y.create.l HWIO_PMIC_ARB1_CHNL211_CMD_ADDR A:0x2a99000
y.create.l HWIO_PMIC_ARB1_CHNL212_CMD_ADDR A:0x2aa1000
y.create.l HWIO_PMIC_ARB1_CHNL213_CMD_ADDR A:0x2aa9000
y.create.l HWIO_PMIC_ARB1_CHNL214_CMD_ADDR A:0x2ab1000
y.create.l HWIO_PMIC_ARB1_CHNL215_CMD_ADDR A:0x2ab9000
y.create.l HWIO_PMIC_ARB1_CHNL216_CMD_ADDR A:0x2ac1000
y.create.l HWIO_PMIC_ARB1_CHNL217_CMD_ADDR A:0x2ac9000
y.create.l HWIO_PMIC_ARB1_CHNL218_CMD_ADDR A:0x2ad1000
y.create.l HWIO_PMIC_ARB1_CHNL219_CMD_ADDR A:0x2ad9000
y.create.l HWIO_PMIC_ARB1_CHNL220_CMD_ADDR A:0x2ae1000
y.create.l HWIO_PMIC_ARB1_CHNL221_CMD_ADDR A:0x2ae9000
y.create.l HWIO_PMIC_ARB1_CHNL222_CMD_ADDR A:0x2af1000
y.create.l HWIO_PMIC_ARB1_CHNL223_CMD_ADDR A:0x2af9000
y.create.l HWIO_PMIC_ARB1_CHNL224_CMD_ADDR A:0x2b01000
y.create.l HWIO_PMIC_ARB1_CHNL225_CMD_ADDR A:0x2b09000
y.create.l HWIO_PMIC_ARB1_CHNL226_CMD_ADDR A:0x2b11000
y.create.l HWIO_PMIC_ARB1_CHNL227_CMD_ADDR A:0x2b19000
y.create.l HWIO_PMIC_ARB1_CHNL228_CMD_ADDR A:0x2b21000
y.create.l HWIO_PMIC_ARB1_CHNL229_CMD_ADDR A:0x2b29000
y.create.l HWIO_PMIC_ARB1_CHNL230_CMD_ADDR A:0x2b31000
y.create.l HWIO_PMIC_ARB1_CHNL231_CMD_ADDR A:0x2b39000
y.create.l HWIO_PMIC_ARB1_CHNL232_CMD_ADDR A:0x2b41000
y.create.l HWIO_PMIC_ARB1_CHNL233_CMD_ADDR A:0x2b49000
y.create.l HWIO_PMIC_ARB1_CHNL234_CMD_ADDR A:0x2b51000
y.create.l HWIO_PMIC_ARB1_CHNL235_CMD_ADDR A:0x2b59000
y.create.l HWIO_PMIC_ARB1_CHNL236_CMD_ADDR A:0x2b61000
y.create.l HWIO_PMIC_ARB1_CHNL237_CMD_ADDR A:0x2b69000
y.create.l HWIO_PMIC_ARB1_CHNL238_CMD_ADDR A:0x2b71000
y.create.l HWIO_PMIC_ARB1_CHNL239_CMD_ADDR A:0x2b79000
y.create.l HWIO_PMIC_ARB1_CHNL240_CMD_ADDR A:0x2b81000
y.create.l HWIO_PMIC_ARB1_CHNL241_CMD_ADDR A:0x2b89000
y.create.l HWIO_PMIC_ARB1_CHNL242_CMD_ADDR A:0x2b91000
y.create.l HWIO_PMIC_ARB1_CHNL243_CMD_ADDR A:0x2b99000
y.create.l HWIO_PMIC_ARB1_CHNL244_CMD_ADDR A:0x2ba1000
y.create.l HWIO_PMIC_ARB1_CHNL245_CMD_ADDR A:0x2ba9000
y.create.l HWIO_PMIC_ARB1_CHNL246_CMD_ADDR A:0x2bb1000
y.create.l HWIO_PMIC_ARB1_CHNL247_CMD_ADDR A:0x2bb9000
y.create.l HWIO_PMIC_ARB1_CHNL248_CMD_ADDR A:0x2bc1000
y.create.l HWIO_PMIC_ARB1_CHNL249_CMD_ADDR A:0x2bc9000
y.create.l HWIO_PMIC_ARB1_CHNL250_CMD_ADDR A:0x2bd1000
y.create.l HWIO_PMIC_ARB1_CHNL251_CMD_ADDR A:0x2bd9000
y.create.l HWIO_PMIC_ARB1_CHNL252_CMD_ADDR A:0x2be1000
y.create.l HWIO_PMIC_ARB1_CHNL253_CMD_ADDR A:0x2be9000
y.create.l HWIO_PMIC_ARB1_CHNL254_CMD_ADDR A:0x2bf1000
y.create.l HWIO_PMIC_ARB1_CHNL255_CMD_ADDR A:0x2bf9000
y.create.l HWIO_PMIC_ARB2_CHNL0_CMD_ADDR A:0x2402000
y.create.l HWIO_PMIC_ARB2_CHNL1_CMD_ADDR A:0x240a000
y.create.l HWIO_PMIC_ARB2_CHNL2_CMD_ADDR A:0x2412000
y.create.l HWIO_PMIC_ARB2_CHNL3_CMD_ADDR A:0x241a000
y.create.l HWIO_PMIC_ARB2_CHNL4_CMD_ADDR A:0x2422000
y.create.l HWIO_PMIC_ARB2_CHNL5_CMD_ADDR A:0x242a000
y.create.l HWIO_PMIC_ARB2_CHNL6_CMD_ADDR A:0x2432000
y.create.l HWIO_PMIC_ARB2_CHNL7_CMD_ADDR A:0x243a000
y.create.l HWIO_PMIC_ARB2_CHNL8_CMD_ADDR A:0x2442000
y.create.l HWIO_PMIC_ARB2_CHNL9_CMD_ADDR A:0x244a000
y.create.l HWIO_PMIC_ARB2_CHNL10_CMD_ADDR A:0x2452000
y.create.l HWIO_PMIC_ARB2_CHNL11_CMD_ADDR A:0x245a000
y.create.l HWIO_PMIC_ARB2_CHNL12_CMD_ADDR A:0x2462000
y.create.l HWIO_PMIC_ARB2_CHNL13_CMD_ADDR A:0x246a000
y.create.l HWIO_PMIC_ARB2_CHNL14_CMD_ADDR A:0x2472000
y.create.l HWIO_PMIC_ARB2_CHNL15_CMD_ADDR A:0x247a000
y.create.l HWIO_PMIC_ARB2_CHNL16_CMD_ADDR A:0x2482000
y.create.l HWIO_PMIC_ARB2_CHNL17_CMD_ADDR A:0x248a000
y.create.l HWIO_PMIC_ARB2_CHNL18_CMD_ADDR A:0x2492000
y.create.l HWIO_PMIC_ARB2_CHNL19_CMD_ADDR A:0x249a000
y.create.l HWIO_PMIC_ARB2_CHNL20_CMD_ADDR A:0x24a2000
y.create.l HWIO_PMIC_ARB2_CHNL21_CMD_ADDR A:0x24aa000
y.create.l HWIO_PMIC_ARB2_CHNL22_CMD_ADDR A:0x24b2000
y.create.l HWIO_PMIC_ARB2_CHNL23_CMD_ADDR A:0x24ba000
y.create.l HWIO_PMIC_ARB2_CHNL24_CMD_ADDR A:0x24c2000
y.create.l HWIO_PMIC_ARB2_CHNL25_CMD_ADDR A:0x24ca000
y.create.l HWIO_PMIC_ARB2_CHNL26_CMD_ADDR A:0x24d2000
y.create.l HWIO_PMIC_ARB2_CHNL27_CMD_ADDR A:0x24da000
y.create.l HWIO_PMIC_ARB2_CHNL28_CMD_ADDR A:0x24e2000
y.create.l HWIO_PMIC_ARB2_CHNL29_CMD_ADDR A:0x24ea000
y.create.l HWIO_PMIC_ARB2_CHNL30_CMD_ADDR A:0x24f2000
y.create.l HWIO_PMIC_ARB2_CHNL31_CMD_ADDR A:0x24fa000
y.create.l HWIO_PMIC_ARB2_CHNL32_CMD_ADDR A:0x2502000
y.create.l HWIO_PMIC_ARB2_CHNL33_CMD_ADDR A:0x250a000
y.create.l HWIO_PMIC_ARB2_CHNL34_CMD_ADDR A:0x2512000
y.create.l HWIO_PMIC_ARB2_CHNL35_CMD_ADDR A:0x251a000
y.create.l HWIO_PMIC_ARB2_CHNL36_CMD_ADDR A:0x2522000
y.create.l HWIO_PMIC_ARB2_CHNL37_CMD_ADDR A:0x252a000
y.create.l HWIO_PMIC_ARB2_CHNL38_CMD_ADDR A:0x2532000
y.create.l HWIO_PMIC_ARB2_CHNL39_CMD_ADDR A:0x253a000
y.create.l HWIO_PMIC_ARB2_CHNL40_CMD_ADDR A:0x2542000
y.create.l HWIO_PMIC_ARB2_CHNL41_CMD_ADDR A:0x254a000
y.create.l HWIO_PMIC_ARB2_CHNL42_CMD_ADDR A:0x2552000
y.create.l HWIO_PMIC_ARB2_CHNL43_CMD_ADDR A:0x255a000
y.create.l HWIO_PMIC_ARB2_CHNL44_CMD_ADDR A:0x2562000
y.create.l HWIO_PMIC_ARB2_CHNL45_CMD_ADDR A:0x256a000
y.create.l HWIO_PMIC_ARB2_CHNL46_CMD_ADDR A:0x2572000
y.create.l HWIO_PMIC_ARB2_CHNL47_CMD_ADDR A:0x257a000
y.create.l HWIO_PMIC_ARB2_CHNL48_CMD_ADDR A:0x2582000
y.create.l HWIO_PMIC_ARB2_CHNL49_CMD_ADDR A:0x258a000
y.create.l HWIO_PMIC_ARB2_CHNL50_CMD_ADDR A:0x2592000
y.create.l HWIO_PMIC_ARB2_CHNL51_CMD_ADDR A:0x259a000
y.create.l HWIO_PMIC_ARB2_CHNL52_CMD_ADDR A:0x25a2000
y.create.l HWIO_PMIC_ARB2_CHNL53_CMD_ADDR A:0x25aa000
y.create.l HWIO_PMIC_ARB2_CHNL54_CMD_ADDR A:0x25b2000
y.create.l HWIO_PMIC_ARB2_CHNL55_CMD_ADDR A:0x25ba000
y.create.l HWIO_PMIC_ARB2_CHNL56_CMD_ADDR A:0x25c2000
y.create.l HWIO_PMIC_ARB2_CHNL57_CMD_ADDR A:0x25ca000
y.create.l HWIO_PMIC_ARB2_CHNL58_CMD_ADDR A:0x25d2000
y.create.l HWIO_PMIC_ARB2_CHNL59_CMD_ADDR A:0x25da000
y.create.l HWIO_PMIC_ARB2_CHNL60_CMD_ADDR A:0x25e2000
y.create.l HWIO_PMIC_ARB2_CHNL61_CMD_ADDR A:0x25ea000
y.create.l HWIO_PMIC_ARB2_CHNL62_CMD_ADDR A:0x25f2000
y.create.l HWIO_PMIC_ARB2_CHNL63_CMD_ADDR A:0x25fa000
y.create.l HWIO_PMIC_ARB2_CHNL64_CMD_ADDR A:0x2602000
y.create.l HWIO_PMIC_ARB2_CHNL65_CMD_ADDR A:0x260a000
y.create.l HWIO_PMIC_ARB2_CHNL66_CMD_ADDR A:0x2612000
y.create.l HWIO_PMIC_ARB2_CHNL67_CMD_ADDR A:0x261a000
y.create.l HWIO_PMIC_ARB2_CHNL68_CMD_ADDR A:0x2622000
y.create.l HWIO_PMIC_ARB2_CHNL69_CMD_ADDR A:0x262a000
y.create.l HWIO_PMIC_ARB2_CHNL70_CMD_ADDR A:0x2632000
y.create.l HWIO_PMIC_ARB2_CHNL71_CMD_ADDR A:0x263a000
y.create.l HWIO_PMIC_ARB2_CHNL72_CMD_ADDR A:0x2642000
y.create.l HWIO_PMIC_ARB2_CHNL73_CMD_ADDR A:0x264a000
y.create.l HWIO_PMIC_ARB2_CHNL74_CMD_ADDR A:0x2652000
y.create.l HWIO_PMIC_ARB2_CHNL75_CMD_ADDR A:0x265a000
y.create.l HWIO_PMIC_ARB2_CHNL76_CMD_ADDR A:0x2662000
y.create.l HWIO_PMIC_ARB2_CHNL77_CMD_ADDR A:0x266a000
y.create.l HWIO_PMIC_ARB2_CHNL78_CMD_ADDR A:0x2672000
y.create.l HWIO_PMIC_ARB2_CHNL79_CMD_ADDR A:0x267a000
y.create.l HWIO_PMIC_ARB2_CHNL80_CMD_ADDR A:0x2682000
y.create.l HWIO_PMIC_ARB2_CHNL81_CMD_ADDR A:0x268a000
y.create.l HWIO_PMIC_ARB2_CHNL82_CMD_ADDR A:0x2692000
y.create.l HWIO_PMIC_ARB2_CHNL83_CMD_ADDR A:0x269a000
y.create.l HWIO_PMIC_ARB2_CHNL84_CMD_ADDR A:0x26a2000
y.create.l HWIO_PMIC_ARB2_CHNL85_CMD_ADDR A:0x26aa000
y.create.l HWIO_PMIC_ARB2_CHNL86_CMD_ADDR A:0x26b2000
y.create.l HWIO_PMIC_ARB2_CHNL87_CMD_ADDR A:0x26ba000
y.create.l HWIO_PMIC_ARB2_CHNL88_CMD_ADDR A:0x26c2000
y.create.l HWIO_PMIC_ARB2_CHNL89_CMD_ADDR A:0x26ca000
y.create.l HWIO_PMIC_ARB2_CHNL90_CMD_ADDR A:0x26d2000
y.create.l HWIO_PMIC_ARB2_CHNL91_CMD_ADDR A:0x26da000
y.create.l HWIO_PMIC_ARB2_CHNL92_CMD_ADDR A:0x26e2000
y.create.l HWIO_PMIC_ARB2_CHNL93_CMD_ADDR A:0x26ea000
y.create.l HWIO_PMIC_ARB2_CHNL94_CMD_ADDR A:0x26f2000
y.create.l HWIO_PMIC_ARB2_CHNL95_CMD_ADDR A:0x26fa000
y.create.l HWIO_PMIC_ARB2_CHNL96_CMD_ADDR A:0x2702000
y.create.l HWIO_PMIC_ARB2_CHNL97_CMD_ADDR A:0x270a000
y.create.l HWIO_PMIC_ARB2_CHNL98_CMD_ADDR A:0x2712000
y.create.l HWIO_PMIC_ARB2_CHNL99_CMD_ADDR A:0x271a000
y.create.l HWIO_PMIC_ARB2_CHNL100_CMD_ADDR A:0x2722000
y.create.l HWIO_PMIC_ARB2_CHNL101_CMD_ADDR A:0x272a000
y.create.l HWIO_PMIC_ARB2_CHNL102_CMD_ADDR A:0x2732000
y.create.l HWIO_PMIC_ARB2_CHNL103_CMD_ADDR A:0x273a000
y.create.l HWIO_PMIC_ARB2_CHNL104_CMD_ADDR A:0x2742000
y.create.l HWIO_PMIC_ARB2_CHNL105_CMD_ADDR A:0x274a000
y.create.l HWIO_PMIC_ARB2_CHNL106_CMD_ADDR A:0x2752000
y.create.l HWIO_PMIC_ARB2_CHNL107_CMD_ADDR A:0x275a000
y.create.l HWIO_PMIC_ARB2_CHNL108_CMD_ADDR A:0x2762000
y.create.l HWIO_PMIC_ARB2_CHNL109_CMD_ADDR A:0x276a000
y.create.l HWIO_PMIC_ARB2_CHNL110_CMD_ADDR A:0x2772000
y.create.l HWIO_PMIC_ARB2_CHNL111_CMD_ADDR A:0x277a000
y.create.l HWIO_PMIC_ARB2_CHNL112_CMD_ADDR A:0x2782000
y.create.l HWIO_PMIC_ARB2_CHNL113_CMD_ADDR A:0x278a000
y.create.l HWIO_PMIC_ARB2_CHNL114_CMD_ADDR A:0x2792000
y.create.l HWIO_PMIC_ARB2_CHNL115_CMD_ADDR A:0x279a000
y.create.l HWIO_PMIC_ARB2_CHNL116_CMD_ADDR A:0x27a2000
y.create.l HWIO_PMIC_ARB2_CHNL117_CMD_ADDR A:0x27aa000
y.create.l HWIO_PMIC_ARB2_CHNL118_CMD_ADDR A:0x27b2000
y.create.l HWIO_PMIC_ARB2_CHNL119_CMD_ADDR A:0x27ba000
y.create.l HWIO_PMIC_ARB2_CHNL120_CMD_ADDR A:0x27c2000
y.create.l HWIO_PMIC_ARB2_CHNL121_CMD_ADDR A:0x27ca000
y.create.l HWIO_PMIC_ARB2_CHNL122_CMD_ADDR A:0x27d2000
y.create.l HWIO_PMIC_ARB2_CHNL123_CMD_ADDR A:0x27da000
y.create.l HWIO_PMIC_ARB2_CHNL124_CMD_ADDR A:0x27e2000
y.create.l HWIO_PMIC_ARB2_CHNL125_CMD_ADDR A:0x27ea000
y.create.l HWIO_PMIC_ARB2_CHNL126_CMD_ADDR A:0x27f2000
y.create.l HWIO_PMIC_ARB2_CHNL127_CMD_ADDR A:0x27fa000
y.create.l HWIO_PMIC_ARB2_CHNL128_CMD_ADDR A:0x2802000
y.create.l HWIO_PMIC_ARB2_CHNL129_CMD_ADDR A:0x280a000
y.create.l HWIO_PMIC_ARB2_CHNL130_CMD_ADDR A:0x2812000
y.create.l HWIO_PMIC_ARB2_CHNL131_CMD_ADDR A:0x281a000
y.create.l HWIO_PMIC_ARB2_CHNL132_CMD_ADDR A:0x2822000
y.create.l HWIO_PMIC_ARB2_CHNL133_CMD_ADDR A:0x282a000
y.create.l HWIO_PMIC_ARB2_CHNL134_CMD_ADDR A:0x2832000
y.create.l HWIO_PMIC_ARB2_CHNL135_CMD_ADDR A:0x283a000
y.create.l HWIO_PMIC_ARB2_CHNL136_CMD_ADDR A:0x2842000
y.create.l HWIO_PMIC_ARB2_CHNL137_CMD_ADDR A:0x284a000
y.create.l HWIO_PMIC_ARB2_CHNL138_CMD_ADDR A:0x2852000
y.create.l HWIO_PMIC_ARB2_CHNL139_CMD_ADDR A:0x285a000
y.create.l HWIO_PMIC_ARB2_CHNL140_CMD_ADDR A:0x2862000
y.create.l HWIO_PMIC_ARB2_CHNL141_CMD_ADDR A:0x286a000
y.create.l HWIO_PMIC_ARB2_CHNL142_CMD_ADDR A:0x2872000
y.create.l HWIO_PMIC_ARB2_CHNL143_CMD_ADDR A:0x287a000
y.create.l HWIO_PMIC_ARB2_CHNL144_CMD_ADDR A:0x2882000
y.create.l HWIO_PMIC_ARB2_CHNL145_CMD_ADDR A:0x288a000
y.create.l HWIO_PMIC_ARB2_CHNL146_CMD_ADDR A:0x2892000
y.create.l HWIO_PMIC_ARB2_CHNL147_CMD_ADDR A:0x289a000
y.create.l HWIO_PMIC_ARB2_CHNL148_CMD_ADDR A:0x28a2000
y.create.l HWIO_PMIC_ARB2_CHNL149_CMD_ADDR A:0x28aa000
y.create.l HWIO_PMIC_ARB2_CHNL150_CMD_ADDR A:0x28b2000
y.create.l HWIO_PMIC_ARB2_CHNL151_CMD_ADDR A:0x28ba000
y.create.l HWIO_PMIC_ARB2_CHNL152_CMD_ADDR A:0x28c2000
y.create.l HWIO_PMIC_ARB2_CHNL153_CMD_ADDR A:0x28ca000
y.create.l HWIO_PMIC_ARB2_CHNL154_CMD_ADDR A:0x28d2000
y.create.l HWIO_PMIC_ARB2_CHNL155_CMD_ADDR A:0x28da000
y.create.l HWIO_PMIC_ARB2_CHNL156_CMD_ADDR A:0x28e2000
y.create.l HWIO_PMIC_ARB2_CHNL157_CMD_ADDR A:0x28ea000
y.create.l HWIO_PMIC_ARB2_CHNL158_CMD_ADDR A:0x28f2000
y.create.l HWIO_PMIC_ARB2_CHNL159_CMD_ADDR A:0x28fa000
y.create.l HWIO_PMIC_ARB2_CHNL160_CMD_ADDR A:0x2902000
y.create.l HWIO_PMIC_ARB2_CHNL161_CMD_ADDR A:0x290a000
y.create.l HWIO_PMIC_ARB2_CHNL162_CMD_ADDR A:0x2912000
y.create.l HWIO_PMIC_ARB2_CHNL163_CMD_ADDR A:0x291a000
y.create.l HWIO_PMIC_ARB2_CHNL164_CMD_ADDR A:0x2922000
y.create.l HWIO_PMIC_ARB2_CHNL165_CMD_ADDR A:0x292a000
y.create.l HWIO_PMIC_ARB2_CHNL166_CMD_ADDR A:0x2932000
y.create.l HWIO_PMIC_ARB2_CHNL167_CMD_ADDR A:0x293a000
y.create.l HWIO_PMIC_ARB2_CHNL168_CMD_ADDR A:0x2942000
y.create.l HWIO_PMIC_ARB2_CHNL169_CMD_ADDR A:0x294a000
y.create.l HWIO_PMIC_ARB2_CHNL170_CMD_ADDR A:0x2952000
y.create.l HWIO_PMIC_ARB2_CHNL171_CMD_ADDR A:0x295a000
y.create.l HWIO_PMIC_ARB2_CHNL172_CMD_ADDR A:0x2962000
y.create.l HWIO_PMIC_ARB2_CHNL173_CMD_ADDR A:0x296a000
y.create.l HWIO_PMIC_ARB2_CHNL174_CMD_ADDR A:0x2972000
y.create.l HWIO_PMIC_ARB2_CHNL175_CMD_ADDR A:0x297a000
y.create.l HWIO_PMIC_ARB2_CHNL176_CMD_ADDR A:0x2982000
y.create.l HWIO_PMIC_ARB2_CHNL177_CMD_ADDR A:0x298a000
y.create.l HWIO_PMIC_ARB2_CHNL178_CMD_ADDR A:0x2992000
y.create.l HWIO_PMIC_ARB2_CHNL179_CMD_ADDR A:0x299a000
y.create.l HWIO_PMIC_ARB2_CHNL180_CMD_ADDR A:0x29a2000
y.create.l HWIO_PMIC_ARB2_CHNL181_CMD_ADDR A:0x29aa000
y.create.l HWIO_PMIC_ARB2_CHNL182_CMD_ADDR A:0x29b2000
y.create.l HWIO_PMIC_ARB2_CHNL183_CMD_ADDR A:0x29ba000
y.create.l HWIO_PMIC_ARB2_CHNL184_CMD_ADDR A:0x29c2000
y.create.l HWIO_PMIC_ARB2_CHNL185_CMD_ADDR A:0x29ca000
y.create.l HWIO_PMIC_ARB2_CHNL186_CMD_ADDR A:0x29d2000
y.create.l HWIO_PMIC_ARB2_CHNL187_CMD_ADDR A:0x29da000
y.create.l HWIO_PMIC_ARB2_CHNL188_CMD_ADDR A:0x29e2000
y.create.l HWIO_PMIC_ARB2_CHNL189_CMD_ADDR A:0x29ea000
y.create.l HWIO_PMIC_ARB2_CHNL190_CMD_ADDR A:0x29f2000
y.create.l HWIO_PMIC_ARB2_CHNL191_CMD_ADDR A:0x29fa000
y.create.l HWIO_PMIC_ARB2_CHNL192_CMD_ADDR A:0x2a02000
y.create.l HWIO_PMIC_ARB2_CHNL193_CMD_ADDR A:0x2a0a000
y.create.l HWIO_PMIC_ARB2_CHNL194_CMD_ADDR A:0x2a12000
y.create.l HWIO_PMIC_ARB2_CHNL195_CMD_ADDR A:0x2a1a000
y.create.l HWIO_PMIC_ARB2_CHNL196_CMD_ADDR A:0x2a22000
y.create.l HWIO_PMIC_ARB2_CHNL197_CMD_ADDR A:0x2a2a000
y.create.l HWIO_PMIC_ARB2_CHNL198_CMD_ADDR A:0x2a32000
y.create.l HWIO_PMIC_ARB2_CHNL199_CMD_ADDR A:0x2a3a000
y.create.l HWIO_PMIC_ARB2_CHNL200_CMD_ADDR A:0x2a42000
y.create.l HWIO_PMIC_ARB2_CHNL201_CMD_ADDR A:0x2a4a000
y.create.l HWIO_PMIC_ARB2_CHNL202_CMD_ADDR A:0x2a52000
y.create.l HWIO_PMIC_ARB2_CHNL203_CMD_ADDR A:0x2a5a000
y.create.l HWIO_PMIC_ARB2_CHNL204_CMD_ADDR A:0x2a62000
y.create.l HWIO_PMIC_ARB2_CHNL205_CMD_ADDR A:0x2a6a000
y.create.l HWIO_PMIC_ARB2_CHNL206_CMD_ADDR A:0x2a72000
y.create.l HWIO_PMIC_ARB2_CHNL207_CMD_ADDR A:0x2a7a000
y.create.l HWIO_PMIC_ARB2_CHNL208_CMD_ADDR A:0x2a82000
y.create.l HWIO_PMIC_ARB2_CHNL209_CMD_ADDR A:0x2a8a000
y.create.l HWIO_PMIC_ARB2_CHNL210_CMD_ADDR A:0x2a92000
y.create.l HWIO_PMIC_ARB2_CHNL211_CMD_ADDR A:0x2a9a000
y.create.l HWIO_PMIC_ARB2_CHNL212_CMD_ADDR A:0x2aa2000
y.create.l HWIO_PMIC_ARB2_CHNL213_CMD_ADDR A:0x2aaa000
y.create.l HWIO_PMIC_ARB2_CHNL214_CMD_ADDR A:0x2ab2000
y.create.l HWIO_PMIC_ARB2_CHNL215_CMD_ADDR A:0x2aba000
y.create.l HWIO_PMIC_ARB2_CHNL216_CMD_ADDR A:0x2ac2000
y.create.l HWIO_PMIC_ARB2_CHNL217_CMD_ADDR A:0x2aca000
y.create.l HWIO_PMIC_ARB2_CHNL218_CMD_ADDR A:0x2ad2000
y.create.l HWIO_PMIC_ARB2_CHNL219_CMD_ADDR A:0x2ada000
y.create.l HWIO_PMIC_ARB2_CHNL220_CMD_ADDR A:0x2ae2000
y.create.l HWIO_PMIC_ARB2_CHNL221_CMD_ADDR A:0x2aea000
y.create.l HWIO_PMIC_ARB2_CHNL222_CMD_ADDR A:0x2af2000
y.create.l HWIO_PMIC_ARB2_CHNL223_CMD_ADDR A:0x2afa000
y.create.l HWIO_PMIC_ARB2_CHNL224_CMD_ADDR A:0x2b02000
y.create.l HWIO_PMIC_ARB2_CHNL225_CMD_ADDR A:0x2b0a000
y.create.l HWIO_PMIC_ARB2_CHNL226_CMD_ADDR A:0x2b12000
y.create.l HWIO_PMIC_ARB2_CHNL227_CMD_ADDR A:0x2b1a000
y.create.l HWIO_PMIC_ARB2_CHNL228_CMD_ADDR A:0x2b22000
y.create.l HWIO_PMIC_ARB2_CHNL229_CMD_ADDR A:0x2b2a000
y.create.l HWIO_PMIC_ARB2_CHNL230_CMD_ADDR A:0x2b32000
y.create.l HWIO_PMIC_ARB2_CHNL231_CMD_ADDR A:0x2b3a000
y.create.l HWIO_PMIC_ARB2_CHNL232_CMD_ADDR A:0x2b42000
y.create.l HWIO_PMIC_ARB2_CHNL233_CMD_ADDR A:0x2b4a000
y.create.l HWIO_PMIC_ARB2_CHNL234_CMD_ADDR A:0x2b52000
y.create.l HWIO_PMIC_ARB2_CHNL235_CMD_ADDR A:0x2b5a000
y.create.l HWIO_PMIC_ARB2_CHNL236_CMD_ADDR A:0x2b62000
y.create.l HWIO_PMIC_ARB2_CHNL237_CMD_ADDR A:0x2b6a000
y.create.l HWIO_PMIC_ARB2_CHNL238_CMD_ADDR A:0x2b72000
y.create.l HWIO_PMIC_ARB2_CHNL239_CMD_ADDR A:0x2b7a000
y.create.l HWIO_PMIC_ARB2_CHNL240_CMD_ADDR A:0x2b82000
y.create.l HWIO_PMIC_ARB2_CHNL241_CMD_ADDR A:0x2b8a000
y.create.l HWIO_PMIC_ARB2_CHNL242_CMD_ADDR A:0x2b92000
y.create.l HWIO_PMIC_ARB2_CHNL243_CMD_ADDR A:0x2b9a000
y.create.l HWIO_PMIC_ARB2_CHNL244_CMD_ADDR A:0x2ba2000
y.create.l HWIO_PMIC_ARB2_CHNL245_CMD_ADDR A:0x2baa000
y.create.l HWIO_PMIC_ARB2_CHNL246_CMD_ADDR A:0x2bb2000
y.create.l HWIO_PMIC_ARB2_CHNL247_CMD_ADDR A:0x2bba000
y.create.l HWIO_PMIC_ARB2_CHNL248_CMD_ADDR A:0x2bc2000
y.create.l HWIO_PMIC_ARB2_CHNL249_CMD_ADDR A:0x2bca000
y.create.l HWIO_PMIC_ARB2_CHNL250_CMD_ADDR A:0x2bd2000
y.create.l HWIO_PMIC_ARB2_CHNL251_CMD_ADDR A:0x2bda000
y.create.l HWIO_PMIC_ARB2_CHNL252_CMD_ADDR A:0x2be2000
y.create.l HWIO_PMIC_ARB2_CHNL253_CMD_ADDR A:0x2bea000
y.create.l HWIO_PMIC_ARB2_CHNL254_CMD_ADDR A:0x2bf2000
y.create.l HWIO_PMIC_ARB2_CHNL255_CMD_ADDR A:0x2bfa000
y.create.l HWIO_PMIC_ARB3_CHNL0_CMD_ADDR A:0x2403000
y.create.l HWIO_PMIC_ARB3_CHNL1_CMD_ADDR A:0x240b000
y.create.l HWIO_PMIC_ARB3_CHNL2_CMD_ADDR A:0x2413000
y.create.l HWIO_PMIC_ARB3_CHNL3_CMD_ADDR A:0x241b000
y.create.l HWIO_PMIC_ARB3_CHNL4_CMD_ADDR A:0x2423000
y.create.l HWIO_PMIC_ARB3_CHNL5_CMD_ADDR A:0x242b000
y.create.l HWIO_PMIC_ARB3_CHNL6_CMD_ADDR A:0x2433000
y.create.l HWIO_PMIC_ARB3_CHNL7_CMD_ADDR A:0x243b000
y.create.l HWIO_PMIC_ARB3_CHNL8_CMD_ADDR A:0x2443000
y.create.l HWIO_PMIC_ARB3_CHNL9_CMD_ADDR A:0x244b000
y.create.l HWIO_PMIC_ARB3_CHNL10_CMD_ADDR A:0x2453000
y.create.l HWIO_PMIC_ARB3_CHNL11_CMD_ADDR A:0x245b000
y.create.l HWIO_PMIC_ARB3_CHNL12_CMD_ADDR A:0x2463000
y.create.l HWIO_PMIC_ARB3_CHNL13_CMD_ADDR A:0x246b000
y.create.l HWIO_PMIC_ARB3_CHNL14_CMD_ADDR A:0x2473000
y.create.l HWIO_PMIC_ARB3_CHNL15_CMD_ADDR A:0x247b000
y.create.l HWIO_PMIC_ARB3_CHNL16_CMD_ADDR A:0x2483000
y.create.l HWIO_PMIC_ARB3_CHNL17_CMD_ADDR A:0x248b000
y.create.l HWIO_PMIC_ARB3_CHNL18_CMD_ADDR A:0x2493000
y.create.l HWIO_PMIC_ARB3_CHNL19_CMD_ADDR A:0x249b000
y.create.l HWIO_PMIC_ARB3_CHNL20_CMD_ADDR A:0x24a3000
y.create.l HWIO_PMIC_ARB3_CHNL21_CMD_ADDR A:0x24ab000
y.create.l HWIO_PMIC_ARB3_CHNL22_CMD_ADDR A:0x24b3000
y.create.l HWIO_PMIC_ARB3_CHNL23_CMD_ADDR A:0x24bb000
y.create.l HWIO_PMIC_ARB3_CHNL24_CMD_ADDR A:0x24c3000
y.create.l HWIO_PMIC_ARB3_CHNL25_CMD_ADDR A:0x24cb000
y.create.l HWIO_PMIC_ARB3_CHNL26_CMD_ADDR A:0x24d3000
y.create.l HWIO_PMIC_ARB3_CHNL27_CMD_ADDR A:0x24db000
y.create.l HWIO_PMIC_ARB3_CHNL28_CMD_ADDR A:0x24e3000
y.create.l HWIO_PMIC_ARB3_CHNL29_CMD_ADDR A:0x24eb000
y.create.l HWIO_PMIC_ARB3_CHNL30_CMD_ADDR A:0x24f3000
y.create.l HWIO_PMIC_ARB3_CHNL31_CMD_ADDR A:0x24fb000
y.create.l HWIO_PMIC_ARB3_CHNL32_CMD_ADDR A:0x2503000
y.create.l HWIO_PMIC_ARB3_CHNL33_CMD_ADDR A:0x250b000
y.create.l HWIO_PMIC_ARB3_CHNL34_CMD_ADDR A:0x2513000
y.create.l HWIO_PMIC_ARB3_CHNL35_CMD_ADDR A:0x251b000
y.create.l HWIO_PMIC_ARB3_CHNL36_CMD_ADDR A:0x2523000
y.create.l HWIO_PMIC_ARB3_CHNL37_CMD_ADDR A:0x252b000
y.create.l HWIO_PMIC_ARB3_CHNL38_CMD_ADDR A:0x2533000
y.create.l HWIO_PMIC_ARB3_CHNL39_CMD_ADDR A:0x253b000
y.create.l HWIO_PMIC_ARB3_CHNL40_CMD_ADDR A:0x2543000
y.create.l HWIO_PMIC_ARB3_CHNL41_CMD_ADDR A:0x254b000
y.create.l HWIO_PMIC_ARB3_CHNL42_CMD_ADDR A:0x2553000
y.create.l HWIO_PMIC_ARB3_CHNL43_CMD_ADDR A:0x255b000
y.create.l HWIO_PMIC_ARB3_CHNL44_CMD_ADDR A:0x2563000
y.create.l HWIO_PMIC_ARB3_CHNL45_CMD_ADDR A:0x256b000
y.create.l HWIO_PMIC_ARB3_CHNL46_CMD_ADDR A:0x2573000
y.create.l HWIO_PMIC_ARB3_CHNL47_CMD_ADDR A:0x257b000
y.create.l HWIO_PMIC_ARB3_CHNL48_CMD_ADDR A:0x2583000
y.create.l HWIO_PMIC_ARB3_CHNL49_CMD_ADDR A:0x258b000
y.create.l HWIO_PMIC_ARB3_CHNL50_CMD_ADDR A:0x2593000
y.create.l HWIO_PMIC_ARB3_CHNL51_CMD_ADDR A:0x259b000
y.create.l HWIO_PMIC_ARB3_CHNL52_CMD_ADDR A:0x25a3000
y.create.l HWIO_PMIC_ARB3_CHNL53_CMD_ADDR A:0x25ab000
y.create.l HWIO_PMIC_ARB3_CHNL54_CMD_ADDR A:0x25b3000
y.create.l HWIO_PMIC_ARB3_CHNL55_CMD_ADDR A:0x25bb000
y.create.l HWIO_PMIC_ARB3_CHNL56_CMD_ADDR A:0x25c3000
y.create.l HWIO_PMIC_ARB3_CHNL57_CMD_ADDR A:0x25cb000
y.create.l HWIO_PMIC_ARB3_CHNL58_CMD_ADDR A:0x25d3000
y.create.l HWIO_PMIC_ARB3_CHNL59_CMD_ADDR A:0x25db000
y.create.l HWIO_PMIC_ARB3_CHNL60_CMD_ADDR A:0x25e3000
y.create.l HWIO_PMIC_ARB3_CHNL61_CMD_ADDR A:0x25eb000
y.create.l HWIO_PMIC_ARB3_CHNL62_CMD_ADDR A:0x25f3000
y.create.l HWIO_PMIC_ARB3_CHNL63_CMD_ADDR A:0x25fb000
y.create.l HWIO_PMIC_ARB3_CHNL64_CMD_ADDR A:0x2603000
y.create.l HWIO_PMIC_ARB3_CHNL65_CMD_ADDR A:0x260b000
y.create.l HWIO_PMIC_ARB3_CHNL66_CMD_ADDR A:0x2613000
y.create.l HWIO_PMIC_ARB3_CHNL67_CMD_ADDR A:0x261b000
y.create.l HWIO_PMIC_ARB3_CHNL68_CMD_ADDR A:0x2623000
y.create.l HWIO_PMIC_ARB3_CHNL69_CMD_ADDR A:0x262b000
y.create.l HWIO_PMIC_ARB3_CHNL70_CMD_ADDR A:0x2633000
y.create.l HWIO_PMIC_ARB3_CHNL71_CMD_ADDR A:0x263b000
y.create.l HWIO_PMIC_ARB3_CHNL72_CMD_ADDR A:0x2643000
y.create.l HWIO_PMIC_ARB3_CHNL73_CMD_ADDR A:0x264b000
y.create.l HWIO_PMIC_ARB3_CHNL74_CMD_ADDR A:0x2653000
y.create.l HWIO_PMIC_ARB3_CHNL75_CMD_ADDR A:0x265b000
y.create.l HWIO_PMIC_ARB3_CHNL76_CMD_ADDR A:0x2663000
y.create.l HWIO_PMIC_ARB3_CHNL77_CMD_ADDR A:0x266b000
y.create.l HWIO_PMIC_ARB3_CHNL78_CMD_ADDR A:0x2673000
y.create.l HWIO_PMIC_ARB3_CHNL79_CMD_ADDR A:0x267b000
y.create.l HWIO_PMIC_ARB3_CHNL80_CMD_ADDR A:0x2683000
y.create.l HWIO_PMIC_ARB3_CHNL81_CMD_ADDR A:0x268b000
y.create.l HWIO_PMIC_ARB3_CHNL82_CMD_ADDR A:0x2693000
y.create.l HWIO_PMIC_ARB3_CHNL83_CMD_ADDR A:0x269b000
y.create.l HWIO_PMIC_ARB3_CHNL84_CMD_ADDR A:0x26a3000
y.create.l HWIO_PMIC_ARB3_CHNL85_CMD_ADDR A:0x26ab000
y.create.l HWIO_PMIC_ARB3_CHNL86_CMD_ADDR A:0x26b3000
y.create.l HWIO_PMIC_ARB3_CHNL87_CMD_ADDR A:0x26bb000
y.create.l HWIO_PMIC_ARB3_CHNL88_CMD_ADDR A:0x26c3000
y.create.l HWIO_PMIC_ARB3_CHNL89_CMD_ADDR A:0x26cb000
y.create.l HWIO_PMIC_ARB3_CHNL90_CMD_ADDR A:0x26d3000
y.create.l HWIO_PMIC_ARB3_CHNL91_CMD_ADDR A:0x26db000
y.create.l HWIO_PMIC_ARB3_CHNL92_CMD_ADDR A:0x26e3000
y.create.l HWIO_PMIC_ARB3_CHNL93_CMD_ADDR A:0x26eb000
y.create.l HWIO_PMIC_ARB3_CHNL94_CMD_ADDR A:0x26f3000
y.create.l HWIO_PMIC_ARB3_CHNL95_CMD_ADDR A:0x26fb000
y.create.l HWIO_PMIC_ARB3_CHNL96_CMD_ADDR A:0x2703000
y.create.l HWIO_PMIC_ARB3_CHNL97_CMD_ADDR A:0x270b000
y.create.l HWIO_PMIC_ARB3_CHNL98_CMD_ADDR A:0x2713000
y.create.l HWIO_PMIC_ARB3_CHNL99_CMD_ADDR A:0x271b000
y.create.l HWIO_PMIC_ARB3_CHNL100_CMD_ADDR A:0x2723000
y.create.l HWIO_PMIC_ARB3_CHNL101_CMD_ADDR A:0x272b000
y.create.l HWIO_PMIC_ARB3_CHNL102_CMD_ADDR A:0x2733000
y.create.l HWIO_PMIC_ARB3_CHNL103_CMD_ADDR A:0x273b000
y.create.l HWIO_PMIC_ARB3_CHNL104_CMD_ADDR A:0x2743000
y.create.l HWIO_PMIC_ARB3_CHNL105_CMD_ADDR A:0x274b000
y.create.l HWIO_PMIC_ARB3_CHNL106_CMD_ADDR A:0x2753000
y.create.l HWIO_PMIC_ARB3_CHNL107_CMD_ADDR A:0x275b000
y.create.l HWIO_PMIC_ARB3_CHNL108_CMD_ADDR A:0x2763000
y.create.l HWIO_PMIC_ARB3_CHNL109_CMD_ADDR A:0x276b000
y.create.l HWIO_PMIC_ARB3_CHNL110_CMD_ADDR A:0x2773000
y.create.l HWIO_PMIC_ARB3_CHNL111_CMD_ADDR A:0x277b000
y.create.l HWIO_PMIC_ARB3_CHNL112_CMD_ADDR A:0x2783000
y.create.l HWIO_PMIC_ARB3_CHNL113_CMD_ADDR A:0x278b000
y.create.l HWIO_PMIC_ARB3_CHNL114_CMD_ADDR A:0x2793000
y.create.l HWIO_PMIC_ARB3_CHNL115_CMD_ADDR A:0x279b000
y.create.l HWIO_PMIC_ARB3_CHNL116_CMD_ADDR A:0x27a3000
y.create.l HWIO_PMIC_ARB3_CHNL117_CMD_ADDR A:0x27ab000
y.create.l HWIO_PMIC_ARB3_CHNL118_CMD_ADDR A:0x27b3000
y.create.l HWIO_PMIC_ARB3_CHNL119_CMD_ADDR A:0x27bb000
y.create.l HWIO_PMIC_ARB3_CHNL120_CMD_ADDR A:0x27c3000
y.create.l HWIO_PMIC_ARB3_CHNL121_CMD_ADDR A:0x27cb000
y.create.l HWIO_PMIC_ARB3_CHNL122_CMD_ADDR A:0x27d3000
y.create.l HWIO_PMIC_ARB3_CHNL123_CMD_ADDR A:0x27db000
y.create.l HWIO_PMIC_ARB3_CHNL124_CMD_ADDR A:0x27e3000
y.create.l HWIO_PMIC_ARB3_CHNL125_CMD_ADDR A:0x27eb000
y.create.l HWIO_PMIC_ARB3_CHNL126_CMD_ADDR A:0x27f3000
y.create.l HWIO_PMIC_ARB3_CHNL127_CMD_ADDR A:0x27fb000
y.create.l HWIO_PMIC_ARB3_CHNL128_CMD_ADDR A:0x2803000
y.create.l HWIO_PMIC_ARB3_CHNL129_CMD_ADDR A:0x280b000
y.create.l HWIO_PMIC_ARB3_CHNL130_CMD_ADDR A:0x2813000
y.create.l HWIO_PMIC_ARB3_CHNL131_CMD_ADDR A:0x281b000
y.create.l HWIO_PMIC_ARB3_CHNL132_CMD_ADDR A:0x2823000
y.create.l HWIO_PMIC_ARB3_CHNL133_CMD_ADDR A:0x282b000
y.create.l HWIO_PMIC_ARB3_CHNL134_CMD_ADDR A:0x2833000
y.create.l HWIO_PMIC_ARB3_CHNL135_CMD_ADDR A:0x283b000
y.create.l HWIO_PMIC_ARB3_CHNL136_CMD_ADDR A:0x2843000
y.create.l HWIO_PMIC_ARB3_CHNL137_CMD_ADDR A:0x284b000
y.create.l HWIO_PMIC_ARB3_CHNL138_CMD_ADDR A:0x2853000
y.create.l HWIO_PMIC_ARB3_CHNL139_CMD_ADDR A:0x285b000
y.create.l HWIO_PMIC_ARB3_CHNL140_CMD_ADDR A:0x2863000
y.create.l HWIO_PMIC_ARB3_CHNL141_CMD_ADDR A:0x286b000
y.create.l HWIO_PMIC_ARB3_CHNL142_CMD_ADDR A:0x2873000
y.create.l HWIO_PMIC_ARB3_CHNL143_CMD_ADDR A:0x287b000
y.create.l HWIO_PMIC_ARB3_CHNL144_CMD_ADDR A:0x2883000
y.create.l HWIO_PMIC_ARB3_CHNL145_CMD_ADDR A:0x288b000
y.create.l HWIO_PMIC_ARB3_CHNL146_CMD_ADDR A:0x2893000
y.create.l HWIO_PMIC_ARB3_CHNL147_CMD_ADDR A:0x289b000
y.create.l HWIO_PMIC_ARB3_CHNL148_CMD_ADDR A:0x28a3000
y.create.l HWIO_PMIC_ARB3_CHNL149_CMD_ADDR A:0x28ab000
y.create.l HWIO_PMIC_ARB3_CHNL150_CMD_ADDR A:0x28b3000
y.create.l HWIO_PMIC_ARB3_CHNL151_CMD_ADDR A:0x28bb000
y.create.l HWIO_PMIC_ARB3_CHNL152_CMD_ADDR A:0x28c3000
y.create.l HWIO_PMIC_ARB3_CHNL153_CMD_ADDR A:0x28cb000
y.create.l HWIO_PMIC_ARB3_CHNL154_CMD_ADDR A:0x28d3000
y.create.l HWIO_PMIC_ARB3_CHNL155_CMD_ADDR A:0x28db000
y.create.l HWIO_PMIC_ARB3_CHNL156_CMD_ADDR A:0x28e3000
y.create.l HWIO_PMIC_ARB3_CHNL157_CMD_ADDR A:0x28eb000
y.create.l HWIO_PMIC_ARB3_CHNL158_CMD_ADDR A:0x28f3000
y.create.l HWIO_PMIC_ARB3_CHNL159_CMD_ADDR A:0x28fb000
y.create.l HWIO_PMIC_ARB3_CHNL160_CMD_ADDR A:0x2903000
y.create.l HWIO_PMIC_ARB3_CHNL161_CMD_ADDR A:0x290b000
y.create.l HWIO_PMIC_ARB3_CHNL162_CMD_ADDR A:0x2913000
y.create.l HWIO_PMIC_ARB3_CHNL163_CMD_ADDR A:0x291b000
y.create.l HWIO_PMIC_ARB3_CHNL164_CMD_ADDR A:0x2923000
y.create.l HWIO_PMIC_ARB3_CHNL165_CMD_ADDR A:0x292b000
y.create.l HWIO_PMIC_ARB3_CHNL166_CMD_ADDR A:0x2933000
y.create.l HWIO_PMIC_ARB3_CHNL167_CMD_ADDR A:0x293b000
y.create.l HWIO_PMIC_ARB3_CHNL168_CMD_ADDR A:0x2943000
y.create.l HWIO_PMIC_ARB3_CHNL169_CMD_ADDR A:0x294b000
y.create.l HWIO_PMIC_ARB3_CHNL170_CMD_ADDR A:0x2953000
y.create.l HWIO_PMIC_ARB3_CHNL171_CMD_ADDR A:0x295b000
y.create.l HWIO_PMIC_ARB3_CHNL172_CMD_ADDR A:0x2963000
y.create.l HWIO_PMIC_ARB3_CHNL173_CMD_ADDR A:0x296b000
y.create.l HWIO_PMIC_ARB3_CHNL174_CMD_ADDR A:0x2973000
y.create.l HWIO_PMIC_ARB3_CHNL175_CMD_ADDR A:0x297b000
y.create.l HWIO_PMIC_ARB3_CHNL176_CMD_ADDR A:0x2983000
y.create.l HWIO_PMIC_ARB3_CHNL177_CMD_ADDR A:0x298b000
y.create.l HWIO_PMIC_ARB3_CHNL178_CMD_ADDR A:0x2993000
y.create.l HWIO_PMIC_ARB3_CHNL179_CMD_ADDR A:0x299b000
y.create.l HWIO_PMIC_ARB3_CHNL180_CMD_ADDR A:0x29a3000
y.create.l HWIO_PMIC_ARB3_CHNL181_CMD_ADDR A:0x29ab000
y.create.l HWIO_PMIC_ARB3_CHNL182_CMD_ADDR A:0x29b3000
y.create.l HWIO_PMIC_ARB3_CHNL183_CMD_ADDR A:0x29bb000
y.create.l HWIO_PMIC_ARB3_CHNL184_CMD_ADDR A:0x29c3000
y.create.l HWIO_PMIC_ARB3_CHNL185_CMD_ADDR A:0x29cb000
y.create.l HWIO_PMIC_ARB3_CHNL186_CMD_ADDR A:0x29d3000
y.create.l HWIO_PMIC_ARB3_CHNL187_CMD_ADDR A:0x29db000
y.create.l HWIO_PMIC_ARB3_CHNL188_CMD_ADDR A:0x29e3000
y.create.l HWIO_PMIC_ARB3_CHNL189_CMD_ADDR A:0x29eb000
y.create.l HWIO_PMIC_ARB3_CHNL190_CMD_ADDR A:0x29f3000
y.create.l HWIO_PMIC_ARB3_CHNL191_CMD_ADDR A:0x29fb000
y.create.l HWIO_PMIC_ARB3_CHNL192_CMD_ADDR A:0x2a03000
y.create.l HWIO_PMIC_ARB3_CHNL193_CMD_ADDR A:0x2a0b000
y.create.l HWIO_PMIC_ARB3_CHNL194_CMD_ADDR A:0x2a13000
y.create.l HWIO_PMIC_ARB3_CHNL195_CMD_ADDR A:0x2a1b000
y.create.l HWIO_PMIC_ARB3_CHNL196_CMD_ADDR A:0x2a23000
y.create.l HWIO_PMIC_ARB3_CHNL197_CMD_ADDR A:0x2a2b000
y.create.l HWIO_PMIC_ARB3_CHNL198_CMD_ADDR A:0x2a33000
y.create.l HWIO_PMIC_ARB3_CHNL199_CMD_ADDR A:0x2a3b000
y.create.l HWIO_PMIC_ARB3_CHNL200_CMD_ADDR A:0x2a43000
y.create.l HWIO_PMIC_ARB3_CHNL201_CMD_ADDR A:0x2a4b000
y.create.l HWIO_PMIC_ARB3_CHNL202_CMD_ADDR A:0x2a53000
y.create.l HWIO_PMIC_ARB3_CHNL203_CMD_ADDR A:0x2a5b000
y.create.l HWIO_PMIC_ARB3_CHNL204_CMD_ADDR A:0x2a63000
y.create.l HWIO_PMIC_ARB3_CHNL205_CMD_ADDR A:0x2a6b000
y.create.l HWIO_PMIC_ARB3_CHNL206_CMD_ADDR A:0x2a73000
y.create.l HWIO_PMIC_ARB3_CHNL207_CMD_ADDR A:0x2a7b000
y.create.l HWIO_PMIC_ARB3_CHNL208_CMD_ADDR A:0x2a83000
y.create.l HWIO_PMIC_ARB3_CHNL209_CMD_ADDR A:0x2a8b000
y.create.l HWIO_PMIC_ARB3_CHNL210_CMD_ADDR A:0x2a93000
y.create.l HWIO_PMIC_ARB3_CHNL211_CMD_ADDR A:0x2a9b000
y.create.l HWIO_PMIC_ARB3_CHNL212_CMD_ADDR A:0x2aa3000
y.create.l HWIO_PMIC_ARB3_CHNL213_CMD_ADDR A:0x2aab000
y.create.l HWIO_PMIC_ARB3_CHNL214_CMD_ADDR A:0x2ab3000
y.create.l HWIO_PMIC_ARB3_CHNL215_CMD_ADDR A:0x2abb000
y.create.l HWIO_PMIC_ARB3_CHNL216_CMD_ADDR A:0x2ac3000
y.create.l HWIO_PMIC_ARB3_CHNL217_CMD_ADDR A:0x2acb000
y.create.l HWIO_PMIC_ARB3_CHNL218_CMD_ADDR A:0x2ad3000
y.create.l HWIO_PMIC_ARB3_CHNL219_CMD_ADDR A:0x2adb000
y.create.l HWIO_PMIC_ARB3_CHNL220_CMD_ADDR A:0x2ae3000
y.create.l HWIO_PMIC_ARB3_CHNL221_CMD_ADDR A:0x2aeb000
y.create.l HWIO_PMIC_ARB3_CHNL222_CMD_ADDR A:0x2af3000
y.create.l HWIO_PMIC_ARB3_CHNL223_CMD_ADDR A:0x2afb000
y.create.l HWIO_PMIC_ARB3_CHNL224_CMD_ADDR A:0x2b03000
y.create.l HWIO_PMIC_ARB3_CHNL225_CMD_ADDR A:0x2b0b000
y.create.l HWIO_PMIC_ARB3_CHNL226_CMD_ADDR A:0x2b13000
y.create.l HWIO_PMIC_ARB3_CHNL227_CMD_ADDR A:0x2b1b000
y.create.l HWIO_PMIC_ARB3_CHNL228_CMD_ADDR A:0x2b23000
y.create.l HWIO_PMIC_ARB3_CHNL229_CMD_ADDR A:0x2b2b000
y.create.l HWIO_PMIC_ARB3_CHNL230_CMD_ADDR A:0x2b33000
y.create.l HWIO_PMIC_ARB3_CHNL231_CMD_ADDR A:0x2b3b000
y.create.l HWIO_PMIC_ARB3_CHNL232_CMD_ADDR A:0x2b43000
y.create.l HWIO_PMIC_ARB3_CHNL233_CMD_ADDR A:0x2b4b000
y.create.l HWIO_PMIC_ARB3_CHNL234_CMD_ADDR A:0x2b53000
y.create.l HWIO_PMIC_ARB3_CHNL235_CMD_ADDR A:0x2b5b000
y.create.l HWIO_PMIC_ARB3_CHNL236_CMD_ADDR A:0x2b63000
y.create.l HWIO_PMIC_ARB3_CHNL237_CMD_ADDR A:0x2b6b000
y.create.l HWIO_PMIC_ARB3_CHNL238_CMD_ADDR A:0x2b73000
y.create.l HWIO_PMIC_ARB3_CHNL239_CMD_ADDR A:0x2b7b000
y.create.l HWIO_PMIC_ARB3_CHNL240_CMD_ADDR A:0x2b83000
y.create.l HWIO_PMIC_ARB3_CHNL241_CMD_ADDR A:0x2b8b000
y.create.l HWIO_PMIC_ARB3_CHNL242_CMD_ADDR A:0x2b93000
y.create.l HWIO_PMIC_ARB3_CHNL243_CMD_ADDR A:0x2b9b000
y.create.l HWIO_PMIC_ARB3_CHNL244_CMD_ADDR A:0x2ba3000
y.create.l HWIO_PMIC_ARB3_CHNL245_CMD_ADDR A:0x2bab000
y.create.l HWIO_PMIC_ARB3_CHNL246_CMD_ADDR A:0x2bb3000
y.create.l HWIO_PMIC_ARB3_CHNL247_CMD_ADDR A:0x2bbb000
y.create.l HWIO_PMIC_ARB3_CHNL248_CMD_ADDR A:0x2bc3000
y.create.l HWIO_PMIC_ARB3_CHNL249_CMD_ADDR A:0x2bcb000
y.create.l HWIO_PMIC_ARB3_CHNL250_CMD_ADDR A:0x2bd3000
y.create.l HWIO_PMIC_ARB3_CHNL251_CMD_ADDR A:0x2bdb000
y.create.l HWIO_PMIC_ARB3_CHNL252_CMD_ADDR A:0x2be3000
y.create.l HWIO_PMIC_ARB3_CHNL253_CMD_ADDR A:0x2beb000
y.create.l HWIO_PMIC_ARB3_CHNL254_CMD_ADDR A:0x2bf3000
y.create.l HWIO_PMIC_ARB3_CHNL255_CMD_ADDR A:0x2bfb000
y.create.l HWIO_PMIC_ARB4_CHNL0_CMD_ADDR A:0x2404000
y.create.l HWIO_PMIC_ARB4_CHNL1_CMD_ADDR A:0x240c000
y.create.l HWIO_PMIC_ARB4_CHNL2_CMD_ADDR A:0x2414000
y.create.l HWIO_PMIC_ARB4_CHNL3_CMD_ADDR A:0x241c000
y.create.l HWIO_PMIC_ARB4_CHNL4_CMD_ADDR A:0x2424000
y.create.l HWIO_PMIC_ARB4_CHNL5_CMD_ADDR A:0x242c000
y.create.l HWIO_PMIC_ARB4_CHNL6_CMD_ADDR A:0x2434000
y.create.l HWIO_PMIC_ARB4_CHNL7_CMD_ADDR A:0x243c000
y.create.l HWIO_PMIC_ARB4_CHNL8_CMD_ADDR A:0x2444000
y.create.l HWIO_PMIC_ARB4_CHNL9_CMD_ADDR A:0x244c000
y.create.l HWIO_PMIC_ARB4_CHNL10_CMD_ADDR A:0x2454000
y.create.l HWIO_PMIC_ARB4_CHNL11_CMD_ADDR A:0x245c000
y.create.l HWIO_PMIC_ARB4_CHNL12_CMD_ADDR A:0x2464000
y.create.l HWIO_PMIC_ARB4_CHNL13_CMD_ADDR A:0x246c000
y.create.l HWIO_PMIC_ARB4_CHNL14_CMD_ADDR A:0x2474000
y.create.l HWIO_PMIC_ARB4_CHNL15_CMD_ADDR A:0x247c000
y.create.l HWIO_PMIC_ARB4_CHNL16_CMD_ADDR A:0x2484000
y.create.l HWIO_PMIC_ARB4_CHNL17_CMD_ADDR A:0x248c000
y.create.l HWIO_PMIC_ARB4_CHNL18_CMD_ADDR A:0x2494000
y.create.l HWIO_PMIC_ARB4_CHNL19_CMD_ADDR A:0x249c000
y.create.l HWIO_PMIC_ARB4_CHNL20_CMD_ADDR A:0x24a4000
y.create.l HWIO_PMIC_ARB4_CHNL21_CMD_ADDR A:0x24ac000
y.create.l HWIO_PMIC_ARB4_CHNL22_CMD_ADDR A:0x24b4000
y.create.l HWIO_PMIC_ARB4_CHNL23_CMD_ADDR A:0x24bc000
y.create.l HWIO_PMIC_ARB4_CHNL24_CMD_ADDR A:0x24c4000
y.create.l HWIO_PMIC_ARB4_CHNL25_CMD_ADDR A:0x24cc000
y.create.l HWIO_PMIC_ARB4_CHNL26_CMD_ADDR A:0x24d4000
y.create.l HWIO_PMIC_ARB4_CHNL27_CMD_ADDR A:0x24dc000
y.create.l HWIO_PMIC_ARB4_CHNL28_CMD_ADDR A:0x24e4000
y.create.l HWIO_PMIC_ARB4_CHNL29_CMD_ADDR A:0x24ec000
y.create.l HWIO_PMIC_ARB4_CHNL30_CMD_ADDR A:0x24f4000
y.create.l HWIO_PMIC_ARB4_CHNL31_CMD_ADDR A:0x24fc000
y.create.l HWIO_PMIC_ARB4_CHNL32_CMD_ADDR A:0x2504000
y.create.l HWIO_PMIC_ARB4_CHNL33_CMD_ADDR A:0x250c000
y.create.l HWIO_PMIC_ARB4_CHNL34_CMD_ADDR A:0x2514000
y.create.l HWIO_PMIC_ARB4_CHNL35_CMD_ADDR A:0x251c000
y.create.l HWIO_PMIC_ARB4_CHNL36_CMD_ADDR A:0x2524000
y.create.l HWIO_PMIC_ARB4_CHNL37_CMD_ADDR A:0x252c000
y.create.l HWIO_PMIC_ARB4_CHNL38_CMD_ADDR A:0x2534000
y.create.l HWIO_PMIC_ARB4_CHNL39_CMD_ADDR A:0x253c000
y.create.l HWIO_PMIC_ARB4_CHNL40_CMD_ADDR A:0x2544000
y.create.l HWIO_PMIC_ARB4_CHNL41_CMD_ADDR A:0x254c000
y.create.l HWIO_PMIC_ARB4_CHNL42_CMD_ADDR A:0x2554000
y.create.l HWIO_PMIC_ARB4_CHNL43_CMD_ADDR A:0x255c000
y.create.l HWIO_PMIC_ARB4_CHNL44_CMD_ADDR A:0x2564000
y.create.l HWIO_PMIC_ARB4_CHNL45_CMD_ADDR A:0x256c000
y.create.l HWIO_PMIC_ARB4_CHNL46_CMD_ADDR A:0x2574000
y.create.l HWIO_PMIC_ARB4_CHNL47_CMD_ADDR A:0x257c000
y.create.l HWIO_PMIC_ARB4_CHNL48_CMD_ADDR A:0x2584000
y.create.l HWIO_PMIC_ARB4_CHNL49_CMD_ADDR A:0x258c000
y.create.l HWIO_PMIC_ARB4_CHNL50_CMD_ADDR A:0x2594000
y.create.l HWIO_PMIC_ARB4_CHNL51_CMD_ADDR A:0x259c000
y.create.l HWIO_PMIC_ARB4_CHNL52_CMD_ADDR A:0x25a4000
y.create.l HWIO_PMIC_ARB4_CHNL53_CMD_ADDR A:0x25ac000
y.create.l HWIO_PMIC_ARB4_CHNL54_CMD_ADDR A:0x25b4000
y.create.l HWIO_PMIC_ARB4_CHNL55_CMD_ADDR A:0x25bc000
y.create.l HWIO_PMIC_ARB4_CHNL56_CMD_ADDR A:0x25c4000
y.create.l HWIO_PMIC_ARB4_CHNL57_CMD_ADDR A:0x25cc000
y.create.l HWIO_PMIC_ARB4_CHNL58_CMD_ADDR A:0x25d4000
y.create.l HWIO_PMIC_ARB4_CHNL59_CMD_ADDR A:0x25dc000
y.create.l HWIO_PMIC_ARB4_CHNL60_CMD_ADDR A:0x25e4000
y.create.l HWIO_PMIC_ARB4_CHNL61_CMD_ADDR A:0x25ec000
y.create.l HWIO_PMIC_ARB4_CHNL62_CMD_ADDR A:0x25f4000
y.create.l HWIO_PMIC_ARB4_CHNL63_CMD_ADDR A:0x25fc000
y.create.l HWIO_PMIC_ARB4_CHNL64_CMD_ADDR A:0x2604000
y.create.l HWIO_PMIC_ARB4_CHNL65_CMD_ADDR A:0x260c000
y.create.l HWIO_PMIC_ARB4_CHNL66_CMD_ADDR A:0x2614000
y.create.l HWIO_PMIC_ARB4_CHNL67_CMD_ADDR A:0x261c000
y.create.l HWIO_PMIC_ARB4_CHNL68_CMD_ADDR A:0x2624000
y.create.l HWIO_PMIC_ARB4_CHNL69_CMD_ADDR A:0x262c000
y.create.l HWIO_PMIC_ARB4_CHNL70_CMD_ADDR A:0x2634000
y.create.l HWIO_PMIC_ARB4_CHNL71_CMD_ADDR A:0x263c000
y.create.l HWIO_PMIC_ARB4_CHNL72_CMD_ADDR A:0x2644000
y.create.l HWIO_PMIC_ARB4_CHNL73_CMD_ADDR A:0x264c000
y.create.l HWIO_PMIC_ARB4_CHNL74_CMD_ADDR A:0x2654000
y.create.l HWIO_PMIC_ARB4_CHNL75_CMD_ADDR A:0x265c000
y.create.l HWIO_PMIC_ARB4_CHNL76_CMD_ADDR A:0x2664000
y.create.l HWIO_PMIC_ARB4_CHNL77_CMD_ADDR A:0x266c000
y.create.l HWIO_PMIC_ARB4_CHNL78_CMD_ADDR A:0x2674000
y.create.l HWIO_PMIC_ARB4_CHNL79_CMD_ADDR A:0x267c000
y.create.l HWIO_PMIC_ARB4_CHNL80_CMD_ADDR A:0x2684000
y.create.l HWIO_PMIC_ARB4_CHNL81_CMD_ADDR A:0x268c000
y.create.l HWIO_PMIC_ARB4_CHNL82_CMD_ADDR A:0x2694000
y.create.l HWIO_PMIC_ARB4_CHNL83_CMD_ADDR A:0x269c000
y.create.l HWIO_PMIC_ARB4_CHNL84_CMD_ADDR A:0x26a4000
y.create.l HWIO_PMIC_ARB4_CHNL85_CMD_ADDR A:0x26ac000
y.create.l HWIO_PMIC_ARB4_CHNL86_CMD_ADDR A:0x26b4000
y.create.l HWIO_PMIC_ARB4_CHNL87_CMD_ADDR A:0x26bc000
y.create.l HWIO_PMIC_ARB4_CHNL88_CMD_ADDR A:0x26c4000
y.create.l HWIO_PMIC_ARB4_CHNL89_CMD_ADDR A:0x26cc000
y.create.l HWIO_PMIC_ARB4_CHNL90_CMD_ADDR A:0x26d4000
y.create.l HWIO_PMIC_ARB4_CHNL91_CMD_ADDR A:0x26dc000
y.create.l HWIO_PMIC_ARB4_CHNL92_CMD_ADDR A:0x26e4000
y.create.l HWIO_PMIC_ARB4_CHNL93_CMD_ADDR A:0x26ec000
y.create.l HWIO_PMIC_ARB4_CHNL94_CMD_ADDR A:0x26f4000
y.create.l HWIO_PMIC_ARB4_CHNL95_CMD_ADDR A:0x26fc000
y.create.l HWIO_PMIC_ARB4_CHNL96_CMD_ADDR A:0x2704000
y.create.l HWIO_PMIC_ARB4_CHNL97_CMD_ADDR A:0x270c000
y.create.l HWIO_PMIC_ARB4_CHNL98_CMD_ADDR A:0x2714000
y.create.l HWIO_PMIC_ARB4_CHNL99_CMD_ADDR A:0x271c000
y.create.l HWIO_PMIC_ARB4_CHNL100_CMD_ADDR A:0x2724000
y.create.l HWIO_PMIC_ARB4_CHNL101_CMD_ADDR A:0x272c000
y.create.l HWIO_PMIC_ARB4_CHNL102_CMD_ADDR A:0x2734000
y.create.l HWIO_PMIC_ARB4_CHNL103_CMD_ADDR A:0x273c000
y.create.l HWIO_PMIC_ARB4_CHNL104_CMD_ADDR A:0x2744000
y.create.l HWIO_PMIC_ARB4_CHNL105_CMD_ADDR A:0x274c000
y.create.l HWIO_PMIC_ARB4_CHNL106_CMD_ADDR A:0x2754000
y.create.l HWIO_PMIC_ARB4_CHNL107_CMD_ADDR A:0x275c000
y.create.l HWIO_PMIC_ARB4_CHNL108_CMD_ADDR A:0x2764000
y.create.l HWIO_PMIC_ARB4_CHNL109_CMD_ADDR A:0x276c000
y.create.l HWIO_PMIC_ARB4_CHNL110_CMD_ADDR A:0x2774000
y.create.l HWIO_PMIC_ARB4_CHNL111_CMD_ADDR A:0x277c000
y.create.l HWIO_PMIC_ARB4_CHNL112_CMD_ADDR A:0x2784000
y.create.l HWIO_PMIC_ARB4_CHNL113_CMD_ADDR A:0x278c000
y.create.l HWIO_PMIC_ARB4_CHNL114_CMD_ADDR A:0x2794000
y.create.l HWIO_PMIC_ARB4_CHNL115_CMD_ADDR A:0x279c000
y.create.l HWIO_PMIC_ARB4_CHNL116_CMD_ADDR A:0x27a4000
y.create.l HWIO_PMIC_ARB4_CHNL117_CMD_ADDR A:0x27ac000
y.create.l HWIO_PMIC_ARB4_CHNL118_CMD_ADDR A:0x27b4000
y.create.l HWIO_PMIC_ARB4_CHNL119_CMD_ADDR A:0x27bc000
y.create.l HWIO_PMIC_ARB4_CHNL120_CMD_ADDR A:0x27c4000
y.create.l HWIO_PMIC_ARB4_CHNL121_CMD_ADDR A:0x27cc000
y.create.l HWIO_PMIC_ARB4_CHNL122_CMD_ADDR A:0x27d4000
y.create.l HWIO_PMIC_ARB4_CHNL123_CMD_ADDR A:0x27dc000
y.create.l HWIO_PMIC_ARB4_CHNL124_CMD_ADDR A:0x27e4000
y.create.l HWIO_PMIC_ARB4_CHNL125_CMD_ADDR A:0x27ec000
y.create.l HWIO_PMIC_ARB4_CHNL126_CMD_ADDR A:0x27f4000
y.create.l HWIO_PMIC_ARB4_CHNL127_CMD_ADDR A:0x27fc000
y.create.l HWIO_PMIC_ARB4_CHNL128_CMD_ADDR A:0x2804000
y.create.l HWIO_PMIC_ARB4_CHNL129_CMD_ADDR A:0x280c000
y.create.l HWIO_PMIC_ARB4_CHNL130_CMD_ADDR A:0x2814000
y.create.l HWIO_PMIC_ARB4_CHNL131_CMD_ADDR A:0x281c000
y.create.l HWIO_PMIC_ARB4_CHNL132_CMD_ADDR A:0x2824000
y.create.l HWIO_PMIC_ARB4_CHNL133_CMD_ADDR A:0x282c000
y.create.l HWIO_PMIC_ARB4_CHNL134_CMD_ADDR A:0x2834000
y.create.l HWIO_PMIC_ARB4_CHNL135_CMD_ADDR A:0x283c000
y.create.l HWIO_PMIC_ARB4_CHNL136_CMD_ADDR A:0x2844000
y.create.l HWIO_PMIC_ARB4_CHNL137_CMD_ADDR A:0x284c000
y.create.l HWIO_PMIC_ARB4_CHNL138_CMD_ADDR A:0x2854000
y.create.l HWIO_PMIC_ARB4_CHNL139_CMD_ADDR A:0x285c000
y.create.l HWIO_PMIC_ARB4_CHNL140_CMD_ADDR A:0x2864000
y.create.l HWIO_PMIC_ARB4_CHNL141_CMD_ADDR A:0x286c000
y.create.l HWIO_PMIC_ARB4_CHNL142_CMD_ADDR A:0x2874000
y.create.l HWIO_PMIC_ARB4_CHNL143_CMD_ADDR A:0x287c000
y.create.l HWIO_PMIC_ARB4_CHNL144_CMD_ADDR A:0x2884000
y.create.l HWIO_PMIC_ARB4_CHNL145_CMD_ADDR A:0x288c000
y.create.l HWIO_PMIC_ARB4_CHNL146_CMD_ADDR A:0x2894000
y.create.l HWIO_PMIC_ARB4_CHNL147_CMD_ADDR A:0x289c000
y.create.l HWIO_PMIC_ARB4_CHNL148_CMD_ADDR A:0x28a4000
y.create.l HWIO_PMIC_ARB4_CHNL149_CMD_ADDR A:0x28ac000
y.create.l HWIO_PMIC_ARB4_CHNL150_CMD_ADDR A:0x28b4000
y.create.l HWIO_PMIC_ARB4_CHNL151_CMD_ADDR A:0x28bc000
y.create.l HWIO_PMIC_ARB4_CHNL152_CMD_ADDR A:0x28c4000
y.create.l HWIO_PMIC_ARB4_CHNL153_CMD_ADDR A:0x28cc000
y.create.l HWIO_PMIC_ARB4_CHNL154_CMD_ADDR A:0x28d4000
y.create.l HWIO_PMIC_ARB4_CHNL155_CMD_ADDR A:0x28dc000
y.create.l HWIO_PMIC_ARB4_CHNL156_CMD_ADDR A:0x28e4000
y.create.l HWIO_PMIC_ARB4_CHNL157_CMD_ADDR A:0x28ec000
y.create.l HWIO_PMIC_ARB4_CHNL158_CMD_ADDR A:0x28f4000
y.create.l HWIO_PMIC_ARB4_CHNL159_CMD_ADDR A:0x28fc000
y.create.l HWIO_PMIC_ARB4_CHNL160_CMD_ADDR A:0x2904000
y.create.l HWIO_PMIC_ARB4_CHNL161_CMD_ADDR A:0x290c000
y.create.l HWIO_PMIC_ARB4_CHNL162_CMD_ADDR A:0x2914000
y.create.l HWIO_PMIC_ARB4_CHNL163_CMD_ADDR A:0x291c000
y.create.l HWIO_PMIC_ARB4_CHNL164_CMD_ADDR A:0x2924000
y.create.l HWIO_PMIC_ARB4_CHNL165_CMD_ADDR A:0x292c000
y.create.l HWIO_PMIC_ARB4_CHNL166_CMD_ADDR A:0x2934000
y.create.l HWIO_PMIC_ARB4_CHNL167_CMD_ADDR A:0x293c000
y.create.l HWIO_PMIC_ARB4_CHNL168_CMD_ADDR A:0x2944000
y.create.l HWIO_PMIC_ARB4_CHNL169_CMD_ADDR A:0x294c000
y.create.l HWIO_PMIC_ARB4_CHNL170_CMD_ADDR A:0x2954000
y.create.l HWIO_PMIC_ARB4_CHNL171_CMD_ADDR A:0x295c000
y.create.l HWIO_PMIC_ARB4_CHNL172_CMD_ADDR A:0x2964000
y.create.l HWIO_PMIC_ARB4_CHNL173_CMD_ADDR A:0x296c000
y.create.l HWIO_PMIC_ARB4_CHNL174_CMD_ADDR A:0x2974000
y.create.l HWIO_PMIC_ARB4_CHNL175_CMD_ADDR A:0x297c000
y.create.l HWIO_PMIC_ARB4_CHNL176_CMD_ADDR A:0x2984000
y.create.l HWIO_PMIC_ARB4_CHNL177_CMD_ADDR A:0x298c000
y.create.l HWIO_PMIC_ARB4_CHNL178_CMD_ADDR A:0x2994000
y.create.l HWIO_PMIC_ARB4_CHNL179_CMD_ADDR A:0x299c000
y.create.l HWIO_PMIC_ARB4_CHNL180_CMD_ADDR A:0x29a4000
y.create.l HWIO_PMIC_ARB4_CHNL181_CMD_ADDR A:0x29ac000
y.create.l HWIO_PMIC_ARB4_CHNL182_CMD_ADDR A:0x29b4000
y.create.l HWIO_PMIC_ARB4_CHNL183_CMD_ADDR A:0x29bc000
y.create.l HWIO_PMIC_ARB4_CHNL184_CMD_ADDR A:0x29c4000
y.create.l HWIO_PMIC_ARB4_CHNL185_CMD_ADDR A:0x29cc000
y.create.l HWIO_PMIC_ARB4_CHNL186_CMD_ADDR A:0x29d4000
y.create.l HWIO_PMIC_ARB4_CHNL187_CMD_ADDR A:0x29dc000
y.create.l HWIO_PMIC_ARB4_CHNL188_CMD_ADDR A:0x29e4000
y.create.l HWIO_PMIC_ARB4_CHNL189_CMD_ADDR A:0x29ec000
y.create.l HWIO_PMIC_ARB4_CHNL190_CMD_ADDR A:0x29f4000
y.create.l HWIO_PMIC_ARB4_CHNL191_CMD_ADDR A:0x29fc000
y.create.l HWIO_PMIC_ARB4_CHNL192_CMD_ADDR A:0x2a04000
y.create.l HWIO_PMIC_ARB4_CHNL193_CMD_ADDR A:0x2a0c000
y.create.l HWIO_PMIC_ARB4_CHNL194_CMD_ADDR A:0x2a14000
y.create.l HWIO_PMIC_ARB4_CHNL195_CMD_ADDR A:0x2a1c000
y.create.l HWIO_PMIC_ARB4_CHNL196_CMD_ADDR A:0x2a24000
y.create.l HWIO_PMIC_ARB4_CHNL197_CMD_ADDR A:0x2a2c000
y.create.l HWIO_PMIC_ARB4_CHNL198_CMD_ADDR A:0x2a34000
y.create.l HWIO_PMIC_ARB4_CHNL199_CMD_ADDR A:0x2a3c000
y.create.l HWIO_PMIC_ARB4_CHNL200_CMD_ADDR A:0x2a44000
y.create.l HWIO_PMIC_ARB4_CHNL201_CMD_ADDR A:0x2a4c000
y.create.l HWIO_PMIC_ARB4_CHNL202_CMD_ADDR A:0x2a54000
y.create.l HWIO_PMIC_ARB4_CHNL203_CMD_ADDR A:0x2a5c000
y.create.l HWIO_PMIC_ARB4_CHNL204_CMD_ADDR A:0x2a64000
y.create.l HWIO_PMIC_ARB4_CHNL205_CMD_ADDR A:0x2a6c000
y.create.l HWIO_PMIC_ARB4_CHNL206_CMD_ADDR A:0x2a74000
y.create.l HWIO_PMIC_ARB4_CHNL207_CMD_ADDR A:0x2a7c000
y.create.l HWIO_PMIC_ARB4_CHNL208_CMD_ADDR A:0x2a84000
y.create.l HWIO_PMIC_ARB4_CHNL209_CMD_ADDR A:0x2a8c000
y.create.l HWIO_PMIC_ARB4_CHNL210_CMD_ADDR A:0x2a94000
y.create.l HWIO_PMIC_ARB4_CHNL211_CMD_ADDR A:0x2a9c000
y.create.l HWIO_PMIC_ARB4_CHNL212_CMD_ADDR A:0x2aa4000
y.create.l HWIO_PMIC_ARB4_CHNL213_CMD_ADDR A:0x2aac000
y.create.l HWIO_PMIC_ARB4_CHNL214_CMD_ADDR A:0x2ab4000
y.create.l HWIO_PMIC_ARB4_CHNL215_CMD_ADDR A:0x2abc000
y.create.l HWIO_PMIC_ARB4_CHNL216_CMD_ADDR A:0x2ac4000
y.create.l HWIO_PMIC_ARB4_CHNL217_CMD_ADDR A:0x2acc000
y.create.l HWIO_PMIC_ARB4_CHNL218_CMD_ADDR A:0x2ad4000
y.create.l HWIO_PMIC_ARB4_CHNL219_CMD_ADDR A:0x2adc000
y.create.l HWIO_PMIC_ARB4_CHNL220_CMD_ADDR A:0x2ae4000
y.create.l HWIO_PMIC_ARB4_CHNL221_CMD_ADDR A:0x2aec000
y.create.l HWIO_PMIC_ARB4_CHNL222_CMD_ADDR A:0x2af4000
y.create.l HWIO_PMIC_ARB4_CHNL223_CMD_ADDR A:0x2afc000
y.create.l HWIO_PMIC_ARB4_CHNL224_CMD_ADDR A:0x2b04000
y.create.l HWIO_PMIC_ARB4_CHNL225_CMD_ADDR A:0x2b0c000
y.create.l HWIO_PMIC_ARB4_CHNL226_CMD_ADDR A:0x2b14000
y.create.l HWIO_PMIC_ARB4_CHNL227_CMD_ADDR A:0x2b1c000
y.create.l HWIO_PMIC_ARB4_CHNL228_CMD_ADDR A:0x2b24000
y.create.l HWIO_PMIC_ARB4_CHNL229_CMD_ADDR A:0x2b2c000
y.create.l HWIO_PMIC_ARB4_CHNL230_CMD_ADDR A:0x2b34000
y.create.l HWIO_PMIC_ARB4_CHNL231_CMD_ADDR A:0x2b3c000
y.create.l HWIO_PMIC_ARB4_CHNL232_CMD_ADDR A:0x2b44000
y.create.l HWIO_PMIC_ARB4_CHNL233_CMD_ADDR A:0x2b4c000
y.create.l HWIO_PMIC_ARB4_CHNL234_CMD_ADDR A:0x2b54000
y.create.l HWIO_PMIC_ARB4_CHNL235_CMD_ADDR A:0x2b5c000
y.create.l HWIO_PMIC_ARB4_CHNL236_CMD_ADDR A:0x2b64000
y.create.l HWIO_PMIC_ARB4_CHNL237_CMD_ADDR A:0x2b6c000
y.create.l HWIO_PMIC_ARB4_CHNL238_CMD_ADDR A:0x2b74000
y.create.l HWIO_PMIC_ARB4_CHNL239_CMD_ADDR A:0x2b7c000
y.create.l HWIO_PMIC_ARB4_CHNL240_CMD_ADDR A:0x2b84000
y.create.l HWIO_PMIC_ARB4_CHNL241_CMD_ADDR A:0x2b8c000
y.create.l HWIO_PMIC_ARB4_CHNL242_CMD_ADDR A:0x2b94000
y.create.l HWIO_PMIC_ARB4_CHNL243_CMD_ADDR A:0x2b9c000
y.create.l HWIO_PMIC_ARB4_CHNL244_CMD_ADDR A:0x2ba4000
y.create.l HWIO_PMIC_ARB4_CHNL245_CMD_ADDR A:0x2bac000
y.create.l HWIO_PMIC_ARB4_CHNL246_CMD_ADDR A:0x2bb4000
y.create.l HWIO_PMIC_ARB4_CHNL247_CMD_ADDR A:0x2bbc000
y.create.l HWIO_PMIC_ARB4_CHNL248_CMD_ADDR A:0x2bc4000
y.create.l HWIO_PMIC_ARB4_CHNL249_CMD_ADDR A:0x2bcc000
y.create.l HWIO_PMIC_ARB4_CHNL250_CMD_ADDR A:0x2bd4000
y.create.l HWIO_PMIC_ARB4_CHNL251_CMD_ADDR A:0x2bdc000
y.create.l HWIO_PMIC_ARB4_CHNL252_CMD_ADDR A:0x2be4000
y.create.l HWIO_PMIC_ARB4_CHNL253_CMD_ADDR A:0x2bec000
y.create.l HWIO_PMIC_ARB4_CHNL254_CMD_ADDR A:0x2bf4000
y.create.l HWIO_PMIC_ARB4_CHNL255_CMD_ADDR A:0x2bfc000
y.create.l HWIO_PMIC_ARB5_CHNL0_CMD_ADDR A:0x2405000
y.create.l HWIO_PMIC_ARB5_CHNL1_CMD_ADDR A:0x240d000
y.create.l HWIO_PMIC_ARB5_CHNL2_CMD_ADDR A:0x2415000
y.create.l HWIO_PMIC_ARB5_CHNL3_CMD_ADDR A:0x241d000
y.create.l HWIO_PMIC_ARB5_CHNL4_CMD_ADDR A:0x2425000
y.create.l HWIO_PMIC_ARB5_CHNL5_CMD_ADDR A:0x242d000
y.create.l HWIO_PMIC_ARB5_CHNL6_CMD_ADDR A:0x2435000
y.create.l HWIO_PMIC_ARB5_CHNL7_CMD_ADDR A:0x243d000
y.create.l HWIO_PMIC_ARB5_CHNL8_CMD_ADDR A:0x2445000
y.create.l HWIO_PMIC_ARB5_CHNL9_CMD_ADDR A:0x244d000
y.create.l HWIO_PMIC_ARB5_CHNL10_CMD_ADDR A:0x2455000
y.create.l HWIO_PMIC_ARB5_CHNL11_CMD_ADDR A:0x245d000
y.create.l HWIO_PMIC_ARB5_CHNL12_CMD_ADDR A:0x2465000
y.create.l HWIO_PMIC_ARB5_CHNL13_CMD_ADDR A:0x246d000
y.create.l HWIO_PMIC_ARB5_CHNL14_CMD_ADDR A:0x2475000
y.create.l HWIO_PMIC_ARB5_CHNL15_CMD_ADDR A:0x247d000
y.create.l HWIO_PMIC_ARB5_CHNL16_CMD_ADDR A:0x2485000
y.create.l HWIO_PMIC_ARB5_CHNL17_CMD_ADDR A:0x248d000
y.create.l HWIO_PMIC_ARB5_CHNL18_CMD_ADDR A:0x2495000
y.create.l HWIO_PMIC_ARB5_CHNL19_CMD_ADDR A:0x249d000
y.create.l HWIO_PMIC_ARB5_CHNL20_CMD_ADDR A:0x24a5000
y.create.l HWIO_PMIC_ARB5_CHNL21_CMD_ADDR A:0x24ad000
y.create.l HWIO_PMIC_ARB5_CHNL22_CMD_ADDR A:0x24b5000
y.create.l HWIO_PMIC_ARB5_CHNL23_CMD_ADDR A:0x24bd000
y.create.l HWIO_PMIC_ARB5_CHNL24_CMD_ADDR A:0x24c5000
y.create.l HWIO_PMIC_ARB5_CHNL25_CMD_ADDR A:0x24cd000
y.create.l HWIO_PMIC_ARB5_CHNL26_CMD_ADDR A:0x24d5000
y.create.l HWIO_PMIC_ARB5_CHNL27_CMD_ADDR A:0x24dd000
y.create.l HWIO_PMIC_ARB5_CHNL28_CMD_ADDR A:0x24e5000
y.create.l HWIO_PMIC_ARB5_CHNL29_CMD_ADDR A:0x24ed000
y.create.l HWIO_PMIC_ARB5_CHNL30_CMD_ADDR A:0x24f5000
y.create.l HWIO_PMIC_ARB5_CHNL31_CMD_ADDR A:0x24fd000
y.create.l HWIO_PMIC_ARB5_CHNL32_CMD_ADDR A:0x2505000
y.create.l HWIO_PMIC_ARB5_CHNL33_CMD_ADDR A:0x250d000
y.create.l HWIO_PMIC_ARB5_CHNL34_CMD_ADDR A:0x2515000
y.create.l HWIO_PMIC_ARB5_CHNL35_CMD_ADDR A:0x251d000
y.create.l HWIO_PMIC_ARB5_CHNL36_CMD_ADDR A:0x2525000
y.create.l HWIO_PMIC_ARB5_CHNL37_CMD_ADDR A:0x252d000
y.create.l HWIO_PMIC_ARB5_CHNL38_CMD_ADDR A:0x2535000
y.create.l HWIO_PMIC_ARB5_CHNL39_CMD_ADDR A:0x253d000
y.create.l HWIO_PMIC_ARB5_CHNL40_CMD_ADDR A:0x2545000
y.create.l HWIO_PMIC_ARB5_CHNL41_CMD_ADDR A:0x254d000
y.create.l HWIO_PMIC_ARB5_CHNL42_CMD_ADDR A:0x2555000
y.create.l HWIO_PMIC_ARB5_CHNL43_CMD_ADDR A:0x255d000
y.create.l HWIO_PMIC_ARB5_CHNL44_CMD_ADDR A:0x2565000
y.create.l HWIO_PMIC_ARB5_CHNL45_CMD_ADDR A:0x256d000
y.create.l HWIO_PMIC_ARB5_CHNL46_CMD_ADDR A:0x2575000
y.create.l HWIO_PMIC_ARB5_CHNL47_CMD_ADDR A:0x257d000
y.create.l HWIO_PMIC_ARB5_CHNL48_CMD_ADDR A:0x2585000
y.create.l HWIO_PMIC_ARB5_CHNL49_CMD_ADDR A:0x258d000
y.create.l HWIO_PMIC_ARB5_CHNL50_CMD_ADDR A:0x2595000
y.create.l HWIO_PMIC_ARB5_CHNL51_CMD_ADDR A:0x259d000
y.create.l HWIO_PMIC_ARB5_CHNL52_CMD_ADDR A:0x25a5000
y.create.l HWIO_PMIC_ARB5_CHNL53_CMD_ADDR A:0x25ad000
y.create.l HWIO_PMIC_ARB5_CHNL54_CMD_ADDR A:0x25b5000
y.create.l HWIO_PMIC_ARB5_CHNL55_CMD_ADDR A:0x25bd000
y.create.l HWIO_PMIC_ARB5_CHNL56_CMD_ADDR A:0x25c5000
y.create.l HWIO_PMIC_ARB5_CHNL57_CMD_ADDR A:0x25cd000
y.create.l HWIO_PMIC_ARB5_CHNL58_CMD_ADDR A:0x25d5000
y.create.l HWIO_PMIC_ARB5_CHNL59_CMD_ADDR A:0x25dd000
y.create.l HWIO_PMIC_ARB5_CHNL60_CMD_ADDR A:0x25e5000
y.create.l HWIO_PMIC_ARB5_CHNL61_CMD_ADDR A:0x25ed000
y.create.l HWIO_PMIC_ARB5_CHNL62_CMD_ADDR A:0x25f5000
y.create.l HWIO_PMIC_ARB5_CHNL63_CMD_ADDR A:0x25fd000
y.create.l HWIO_PMIC_ARB5_CHNL64_CMD_ADDR A:0x2605000
y.create.l HWIO_PMIC_ARB5_CHNL65_CMD_ADDR A:0x260d000
y.create.l HWIO_PMIC_ARB5_CHNL66_CMD_ADDR A:0x2615000
y.create.l HWIO_PMIC_ARB5_CHNL67_CMD_ADDR A:0x261d000
y.create.l HWIO_PMIC_ARB5_CHNL68_CMD_ADDR A:0x2625000
y.create.l HWIO_PMIC_ARB5_CHNL69_CMD_ADDR A:0x262d000
y.create.l HWIO_PMIC_ARB5_CHNL70_CMD_ADDR A:0x2635000
y.create.l HWIO_PMIC_ARB5_CHNL71_CMD_ADDR A:0x263d000
y.create.l HWIO_PMIC_ARB5_CHNL72_CMD_ADDR A:0x2645000
y.create.l HWIO_PMIC_ARB5_CHNL73_CMD_ADDR A:0x264d000
y.create.l HWIO_PMIC_ARB5_CHNL74_CMD_ADDR A:0x2655000
y.create.l HWIO_PMIC_ARB5_CHNL75_CMD_ADDR A:0x265d000
y.create.l HWIO_PMIC_ARB5_CHNL76_CMD_ADDR A:0x2665000
y.create.l HWIO_PMIC_ARB5_CHNL77_CMD_ADDR A:0x266d000
y.create.l HWIO_PMIC_ARB5_CHNL78_CMD_ADDR A:0x2675000
y.create.l HWIO_PMIC_ARB5_CHNL79_CMD_ADDR A:0x267d000
y.create.l HWIO_PMIC_ARB5_CHNL80_CMD_ADDR A:0x2685000
y.create.l HWIO_PMIC_ARB5_CHNL81_CMD_ADDR A:0x268d000
y.create.l HWIO_PMIC_ARB5_CHNL82_CMD_ADDR A:0x2695000
y.create.l HWIO_PMIC_ARB5_CHNL83_CMD_ADDR A:0x269d000
y.create.l HWIO_PMIC_ARB5_CHNL84_CMD_ADDR A:0x26a5000
y.create.l HWIO_PMIC_ARB5_CHNL85_CMD_ADDR A:0x26ad000
y.create.l HWIO_PMIC_ARB5_CHNL86_CMD_ADDR A:0x26b5000
y.create.l HWIO_PMIC_ARB5_CHNL87_CMD_ADDR A:0x26bd000
y.create.l HWIO_PMIC_ARB5_CHNL88_CMD_ADDR A:0x26c5000
y.create.l HWIO_PMIC_ARB5_CHNL89_CMD_ADDR A:0x26cd000
y.create.l HWIO_PMIC_ARB5_CHNL90_CMD_ADDR A:0x26d5000
y.create.l HWIO_PMIC_ARB5_CHNL91_CMD_ADDR A:0x26dd000
y.create.l HWIO_PMIC_ARB5_CHNL92_CMD_ADDR A:0x26e5000
y.create.l HWIO_PMIC_ARB5_CHNL93_CMD_ADDR A:0x26ed000
y.create.l HWIO_PMIC_ARB5_CHNL94_CMD_ADDR A:0x26f5000
y.create.l HWIO_PMIC_ARB5_CHNL95_CMD_ADDR A:0x26fd000
y.create.l HWIO_PMIC_ARB5_CHNL96_CMD_ADDR A:0x2705000
y.create.l HWIO_PMIC_ARB5_CHNL97_CMD_ADDR A:0x270d000
y.create.l HWIO_PMIC_ARB5_CHNL98_CMD_ADDR A:0x2715000
y.create.l HWIO_PMIC_ARB5_CHNL99_CMD_ADDR A:0x271d000
y.create.l HWIO_PMIC_ARB5_CHNL100_CMD_ADDR A:0x2725000
y.create.l HWIO_PMIC_ARB5_CHNL101_CMD_ADDR A:0x272d000
y.create.l HWIO_PMIC_ARB5_CHNL102_CMD_ADDR A:0x2735000
y.create.l HWIO_PMIC_ARB5_CHNL103_CMD_ADDR A:0x273d000
y.create.l HWIO_PMIC_ARB5_CHNL104_CMD_ADDR A:0x2745000
y.create.l HWIO_PMIC_ARB5_CHNL105_CMD_ADDR A:0x274d000
y.create.l HWIO_PMIC_ARB5_CHNL106_CMD_ADDR A:0x2755000
y.create.l HWIO_PMIC_ARB5_CHNL107_CMD_ADDR A:0x275d000
y.create.l HWIO_PMIC_ARB5_CHNL108_CMD_ADDR A:0x2765000
y.create.l HWIO_PMIC_ARB5_CHNL109_CMD_ADDR A:0x276d000
y.create.l HWIO_PMIC_ARB5_CHNL110_CMD_ADDR A:0x2775000
y.create.l HWIO_PMIC_ARB5_CHNL111_CMD_ADDR A:0x277d000
y.create.l HWIO_PMIC_ARB5_CHNL112_CMD_ADDR A:0x2785000
y.create.l HWIO_PMIC_ARB5_CHNL113_CMD_ADDR A:0x278d000
y.create.l HWIO_PMIC_ARB5_CHNL114_CMD_ADDR A:0x2795000
y.create.l HWIO_PMIC_ARB5_CHNL115_CMD_ADDR A:0x279d000
y.create.l HWIO_PMIC_ARB5_CHNL116_CMD_ADDR A:0x27a5000
y.create.l HWIO_PMIC_ARB5_CHNL117_CMD_ADDR A:0x27ad000
y.create.l HWIO_PMIC_ARB5_CHNL118_CMD_ADDR A:0x27b5000
y.create.l HWIO_PMIC_ARB5_CHNL119_CMD_ADDR A:0x27bd000
y.create.l HWIO_PMIC_ARB5_CHNL120_CMD_ADDR A:0x27c5000
y.create.l HWIO_PMIC_ARB5_CHNL121_CMD_ADDR A:0x27cd000
y.create.l HWIO_PMIC_ARB5_CHNL122_CMD_ADDR A:0x27d5000
y.create.l HWIO_PMIC_ARB5_CHNL123_CMD_ADDR A:0x27dd000
y.create.l HWIO_PMIC_ARB5_CHNL124_CMD_ADDR A:0x27e5000
y.create.l HWIO_PMIC_ARB5_CHNL125_CMD_ADDR A:0x27ed000
y.create.l HWIO_PMIC_ARB5_CHNL126_CMD_ADDR A:0x27f5000
y.create.l HWIO_PMIC_ARB5_CHNL127_CMD_ADDR A:0x27fd000
y.create.l HWIO_PMIC_ARB5_CHNL128_CMD_ADDR A:0x2805000
y.create.l HWIO_PMIC_ARB5_CHNL129_CMD_ADDR A:0x280d000
y.create.l HWIO_PMIC_ARB5_CHNL130_CMD_ADDR A:0x2815000
y.create.l HWIO_PMIC_ARB5_CHNL131_CMD_ADDR A:0x281d000
y.create.l HWIO_PMIC_ARB5_CHNL132_CMD_ADDR A:0x2825000
y.create.l HWIO_PMIC_ARB5_CHNL133_CMD_ADDR A:0x282d000
y.create.l HWIO_PMIC_ARB5_CHNL134_CMD_ADDR A:0x2835000
y.create.l HWIO_PMIC_ARB5_CHNL135_CMD_ADDR A:0x283d000
y.create.l HWIO_PMIC_ARB5_CHNL136_CMD_ADDR A:0x2845000
y.create.l HWIO_PMIC_ARB5_CHNL137_CMD_ADDR A:0x284d000
y.create.l HWIO_PMIC_ARB5_CHNL138_CMD_ADDR A:0x2855000
y.create.l HWIO_PMIC_ARB5_CHNL139_CMD_ADDR A:0x285d000
y.create.l HWIO_PMIC_ARB5_CHNL140_CMD_ADDR A:0x2865000
y.create.l HWIO_PMIC_ARB5_CHNL141_CMD_ADDR A:0x286d000
y.create.l HWIO_PMIC_ARB5_CHNL142_CMD_ADDR A:0x2875000
y.create.l HWIO_PMIC_ARB5_CHNL143_CMD_ADDR A:0x287d000
y.create.l HWIO_PMIC_ARB5_CHNL144_CMD_ADDR A:0x2885000
y.create.l HWIO_PMIC_ARB5_CHNL145_CMD_ADDR A:0x288d000
y.create.l HWIO_PMIC_ARB5_CHNL146_CMD_ADDR A:0x2895000
y.create.l HWIO_PMIC_ARB5_CHNL147_CMD_ADDR A:0x289d000
y.create.l HWIO_PMIC_ARB5_CHNL148_CMD_ADDR A:0x28a5000
y.create.l HWIO_PMIC_ARB5_CHNL149_CMD_ADDR A:0x28ad000
y.create.l HWIO_PMIC_ARB5_CHNL150_CMD_ADDR A:0x28b5000
y.create.l HWIO_PMIC_ARB5_CHNL151_CMD_ADDR A:0x28bd000
y.create.l HWIO_PMIC_ARB5_CHNL152_CMD_ADDR A:0x28c5000
y.create.l HWIO_PMIC_ARB5_CHNL153_CMD_ADDR A:0x28cd000
y.create.l HWIO_PMIC_ARB5_CHNL154_CMD_ADDR A:0x28d5000
y.create.l HWIO_PMIC_ARB5_CHNL155_CMD_ADDR A:0x28dd000
y.create.l HWIO_PMIC_ARB5_CHNL156_CMD_ADDR A:0x28e5000
y.create.l HWIO_PMIC_ARB5_CHNL157_CMD_ADDR A:0x28ed000
y.create.l HWIO_PMIC_ARB5_CHNL158_CMD_ADDR A:0x28f5000
y.create.l HWIO_PMIC_ARB5_CHNL159_CMD_ADDR A:0x28fd000
y.create.l HWIO_PMIC_ARB5_CHNL160_CMD_ADDR A:0x2905000
y.create.l HWIO_PMIC_ARB5_CHNL161_CMD_ADDR A:0x290d000
y.create.l HWIO_PMIC_ARB5_CHNL162_CMD_ADDR A:0x2915000
y.create.l HWIO_PMIC_ARB5_CHNL163_CMD_ADDR A:0x291d000
y.create.l HWIO_PMIC_ARB5_CHNL164_CMD_ADDR A:0x2925000
y.create.l HWIO_PMIC_ARB5_CHNL165_CMD_ADDR A:0x292d000
y.create.l HWIO_PMIC_ARB5_CHNL166_CMD_ADDR A:0x2935000
y.create.l HWIO_PMIC_ARB5_CHNL167_CMD_ADDR A:0x293d000
y.create.l HWIO_PMIC_ARB5_CHNL168_CMD_ADDR A:0x2945000
y.create.l HWIO_PMIC_ARB5_CHNL169_CMD_ADDR A:0x294d000
y.create.l HWIO_PMIC_ARB5_CHNL170_CMD_ADDR A:0x2955000
y.create.l HWIO_PMIC_ARB5_CHNL171_CMD_ADDR A:0x295d000
y.create.l HWIO_PMIC_ARB5_CHNL172_CMD_ADDR A:0x2965000
y.create.l HWIO_PMIC_ARB5_CHNL173_CMD_ADDR A:0x296d000
y.create.l HWIO_PMIC_ARB5_CHNL174_CMD_ADDR A:0x2975000
y.create.l HWIO_PMIC_ARB5_CHNL175_CMD_ADDR A:0x297d000
y.create.l HWIO_PMIC_ARB5_CHNL176_CMD_ADDR A:0x2985000
y.create.l HWIO_PMIC_ARB5_CHNL177_CMD_ADDR A:0x298d000
y.create.l HWIO_PMIC_ARB5_CHNL178_CMD_ADDR A:0x2995000
y.create.l HWIO_PMIC_ARB5_CHNL179_CMD_ADDR A:0x299d000
y.create.l HWIO_PMIC_ARB5_CHNL180_CMD_ADDR A:0x29a5000
y.create.l HWIO_PMIC_ARB5_CHNL181_CMD_ADDR A:0x29ad000
y.create.l HWIO_PMIC_ARB5_CHNL182_CMD_ADDR A:0x29b5000
y.create.l HWIO_PMIC_ARB5_CHNL183_CMD_ADDR A:0x29bd000
y.create.l HWIO_PMIC_ARB5_CHNL184_CMD_ADDR A:0x29c5000
y.create.l HWIO_PMIC_ARB5_CHNL185_CMD_ADDR A:0x29cd000
y.create.l HWIO_PMIC_ARB5_CHNL186_CMD_ADDR A:0x29d5000
y.create.l HWIO_PMIC_ARB5_CHNL187_CMD_ADDR A:0x29dd000
y.create.l HWIO_PMIC_ARB5_CHNL188_CMD_ADDR A:0x29e5000
y.create.l HWIO_PMIC_ARB5_CHNL189_CMD_ADDR A:0x29ed000
y.create.l HWIO_PMIC_ARB5_CHNL190_CMD_ADDR A:0x29f5000
y.create.l HWIO_PMIC_ARB5_CHNL191_CMD_ADDR A:0x29fd000
y.create.l HWIO_PMIC_ARB5_CHNL192_CMD_ADDR A:0x2a05000
y.create.l HWIO_PMIC_ARB5_CHNL193_CMD_ADDR A:0x2a0d000
y.create.l HWIO_PMIC_ARB5_CHNL194_CMD_ADDR A:0x2a15000
y.create.l HWIO_PMIC_ARB5_CHNL195_CMD_ADDR A:0x2a1d000
y.create.l HWIO_PMIC_ARB5_CHNL196_CMD_ADDR A:0x2a25000
y.create.l HWIO_PMIC_ARB5_CHNL197_CMD_ADDR A:0x2a2d000
y.create.l HWIO_PMIC_ARB5_CHNL198_CMD_ADDR A:0x2a35000
y.create.l HWIO_PMIC_ARB5_CHNL199_CMD_ADDR A:0x2a3d000
y.create.l HWIO_PMIC_ARB5_CHNL200_CMD_ADDR A:0x2a45000
y.create.l HWIO_PMIC_ARB5_CHNL201_CMD_ADDR A:0x2a4d000
y.create.l HWIO_PMIC_ARB5_CHNL202_CMD_ADDR A:0x2a55000
y.create.l HWIO_PMIC_ARB5_CHNL203_CMD_ADDR A:0x2a5d000
y.create.l HWIO_PMIC_ARB5_CHNL204_CMD_ADDR A:0x2a65000
y.create.l HWIO_PMIC_ARB5_CHNL205_CMD_ADDR A:0x2a6d000
y.create.l HWIO_PMIC_ARB5_CHNL206_CMD_ADDR A:0x2a75000
y.create.l HWIO_PMIC_ARB5_CHNL207_CMD_ADDR A:0x2a7d000
y.create.l HWIO_PMIC_ARB5_CHNL208_CMD_ADDR A:0x2a85000
y.create.l HWIO_PMIC_ARB5_CHNL209_CMD_ADDR A:0x2a8d000
y.create.l HWIO_PMIC_ARB5_CHNL210_CMD_ADDR A:0x2a95000
y.create.l HWIO_PMIC_ARB5_CHNL211_CMD_ADDR A:0x2a9d000
y.create.l HWIO_PMIC_ARB5_CHNL212_CMD_ADDR A:0x2aa5000
y.create.l HWIO_PMIC_ARB5_CHNL213_CMD_ADDR A:0x2aad000
y.create.l HWIO_PMIC_ARB5_CHNL214_CMD_ADDR A:0x2ab5000
y.create.l HWIO_PMIC_ARB5_CHNL215_CMD_ADDR A:0x2abd000
y.create.l HWIO_PMIC_ARB5_CHNL216_CMD_ADDR A:0x2ac5000
y.create.l HWIO_PMIC_ARB5_CHNL217_CMD_ADDR A:0x2acd000
y.create.l HWIO_PMIC_ARB5_CHNL218_CMD_ADDR A:0x2ad5000
y.create.l HWIO_PMIC_ARB5_CHNL219_CMD_ADDR A:0x2add000
y.create.l HWIO_PMIC_ARB5_CHNL220_CMD_ADDR A:0x2ae5000
y.create.l HWIO_PMIC_ARB5_CHNL221_CMD_ADDR A:0x2aed000
y.create.l HWIO_PMIC_ARB5_CHNL222_CMD_ADDR A:0x2af5000
y.create.l HWIO_PMIC_ARB5_CHNL223_CMD_ADDR A:0x2afd000
y.create.l HWIO_PMIC_ARB5_CHNL224_CMD_ADDR A:0x2b05000
y.create.l HWIO_PMIC_ARB5_CHNL225_CMD_ADDR A:0x2b0d000
y.create.l HWIO_PMIC_ARB5_CHNL226_CMD_ADDR A:0x2b15000
y.create.l HWIO_PMIC_ARB5_CHNL227_CMD_ADDR A:0x2b1d000
y.create.l HWIO_PMIC_ARB5_CHNL228_CMD_ADDR A:0x2b25000
y.create.l HWIO_PMIC_ARB5_CHNL229_CMD_ADDR A:0x2b2d000
y.create.l HWIO_PMIC_ARB5_CHNL230_CMD_ADDR A:0x2b35000
y.create.l HWIO_PMIC_ARB5_CHNL231_CMD_ADDR A:0x2b3d000
y.create.l HWIO_PMIC_ARB5_CHNL232_CMD_ADDR A:0x2b45000
y.create.l HWIO_PMIC_ARB5_CHNL233_CMD_ADDR A:0x2b4d000
y.create.l HWIO_PMIC_ARB5_CHNL234_CMD_ADDR A:0x2b55000
y.create.l HWIO_PMIC_ARB5_CHNL235_CMD_ADDR A:0x2b5d000
y.create.l HWIO_PMIC_ARB5_CHNL236_CMD_ADDR A:0x2b65000
y.create.l HWIO_PMIC_ARB5_CHNL237_CMD_ADDR A:0x2b6d000
y.create.l HWIO_PMIC_ARB5_CHNL238_CMD_ADDR A:0x2b75000
y.create.l HWIO_PMIC_ARB5_CHNL239_CMD_ADDR A:0x2b7d000
y.create.l HWIO_PMIC_ARB5_CHNL240_CMD_ADDR A:0x2b85000
y.create.l HWIO_PMIC_ARB5_CHNL241_CMD_ADDR A:0x2b8d000
y.create.l HWIO_PMIC_ARB5_CHNL242_CMD_ADDR A:0x2b95000
y.create.l HWIO_PMIC_ARB5_CHNL243_CMD_ADDR A:0x2b9d000
y.create.l HWIO_PMIC_ARB5_CHNL244_CMD_ADDR A:0x2ba5000
y.create.l HWIO_PMIC_ARB5_CHNL245_CMD_ADDR A:0x2bad000
y.create.l HWIO_PMIC_ARB5_CHNL246_CMD_ADDR A:0x2bb5000
y.create.l HWIO_PMIC_ARB5_CHNL247_CMD_ADDR A:0x2bbd000
y.create.l HWIO_PMIC_ARB5_CHNL248_CMD_ADDR A:0x2bc5000
y.create.l HWIO_PMIC_ARB5_CHNL249_CMD_ADDR A:0x2bcd000
y.create.l HWIO_PMIC_ARB5_CHNL250_CMD_ADDR A:0x2bd5000
y.create.l HWIO_PMIC_ARB5_CHNL251_CMD_ADDR A:0x2bdd000
y.create.l HWIO_PMIC_ARB5_CHNL252_CMD_ADDR A:0x2be5000
y.create.l HWIO_PMIC_ARB5_CHNL253_CMD_ADDR A:0x2bed000
y.create.l HWIO_PMIC_ARB5_CHNL254_CMD_ADDR A:0x2bf5000
y.create.l HWIO_PMIC_ARB5_CHNL255_CMD_ADDR A:0x2bfd000
y.create.l HWIO_PMIC_ARB6_CHNL0_CMD_ADDR A:0x2406000
y.create.l HWIO_PMIC_ARB6_CHNL1_CMD_ADDR A:0x240e000
y.create.l HWIO_PMIC_ARB6_CHNL2_CMD_ADDR A:0x2416000
y.create.l HWIO_PMIC_ARB6_CHNL3_CMD_ADDR A:0x241e000
y.create.l HWIO_PMIC_ARB6_CHNL4_CMD_ADDR A:0x2426000
y.create.l HWIO_PMIC_ARB6_CHNL5_CMD_ADDR A:0x242e000
y.create.l HWIO_PMIC_ARB6_CHNL6_CMD_ADDR A:0x2436000
y.create.l HWIO_PMIC_ARB6_CHNL7_CMD_ADDR A:0x243e000
y.create.l HWIO_PMIC_ARB6_CHNL8_CMD_ADDR A:0x2446000
y.create.l HWIO_PMIC_ARB6_CHNL9_CMD_ADDR A:0x244e000
y.create.l HWIO_PMIC_ARB6_CHNL10_CMD_ADDR A:0x2456000
y.create.l HWIO_PMIC_ARB6_CHNL11_CMD_ADDR A:0x245e000
y.create.l HWIO_PMIC_ARB6_CHNL12_CMD_ADDR A:0x2466000
y.create.l HWIO_PMIC_ARB6_CHNL13_CMD_ADDR A:0x246e000
y.create.l HWIO_PMIC_ARB6_CHNL14_CMD_ADDR A:0x2476000
y.create.l HWIO_PMIC_ARB6_CHNL15_CMD_ADDR A:0x247e000
y.create.l HWIO_PMIC_ARB6_CHNL16_CMD_ADDR A:0x2486000
y.create.l HWIO_PMIC_ARB6_CHNL17_CMD_ADDR A:0x248e000
y.create.l HWIO_PMIC_ARB6_CHNL18_CMD_ADDR A:0x2496000
y.create.l HWIO_PMIC_ARB6_CHNL19_CMD_ADDR A:0x249e000
y.create.l HWIO_PMIC_ARB6_CHNL20_CMD_ADDR A:0x24a6000
y.create.l HWIO_PMIC_ARB6_CHNL21_CMD_ADDR A:0x24ae000
y.create.l HWIO_PMIC_ARB6_CHNL22_CMD_ADDR A:0x24b6000
y.create.l HWIO_PMIC_ARB6_CHNL23_CMD_ADDR A:0x24be000
y.create.l HWIO_PMIC_ARB6_CHNL24_CMD_ADDR A:0x24c6000
y.create.l HWIO_PMIC_ARB6_CHNL25_CMD_ADDR A:0x24ce000
y.create.l HWIO_PMIC_ARB6_CHNL26_CMD_ADDR A:0x24d6000
y.create.l HWIO_PMIC_ARB6_CHNL27_CMD_ADDR A:0x24de000
y.create.l HWIO_PMIC_ARB6_CHNL28_CMD_ADDR A:0x24e6000
y.create.l HWIO_PMIC_ARB6_CHNL29_CMD_ADDR A:0x24ee000
y.create.l HWIO_PMIC_ARB6_CHNL30_CMD_ADDR A:0x24f6000
y.create.l HWIO_PMIC_ARB6_CHNL31_CMD_ADDR A:0x24fe000
y.create.l HWIO_PMIC_ARB6_CHNL32_CMD_ADDR A:0x2506000
y.create.l HWIO_PMIC_ARB6_CHNL33_CMD_ADDR A:0x250e000
y.create.l HWIO_PMIC_ARB6_CHNL34_CMD_ADDR A:0x2516000
y.create.l HWIO_PMIC_ARB6_CHNL35_CMD_ADDR A:0x251e000
y.create.l HWIO_PMIC_ARB6_CHNL36_CMD_ADDR A:0x2526000
y.create.l HWIO_PMIC_ARB6_CHNL37_CMD_ADDR A:0x252e000
y.create.l HWIO_PMIC_ARB6_CHNL38_CMD_ADDR A:0x2536000
y.create.l HWIO_PMIC_ARB6_CHNL39_CMD_ADDR A:0x253e000
y.create.l HWIO_PMIC_ARB6_CHNL40_CMD_ADDR A:0x2546000
y.create.l HWIO_PMIC_ARB6_CHNL41_CMD_ADDR A:0x254e000
y.create.l HWIO_PMIC_ARB6_CHNL42_CMD_ADDR A:0x2556000
y.create.l HWIO_PMIC_ARB6_CHNL43_CMD_ADDR A:0x255e000
y.create.l HWIO_PMIC_ARB6_CHNL44_CMD_ADDR A:0x2566000
y.create.l HWIO_PMIC_ARB6_CHNL45_CMD_ADDR A:0x256e000
y.create.l HWIO_PMIC_ARB6_CHNL46_CMD_ADDR A:0x2576000
y.create.l HWIO_PMIC_ARB6_CHNL47_CMD_ADDR A:0x257e000
y.create.l HWIO_PMIC_ARB6_CHNL48_CMD_ADDR A:0x2586000
y.create.l HWIO_PMIC_ARB6_CHNL49_CMD_ADDR A:0x258e000
y.create.l HWIO_PMIC_ARB6_CHNL50_CMD_ADDR A:0x2596000
y.create.l HWIO_PMIC_ARB6_CHNL51_CMD_ADDR A:0x259e000
y.create.l HWIO_PMIC_ARB6_CHNL52_CMD_ADDR A:0x25a6000
y.create.l HWIO_PMIC_ARB6_CHNL53_CMD_ADDR A:0x25ae000
y.create.l HWIO_PMIC_ARB6_CHNL54_CMD_ADDR A:0x25b6000
y.create.l HWIO_PMIC_ARB6_CHNL55_CMD_ADDR A:0x25be000
y.create.l HWIO_PMIC_ARB6_CHNL56_CMD_ADDR A:0x25c6000
y.create.l HWIO_PMIC_ARB6_CHNL57_CMD_ADDR A:0x25ce000
y.create.l HWIO_PMIC_ARB6_CHNL58_CMD_ADDR A:0x25d6000
y.create.l HWIO_PMIC_ARB6_CHNL59_CMD_ADDR A:0x25de000
y.create.l HWIO_PMIC_ARB6_CHNL60_CMD_ADDR A:0x25e6000
y.create.l HWIO_PMIC_ARB6_CHNL61_CMD_ADDR A:0x25ee000
y.create.l HWIO_PMIC_ARB6_CHNL62_CMD_ADDR A:0x25f6000
y.create.l HWIO_PMIC_ARB6_CHNL63_CMD_ADDR A:0x25fe000
y.create.l HWIO_PMIC_ARB6_CHNL64_CMD_ADDR A:0x2606000
y.create.l HWIO_PMIC_ARB6_CHNL65_CMD_ADDR A:0x260e000
y.create.l HWIO_PMIC_ARB6_CHNL66_CMD_ADDR A:0x2616000
y.create.l HWIO_PMIC_ARB6_CHNL67_CMD_ADDR A:0x261e000
y.create.l HWIO_PMIC_ARB6_CHNL68_CMD_ADDR A:0x2626000
y.create.l HWIO_PMIC_ARB6_CHNL69_CMD_ADDR A:0x262e000
y.create.l HWIO_PMIC_ARB6_CHNL70_CMD_ADDR A:0x2636000
y.create.l HWIO_PMIC_ARB6_CHNL71_CMD_ADDR A:0x263e000
y.create.l HWIO_PMIC_ARB6_CHNL72_CMD_ADDR A:0x2646000
y.create.l HWIO_PMIC_ARB6_CHNL73_CMD_ADDR A:0x264e000
y.create.l HWIO_PMIC_ARB6_CHNL74_CMD_ADDR A:0x2656000
y.create.l HWIO_PMIC_ARB6_CHNL75_CMD_ADDR A:0x265e000
y.create.l HWIO_PMIC_ARB6_CHNL76_CMD_ADDR A:0x2666000
y.create.l HWIO_PMIC_ARB6_CHNL77_CMD_ADDR A:0x266e000
y.create.l HWIO_PMIC_ARB6_CHNL78_CMD_ADDR A:0x2676000
y.create.l HWIO_PMIC_ARB6_CHNL79_CMD_ADDR A:0x267e000
y.create.l HWIO_PMIC_ARB6_CHNL80_CMD_ADDR A:0x2686000
y.create.l HWIO_PMIC_ARB6_CHNL81_CMD_ADDR A:0x268e000
y.create.l HWIO_PMIC_ARB6_CHNL82_CMD_ADDR A:0x2696000
y.create.l HWIO_PMIC_ARB6_CHNL83_CMD_ADDR A:0x269e000
y.create.l HWIO_PMIC_ARB6_CHNL84_CMD_ADDR A:0x26a6000
y.create.l HWIO_PMIC_ARB6_CHNL85_CMD_ADDR A:0x26ae000
y.create.l HWIO_PMIC_ARB6_CHNL86_CMD_ADDR A:0x26b6000
y.create.l HWIO_PMIC_ARB6_CHNL87_CMD_ADDR A:0x26be000
y.create.l HWIO_PMIC_ARB6_CHNL88_CMD_ADDR A:0x26c6000
y.create.l HWIO_PMIC_ARB6_CHNL89_CMD_ADDR A:0x26ce000
y.create.l HWIO_PMIC_ARB6_CHNL90_CMD_ADDR A:0x26d6000
y.create.l HWIO_PMIC_ARB6_CHNL91_CMD_ADDR A:0x26de000
y.create.l HWIO_PMIC_ARB6_CHNL92_CMD_ADDR A:0x26e6000
y.create.l HWIO_PMIC_ARB6_CHNL93_CMD_ADDR A:0x26ee000
y.create.l HWIO_PMIC_ARB6_CHNL94_CMD_ADDR A:0x26f6000
y.create.l HWIO_PMIC_ARB6_CHNL95_CMD_ADDR A:0x26fe000
y.create.l HWIO_PMIC_ARB6_CHNL96_CMD_ADDR A:0x2706000
y.create.l HWIO_PMIC_ARB6_CHNL97_CMD_ADDR A:0x270e000
y.create.l HWIO_PMIC_ARB6_CHNL98_CMD_ADDR A:0x2716000
y.create.l HWIO_PMIC_ARB6_CHNL99_CMD_ADDR A:0x271e000
y.create.l HWIO_PMIC_ARB6_CHNL100_CMD_ADDR A:0x2726000
y.create.l HWIO_PMIC_ARB6_CHNL101_CMD_ADDR A:0x272e000
y.create.l HWIO_PMIC_ARB6_CHNL102_CMD_ADDR A:0x2736000
y.create.l HWIO_PMIC_ARB6_CHNL103_CMD_ADDR A:0x273e000
y.create.l HWIO_PMIC_ARB6_CHNL104_CMD_ADDR A:0x2746000
y.create.l HWIO_PMIC_ARB6_CHNL105_CMD_ADDR A:0x274e000
y.create.l HWIO_PMIC_ARB6_CHNL106_CMD_ADDR A:0x2756000
y.create.l HWIO_PMIC_ARB6_CHNL107_CMD_ADDR A:0x275e000
y.create.l HWIO_PMIC_ARB6_CHNL108_CMD_ADDR A:0x2766000
y.create.l HWIO_PMIC_ARB6_CHNL109_CMD_ADDR A:0x276e000
y.create.l HWIO_PMIC_ARB6_CHNL110_CMD_ADDR A:0x2776000
y.create.l HWIO_PMIC_ARB6_CHNL111_CMD_ADDR A:0x277e000
y.create.l HWIO_PMIC_ARB6_CHNL112_CMD_ADDR A:0x2786000
y.create.l HWIO_PMIC_ARB6_CHNL113_CMD_ADDR A:0x278e000
y.create.l HWIO_PMIC_ARB6_CHNL114_CMD_ADDR A:0x2796000
y.create.l HWIO_PMIC_ARB6_CHNL115_CMD_ADDR A:0x279e000
y.create.l HWIO_PMIC_ARB6_CHNL116_CMD_ADDR A:0x27a6000
y.create.l HWIO_PMIC_ARB6_CHNL117_CMD_ADDR A:0x27ae000
y.create.l HWIO_PMIC_ARB6_CHNL118_CMD_ADDR A:0x27b6000
y.create.l HWIO_PMIC_ARB6_CHNL119_CMD_ADDR A:0x27be000
y.create.l HWIO_PMIC_ARB6_CHNL120_CMD_ADDR A:0x27c6000
y.create.l HWIO_PMIC_ARB6_CHNL121_CMD_ADDR A:0x27ce000
y.create.l HWIO_PMIC_ARB6_CHNL122_CMD_ADDR A:0x27d6000
y.create.l HWIO_PMIC_ARB6_CHNL123_CMD_ADDR A:0x27de000
y.create.l HWIO_PMIC_ARB6_CHNL124_CMD_ADDR A:0x27e6000
y.create.l HWIO_PMIC_ARB6_CHNL125_CMD_ADDR A:0x27ee000
y.create.l HWIO_PMIC_ARB6_CHNL126_CMD_ADDR A:0x27f6000
y.create.l HWIO_PMIC_ARB6_CHNL127_CMD_ADDR A:0x27fe000
y.create.l HWIO_PMIC_ARB6_CHNL128_CMD_ADDR A:0x2806000
y.create.l HWIO_PMIC_ARB6_CHNL129_CMD_ADDR A:0x280e000
y.create.l HWIO_PMIC_ARB6_CHNL130_CMD_ADDR A:0x2816000
y.create.l HWIO_PMIC_ARB6_CHNL131_CMD_ADDR A:0x281e000
y.create.l HWIO_PMIC_ARB6_CHNL132_CMD_ADDR A:0x2826000
y.create.l HWIO_PMIC_ARB6_CHNL133_CMD_ADDR A:0x282e000
y.create.l HWIO_PMIC_ARB6_CHNL134_CMD_ADDR A:0x2836000
y.create.l HWIO_PMIC_ARB6_CHNL135_CMD_ADDR A:0x283e000
y.create.l HWIO_PMIC_ARB6_CHNL136_CMD_ADDR A:0x2846000
y.create.l HWIO_PMIC_ARB6_CHNL137_CMD_ADDR A:0x284e000
y.create.l HWIO_PMIC_ARB6_CHNL138_CMD_ADDR A:0x2856000
y.create.l HWIO_PMIC_ARB6_CHNL139_CMD_ADDR A:0x285e000
y.create.l HWIO_PMIC_ARB6_CHNL140_CMD_ADDR A:0x2866000
y.create.l HWIO_PMIC_ARB6_CHNL141_CMD_ADDR A:0x286e000
y.create.l HWIO_PMIC_ARB6_CHNL142_CMD_ADDR A:0x2876000
y.create.l HWIO_PMIC_ARB6_CHNL143_CMD_ADDR A:0x287e000
y.create.l HWIO_PMIC_ARB6_CHNL144_CMD_ADDR A:0x2886000
y.create.l HWIO_PMIC_ARB6_CHNL145_CMD_ADDR A:0x288e000
y.create.l HWIO_PMIC_ARB6_CHNL146_CMD_ADDR A:0x2896000
y.create.l HWIO_PMIC_ARB6_CHNL147_CMD_ADDR A:0x289e000
y.create.l HWIO_PMIC_ARB6_CHNL148_CMD_ADDR A:0x28a6000
y.create.l HWIO_PMIC_ARB6_CHNL149_CMD_ADDR A:0x28ae000
y.create.l HWIO_PMIC_ARB6_CHNL150_CMD_ADDR A:0x28b6000
y.create.l HWIO_PMIC_ARB6_CHNL151_CMD_ADDR A:0x28be000
y.create.l HWIO_PMIC_ARB6_CHNL152_CMD_ADDR A:0x28c6000
y.create.l HWIO_PMIC_ARB6_CHNL153_CMD_ADDR A:0x28ce000
y.create.l HWIO_PMIC_ARB6_CHNL154_CMD_ADDR A:0x28d6000
y.create.l HWIO_PMIC_ARB6_CHNL155_CMD_ADDR A:0x28de000
y.create.l HWIO_PMIC_ARB6_CHNL156_CMD_ADDR A:0x28e6000
y.create.l HWIO_PMIC_ARB6_CHNL157_CMD_ADDR A:0x28ee000
y.create.l HWIO_PMIC_ARB6_CHNL158_CMD_ADDR A:0x28f6000
y.create.l HWIO_PMIC_ARB6_CHNL159_CMD_ADDR A:0x28fe000
y.create.l HWIO_PMIC_ARB6_CHNL160_CMD_ADDR A:0x2906000
y.create.l HWIO_PMIC_ARB6_CHNL161_CMD_ADDR A:0x290e000
y.create.l HWIO_PMIC_ARB6_CHNL162_CMD_ADDR A:0x2916000
y.create.l HWIO_PMIC_ARB6_CHNL163_CMD_ADDR A:0x291e000
y.create.l HWIO_PMIC_ARB6_CHNL164_CMD_ADDR A:0x2926000
y.create.l HWIO_PMIC_ARB6_CHNL165_CMD_ADDR A:0x292e000
y.create.l HWIO_PMIC_ARB6_CHNL166_CMD_ADDR A:0x2936000
y.create.l HWIO_PMIC_ARB6_CHNL167_CMD_ADDR A:0x293e000
y.create.l HWIO_PMIC_ARB6_CHNL168_CMD_ADDR A:0x2946000
y.create.l HWIO_PMIC_ARB6_CHNL169_CMD_ADDR A:0x294e000
y.create.l HWIO_PMIC_ARB6_CHNL170_CMD_ADDR A:0x2956000
y.create.l HWIO_PMIC_ARB6_CHNL171_CMD_ADDR A:0x295e000
y.create.l HWIO_PMIC_ARB6_CHNL172_CMD_ADDR A:0x2966000
y.create.l HWIO_PMIC_ARB6_CHNL173_CMD_ADDR A:0x296e000
y.create.l HWIO_PMIC_ARB6_CHNL174_CMD_ADDR A:0x2976000
y.create.l HWIO_PMIC_ARB6_CHNL175_CMD_ADDR A:0x297e000
y.create.l HWIO_PMIC_ARB6_CHNL176_CMD_ADDR A:0x2986000
y.create.l HWIO_PMIC_ARB6_CHNL177_CMD_ADDR A:0x298e000
y.create.l HWIO_PMIC_ARB6_CHNL178_CMD_ADDR A:0x2996000
y.create.l HWIO_PMIC_ARB6_CHNL179_CMD_ADDR A:0x299e000
y.create.l HWIO_PMIC_ARB6_CHNL180_CMD_ADDR A:0x29a6000
y.create.l HWIO_PMIC_ARB6_CHNL181_CMD_ADDR A:0x29ae000
y.create.l HWIO_PMIC_ARB6_CHNL182_CMD_ADDR A:0x29b6000
y.create.l HWIO_PMIC_ARB6_CHNL183_CMD_ADDR A:0x29be000
y.create.l HWIO_PMIC_ARB6_CHNL184_CMD_ADDR A:0x29c6000
y.create.l HWIO_PMIC_ARB6_CHNL185_CMD_ADDR A:0x29ce000
y.create.l HWIO_PMIC_ARB6_CHNL186_CMD_ADDR A:0x29d6000
y.create.l HWIO_PMIC_ARB6_CHNL187_CMD_ADDR A:0x29de000
y.create.l HWIO_PMIC_ARB6_CHNL188_CMD_ADDR A:0x29e6000
y.create.l HWIO_PMIC_ARB6_CHNL189_CMD_ADDR A:0x29ee000
y.create.l HWIO_PMIC_ARB6_CHNL190_CMD_ADDR A:0x29f6000
y.create.l HWIO_PMIC_ARB6_CHNL191_CMD_ADDR A:0x29fe000
y.create.l HWIO_PMIC_ARB6_CHNL192_CMD_ADDR A:0x2a06000
y.create.l HWIO_PMIC_ARB6_CHNL193_CMD_ADDR A:0x2a0e000
y.create.l HWIO_PMIC_ARB6_CHNL194_CMD_ADDR A:0x2a16000
y.create.l HWIO_PMIC_ARB6_CHNL195_CMD_ADDR A:0x2a1e000
y.create.l HWIO_PMIC_ARB6_CHNL196_CMD_ADDR A:0x2a26000
y.create.l HWIO_PMIC_ARB6_CHNL197_CMD_ADDR A:0x2a2e000
y.create.l HWIO_PMIC_ARB6_CHNL198_CMD_ADDR A:0x2a36000
y.create.l HWIO_PMIC_ARB6_CHNL199_CMD_ADDR A:0x2a3e000
y.create.l HWIO_PMIC_ARB6_CHNL200_CMD_ADDR A:0x2a46000
y.create.l HWIO_PMIC_ARB6_CHNL201_CMD_ADDR A:0x2a4e000
y.create.l HWIO_PMIC_ARB6_CHNL202_CMD_ADDR A:0x2a56000
y.create.l HWIO_PMIC_ARB6_CHNL203_CMD_ADDR A:0x2a5e000
y.create.l HWIO_PMIC_ARB6_CHNL204_CMD_ADDR A:0x2a66000
y.create.l HWIO_PMIC_ARB6_CHNL205_CMD_ADDR A:0x2a6e000
y.create.l HWIO_PMIC_ARB6_CHNL206_CMD_ADDR A:0x2a76000
y.create.l HWIO_PMIC_ARB6_CHNL207_CMD_ADDR A:0x2a7e000
y.create.l HWIO_PMIC_ARB6_CHNL208_CMD_ADDR A:0x2a86000
y.create.l HWIO_PMIC_ARB6_CHNL209_CMD_ADDR A:0x2a8e000
y.create.l HWIO_PMIC_ARB6_CHNL210_CMD_ADDR A:0x2a96000
y.create.l HWIO_PMIC_ARB6_CHNL211_CMD_ADDR A:0x2a9e000
y.create.l HWIO_PMIC_ARB6_CHNL212_CMD_ADDR A:0x2aa6000
y.create.l HWIO_PMIC_ARB6_CHNL213_CMD_ADDR A:0x2aae000
y.create.l HWIO_PMIC_ARB6_CHNL214_CMD_ADDR A:0x2ab6000
y.create.l HWIO_PMIC_ARB6_CHNL215_CMD_ADDR A:0x2abe000
y.create.l HWIO_PMIC_ARB6_CHNL216_CMD_ADDR A:0x2ac6000
y.create.l HWIO_PMIC_ARB6_CHNL217_CMD_ADDR A:0x2ace000
y.create.l HWIO_PMIC_ARB6_CHNL218_CMD_ADDR A:0x2ad6000
y.create.l HWIO_PMIC_ARB6_CHNL219_CMD_ADDR A:0x2ade000
y.create.l HWIO_PMIC_ARB6_CHNL220_CMD_ADDR A:0x2ae6000
y.create.l HWIO_PMIC_ARB6_CHNL221_CMD_ADDR A:0x2aee000
y.create.l HWIO_PMIC_ARB6_CHNL222_CMD_ADDR A:0x2af6000
y.create.l HWIO_PMIC_ARB6_CHNL223_CMD_ADDR A:0x2afe000
y.create.l HWIO_PMIC_ARB6_CHNL224_CMD_ADDR A:0x2b06000
y.create.l HWIO_PMIC_ARB6_CHNL225_CMD_ADDR A:0x2b0e000
y.create.l HWIO_PMIC_ARB6_CHNL226_CMD_ADDR A:0x2b16000
y.create.l HWIO_PMIC_ARB6_CHNL227_CMD_ADDR A:0x2b1e000
y.create.l HWIO_PMIC_ARB6_CHNL228_CMD_ADDR A:0x2b26000
y.create.l HWIO_PMIC_ARB6_CHNL229_CMD_ADDR A:0x2b2e000
y.create.l HWIO_PMIC_ARB6_CHNL230_CMD_ADDR A:0x2b36000
y.create.l HWIO_PMIC_ARB6_CHNL231_CMD_ADDR A:0x2b3e000
y.create.l HWIO_PMIC_ARB6_CHNL232_CMD_ADDR A:0x2b46000
y.create.l HWIO_PMIC_ARB6_CHNL233_CMD_ADDR A:0x2b4e000
y.create.l HWIO_PMIC_ARB6_CHNL234_CMD_ADDR A:0x2b56000
y.create.l HWIO_PMIC_ARB6_CHNL235_CMD_ADDR A:0x2b5e000
y.create.l HWIO_PMIC_ARB6_CHNL236_CMD_ADDR A:0x2b66000
y.create.l HWIO_PMIC_ARB6_CHNL237_CMD_ADDR A:0x2b6e000
y.create.l HWIO_PMIC_ARB6_CHNL238_CMD_ADDR A:0x2b76000
y.create.l HWIO_PMIC_ARB6_CHNL239_CMD_ADDR A:0x2b7e000
y.create.l HWIO_PMIC_ARB6_CHNL240_CMD_ADDR A:0x2b86000
y.create.l HWIO_PMIC_ARB6_CHNL241_CMD_ADDR A:0x2b8e000
y.create.l HWIO_PMIC_ARB6_CHNL242_CMD_ADDR A:0x2b96000
y.create.l HWIO_PMIC_ARB6_CHNL243_CMD_ADDR A:0x2b9e000
y.create.l HWIO_PMIC_ARB6_CHNL244_CMD_ADDR A:0x2ba6000
y.create.l HWIO_PMIC_ARB6_CHNL245_CMD_ADDR A:0x2bae000
y.create.l HWIO_PMIC_ARB6_CHNL246_CMD_ADDR A:0x2bb6000
y.create.l HWIO_PMIC_ARB6_CHNL247_CMD_ADDR A:0x2bbe000
y.create.l HWIO_PMIC_ARB6_CHNL248_CMD_ADDR A:0x2bc6000
y.create.l HWIO_PMIC_ARB6_CHNL249_CMD_ADDR A:0x2bce000
y.create.l HWIO_PMIC_ARB6_CHNL250_CMD_ADDR A:0x2bd6000
y.create.l HWIO_PMIC_ARB6_CHNL251_CMD_ADDR A:0x2bde000
y.create.l HWIO_PMIC_ARB6_CHNL252_CMD_ADDR A:0x2be6000
y.create.l HWIO_PMIC_ARB6_CHNL253_CMD_ADDR A:0x2bee000
y.create.l HWIO_PMIC_ARB6_CHNL254_CMD_ADDR A:0x2bf6000
y.create.l HWIO_PMIC_ARB6_CHNL255_CMD_ADDR A:0x2bfe000
y.create.l HWIO_PMIC_ARB0_CHNL0_CONFIG_ADDR A:0x2400004
y.create.l HWIO_PMIC_ARB0_CHNL1_CONFIG_ADDR A:0x2408004
y.create.l HWIO_PMIC_ARB0_CHNL2_CONFIG_ADDR A:0x2410004
y.create.l HWIO_PMIC_ARB0_CHNL3_CONFIG_ADDR A:0x2418004
y.create.l HWIO_PMIC_ARB0_CHNL4_CONFIG_ADDR A:0x2420004
y.create.l HWIO_PMIC_ARB0_CHNL5_CONFIG_ADDR A:0x2428004
y.create.l HWIO_PMIC_ARB0_CHNL6_CONFIG_ADDR A:0x2430004
y.create.l HWIO_PMIC_ARB0_CHNL7_CONFIG_ADDR A:0x2438004
y.create.l HWIO_PMIC_ARB0_CHNL8_CONFIG_ADDR A:0x2440004
y.create.l HWIO_PMIC_ARB0_CHNL9_CONFIG_ADDR A:0x2448004
y.create.l HWIO_PMIC_ARB0_CHNL10_CONFIG_ADDR A:0x2450004
y.create.l HWIO_PMIC_ARB0_CHNL11_CONFIG_ADDR A:0x2458004
y.create.l HWIO_PMIC_ARB0_CHNL12_CONFIG_ADDR A:0x2460004
y.create.l HWIO_PMIC_ARB0_CHNL13_CONFIG_ADDR A:0x2468004
y.create.l HWIO_PMIC_ARB0_CHNL14_CONFIG_ADDR A:0x2470004
y.create.l HWIO_PMIC_ARB0_CHNL15_CONFIG_ADDR A:0x2478004
y.create.l HWIO_PMIC_ARB0_CHNL16_CONFIG_ADDR A:0x2480004
y.create.l HWIO_PMIC_ARB0_CHNL17_CONFIG_ADDR A:0x2488004
y.create.l HWIO_PMIC_ARB0_CHNL18_CONFIG_ADDR A:0x2490004
y.create.l HWIO_PMIC_ARB0_CHNL19_CONFIG_ADDR A:0x2498004
y.create.l HWIO_PMIC_ARB0_CHNL20_CONFIG_ADDR A:0x24a0004
y.create.l HWIO_PMIC_ARB0_CHNL21_CONFIG_ADDR A:0x24a8004
y.create.l HWIO_PMIC_ARB0_CHNL22_CONFIG_ADDR A:0x24b0004
y.create.l HWIO_PMIC_ARB0_CHNL23_CONFIG_ADDR A:0x24b8004
y.create.l HWIO_PMIC_ARB0_CHNL24_CONFIG_ADDR A:0x24c0004
y.create.l HWIO_PMIC_ARB0_CHNL25_CONFIG_ADDR A:0x24c8004
y.create.l HWIO_PMIC_ARB0_CHNL26_CONFIG_ADDR A:0x24d0004
y.create.l HWIO_PMIC_ARB0_CHNL27_CONFIG_ADDR A:0x24d8004
y.create.l HWIO_PMIC_ARB0_CHNL28_CONFIG_ADDR A:0x24e0004
y.create.l HWIO_PMIC_ARB0_CHNL29_CONFIG_ADDR A:0x24e8004
y.create.l HWIO_PMIC_ARB0_CHNL30_CONFIG_ADDR A:0x24f0004
y.create.l HWIO_PMIC_ARB0_CHNL31_CONFIG_ADDR A:0x24f8004
y.create.l HWIO_PMIC_ARB0_CHNL32_CONFIG_ADDR A:0x2500004
y.create.l HWIO_PMIC_ARB0_CHNL33_CONFIG_ADDR A:0x2508004
y.create.l HWIO_PMIC_ARB0_CHNL34_CONFIG_ADDR A:0x2510004
y.create.l HWIO_PMIC_ARB0_CHNL35_CONFIG_ADDR A:0x2518004
y.create.l HWIO_PMIC_ARB0_CHNL36_CONFIG_ADDR A:0x2520004
y.create.l HWIO_PMIC_ARB0_CHNL37_CONFIG_ADDR A:0x2528004
y.create.l HWIO_PMIC_ARB0_CHNL38_CONFIG_ADDR A:0x2530004
y.create.l HWIO_PMIC_ARB0_CHNL39_CONFIG_ADDR A:0x2538004
y.create.l HWIO_PMIC_ARB0_CHNL40_CONFIG_ADDR A:0x2540004
y.create.l HWIO_PMIC_ARB0_CHNL41_CONFIG_ADDR A:0x2548004
y.create.l HWIO_PMIC_ARB0_CHNL42_CONFIG_ADDR A:0x2550004
y.create.l HWIO_PMIC_ARB0_CHNL43_CONFIG_ADDR A:0x2558004
y.create.l HWIO_PMIC_ARB0_CHNL44_CONFIG_ADDR A:0x2560004
y.create.l HWIO_PMIC_ARB0_CHNL45_CONFIG_ADDR A:0x2568004
y.create.l HWIO_PMIC_ARB0_CHNL46_CONFIG_ADDR A:0x2570004
y.create.l HWIO_PMIC_ARB0_CHNL47_CONFIG_ADDR A:0x2578004
y.create.l HWIO_PMIC_ARB0_CHNL48_CONFIG_ADDR A:0x2580004
y.create.l HWIO_PMIC_ARB0_CHNL49_CONFIG_ADDR A:0x2588004
y.create.l HWIO_PMIC_ARB0_CHNL50_CONFIG_ADDR A:0x2590004
y.create.l HWIO_PMIC_ARB0_CHNL51_CONFIG_ADDR A:0x2598004
y.create.l HWIO_PMIC_ARB0_CHNL52_CONFIG_ADDR A:0x25a0004
y.create.l HWIO_PMIC_ARB0_CHNL53_CONFIG_ADDR A:0x25a8004
y.create.l HWIO_PMIC_ARB0_CHNL54_CONFIG_ADDR A:0x25b0004
y.create.l HWIO_PMIC_ARB0_CHNL55_CONFIG_ADDR A:0x25b8004
y.create.l HWIO_PMIC_ARB0_CHNL56_CONFIG_ADDR A:0x25c0004
y.create.l HWIO_PMIC_ARB0_CHNL57_CONFIG_ADDR A:0x25c8004
y.create.l HWIO_PMIC_ARB0_CHNL58_CONFIG_ADDR A:0x25d0004
y.create.l HWIO_PMIC_ARB0_CHNL59_CONFIG_ADDR A:0x25d8004
y.create.l HWIO_PMIC_ARB0_CHNL60_CONFIG_ADDR A:0x25e0004
y.create.l HWIO_PMIC_ARB0_CHNL61_CONFIG_ADDR A:0x25e8004
y.create.l HWIO_PMIC_ARB0_CHNL62_CONFIG_ADDR A:0x25f0004
y.create.l HWIO_PMIC_ARB0_CHNL63_CONFIG_ADDR A:0x25f8004
y.create.l HWIO_PMIC_ARB0_CHNL64_CONFIG_ADDR A:0x2600004
y.create.l HWIO_PMIC_ARB0_CHNL65_CONFIG_ADDR A:0x2608004
y.create.l HWIO_PMIC_ARB0_CHNL66_CONFIG_ADDR A:0x2610004
y.create.l HWIO_PMIC_ARB0_CHNL67_CONFIG_ADDR A:0x2618004
y.create.l HWIO_PMIC_ARB0_CHNL68_CONFIG_ADDR A:0x2620004
y.create.l HWIO_PMIC_ARB0_CHNL69_CONFIG_ADDR A:0x2628004
y.create.l HWIO_PMIC_ARB0_CHNL70_CONFIG_ADDR A:0x2630004
y.create.l HWIO_PMIC_ARB0_CHNL71_CONFIG_ADDR A:0x2638004
y.create.l HWIO_PMIC_ARB0_CHNL72_CONFIG_ADDR A:0x2640004
y.create.l HWIO_PMIC_ARB0_CHNL73_CONFIG_ADDR A:0x2648004
y.create.l HWIO_PMIC_ARB0_CHNL74_CONFIG_ADDR A:0x2650004
y.create.l HWIO_PMIC_ARB0_CHNL75_CONFIG_ADDR A:0x2658004
y.create.l HWIO_PMIC_ARB0_CHNL76_CONFIG_ADDR A:0x2660004
y.create.l HWIO_PMIC_ARB0_CHNL77_CONFIG_ADDR A:0x2668004
y.create.l HWIO_PMIC_ARB0_CHNL78_CONFIG_ADDR A:0x2670004
y.create.l HWIO_PMIC_ARB0_CHNL79_CONFIG_ADDR A:0x2678004
y.create.l HWIO_PMIC_ARB0_CHNL80_CONFIG_ADDR A:0x2680004
y.create.l HWIO_PMIC_ARB0_CHNL81_CONFIG_ADDR A:0x2688004
y.create.l HWIO_PMIC_ARB0_CHNL82_CONFIG_ADDR A:0x2690004
y.create.l HWIO_PMIC_ARB0_CHNL83_CONFIG_ADDR A:0x2698004
y.create.l HWIO_PMIC_ARB0_CHNL84_CONFIG_ADDR A:0x26a0004
y.create.l HWIO_PMIC_ARB0_CHNL85_CONFIG_ADDR A:0x26a8004
y.create.l HWIO_PMIC_ARB0_CHNL86_CONFIG_ADDR A:0x26b0004
y.create.l HWIO_PMIC_ARB0_CHNL87_CONFIG_ADDR A:0x26b8004
y.create.l HWIO_PMIC_ARB0_CHNL88_CONFIG_ADDR A:0x26c0004
y.create.l HWIO_PMIC_ARB0_CHNL89_CONFIG_ADDR A:0x26c8004
y.create.l HWIO_PMIC_ARB0_CHNL90_CONFIG_ADDR A:0x26d0004
y.create.l HWIO_PMIC_ARB0_CHNL91_CONFIG_ADDR A:0x26d8004
y.create.l HWIO_PMIC_ARB0_CHNL92_CONFIG_ADDR A:0x26e0004
y.create.l HWIO_PMIC_ARB0_CHNL93_CONFIG_ADDR A:0x26e8004
y.create.l HWIO_PMIC_ARB0_CHNL94_CONFIG_ADDR A:0x26f0004
y.create.l HWIO_PMIC_ARB0_CHNL95_CONFIG_ADDR A:0x26f8004
y.create.l HWIO_PMIC_ARB0_CHNL96_CONFIG_ADDR A:0x2700004
y.create.l HWIO_PMIC_ARB0_CHNL97_CONFIG_ADDR A:0x2708004
y.create.l HWIO_PMIC_ARB0_CHNL98_CONFIG_ADDR A:0x2710004
y.create.l HWIO_PMIC_ARB0_CHNL99_CONFIG_ADDR A:0x2718004
y.create.l HWIO_PMIC_ARB0_CHNL100_CONFIG_ADDR A:0x2720004
y.create.l HWIO_PMIC_ARB0_CHNL101_CONFIG_ADDR A:0x2728004
y.create.l HWIO_PMIC_ARB0_CHNL102_CONFIG_ADDR A:0x2730004
y.create.l HWIO_PMIC_ARB0_CHNL103_CONFIG_ADDR A:0x2738004
y.create.l HWIO_PMIC_ARB0_CHNL104_CONFIG_ADDR A:0x2740004
y.create.l HWIO_PMIC_ARB0_CHNL105_CONFIG_ADDR A:0x2748004
y.create.l HWIO_PMIC_ARB0_CHNL106_CONFIG_ADDR A:0x2750004
y.create.l HWIO_PMIC_ARB0_CHNL107_CONFIG_ADDR A:0x2758004
y.create.l HWIO_PMIC_ARB0_CHNL108_CONFIG_ADDR A:0x2760004
y.create.l HWIO_PMIC_ARB0_CHNL109_CONFIG_ADDR A:0x2768004
y.create.l HWIO_PMIC_ARB0_CHNL110_CONFIG_ADDR A:0x2770004
y.create.l HWIO_PMIC_ARB0_CHNL111_CONFIG_ADDR A:0x2778004
y.create.l HWIO_PMIC_ARB0_CHNL112_CONFIG_ADDR A:0x2780004
y.create.l HWIO_PMIC_ARB0_CHNL113_CONFIG_ADDR A:0x2788004
y.create.l HWIO_PMIC_ARB0_CHNL114_CONFIG_ADDR A:0x2790004
y.create.l HWIO_PMIC_ARB0_CHNL115_CONFIG_ADDR A:0x2798004
y.create.l HWIO_PMIC_ARB0_CHNL116_CONFIG_ADDR A:0x27a0004
y.create.l HWIO_PMIC_ARB0_CHNL117_CONFIG_ADDR A:0x27a8004
y.create.l HWIO_PMIC_ARB0_CHNL118_CONFIG_ADDR A:0x27b0004
y.create.l HWIO_PMIC_ARB0_CHNL119_CONFIG_ADDR A:0x27b8004
y.create.l HWIO_PMIC_ARB0_CHNL120_CONFIG_ADDR A:0x27c0004
y.create.l HWIO_PMIC_ARB0_CHNL121_CONFIG_ADDR A:0x27c8004
y.create.l HWIO_PMIC_ARB0_CHNL122_CONFIG_ADDR A:0x27d0004
y.create.l HWIO_PMIC_ARB0_CHNL123_CONFIG_ADDR A:0x27d8004
y.create.l HWIO_PMIC_ARB0_CHNL124_CONFIG_ADDR A:0x27e0004
y.create.l HWIO_PMIC_ARB0_CHNL125_CONFIG_ADDR A:0x27e8004
y.create.l HWIO_PMIC_ARB0_CHNL126_CONFIG_ADDR A:0x27f0004
y.create.l HWIO_PMIC_ARB0_CHNL127_CONFIG_ADDR A:0x27f8004
y.create.l HWIO_PMIC_ARB0_CHNL128_CONFIG_ADDR A:0x2800004
y.create.l HWIO_PMIC_ARB0_CHNL129_CONFIG_ADDR A:0x2808004
y.create.l HWIO_PMIC_ARB0_CHNL130_CONFIG_ADDR A:0x2810004
y.create.l HWIO_PMIC_ARB0_CHNL131_CONFIG_ADDR A:0x2818004
y.create.l HWIO_PMIC_ARB0_CHNL132_CONFIG_ADDR A:0x2820004
y.create.l HWIO_PMIC_ARB0_CHNL133_CONFIG_ADDR A:0x2828004
y.create.l HWIO_PMIC_ARB0_CHNL134_CONFIG_ADDR A:0x2830004
y.create.l HWIO_PMIC_ARB0_CHNL135_CONFIG_ADDR A:0x2838004
y.create.l HWIO_PMIC_ARB0_CHNL136_CONFIG_ADDR A:0x2840004
y.create.l HWIO_PMIC_ARB0_CHNL137_CONFIG_ADDR A:0x2848004
y.create.l HWIO_PMIC_ARB0_CHNL138_CONFIG_ADDR A:0x2850004
y.create.l HWIO_PMIC_ARB0_CHNL139_CONFIG_ADDR A:0x2858004
y.create.l HWIO_PMIC_ARB0_CHNL140_CONFIG_ADDR A:0x2860004
y.create.l HWIO_PMIC_ARB0_CHNL141_CONFIG_ADDR A:0x2868004
y.create.l HWIO_PMIC_ARB0_CHNL142_CONFIG_ADDR A:0x2870004
y.create.l HWIO_PMIC_ARB0_CHNL143_CONFIG_ADDR A:0x2878004
y.create.l HWIO_PMIC_ARB0_CHNL144_CONFIG_ADDR A:0x2880004
y.create.l HWIO_PMIC_ARB0_CHNL145_CONFIG_ADDR A:0x2888004
y.create.l HWIO_PMIC_ARB0_CHNL146_CONFIG_ADDR A:0x2890004
y.create.l HWIO_PMIC_ARB0_CHNL147_CONFIG_ADDR A:0x2898004
y.create.l HWIO_PMIC_ARB0_CHNL148_CONFIG_ADDR A:0x28a0004
y.create.l HWIO_PMIC_ARB0_CHNL149_CONFIG_ADDR A:0x28a8004
y.create.l HWIO_PMIC_ARB0_CHNL150_CONFIG_ADDR A:0x28b0004
y.create.l HWIO_PMIC_ARB0_CHNL151_CONFIG_ADDR A:0x28b8004
y.create.l HWIO_PMIC_ARB0_CHNL152_CONFIG_ADDR A:0x28c0004
y.create.l HWIO_PMIC_ARB0_CHNL153_CONFIG_ADDR A:0x28c8004
y.create.l HWIO_PMIC_ARB0_CHNL154_CONFIG_ADDR A:0x28d0004
y.create.l HWIO_PMIC_ARB0_CHNL155_CONFIG_ADDR A:0x28d8004
y.create.l HWIO_PMIC_ARB0_CHNL156_CONFIG_ADDR A:0x28e0004
y.create.l HWIO_PMIC_ARB0_CHNL157_CONFIG_ADDR A:0x28e8004
y.create.l HWIO_PMIC_ARB0_CHNL158_CONFIG_ADDR A:0x28f0004
y.create.l HWIO_PMIC_ARB0_CHNL159_CONFIG_ADDR A:0x28f8004
y.create.l HWIO_PMIC_ARB0_CHNL160_CONFIG_ADDR A:0x2900004
y.create.l HWIO_PMIC_ARB0_CHNL161_CONFIG_ADDR A:0x2908004
y.create.l HWIO_PMIC_ARB0_CHNL162_CONFIG_ADDR A:0x2910004
y.create.l HWIO_PMIC_ARB0_CHNL163_CONFIG_ADDR A:0x2918004
y.create.l HWIO_PMIC_ARB0_CHNL164_CONFIG_ADDR A:0x2920004
y.create.l HWIO_PMIC_ARB0_CHNL165_CONFIG_ADDR A:0x2928004
y.create.l HWIO_PMIC_ARB0_CHNL166_CONFIG_ADDR A:0x2930004
y.create.l HWIO_PMIC_ARB0_CHNL167_CONFIG_ADDR A:0x2938004
y.create.l HWIO_PMIC_ARB0_CHNL168_CONFIG_ADDR A:0x2940004
y.create.l HWIO_PMIC_ARB0_CHNL169_CONFIG_ADDR A:0x2948004
y.create.l HWIO_PMIC_ARB0_CHNL170_CONFIG_ADDR A:0x2950004
y.create.l HWIO_PMIC_ARB0_CHNL171_CONFIG_ADDR A:0x2958004
y.create.l HWIO_PMIC_ARB0_CHNL172_CONFIG_ADDR A:0x2960004
y.create.l HWIO_PMIC_ARB0_CHNL173_CONFIG_ADDR A:0x2968004
y.create.l HWIO_PMIC_ARB0_CHNL174_CONFIG_ADDR A:0x2970004
y.create.l HWIO_PMIC_ARB0_CHNL175_CONFIG_ADDR A:0x2978004
y.create.l HWIO_PMIC_ARB0_CHNL176_CONFIG_ADDR A:0x2980004
y.create.l HWIO_PMIC_ARB0_CHNL177_CONFIG_ADDR A:0x2988004
y.create.l HWIO_PMIC_ARB0_CHNL178_CONFIG_ADDR A:0x2990004
y.create.l HWIO_PMIC_ARB0_CHNL179_CONFIG_ADDR A:0x2998004
y.create.l HWIO_PMIC_ARB0_CHNL180_CONFIG_ADDR A:0x29a0004
y.create.l HWIO_PMIC_ARB0_CHNL181_CONFIG_ADDR A:0x29a8004
y.create.l HWIO_PMIC_ARB0_CHNL182_CONFIG_ADDR A:0x29b0004
y.create.l HWIO_PMIC_ARB0_CHNL183_CONFIG_ADDR A:0x29b8004
y.create.l HWIO_PMIC_ARB0_CHNL184_CONFIG_ADDR A:0x29c0004
y.create.l HWIO_PMIC_ARB0_CHNL185_CONFIG_ADDR A:0x29c8004
y.create.l HWIO_PMIC_ARB0_CHNL186_CONFIG_ADDR A:0x29d0004
y.create.l HWIO_PMIC_ARB0_CHNL187_CONFIG_ADDR A:0x29d8004
y.create.l HWIO_PMIC_ARB0_CHNL188_CONFIG_ADDR A:0x29e0004
y.create.l HWIO_PMIC_ARB0_CHNL189_CONFIG_ADDR A:0x29e8004
y.create.l HWIO_PMIC_ARB0_CHNL190_CONFIG_ADDR A:0x29f0004
y.create.l HWIO_PMIC_ARB0_CHNL191_CONFIG_ADDR A:0x29f8004
y.create.l HWIO_PMIC_ARB0_CHNL192_CONFIG_ADDR A:0x2a00004
y.create.l HWIO_PMIC_ARB0_CHNL193_CONFIG_ADDR A:0x2a08004
y.create.l HWIO_PMIC_ARB0_CHNL194_CONFIG_ADDR A:0x2a10004
y.create.l HWIO_PMIC_ARB0_CHNL195_CONFIG_ADDR A:0x2a18004
y.create.l HWIO_PMIC_ARB0_CHNL196_CONFIG_ADDR A:0x2a20004
y.create.l HWIO_PMIC_ARB0_CHNL197_CONFIG_ADDR A:0x2a28004
y.create.l HWIO_PMIC_ARB0_CHNL198_CONFIG_ADDR A:0x2a30004
y.create.l HWIO_PMIC_ARB0_CHNL199_CONFIG_ADDR A:0x2a38004
y.create.l HWIO_PMIC_ARB0_CHNL200_CONFIG_ADDR A:0x2a40004
y.create.l HWIO_PMIC_ARB0_CHNL201_CONFIG_ADDR A:0x2a48004
y.create.l HWIO_PMIC_ARB0_CHNL202_CONFIG_ADDR A:0x2a50004
y.create.l HWIO_PMIC_ARB0_CHNL203_CONFIG_ADDR A:0x2a58004
y.create.l HWIO_PMIC_ARB0_CHNL204_CONFIG_ADDR A:0x2a60004
y.create.l HWIO_PMIC_ARB0_CHNL205_CONFIG_ADDR A:0x2a68004
y.create.l HWIO_PMIC_ARB0_CHNL206_CONFIG_ADDR A:0x2a70004
y.create.l HWIO_PMIC_ARB0_CHNL207_CONFIG_ADDR A:0x2a78004
y.create.l HWIO_PMIC_ARB0_CHNL208_CONFIG_ADDR A:0x2a80004
y.create.l HWIO_PMIC_ARB0_CHNL209_CONFIG_ADDR A:0x2a88004
y.create.l HWIO_PMIC_ARB0_CHNL210_CONFIG_ADDR A:0x2a90004
y.create.l HWIO_PMIC_ARB0_CHNL211_CONFIG_ADDR A:0x2a98004
y.create.l HWIO_PMIC_ARB0_CHNL212_CONFIG_ADDR A:0x2aa0004
y.create.l HWIO_PMIC_ARB0_CHNL213_CONFIG_ADDR A:0x2aa8004
y.create.l HWIO_PMIC_ARB0_CHNL214_CONFIG_ADDR A:0x2ab0004
y.create.l HWIO_PMIC_ARB0_CHNL215_CONFIG_ADDR A:0x2ab8004
y.create.l HWIO_PMIC_ARB0_CHNL216_CONFIG_ADDR A:0x2ac0004
y.create.l HWIO_PMIC_ARB0_CHNL217_CONFIG_ADDR A:0x2ac8004
y.create.l HWIO_PMIC_ARB0_CHNL218_CONFIG_ADDR A:0x2ad0004
y.create.l HWIO_PMIC_ARB0_CHNL219_CONFIG_ADDR A:0x2ad8004
y.create.l HWIO_PMIC_ARB0_CHNL220_CONFIG_ADDR A:0x2ae0004
y.create.l HWIO_PMIC_ARB0_CHNL221_CONFIG_ADDR A:0x2ae8004
y.create.l HWIO_PMIC_ARB0_CHNL222_CONFIG_ADDR A:0x2af0004
y.create.l HWIO_PMIC_ARB0_CHNL223_CONFIG_ADDR A:0x2af8004
y.create.l HWIO_PMIC_ARB0_CHNL224_CONFIG_ADDR A:0x2b00004
y.create.l HWIO_PMIC_ARB0_CHNL225_CONFIG_ADDR A:0x2b08004
y.create.l HWIO_PMIC_ARB0_CHNL226_CONFIG_ADDR A:0x2b10004
y.create.l HWIO_PMIC_ARB0_CHNL227_CONFIG_ADDR A:0x2b18004
y.create.l HWIO_PMIC_ARB0_CHNL228_CONFIG_ADDR A:0x2b20004
y.create.l HWIO_PMIC_ARB0_CHNL229_CONFIG_ADDR A:0x2b28004
y.create.l HWIO_PMIC_ARB0_CHNL230_CONFIG_ADDR A:0x2b30004
y.create.l HWIO_PMIC_ARB0_CHNL231_CONFIG_ADDR A:0x2b38004
y.create.l HWIO_PMIC_ARB0_CHNL232_CONFIG_ADDR A:0x2b40004
y.create.l HWIO_PMIC_ARB0_CHNL233_CONFIG_ADDR A:0x2b48004
y.create.l HWIO_PMIC_ARB0_CHNL234_CONFIG_ADDR A:0x2b50004
y.create.l HWIO_PMIC_ARB0_CHNL235_CONFIG_ADDR A:0x2b58004
y.create.l HWIO_PMIC_ARB0_CHNL236_CONFIG_ADDR A:0x2b60004
y.create.l HWIO_PMIC_ARB0_CHNL237_CONFIG_ADDR A:0x2b68004
y.create.l HWIO_PMIC_ARB0_CHNL238_CONFIG_ADDR A:0x2b70004
y.create.l HWIO_PMIC_ARB0_CHNL239_CONFIG_ADDR A:0x2b78004
y.create.l HWIO_PMIC_ARB0_CHNL240_CONFIG_ADDR A:0x2b80004
y.create.l HWIO_PMIC_ARB0_CHNL241_CONFIG_ADDR A:0x2b88004
y.create.l HWIO_PMIC_ARB0_CHNL242_CONFIG_ADDR A:0x2b90004
y.create.l HWIO_PMIC_ARB0_CHNL243_CONFIG_ADDR A:0x2b98004
y.create.l HWIO_PMIC_ARB0_CHNL244_CONFIG_ADDR A:0x2ba0004
y.create.l HWIO_PMIC_ARB0_CHNL245_CONFIG_ADDR A:0x2ba8004
y.create.l HWIO_PMIC_ARB0_CHNL246_CONFIG_ADDR A:0x2bb0004
y.create.l HWIO_PMIC_ARB0_CHNL247_CONFIG_ADDR A:0x2bb8004
y.create.l HWIO_PMIC_ARB0_CHNL248_CONFIG_ADDR A:0x2bc0004
y.create.l HWIO_PMIC_ARB0_CHNL249_CONFIG_ADDR A:0x2bc8004
y.create.l HWIO_PMIC_ARB0_CHNL250_CONFIG_ADDR A:0x2bd0004
y.create.l HWIO_PMIC_ARB0_CHNL251_CONFIG_ADDR A:0x2bd8004
y.create.l HWIO_PMIC_ARB0_CHNL252_CONFIG_ADDR A:0x2be0004
y.create.l HWIO_PMIC_ARB0_CHNL253_CONFIG_ADDR A:0x2be8004
y.create.l HWIO_PMIC_ARB0_CHNL254_CONFIG_ADDR A:0x2bf0004
y.create.l HWIO_PMIC_ARB0_CHNL255_CONFIG_ADDR A:0x2bf8004
y.create.l HWIO_PMIC_ARB1_CHNL0_CONFIG_ADDR A:0x2401004
y.create.l HWIO_PMIC_ARB1_CHNL1_CONFIG_ADDR A:0x2409004
y.create.l HWIO_PMIC_ARB1_CHNL2_CONFIG_ADDR A:0x2411004
y.create.l HWIO_PMIC_ARB1_CHNL3_CONFIG_ADDR A:0x2419004
y.create.l HWIO_PMIC_ARB1_CHNL4_CONFIG_ADDR A:0x2421004
y.create.l HWIO_PMIC_ARB1_CHNL5_CONFIG_ADDR A:0x2429004
y.create.l HWIO_PMIC_ARB1_CHNL6_CONFIG_ADDR A:0x2431004
y.create.l HWIO_PMIC_ARB1_CHNL7_CONFIG_ADDR A:0x2439004
y.create.l HWIO_PMIC_ARB1_CHNL8_CONFIG_ADDR A:0x2441004
y.create.l HWIO_PMIC_ARB1_CHNL9_CONFIG_ADDR A:0x2449004
y.create.l HWIO_PMIC_ARB1_CHNL10_CONFIG_ADDR A:0x2451004
y.create.l HWIO_PMIC_ARB1_CHNL11_CONFIG_ADDR A:0x2459004
y.create.l HWIO_PMIC_ARB1_CHNL12_CONFIG_ADDR A:0x2461004
y.create.l HWIO_PMIC_ARB1_CHNL13_CONFIG_ADDR A:0x2469004
y.create.l HWIO_PMIC_ARB1_CHNL14_CONFIG_ADDR A:0x2471004
y.create.l HWIO_PMIC_ARB1_CHNL15_CONFIG_ADDR A:0x2479004
y.create.l HWIO_PMIC_ARB1_CHNL16_CONFIG_ADDR A:0x2481004
y.create.l HWIO_PMIC_ARB1_CHNL17_CONFIG_ADDR A:0x2489004
y.create.l HWIO_PMIC_ARB1_CHNL18_CONFIG_ADDR A:0x2491004
y.create.l HWIO_PMIC_ARB1_CHNL19_CONFIG_ADDR A:0x2499004
y.create.l HWIO_PMIC_ARB1_CHNL20_CONFIG_ADDR A:0x24a1004
y.create.l HWIO_PMIC_ARB1_CHNL21_CONFIG_ADDR A:0x24a9004
y.create.l HWIO_PMIC_ARB1_CHNL22_CONFIG_ADDR A:0x24b1004
y.create.l HWIO_PMIC_ARB1_CHNL23_CONFIG_ADDR A:0x24b9004
y.create.l HWIO_PMIC_ARB1_CHNL24_CONFIG_ADDR A:0x24c1004
y.create.l HWIO_PMIC_ARB1_CHNL25_CONFIG_ADDR A:0x24c9004
y.create.l HWIO_PMIC_ARB1_CHNL26_CONFIG_ADDR A:0x24d1004
y.create.l HWIO_PMIC_ARB1_CHNL27_CONFIG_ADDR A:0x24d9004
y.create.l HWIO_PMIC_ARB1_CHNL28_CONFIG_ADDR A:0x24e1004
y.create.l HWIO_PMIC_ARB1_CHNL29_CONFIG_ADDR A:0x24e9004
y.create.l HWIO_PMIC_ARB1_CHNL30_CONFIG_ADDR A:0x24f1004
y.create.l HWIO_PMIC_ARB1_CHNL31_CONFIG_ADDR A:0x24f9004
y.create.l HWIO_PMIC_ARB1_CHNL32_CONFIG_ADDR A:0x2501004
y.create.l HWIO_PMIC_ARB1_CHNL33_CONFIG_ADDR A:0x2509004
y.create.l HWIO_PMIC_ARB1_CHNL34_CONFIG_ADDR A:0x2511004
y.create.l HWIO_PMIC_ARB1_CHNL35_CONFIG_ADDR A:0x2519004
y.create.l HWIO_PMIC_ARB1_CHNL36_CONFIG_ADDR A:0x2521004
y.create.l HWIO_PMIC_ARB1_CHNL37_CONFIG_ADDR A:0x2529004
y.create.l HWIO_PMIC_ARB1_CHNL38_CONFIG_ADDR A:0x2531004
y.create.l HWIO_PMIC_ARB1_CHNL39_CONFIG_ADDR A:0x2539004
y.create.l HWIO_PMIC_ARB1_CHNL40_CONFIG_ADDR A:0x2541004
y.create.l HWIO_PMIC_ARB1_CHNL41_CONFIG_ADDR A:0x2549004
y.create.l HWIO_PMIC_ARB1_CHNL42_CONFIG_ADDR A:0x2551004
y.create.l HWIO_PMIC_ARB1_CHNL43_CONFIG_ADDR A:0x2559004
y.create.l HWIO_PMIC_ARB1_CHNL44_CONFIG_ADDR A:0x2561004
y.create.l HWIO_PMIC_ARB1_CHNL45_CONFIG_ADDR A:0x2569004
y.create.l HWIO_PMIC_ARB1_CHNL46_CONFIG_ADDR A:0x2571004
y.create.l HWIO_PMIC_ARB1_CHNL47_CONFIG_ADDR A:0x2579004
y.create.l HWIO_PMIC_ARB1_CHNL48_CONFIG_ADDR A:0x2581004
y.create.l HWIO_PMIC_ARB1_CHNL49_CONFIG_ADDR A:0x2589004
y.create.l HWIO_PMIC_ARB1_CHNL50_CONFIG_ADDR A:0x2591004
y.create.l HWIO_PMIC_ARB1_CHNL51_CONFIG_ADDR A:0x2599004
y.create.l HWIO_PMIC_ARB1_CHNL52_CONFIG_ADDR A:0x25a1004
y.create.l HWIO_PMIC_ARB1_CHNL53_CONFIG_ADDR A:0x25a9004
y.create.l HWIO_PMIC_ARB1_CHNL54_CONFIG_ADDR A:0x25b1004
y.create.l HWIO_PMIC_ARB1_CHNL55_CONFIG_ADDR A:0x25b9004
y.create.l HWIO_PMIC_ARB1_CHNL56_CONFIG_ADDR A:0x25c1004
y.create.l HWIO_PMIC_ARB1_CHNL57_CONFIG_ADDR A:0x25c9004
y.create.l HWIO_PMIC_ARB1_CHNL58_CONFIG_ADDR A:0x25d1004
y.create.l HWIO_PMIC_ARB1_CHNL59_CONFIG_ADDR A:0x25d9004
y.create.l HWIO_PMIC_ARB1_CHNL60_CONFIG_ADDR A:0x25e1004
y.create.l HWIO_PMIC_ARB1_CHNL61_CONFIG_ADDR A:0x25e9004
y.create.l HWIO_PMIC_ARB1_CHNL62_CONFIG_ADDR A:0x25f1004
y.create.l HWIO_PMIC_ARB1_CHNL63_CONFIG_ADDR A:0x25f9004
y.create.l HWIO_PMIC_ARB1_CHNL64_CONFIG_ADDR A:0x2601004
y.create.l HWIO_PMIC_ARB1_CHNL65_CONFIG_ADDR A:0x2609004
y.create.l HWIO_PMIC_ARB1_CHNL66_CONFIG_ADDR A:0x2611004
y.create.l HWIO_PMIC_ARB1_CHNL67_CONFIG_ADDR A:0x2619004
y.create.l HWIO_PMIC_ARB1_CHNL68_CONFIG_ADDR A:0x2621004
y.create.l HWIO_PMIC_ARB1_CHNL69_CONFIG_ADDR A:0x2629004
y.create.l HWIO_PMIC_ARB1_CHNL70_CONFIG_ADDR A:0x2631004
y.create.l HWIO_PMIC_ARB1_CHNL71_CONFIG_ADDR A:0x2639004
y.create.l HWIO_PMIC_ARB1_CHNL72_CONFIG_ADDR A:0x2641004
y.create.l HWIO_PMIC_ARB1_CHNL73_CONFIG_ADDR A:0x2649004
y.create.l HWIO_PMIC_ARB1_CHNL74_CONFIG_ADDR A:0x2651004
y.create.l HWIO_PMIC_ARB1_CHNL75_CONFIG_ADDR A:0x2659004
y.create.l HWIO_PMIC_ARB1_CHNL76_CONFIG_ADDR A:0x2661004
y.create.l HWIO_PMIC_ARB1_CHNL77_CONFIG_ADDR A:0x2669004
y.create.l HWIO_PMIC_ARB1_CHNL78_CONFIG_ADDR A:0x2671004
y.create.l HWIO_PMIC_ARB1_CHNL79_CONFIG_ADDR A:0x2679004
y.create.l HWIO_PMIC_ARB1_CHNL80_CONFIG_ADDR A:0x2681004
y.create.l HWIO_PMIC_ARB1_CHNL81_CONFIG_ADDR A:0x2689004
y.create.l HWIO_PMIC_ARB1_CHNL82_CONFIG_ADDR A:0x2691004
y.create.l HWIO_PMIC_ARB1_CHNL83_CONFIG_ADDR A:0x2699004
y.create.l HWIO_PMIC_ARB1_CHNL84_CONFIG_ADDR A:0x26a1004
y.create.l HWIO_PMIC_ARB1_CHNL85_CONFIG_ADDR A:0x26a9004
y.create.l HWIO_PMIC_ARB1_CHNL86_CONFIG_ADDR A:0x26b1004
y.create.l HWIO_PMIC_ARB1_CHNL87_CONFIG_ADDR A:0x26b9004
y.create.l HWIO_PMIC_ARB1_CHNL88_CONFIG_ADDR A:0x26c1004
y.create.l HWIO_PMIC_ARB1_CHNL89_CONFIG_ADDR A:0x26c9004
y.create.l HWIO_PMIC_ARB1_CHNL90_CONFIG_ADDR A:0x26d1004
y.create.l HWIO_PMIC_ARB1_CHNL91_CONFIG_ADDR A:0x26d9004
y.create.l HWIO_PMIC_ARB1_CHNL92_CONFIG_ADDR A:0x26e1004
y.create.l HWIO_PMIC_ARB1_CHNL93_CONFIG_ADDR A:0x26e9004
y.create.l HWIO_PMIC_ARB1_CHNL94_CONFIG_ADDR A:0x26f1004
y.create.l HWIO_PMIC_ARB1_CHNL95_CONFIG_ADDR A:0x26f9004
y.create.l HWIO_PMIC_ARB1_CHNL96_CONFIG_ADDR A:0x2701004
y.create.l HWIO_PMIC_ARB1_CHNL97_CONFIG_ADDR A:0x2709004
y.create.l HWIO_PMIC_ARB1_CHNL98_CONFIG_ADDR A:0x2711004
y.create.l HWIO_PMIC_ARB1_CHNL99_CONFIG_ADDR A:0x2719004
y.create.l HWIO_PMIC_ARB1_CHNL100_CONFIG_ADDR A:0x2721004
y.create.l HWIO_PMIC_ARB1_CHNL101_CONFIG_ADDR A:0x2729004
y.create.l HWIO_PMIC_ARB1_CHNL102_CONFIG_ADDR A:0x2731004
y.create.l HWIO_PMIC_ARB1_CHNL103_CONFIG_ADDR A:0x2739004
y.create.l HWIO_PMIC_ARB1_CHNL104_CONFIG_ADDR A:0x2741004
y.create.l HWIO_PMIC_ARB1_CHNL105_CONFIG_ADDR A:0x2749004
y.create.l HWIO_PMIC_ARB1_CHNL106_CONFIG_ADDR A:0x2751004
y.create.l HWIO_PMIC_ARB1_CHNL107_CONFIG_ADDR A:0x2759004
y.create.l HWIO_PMIC_ARB1_CHNL108_CONFIG_ADDR A:0x2761004
y.create.l HWIO_PMIC_ARB1_CHNL109_CONFIG_ADDR A:0x2769004
y.create.l HWIO_PMIC_ARB1_CHNL110_CONFIG_ADDR A:0x2771004
y.create.l HWIO_PMIC_ARB1_CHNL111_CONFIG_ADDR A:0x2779004
y.create.l HWIO_PMIC_ARB1_CHNL112_CONFIG_ADDR A:0x2781004
y.create.l HWIO_PMIC_ARB1_CHNL113_CONFIG_ADDR A:0x2789004
y.create.l HWIO_PMIC_ARB1_CHNL114_CONFIG_ADDR A:0x2791004
y.create.l HWIO_PMIC_ARB1_CHNL115_CONFIG_ADDR A:0x2799004
y.create.l HWIO_PMIC_ARB1_CHNL116_CONFIG_ADDR A:0x27a1004
y.create.l HWIO_PMIC_ARB1_CHNL117_CONFIG_ADDR A:0x27a9004
y.create.l HWIO_PMIC_ARB1_CHNL118_CONFIG_ADDR A:0x27b1004
y.create.l HWIO_PMIC_ARB1_CHNL119_CONFIG_ADDR A:0x27b9004
y.create.l HWIO_PMIC_ARB1_CHNL120_CONFIG_ADDR A:0x27c1004
y.create.l HWIO_PMIC_ARB1_CHNL121_CONFIG_ADDR A:0x27c9004
y.create.l HWIO_PMIC_ARB1_CHNL122_CONFIG_ADDR A:0x27d1004
y.create.l HWIO_PMIC_ARB1_CHNL123_CONFIG_ADDR A:0x27d9004
y.create.l HWIO_PMIC_ARB1_CHNL124_CONFIG_ADDR A:0x27e1004
y.create.l HWIO_PMIC_ARB1_CHNL125_CONFIG_ADDR A:0x27e9004
y.create.l HWIO_PMIC_ARB1_CHNL126_CONFIG_ADDR A:0x27f1004
y.create.l HWIO_PMIC_ARB1_CHNL127_CONFIG_ADDR A:0x27f9004
y.create.l HWIO_PMIC_ARB1_CHNL128_CONFIG_ADDR A:0x2801004
y.create.l HWIO_PMIC_ARB1_CHNL129_CONFIG_ADDR A:0x2809004
y.create.l HWIO_PMIC_ARB1_CHNL130_CONFIG_ADDR A:0x2811004
y.create.l HWIO_PMIC_ARB1_CHNL131_CONFIG_ADDR A:0x2819004
y.create.l HWIO_PMIC_ARB1_CHNL132_CONFIG_ADDR A:0x2821004
y.create.l HWIO_PMIC_ARB1_CHNL133_CONFIG_ADDR A:0x2829004
y.create.l HWIO_PMIC_ARB1_CHNL134_CONFIG_ADDR A:0x2831004
y.create.l HWIO_PMIC_ARB1_CHNL135_CONFIG_ADDR A:0x2839004
y.create.l HWIO_PMIC_ARB1_CHNL136_CONFIG_ADDR A:0x2841004
y.create.l HWIO_PMIC_ARB1_CHNL137_CONFIG_ADDR A:0x2849004
y.create.l HWIO_PMIC_ARB1_CHNL138_CONFIG_ADDR A:0x2851004
y.create.l HWIO_PMIC_ARB1_CHNL139_CONFIG_ADDR A:0x2859004
y.create.l HWIO_PMIC_ARB1_CHNL140_CONFIG_ADDR A:0x2861004
y.create.l HWIO_PMIC_ARB1_CHNL141_CONFIG_ADDR A:0x2869004
y.create.l HWIO_PMIC_ARB1_CHNL142_CONFIG_ADDR A:0x2871004
y.create.l HWIO_PMIC_ARB1_CHNL143_CONFIG_ADDR A:0x2879004
y.create.l HWIO_PMIC_ARB1_CHNL144_CONFIG_ADDR A:0x2881004
y.create.l HWIO_PMIC_ARB1_CHNL145_CONFIG_ADDR A:0x2889004
y.create.l HWIO_PMIC_ARB1_CHNL146_CONFIG_ADDR A:0x2891004
y.create.l HWIO_PMIC_ARB1_CHNL147_CONFIG_ADDR A:0x2899004
y.create.l HWIO_PMIC_ARB1_CHNL148_CONFIG_ADDR A:0x28a1004
y.create.l HWIO_PMIC_ARB1_CHNL149_CONFIG_ADDR A:0x28a9004
y.create.l HWIO_PMIC_ARB1_CHNL150_CONFIG_ADDR A:0x28b1004
y.create.l HWIO_PMIC_ARB1_CHNL151_CONFIG_ADDR A:0x28b9004
y.create.l HWIO_PMIC_ARB1_CHNL152_CONFIG_ADDR A:0x28c1004
y.create.l HWIO_PMIC_ARB1_CHNL153_CONFIG_ADDR A:0x28c9004
y.create.l HWIO_PMIC_ARB1_CHNL154_CONFIG_ADDR A:0x28d1004
y.create.l HWIO_PMIC_ARB1_CHNL155_CONFIG_ADDR A:0x28d9004
y.create.l HWIO_PMIC_ARB1_CHNL156_CONFIG_ADDR A:0x28e1004
y.create.l HWIO_PMIC_ARB1_CHNL157_CONFIG_ADDR A:0x28e9004
y.create.l HWIO_PMIC_ARB1_CHNL158_CONFIG_ADDR A:0x28f1004
y.create.l HWIO_PMIC_ARB1_CHNL159_CONFIG_ADDR A:0x28f9004
y.create.l HWIO_PMIC_ARB1_CHNL160_CONFIG_ADDR A:0x2901004
y.create.l HWIO_PMIC_ARB1_CHNL161_CONFIG_ADDR A:0x2909004
y.create.l HWIO_PMIC_ARB1_CHNL162_CONFIG_ADDR A:0x2911004
y.create.l HWIO_PMIC_ARB1_CHNL163_CONFIG_ADDR A:0x2919004
y.create.l HWIO_PMIC_ARB1_CHNL164_CONFIG_ADDR A:0x2921004
y.create.l HWIO_PMIC_ARB1_CHNL165_CONFIG_ADDR A:0x2929004
y.create.l HWIO_PMIC_ARB1_CHNL166_CONFIG_ADDR A:0x2931004
y.create.l HWIO_PMIC_ARB1_CHNL167_CONFIG_ADDR A:0x2939004
y.create.l HWIO_PMIC_ARB1_CHNL168_CONFIG_ADDR A:0x2941004
y.create.l HWIO_PMIC_ARB1_CHNL169_CONFIG_ADDR A:0x2949004
y.create.l HWIO_PMIC_ARB1_CHNL170_CONFIG_ADDR A:0x2951004
y.create.l HWIO_PMIC_ARB1_CHNL171_CONFIG_ADDR A:0x2959004
y.create.l HWIO_PMIC_ARB1_CHNL172_CONFIG_ADDR A:0x2961004
y.create.l HWIO_PMIC_ARB1_CHNL173_CONFIG_ADDR A:0x2969004
y.create.l HWIO_PMIC_ARB1_CHNL174_CONFIG_ADDR A:0x2971004
y.create.l HWIO_PMIC_ARB1_CHNL175_CONFIG_ADDR A:0x2979004
y.create.l HWIO_PMIC_ARB1_CHNL176_CONFIG_ADDR A:0x2981004
y.create.l HWIO_PMIC_ARB1_CHNL177_CONFIG_ADDR A:0x2989004
y.create.l HWIO_PMIC_ARB1_CHNL178_CONFIG_ADDR A:0x2991004
y.create.l HWIO_PMIC_ARB1_CHNL179_CONFIG_ADDR A:0x2999004
y.create.l HWIO_PMIC_ARB1_CHNL180_CONFIG_ADDR A:0x29a1004
y.create.l HWIO_PMIC_ARB1_CHNL181_CONFIG_ADDR A:0x29a9004
y.create.l HWIO_PMIC_ARB1_CHNL182_CONFIG_ADDR A:0x29b1004
y.create.l HWIO_PMIC_ARB1_CHNL183_CONFIG_ADDR A:0x29b9004
y.create.l HWIO_PMIC_ARB1_CHNL184_CONFIG_ADDR A:0x29c1004
y.create.l HWIO_PMIC_ARB1_CHNL185_CONFIG_ADDR A:0x29c9004
y.create.l HWIO_PMIC_ARB1_CHNL186_CONFIG_ADDR A:0x29d1004
y.create.l HWIO_PMIC_ARB1_CHNL187_CONFIG_ADDR A:0x29d9004
y.create.l HWIO_PMIC_ARB1_CHNL188_CONFIG_ADDR A:0x29e1004
y.create.l HWIO_PMIC_ARB1_CHNL189_CONFIG_ADDR A:0x29e9004
y.create.l HWIO_PMIC_ARB1_CHNL190_CONFIG_ADDR A:0x29f1004
y.create.l HWIO_PMIC_ARB1_CHNL191_CONFIG_ADDR A:0x29f9004
y.create.l HWIO_PMIC_ARB1_CHNL192_CONFIG_ADDR A:0x2a01004
y.create.l HWIO_PMIC_ARB1_CHNL193_CONFIG_ADDR A:0x2a09004
y.create.l HWIO_PMIC_ARB1_CHNL194_CONFIG_ADDR A:0x2a11004
y.create.l HWIO_PMIC_ARB1_CHNL195_CONFIG_ADDR A:0x2a19004
y.create.l HWIO_PMIC_ARB1_CHNL196_CONFIG_ADDR A:0x2a21004
y.create.l HWIO_PMIC_ARB1_CHNL197_CONFIG_ADDR A:0x2a29004
y.create.l HWIO_PMIC_ARB1_CHNL198_CONFIG_ADDR A:0x2a31004
y.create.l HWIO_PMIC_ARB1_CHNL199_CONFIG_ADDR A:0x2a39004
y.create.l HWIO_PMIC_ARB1_CHNL200_CONFIG_ADDR A:0x2a41004
y.create.l HWIO_PMIC_ARB1_CHNL201_CONFIG_ADDR A:0x2a49004
y.create.l HWIO_PMIC_ARB1_CHNL202_CONFIG_ADDR A:0x2a51004
y.create.l HWIO_PMIC_ARB1_CHNL203_CONFIG_ADDR A:0x2a59004
y.create.l HWIO_PMIC_ARB1_CHNL204_CONFIG_ADDR A:0x2a61004
y.create.l HWIO_PMIC_ARB1_CHNL205_CONFIG_ADDR A:0x2a69004
y.create.l HWIO_PMIC_ARB1_CHNL206_CONFIG_ADDR A:0x2a71004
y.create.l HWIO_PMIC_ARB1_CHNL207_CONFIG_ADDR A:0x2a79004
y.create.l HWIO_PMIC_ARB1_CHNL208_CONFIG_ADDR A:0x2a81004
y.create.l HWIO_PMIC_ARB1_CHNL209_CONFIG_ADDR A:0x2a89004
y.create.l HWIO_PMIC_ARB1_CHNL210_CONFIG_ADDR A:0x2a91004
y.create.l HWIO_PMIC_ARB1_CHNL211_CONFIG_ADDR A:0x2a99004
y.create.l HWIO_PMIC_ARB1_CHNL212_CONFIG_ADDR A:0x2aa1004
y.create.l HWIO_PMIC_ARB1_CHNL213_CONFIG_ADDR A:0x2aa9004
y.create.l HWIO_PMIC_ARB1_CHNL214_CONFIG_ADDR A:0x2ab1004
y.create.l HWIO_PMIC_ARB1_CHNL215_CONFIG_ADDR A:0x2ab9004
y.create.l HWIO_PMIC_ARB1_CHNL216_CONFIG_ADDR A:0x2ac1004
y.create.l HWIO_PMIC_ARB1_CHNL217_CONFIG_ADDR A:0x2ac9004
y.create.l HWIO_PMIC_ARB1_CHNL218_CONFIG_ADDR A:0x2ad1004
y.create.l HWIO_PMIC_ARB1_CHNL219_CONFIG_ADDR A:0x2ad9004
y.create.l HWIO_PMIC_ARB1_CHNL220_CONFIG_ADDR A:0x2ae1004
y.create.l HWIO_PMIC_ARB1_CHNL221_CONFIG_ADDR A:0x2ae9004
y.create.l HWIO_PMIC_ARB1_CHNL222_CONFIG_ADDR A:0x2af1004
y.create.l HWIO_PMIC_ARB1_CHNL223_CONFIG_ADDR A:0x2af9004
y.create.l HWIO_PMIC_ARB1_CHNL224_CONFIG_ADDR A:0x2b01004
y.create.l HWIO_PMIC_ARB1_CHNL225_CONFIG_ADDR A:0x2b09004
y.create.l HWIO_PMIC_ARB1_CHNL226_CONFIG_ADDR A:0x2b11004
y.create.l HWIO_PMIC_ARB1_CHNL227_CONFIG_ADDR A:0x2b19004
y.create.l HWIO_PMIC_ARB1_CHNL228_CONFIG_ADDR A:0x2b21004
y.create.l HWIO_PMIC_ARB1_CHNL229_CONFIG_ADDR A:0x2b29004
y.create.l HWIO_PMIC_ARB1_CHNL230_CONFIG_ADDR A:0x2b31004
y.create.l HWIO_PMIC_ARB1_CHNL231_CONFIG_ADDR A:0x2b39004
y.create.l HWIO_PMIC_ARB1_CHNL232_CONFIG_ADDR A:0x2b41004
y.create.l HWIO_PMIC_ARB1_CHNL233_CONFIG_ADDR A:0x2b49004
y.create.l HWIO_PMIC_ARB1_CHNL234_CONFIG_ADDR A:0x2b51004
y.create.l HWIO_PMIC_ARB1_CHNL235_CONFIG_ADDR A:0x2b59004
y.create.l HWIO_PMIC_ARB1_CHNL236_CONFIG_ADDR A:0x2b61004
y.create.l HWIO_PMIC_ARB1_CHNL237_CONFIG_ADDR A:0x2b69004
y.create.l HWIO_PMIC_ARB1_CHNL238_CONFIG_ADDR A:0x2b71004
y.create.l HWIO_PMIC_ARB1_CHNL239_CONFIG_ADDR A:0x2b79004
y.create.l HWIO_PMIC_ARB1_CHNL240_CONFIG_ADDR A:0x2b81004
y.create.l HWIO_PMIC_ARB1_CHNL241_CONFIG_ADDR A:0x2b89004
y.create.l HWIO_PMIC_ARB1_CHNL242_CONFIG_ADDR A:0x2b91004
y.create.l HWIO_PMIC_ARB1_CHNL243_CONFIG_ADDR A:0x2b99004
y.create.l HWIO_PMIC_ARB1_CHNL244_CONFIG_ADDR A:0x2ba1004
y.create.l HWIO_PMIC_ARB1_CHNL245_CONFIG_ADDR A:0x2ba9004
y.create.l HWIO_PMIC_ARB1_CHNL246_CONFIG_ADDR A:0x2bb1004
y.create.l HWIO_PMIC_ARB1_CHNL247_CONFIG_ADDR A:0x2bb9004
y.create.l HWIO_PMIC_ARB1_CHNL248_CONFIG_ADDR A:0x2bc1004
y.create.l HWIO_PMIC_ARB1_CHNL249_CONFIG_ADDR A:0x2bc9004
y.create.l HWIO_PMIC_ARB1_CHNL250_CONFIG_ADDR A:0x2bd1004
y.create.l HWIO_PMIC_ARB1_CHNL251_CONFIG_ADDR A:0x2bd9004
y.create.l HWIO_PMIC_ARB1_CHNL252_CONFIG_ADDR A:0x2be1004
y.create.l HWIO_PMIC_ARB1_CHNL253_CONFIG_ADDR A:0x2be9004
y.create.l HWIO_PMIC_ARB1_CHNL254_CONFIG_ADDR A:0x2bf1004
y.create.l HWIO_PMIC_ARB1_CHNL255_CONFIG_ADDR A:0x2bf9004
y.create.l HWIO_PMIC_ARB2_CHNL0_CONFIG_ADDR A:0x2402004
y.create.l HWIO_PMIC_ARB2_CHNL1_CONFIG_ADDR A:0x240a004
y.create.l HWIO_PMIC_ARB2_CHNL2_CONFIG_ADDR A:0x2412004
y.create.l HWIO_PMIC_ARB2_CHNL3_CONFIG_ADDR A:0x241a004
y.create.l HWIO_PMIC_ARB2_CHNL4_CONFIG_ADDR A:0x2422004
y.create.l HWIO_PMIC_ARB2_CHNL5_CONFIG_ADDR A:0x242a004
y.create.l HWIO_PMIC_ARB2_CHNL6_CONFIG_ADDR A:0x2432004
y.create.l HWIO_PMIC_ARB2_CHNL7_CONFIG_ADDR A:0x243a004
y.create.l HWIO_PMIC_ARB2_CHNL8_CONFIG_ADDR A:0x2442004
y.create.l HWIO_PMIC_ARB2_CHNL9_CONFIG_ADDR A:0x244a004
y.create.l HWIO_PMIC_ARB2_CHNL10_CONFIG_ADDR A:0x2452004
y.create.l HWIO_PMIC_ARB2_CHNL11_CONFIG_ADDR A:0x245a004
y.create.l HWIO_PMIC_ARB2_CHNL12_CONFIG_ADDR A:0x2462004
y.create.l HWIO_PMIC_ARB2_CHNL13_CONFIG_ADDR A:0x246a004
y.create.l HWIO_PMIC_ARB2_CHNL14_CONFIG_ADDR A:0x2472004
y.create.l HWIO_PMIC_ARB2_CHNL15_CONFIG_ADDR A:0x247a004
y.create.l HWIO_PMIC_ARB2_CHNL16_CONFIG_ADDR A:0x2482004
y.create.l HWIO_PMIC_ARB2_CHNL17_CONFIG_ADDR A:0x248a004
y.create.l HWIO_PMIC_ARB2_CHNL18_CONFIG_ADDR A:0x2492004
y.create.l HWIO_PMIC_ARB2_CHNL19_CONFIG_ADDR A:0x249a004
y.create.l HWIO_PMIC_ARB2_CHNL20_CONFIG_ADDR A:0x24a2004
y.create.l HWIO_PMIC_ARB2_CHNL21_CONFIG_ADDR A:0x24aa004
y.create.l HWIO_PMIC_ARB2_CHNL22_CONFIG_ADDR A:0x24b2004
y.create.l HWIO_PMIC_ARB2_CHNL23_CONFIG_ADDR A:0x24ba004
y.create.l HWIO_PMIC_ARB2_CHNL24_CONFIG_ADDR A:0x24c2004
y.create.l HWIO_PMIC_ARB2_CHNL25_CONFIG_ADDR A:0x24ca004
y.create.l HWIO_PMIC_ARB2_CHNL26_CONFIG_ADDR A:0x24d2004
y.create.l HWIO_PMIC_ARB2_CHNL27_CONFIG_ADDR A:0x24da004
y.create.l HWIO_PMIC_ARB2_CHNL28_CONFIG_ADDR A:0x24e2004
y.create.l HWIO_PMIC_ARB2_CHNL29_CONFIG_ADDR A:0x24ea004
y.create.l HWIO_PMIC_ARB2_CHNL30_CONFIG_ADDR A:0x24f2004
y.create.l HWIO_PMIC_ARB2_CHNL31_CONFIG_ADDR A:0x24fa004
y.create.l HWIO_PMIC_ARB2_CHNL32_CONFIG_ADDR A:0x2502004
y.create.l HWIO_PMIC_ARB2_CHNL33_CONFIG_ADDR A:0x250a004
y.create.l HWIO_PMIC_ARB2_CHNL34_CONFIG_ADDR A:0x2512004
y.create.l HWIO_PMIC_ARB2_CHNL35_CONFIG_ADDR A:0x251a004
y.create.l HWIO_PMIC_ARB2_CHNL36_CONFIG_ADDR A:0x2522004
y.create.l HWIO_PMIC_ARB2_CHNL37_CONFIG_ADDR A:0x252a004
y.create.l HWIO_PMIC_ARB2_CHNL38_CONFIG_ADDR A:0x2532004
y.create.l HWIO_PMIC_ARB2_CHNL39_CONFIG_ADDR A:0x253a004
y.create.l HWIO_PMIC_ARB2_CHNL40_CONFIG_ADDR A:0x2542004
y.create.l HWIO_PMIC_ARB2_CHNL41_CONFIG_ADDR A:0x254a004
y.create.l HWIO_PMIC_ARB2_CHNL42_CONFIG_ADDR A:0x2552004
y.create.l HWIO_PMIC_ARB2_CHNL43_CONFIG_ADDR A:0x255a004
y.create.l HWIO_PMIC_ARB2_CHNL44_CONFIG_ADDR A:0x2562004
y.create.l HWIO_PMIC_ARB2_CHNL45_CONFIG_ADDR A:0x256a004
y.create.l HWIO_PMIC_ARB2_CHNL46_CONFIG_ADDR A:0x2572004
y.create.l HWIO_PMIC_ARB2_CHNL47_CONFIG_ADDR A:0x257a004
y.create.l HWIO_PMIC_ARB2_CHNL48_CONFIG_ADDR A:0x2582004
y.create.l HWIO_PMIC_ARB2_CHNL49_CONFIG_ADDR A:0x258a004
y.create.l HWIO_PMIC_ARB2_CHNL50_CONFIG_ADDR A:0x2592004
y.create.l HWIO_PMIC_ARB2_CHNL51_CONFIG_ADDR A:0x259a004
y.create.l HWIO_PMIC_ARB2_CHNL52_CONFIG_ADDR A:0x25a2004
y.create.l HWIO_PMIC_ARB2_CHNL53_CONFIG_ADDR A:0x25aa004
y.create.l HWIO_PMIC_ARB2_CHNL54_CONFIG_ADDR A:0x25b2004
y.create.l HWIO_PMIC_ARB2_CHNL55_CONFIG_ADDR A:0x25ba004
y.create.l HWIO_PMIC_ARB2_CHNL56_CONFIG_ADDR A:0x25c2004
y.create.l HWIO_PMIC_ARB2_CHNL57_CONFIG_ADDR A:0x25ca004
y.create.l HWIO_PMIC_ARB2_CHNL58_CONFIG_ADDR A:0x25d2004
y.create.l HWIO_PMIC_ARB2_CHNL59_CONFIG_ADDR A:0x25da004
y.create.l HWIO_PMIC_ARB2_CHNL60_CONFIG_ADDR A:0x25e2004
y.create.l HWIO_PMIC_ARB2_CHNL61_CONFIG_ADDR A:0x25ea004
y.create.l HWIO_PMIC_ARB2_CHNL62_CONFIG_ADDR A:0x25f2004
y.create.l HWIO_PMIC_ARB2_CHNL63_CONFIG_ADDR A:0x25fa004
y.create.l HWIO_PMIC_ARB2_CHNL64_CONFIG_ADDR A:0x2602004
y.create.l HWIO_PMIC_ARB2_CHNL65_CONFIG_ADDR A:0x260a004
y.create.l HWIO_PMIC_ARB2_CHNL66_CONFIG_ADDR A:0x2612004
y.create.l HWIO_PMIC_ARB2_CHNL67_CONFIG_ADDR A:0x261a004
y.create.l HWIO_PMIC_ARB2_CHNL68_CONFIG_ADDR A:0x2622004
y.create.l HWIO_PMIC_ARB2_CHNL69_CONFIG_ADDR A:0x262a004
y.create.l HWIO_PMIC_ARB2_CHNL70_CONFIG_ADDR A:0x2632004
y.create.l HWIO_PMIC_ARB2_CHNL71_CONFIG_ADDR A:0x263a004
y.create.l HWIO_PMIC_ARB2_CHNL72_CONFIG_ADDR A:0x2642004
y.create.l HWIO_PMIC_ARB2_CHNL73_CONFIG_ADDR A:0x264a004
y.create.l HWIO_PMIC_ARB2_CHNL74_CONFIG_ADDR A:0x2652004
y.create.l HWIO_PMIC_ARB2_CHNL75_CONFIG_ADDR A:0x265a004
y.create.l HWIO_PMIC_ARB2_CHNL76_CONFIG_ADDR A:0x2662004
y.create.l HWIO_PMIC_ARB2_CHNL77_CONFIG_ADDR A:0x266a004
y.create.l HWIO_PMIC_ARB2_CHNL78_CONFIG_ADDR A:0x2672004
y.create.l HWIO_PMIC_ARB2_CHNL79_CONFIG_ADDR A:0x267a004
y.create.l HWIO_PMIC_ARB2_CHNL80_CONFIG_ADDR A:0x2682004
y.create.l HWIO_PMIC_ARB2_CHNL81_CONFIG_ADDR A:0x268a004
y.create.l HWIO_PMIC_ARB2_CHNL82_CONFIG_ADDR A:0x2692004
y.create.l HWIO_PMIC_ARB2_CHNL83_CONFIG_ADDR A:0x269a004
y.create.l HWIO_PMIC_ARB2_CHNL84_CONFIG_ADDR A:0x26a2004
y.create.l HWIO_PMIC_ARB2_CHNL85_CONFIG_ADDR A:0x26aa004
y.create.l HWIO_PMIC_ARB2_CHNL86_CONFIG_ADDR A:0x26b2004
y.create.l HWIO_PMIC_ARB2_CHNL87_CONFIG_ADDR A:0x26ba004
y.create.l HWIO_PMIC_ARB2_CHNL88_CONFIG_ADDR A:0x26c2004
y.create.l HWIO_PMIC_ARB2_CHNL89_CONFIG_ADDR A:0x26ca004
y.create.l HWIO_PMIC_ARB2_CHNL90_CONFIG_ADDR A:0x26d2004
y.create.l HWIO_PMIC_ARB2_CHNL91_CONFIG_ADDR A:0x26da004
y.create.l HWIO_PMIC_ARB2_CHNL92_CONFIG_ADDR A:0x26e2004
y.create.l HWIO_PMIC_ARB2_CHNL93_CONFIG_ADDR A:0x26ea004
y.create.l HWIO_PMIC_ARB2_CHNL94_CONFIG_ADDR A:0x26f2004
y.create.l HWIO_PMIC_ARB2_CHNL95_CONFIG_ADDR A:0x26fa004
y.create.l HWIO_PMIC_ARB2_CHNL96_CONFIG_ADDR A:0x2702004
y.create.l HWIO_PMIC_ARB2_CHNL97_CONFIG_ADDR A:0x270a004
y.create.l HWIO_PMIC_ARB2_CHNL98_CONFIG_ADDR A:0x2712004
y.create.l HWIO_PMIC_ARB2_CHNL99_CONFIG_ADDR A:0x271a004
y.create.l HWIO_PMIC_ARB2_CHNL100_CONFIG_ADDR A:0x2722004
y.create.l HWIO_PMIC_ARB2_CHNL101_CONFIG_ADDR A:0x272a004
y.create.l HWIO_PMIC_ARB2_CHNL102_CONFIG_ADDR A:0x2732004
y.create.l HWIO_PMIC_ARB2_CHNL103_CONFIG_ADDR A:0x273a004
y.create.l HWIO_PMIC_ARB2_CHNL104_CONFIG_ADDR A:0x2742004
y.create.l HWIO_PMIC_ARB2_CHNL105_CONFIG_ADDR A:0x274a004
y.create.l HWIO_PMIC_ARB2_CHNL106_CONFIG_ADDR A:0x2752004
y.create.l HWIO_PMIC_ARB2_CHNL107_CONFIG_ADDR A:0x275a004
y.create.l HWIO_PMIC_ARB2_CHNL108_CONFIG_ADDR A:0x2762004
y.create.l HWIO_PMIC_ARB2_CHNL109_CONFIG_ADDR A:0x276a004
y.create.l HWIO_PMIC_ARB2_CHNL110_CONFIG_ADDR A:0x2772004
y.create.l HWIO_PMIC_ARB2_CHNL111_CONFIG_ADDR A:0x277a004
y.create.l HWIO_PMIC_ARB2_CHNL112_CONFIG_ADDR A:0x2782004
y.create.l HWIO_PMIC_ARB2_CHNL113_CONFIG_ADDR A:0x278a004
y.create.l HWIO_PMIC_ARB2_CHNL114_CONFIG_ADDR A:0x2792004
y.create.l HWIO_PMIC_ARB2_CHNL115_CONFIG_ADDR A:0x279a004
y.create.l HWIO_PMIC_ARB2_CHNL116_CONFIG_ADDR A:0x27a2004
y.create.l HWIO_PMIC_ARB2_CHNL117_CONFIG_ADDR A:0x27aa004
y.create.l HWIO_PMIC_ARB2_CHNL118_CONFIG_ADDR A:0x27b2004
y.create.l HWIO_PMIC_ARB2_CHNL119_CONFIG_ADDR A:0x27ba004
y.create.l HWIO_PMIC_ARB2_CHNL120_CONFIG_ADDR A:0x27c2004
y.create.l HWIO_PMIC_ARB2_CHNL121_CONFIG_ADDR A:0x27ca004
y.create.l HWIO_PMIC_ARB2_CHNL122_CONFIG_ADDR A:0x27d2004
y.create.l HWIO_PMIC_ARB2_CHNL123_CONFIG_ADDR A:0x27da004
y.create.l HWIO_PMIC_ARB2_CHNL124_CONFIG_ADDR A:0x27e2004
y.create.l HWIO_PMIC_ARB2_CHNL125_CONFIG_ADDR A:0x27ea004
y.create.l HWIO_PMIC_ARB2_CHNL126_CONFIG_ADDR A:0x27f2004
y.create.l HWIO_PMIC_ARB2_CHNL127_CONFIG_ADDR A:0x27fa004
y.create.l HWIO_PMIC_ARB2_CHNL128_CONFIG_ADDR A:0x2802004
y.create.l HWIO_PMIC_ARB2_CHNL129_CONFIG_ADDR A:0x280a004
y.create.l HWIO_PMIC_ARB2_CHNL130_CONFIG_ADDR A:0x2812004
y.create.l HWIO_PMIC_ARB2_CHNL131_CONFIG_ADDR A:0x281a004
y.create.l HWIO_PMIC_ARB2_CHNL132_CONFIG_ADDR A:0x2822004
y.create.l HWIO_PMIC_ARB2_CHNL133_CONFIG_ADDR A:0x282a004
y.create.l HWIO_PMIC_ARB2_CHNL134_CONFIG_ADDR A:0x2832004
y.create.l HWIO_PMIC_ARB2_CHNL135_CONFIG_ADDR A:0x283a004
y.create.l HWIO_PMIC_ARB2_CHNL136_CONFIG_ADDR A:0x2842004
y.create.l HWIO_PMIC_ARB2_CHNL137_CONFIG_ADDR A:0x284a004
y.create.l HWIO_PMIC_ARB2_CHNL138_CONFIG_ADDR A:0x2852004
y.create.l HWIO_PMIC_ARB2_CHNL139_CONFIG_ADDR A:0x285a004
y.create.l HWIO_PMIC_ARB2_CHNL140_CONFIG_ADDR A:0x2862004
y.create.l HWIO_PMIC_ARB2_CHNL141_CONFIG_ADDR A:0x286a004
y.create.l HWIO_PMIC_ARB2_CHNL142_CONFIG_ADDR A:0x2872004
y.create.l HWIO_PMIC_ARB2_CHNL143_CONFIG_ADDR A:0x287a004
y.create.l HWIO_PMIC_ARB2_CHNL144_CONFIG_ADDR A:0x2882004
y.create.l HWIO_PMIC_ARB2_CHNL145_CONFIG_ADDR A:0x288a004
y.create.l HWIO_PMIC_ARB2_CHNL146_CONFIG_ADDR A:0x2892004
y.create.l HWIO_PMIC_ARB2_CHNL147_CONFIG_ADDR A:0x289a004
y.create.l HWIO_PMIC_ARB2_CHNL148_CONFIG_ADDR A:0x28a2004
y.create.l HWIO_PMIC_ARB2_CHNL149_CONFIG_ADDR A:0x28aa004
y.create.l HWIO_PMIC_ARB2_CHNL150_CONFIG_ADDR A:0x28b2004
y.create.l HWIO_PMIC_ARB2_CHNL151_CONFIG_ADDR A:0x28ba004
y.create.l HWIO_PMIC_ARB2_CHNL152_CONFIG_ADDR A:0x28c2004
y.create.l HWIO_PMIC_ARB2_CHNL153_CONFIG_ADDR A:0x28ca004
y.create.l HWIO_PMIC_ARB2_CHNL154_CONFIG_ADDR A:0x28d2004
y.create.l HWIO_PMIC_ARB2_CHNL155_CONFIG_ADDR A:0x28da004
y.create.l HWIO_PMIC_ARB2_CHNL156_CONFIG_ADDR A:0x28e2004
y.create.l HWIO_PMIC_ARB2_CHNL157_CONFIG_ADDR A:0x28ea004
y.create.l HWIO_PMIC_ARB2_CHNL158_CONFIG_ADDR A:0x28f2004
y.create.l HWIO_PMIC_ARB2_CHNL159_CONFIG_ADDR A:0x28fa004
y.create.l HWIO_PMIC_ARB2_CHNL160_CONFIG_ADDR A:0x2902004
y.create.l HWIO_PMIC_ARB2_CHNL161_CONFIG_ADDR A:0x290a004
y.create.l HWIO_PMIC_ARB2_CHNL162_CONFIG_ADDR A:0x2912004
y.create.l HWIO_PMIC_ARB2_CHNL163_CONFIG_ADDR A:0x291a004
y.create.l HWIO_PMIC_ARB2_CHNL164_CONFIG_ADDR A:0x2922004
y.create.l HWIO_PMIC_ARB2_CHNL165_CONFIG_ADDR A:0x292a004
y.create.l HWIO_PMIC_ARB2_CHNL166_CONFIG_ADDR A:0x2932004
y.create.l HWIO_PMIC_ARB2_CHNL167_CONFIG_ADDR A:0x293a004
y.create.l HWIO_PMIC_ARB2_CHNL168_CONFIG_ADDR A:0x2942004
y.create.l HWIO_PMIC_ARB2_CHNL169_CONFIG_ADDR A:0x294a004
y.create.l HWIO_PMIC_ARB2_CHNL170_CONFIG_ADDR A:0x2952004
y.create.l HWIO_PMIC_ARB2_CHNL171_CONFIG_ADDR A:0x295a004
y.create.l HWIO_PMIC_ARB2_CHNL172_CONFIG_ADDR A:0x2962004
y.create.l HWIO_PMIC_ARB2_CHNL173_CONFIG_ADDR A:0x296a004
y.create.l HWIO_PMIC_ARB2_CHNL174_CONFIG_ADDR A:0x2972004
y.create.l HWIO_PMIC_ARB2_CHNL175_CONFIG_ADDR A:0x297a004
y.create.l HWIO_PMIC_ARB2_CHNL176_CONFIG_ADDR A:0x2982004
y.create.l HWIO_PMIC_ARB2_CHNL177_CONFIG_ADDR A:0x298a004
y.create.l HWIO_PMIC_ARB2_CHNL178_CONFIG_ADDR A:0x2992004
y.create.l HWIO_PMIC_ARB2_CHNL179_CONFIG_ADDR A:0x299a004
y.create.l HWIO_PMIC_ARB2_CHNL180_CONFIG_ADDR A:0x29a2004
y.create.l HWIO_PMIC_ARB2_CHNL181_CONFIG_ADDR A:0x29aa004
y.create.l HWIO_PMIC_ARB2_CHNL182_CONFIG_ADDR A:0x29b2004
y.create.l HWIO_PMIC_ARB2_CHNL183_CONFIG_ADDR A:0x29ba004
y.create.l HWIO_PMIC_ARB2_CHNL184_CONFIG_ADDR A:0x29c2004
y.create.l HWIO_PMIC_ARB2_CHNL185_CONFIG_ADDR A:0x29ca004
y.create.l HWIO_PMIC_ARB2_CHNL186_CONFIG_ADDR A:0x29d2004
y.create.l HWIO_PMIC_ARB2_CHNL187_CONFIG_ADDR A:0x29da004
y.create.l HWIO_PMIC_ARB2_CHNL188_CONFIG_ADDR A:0x29e2004
y.create.l HWIO_PMIC_ARB2_CHNL189_CONFIG_ADDR A:0x29ea004
y.create.l HWIO_PMIC_ARB2_CHNL190_CONFIG_ADDR A:0x29f2004
y.create.l HWIO_PMIC_ARB2_CHNL191_CONFIG_ADDR A:0x29fa004
y.create.l HWIO_PMIC_ARB2_CHNL192_CONFIG_ADDR A:0x2a02004
y.create.l HWIO_PMIC_ARB2_CHNL193_CONFIG_ADDR A:0x2a0a004
y.create.l HWIO_PMIC_ARB2_CHNL194_CONFIG_ADDR A:0x2a12004
y.create.l HWIO_PMIC_ARB2_CHNL195_CONFIG_ADDR A:0x2a1a004
y.create.l HWIO_PMIC_ARB2_CHNL196_CONFIG_ADDR A:0x2a22004
y.create.l HWIO_PMIC_ARB2_CHNL197_CONFIG_ADDR A:0x2a2a004
y.create.l HWIO_PMIC_ARB2_CHNL198_CONFIG_ADDR A:0x2a32004
y.create.l HWIO_PMIC_ARB2_CHNL199_CONFIG_ADDR A:0x2a3a004
y.create.l HWIO_PMIC_ARB2_CHNL200_CONFIG_ADDR A:0x2a42004
y.create.l HWIO_PMIC_ARB2_CHNL201_CONFIG_ADDR A:0x2a4a004
y.create.l HWIO_PMIC_ARB2_CHNL202_CONFIG_ADDR A:0x2a52004
y.create.l HWIO_PMIC_ARB2_CHNL203_CONFIG_ADDR A:0x2a5a004
y.create.l HWIO_PMIC_ARB2_CHNL204_CONFIG_ADDR A:0x2a62004
y.create.l HWIO_PMIC_ARB2_CHNL205_CONFIG_ADDR A:0x2a6a004
y.create.l HWIO_PMIC_ARB2_CHNL206_CONFIG_ADDR A:0x2a72004
y.create.l HWIO_PMIC_ARB2_CHNL207_CONFIG_ADDR A:0x2a7a004
y.create.l HWIO_PMIC_ARB2_CHNL208_CONFIG_ADDR A:0x2a82004
y.create.l HWIO_PMIC_ARB2_CHNL209_CONFIG_ADDR A:0x2a8a004
y.create.l HWIO_PMIC_ARB2_CHNL210_CONFIG_ADDR A:0x2a92004
y.create.l HWIO_PMIC_ARB2_CHNL211_CONFIG_ADDR A:0x2a9a004
y.create.l HWIO_PMIC_ARB2_CHNL212_CONFIG_ADDR A:0x2aa2004
y.create.l HWIO_PMIC_ARB2_CHNL213_CONFIG_ADDR A:0x2aaa004
y.create.l HWIO_PMIC_ARB2_CHNL214_CONFIG_ADDR A:0x2ab2004
y.create.l HWIO_PMIC_ARB2_CHNL215_CONFIG_ADDR A:0x2aba004
y.create.l HWIO_PMIC_ARB2_CHNL216_CONFIG_ADDR A:0x2ac2004
y.create.l HWIO_PMIC_ARB2_CHNL217_CONFIG_ADDR A:0x2aca004
y.create.l HWIO_PMIC_ARB2_CHNL218_CONFIG_ADDR A:0x2ad2004
y.create.l HWIO_PMIC_ARB2_CHNL219_CONFIG_ADDR A:0x2ada004
y.create.l HWIO_PMIC_ARB2_CHNL220_CONFIG_ADDR A:0x2ae2004
y.create.l HWIO_PMIC_ARB2_CHNL221_CONFIG_ADDR A:0x2aea004
y.create.l HWIO_PMIC_ARB2_CHNL222_CONFIG_ADDR A:0x2af2004
y.create.l HWIO_PMIC_ARB2_CHNL223_CONFIG_ADDR A:0x2afa004
y.create.l HWIO_PMIC_ARB2_CHNL224_CONFIG_ADDR A:0x2b02004
y.create.l HWIO_PMIC_ARB2_CHNL225_CONFIG_ADDR A:0x2b0a004
y.create.l HWIO_PMIC_ARB2_CHNL226_CONFIG_ADDR A:0x2b12004
y.create.l HWIO_PMIC_ARB2_CHNL227_CONFIG_ADDR A:0x2b1a004
y.create.l HWIO_PMIC_ARB2_CHNL228_CONFIG_ADDR A:0x2b22004
y.create.l HWIO_PMIC_ARB2_CHNL229_CONFIG_ADDR A:0x2b2a004
y.create.l HWIO_PMIC_ARB2_CHNL230_CONFIG_ADDR A:0x2b32004
y.create.l HWIO_PMIC_ARB2_CHNL231_CONFIG_ADDR A:0x2b3a004
y.create.l HWIO_PMIC_ARB2_CHNL232_CONFIG_ADDR A:0x2b42004
y.create.l HWIO_PMIC_ARB2_CHNL233_CONFIG_ADDR A:0x2b4a004
y.create.l HWIO_PMIC_ARB2_CHNL234_CONFIG_ADDR A:0x2b52004
y.create.l HWIO_PMIC_ARB2_CHNL235_CONFIG_ADDR A:0x2b5a004
y.create.l HWIO_PMIC_ARB2_CHNL236_CONFIG_ADDR A:0x2b62004
y.create.l HWIO_PMIC_ARB2_CHNL237_CONFIG_ADDR A:0x2b6a004
y.create.l HWIO_PMIC_ARB2_CHNL238_CONFIG_ADDR A:0x2b72004
y.create.l HWIO_PMIC_ARB2_CHNL239_CONFIG_ADDR A:0x2b7a004
y.create.l HWIO_PMIC_ARB2_CHNL240_CONFIG_ADDR A:0x2b82004
y.create.l HWIO_PMIC_ARB2_CHNL241_CONFIG_ADDR A:0x2b8a004
y.create.l HWIO_PMIC_ARB2_CHNL242_CONFIG_ADDR A:0x2b92004
y.create.l HWIO_PMIC_ARB2_CHNL243_CONFIG_ADDR A:0x2b9a004
y.create.l HWIO_PMIC_ARB2_CHNL244_CONFIG_ADDR A:0x2ba2004
y.create.l HWIO_PMIC_ARB2_CHNL245_CONFIG_ADDR A:0x2baa004
y.create.l HWIO_PMIC_ARB2_CHNL246_CONFIG_ADDR A:0x2bb2004
y.create.l HWIO_PMIC_ARB2_CHNL247_CONFIG_ADDR A:0x2bba004
y.create.l HWIO_PMIC_ARB2_CHNL248_CONFIG_ADDR A:0x2bc2004
y.create.l HWIO_PMIC_ARB2_CHNL249_CONFIG_ADDR A:0x2bca004
y.create.l HWIO_PMIC_ARB2_CHNL250_CONFIG_ADDR A:0x2bd2004
y.create.l HWIO_PMIC_ARB2_CHNL251_CONFIG_ADDR A:0x2bda004
y.create.l HWIO_PMIC_ARB2_CHNL252_CONFIG_ADDR A:0x2be2004
y.create.l HWIO_PMIC_ARB2_CHNL253_CONFIG_ADDR A:0x2bea004
y.create.l HWIO_PMIC_ARB2_CHNL254_CONFIG_ADDR A:0x2bf2004
y.create.l HWIO_PMIC_ARB2_CHNL255_CONFIG_ADDR A:0x2bfa004
y.create.l HWIO_PMIC_ARB3_CHNL0_CONFIG_ADDR A:0x2403004
y.create.l HWIO_PMIC_ARB3_CHNL1_CONFIG_ADDR A:0x240b004
y.create.l HWIO_PMIC_ARB3_CHNL2_CONFIG_ADDR A:0x2413004
y.create.l HWIO_PMIC_ARB3_CHNL3_CONFIG_ADDR A:0x241b004
y.create.l HWIO_PMIC_ARB3_CHNL4_CONFIG_ADDR A:0x2423004
y.create.l HWIO_PMIC_ARB3_CHNL5_CONFIG_ADDR A:0x242b004
y.create.l HWIO_PMIC_ARB3_CHNL6_CONFIG_ADDR A:0x2433004
y.create.l HWIO_PMIC_ARB3_CHNL7_CONFIG_ADDR A:0x243b004
y.create.l HWIO_PMIC_ARB3_CHNL8_CONFIG_ADDR A:0x2443004
y.create.l HWIO_PMIC_ARB3_CHNL9_CONFIG_ADDR A:0x244b004
y.create.l HWIO_PMIC_ARB3_CHNL10_CONFIG_ADDR A:0x2453004
y.create.l HWIO_PMIC_ARB3_CHNL11_CONFIG_ADDR A:0x245b004
y.create.l HWIO_PMIC_ARB3_CHNL12_CONFIG_ADDR A:0x2463004
y.create.l HWIO_PMIC_ARB3_CHNL13_CONFIG_ADDR A:0x246b004
y.create.l HWIO_PMIC_ARB3_CHNL14_CONFIG_ADDR A:0x2473004
y.create.l HWIO_PMIC_ARB3_CHNL15_CONFIG_ADDR A:0x247b004
y.create.l HWIO_PMIC_ARB3_CHNL16_CONFIG_ADDR A:0x2483004
y.create.l HWIO_PMIC_ARB3_CHNL17_CONFIG_ADDR A:0x248b004
y.create.l HWIO_PMIC_ARB3_CHNL18_CONFIG_ADDR A:0x2493004
y.create.l HWIO_PMIC_ARB3_CHNL19_CONFIG_ADDR A:0x249b004
y.create.l HWIO_PMIC_ARB3_CHNL20_CONFIG_ADDR A:0x24a3004
y.create.l HWIO_PMIC_ARB3_CHNL21_CONFIG_ADDR A:0x24ab004
y.create.l HWIO_PMIC_ARB3_CHNL22_CONFIG_ADDR A:0x24b3004
y.create.l HWIO_PMIC_ARB3_CHNL23_CONFIG_ADDR A:0x24bb004
y.create.l HWIO_PMIC_ARB3_CHNL24_CONFIG_ADDR A:0x24c3004
y.create.l HWIO_PMIC_ARB3_CHNL25_CONFIG_ADDR A:0x24cb004
y.create.l HWIO_PMIC_ARB3_CHNL26_CONFIG_ADDR A:0x24d3004
y.create.l HWIO_PMIC_ARB3_CHNL27_CONFIG_ADDR A:0x24db004
y.create.l HWIO_PMIC_ARB3_CHNL28_CONFIG_ADDR A:0x24e3004
y.create.l HWIO_PMIC_ARB3_CHNL29_CONFIG_ADDR A:0x24eb004
y.create.l HWIO_PMIC_ARB3_CHNL30_CONFIG_ADDR A:0x24f3004
y.create.l HWIO_PMIC_ARB3_CHNL31_CONFIG_ADDR A:0x24fb004
y.create.l HWIO_PMIC_ARB3_CHNL32_CONFIG_ADDR A:0x2503004
y.create.l HWIO_PMIC_ARB3_CHNL33_CONFIG_ADDR A:0x250b004
y.create.l HWIO_PMIC_ARB3_CHNL34_CONFIG_ADDR A:0x2513004
y.create.l HWIO_PMIC_ARB3_CHNL35_CONFIG_ADDR A:0x251b004
y.create.l HWIO_PMIC_ARB3_CHNL36_CONFIG_ADDR A:0x2523004
y.create.l HWIO_PMIC_ARB3_CHNL37_CONFIG_ADDR A:0x252b004
y.create.l HWIO_PMIC_ARB3_CHNL38_CONFIG_ADDR A:0x2533004
y.create.l HWIO_PMIC_ARB3_CHNL39_CONFIG_ADDR A:0x253b004
y.create.l HWIO_PMIC_ARB3_CHNL40_CONFIG_ADDR A:0x2543004
y.create.l HWIO_PMIC_ARB3_CHNL41_CONFIG_ADDR A:0x254b004
y.create.l HWIO_PMIC_ARB3_CHNL42_CONFIG_ADDR A:0x2553004
y.create.l HWIO_PMIC_ARB3_CHNL43_CONFIG_ADDR A:0x255b004
y.create.l HWIO_PMIC_ARB3_CHNL44_CONFIG_ADDR A:0x2563004
y.create.l HWIO_PMIC_ARB3_CHNL45_CONFIG_ADDR A:0x256b004
y.create.l HWIO_PMIC_ARB3_CHNL46_CONFIG_ADDR A:0x2573004
y.create.l HWIO_PMIC_ARB3_CHNL47_CONFIG_ADDR A:0x257b004
y.create.l HWIO_PMIC_ARB3_CHNL48_CONFIG_ADDR A:0x2583004
y.create.l HWIO_PMIC_ARB3_CHNL49_CONFIG_ADDR A:0x258b004
y.create.l HWIO_PMIC_ARB3_CHNL50_CONFIG_ADDR A:0x2593004
y.create.l HWIO_PMIC_ARB3_CHNL51_CONFIG_ADDR A:0x259b004
y.create.l HWIO_PMIC_ARB3_CHNL52_CONFIG_ADDR A:0x25a3004
y.create.l HWIO_PMIC_ARB3_CHNL53_CONFIG_ADDR A:0x25ab004
y.create.l HWIO_PMIC_ARB3_CHNL54_CONFIG_ADDR A:0x25b3004
y.create.l HWIO_PMIC_ARB3_CHNL55_CONFIG_ADDR A:0x25bb004
y.create.l HWIO_PMIC_ARB3_CHNL56_CONFIG_ADDR A:0x25c3004
y.create.l HWIO_PMIC_ARB3_CHNL57_CONFIG_ADDR A:0x25cb004
y.create.l HWIO_PMIC_ARB3_CHNL58_CONFIG_ADDR A:0x25d3004
y.create.l HWIO_PMIC_ARB3_CHNL59_CONFIG_ADDR A:0x25db004
y.create.l HWIO_PMIC_ARB3_CHNL60_CONFIG_ADDR A:0x25e3004
y.create.l HWIO_PMIC_ARB3_CHNL61_CONFIG_ADDR A:0x25eb004
y.create.l HWIO_PMIC_ARB3_CHNL62_CONFIG_ADDR A:0x25f3004
y.create.l HWIO_PMIC_ARB3_CHNL63_CONFIG_ADDR A:0x25fb004
y.create.l HWIO_PMIC_ARB3_CHNL64_CONFIG_ADDR A:0x2603004
y.create.l HWIO_PMIC_ARB3_CHNL65_CONFIG_ADDR A:0x260b004
y.create.l HWIO_PMIC_ARB3_CHNL66_CONFIG_ADDR A:0x2613004
y.create.l HWIO_PMIC_ARB3_CHNL67_CONFIG_ADDR A:0x261b004
y.create.l HWIO_PMIC_ARB3_CHNL68_CONFIG_ADDR A:0x2623004
y.create.l HWIO_PMIC_ARB3_CHNL69_CONFIG_ADDR A:0x262b004
y.create.l HWIO_PMIC_ARB3_CHNL70_CONFIG_ADDR A:0x2633004
y.create.l HWIO_PMIC_ARB3_CHNL71_CONFIG_ADDR A:0x263b004
y.create.l HWIO_PMIC_ARB3_CHNL72_CONFIG_ADDR A:0x2643004
y.create.l HWIO_PMIC_ARB3_CHNL73_CONFIG_ADDR A:0x264b004
y.create.l HWIO_PMIC_ARB3_CHNL74_CONFIG_ADDR A:0x2653004
y.create.l HWIO_PMIC_ARB3_CHNL75_CONFIG_ADDR A:0x265b004
y.create.l HWIO_PMIC_ARB3_CHNL76_CONFIG_ADDR A:0x2663004
y.create.l HWIO_PMIC_ARB3_CHNL77_CONFIG_ADDR A:0x266b004
y.create.l HWIO_PMIC_ARB3_CHNL78_CONFIG_ADDR A:0x2673004
y.create.l HWIO_PMIC_ARB3_CHNL79_CONFIG_ADDR A:0x267b004
y.create.l HWIO_PMIC_ARB3_CHNL80_CONFIG_ADDR A:0x2683004
y.create.l HWIO_PMIC_ARB3_CHNL81_CONFIG_ADDR A:0x268b004
y.create.l HWIO_PMIC_ARB3_CHNL82_CONFIG_ADDR A:0x2693004
y.create.l HWIO_PMIC_ARB3_CHNL83_CONFIG_ADDR A:0x269b004
y.create.l HWIO_PMIC_ARB3_CHNL84_CONFIG_ADDR A:0x26a3004
y.create.l HWIO_PMIC_ARB3_CHNL85_CONFIG_ADDR A:0x26ab004
y.create.l HWIO_PMIC_ARB3_CHNL86_CONFIG_ADDR A:0x26b3004
y.create.l HWIO_PMIC_ARB3_CHNL87_CONFIG_ADDR A:0x26bb004
y.create.l HWIO_PMIC_ARB3_CHNL88_CONFIG_ADDR A:0x26c3004
y.create.l HWIO_PMIC_ARB3_CHNL89_CONFIG_ADDR A:0x26cb004
y.create.l HWIO_PMIC_ARB3_CHNL90_CONFIG_ADDR A:0x26d3004
y.create.l HWIO_PMIC_ARB3_CHNL91_CONFIG_ADDR A:0x26db004
y.create.l HWIO_PMIC_ARB3_CHNL92_CONFIG_ADDR A:0x26e3004
y.create.l HWIO_PMIC_ARB3_CHNL93_CONFIG_ADDR A:0x26eb004
y.create.l HWIO_PMIC_ARB3_CHNL94_CONFIG_ADDR A:0x26f3004
y.create.l HWIO_PMIC_ARB3_CHNL95_CONFIG_ADDR A:0x26fb004
y.create.l HWIO_PMIC_ARB3_CHNL96_CONFIG_ADDR A:0x2703004
y.create.l HWIO_PMIC_ARB3_CHNL97_CONFIG_ADDR A:0x270b004
y.create.l HWIO_PMIC_ARB3_CHNL98_CONFIG_ADDR A:0x2713004
y.create.l HWIO_PMIC_ARB3_CHNL99_CONFIG_ADDR A:0x271b004
y.create.l HWIO_PMIC_ARB3_CHNL100_CONFIG_ADDR A:0x2723004
y.create.l HWIO_PMIC_ARB3_CHNL101_CONFIG_ADDR A:0x272b004
y.create.l HWIO_PMIC_ARB3_CHNL102_CONFIG_ADDR A:0x2733004
y.create.l HWIO_PMIC_ARB3_CHNL103_CONFIG_ADDR A:0x273b004
y.create.l HWIO_PMIC_ARB3_CHNL104_CONFIG_ADDR A:0x2743004
y.create.l HWIO_PMIC_ARB3_CHNL105_CONFIG_ADDR A:0x274b004
y.create.l HWIO_PMIC_ARB3_CHNL106_CONFIG_ADDR A:0x2753004
y.create.l HWIO_PMIC_ARB3_CHNL107_CONFIG_ADDR A:0x275b004
y.create.l HWIO_PMIC_ARB3_CHNL108_CONFIG_ADDR A:0x2763004
y.create.l HWIO_PMIC_ARB3_CHNL109_CONFIG_ADDR A:0x276b004
y.create.l HWIO_PMIC_ARB3_CHNL110_CONFIG_ADDR A:0x2773004
y.create.l HWIO_PMIC_ARB3_CHNL111_CONFIG_ADDR A:0x277b004
y.create.l HWIO_PMIC_ARB3_CHNL112_CONFIG_ADDR A:0x2783004
y.create.l HWIO_PMIC_ARB3_CHNL113_CONFIG_ADDR A:0x278b004
y.create.l HWIO_PMIC_ARB3_CHNL114_CONFIG_ADDR A:0x2793004
y.create.l HWIO_PMIC_ARB3_CHNL115_CONFIG_ADDR A:0x279b004
y.create.l HWIO_PMIC_ARB3_CHNL116_CONFIG_ADDR A:0x27a3004
y.create.l HWIO_PMIC_ARB3_CHNL117_CONFIG_ADDR A:0x27ab004
y.create.l HWIO_PMIC_ARB3_CHNL118_CONFIG_ADDR A:0x27b3004
y.create.l HWIO_PMIC_ARB3_CHNL119_CONFIG_ADDR A:0x27bb004
y.create.l HWIO_PMIC_ARB3_CHNL120_CONFIG_ADDR A:0x27c3004
y.create.l HWIO_PMIC_ARB3_CHNL121_CONFIG_ADDR A:0x27cb004
y.create.l HWIO_PMIC_ARB3_CHNL122_CONFIG_ADDR A:0x27d3004
y.create.l HWIO_PMIC_ARB3_CHNL123_CONFIG_ADDR A:0x27db004
y.create.l HWIO_PMIC_ARB3_CHNL124_CONFIG_ADDR A:0x27e3004
y.create.l HWIO_PMIC_ARB3_CHNL125_CONFIG_ADDR A:0x27eb004
y.create.l HWIO_PMIC_ARB3_CHNL126_CONFIG_ADDR A:0x27f3004
y.create.l HWIO_PMIC_ARB3_CHNL127_CONFIG_ADDR A:0x27fb004
y.create.l HWIO_PMIC_ARB3_CHNL128_CONFIG_ADDR A:0x2803004
y.create.l HWIO_PMIC_ARB3_CHNL129_CONFIG_ADDR A:0x280b004
y.create.l HWIO_PMIC_ARB3_CHNL130_CONFIG_ADDR A:0x2813004
y.create.l HWIO_PMIC_ARB3_CHNL131_CONFIG_ADDR A:0x281b004
y.create.l HWIO_PMIC_ARB3_CHNL132_CONFIG_ADDR A:0x2823004
y.create.l HWIO_PMIC_ARB3_CHNL133_CONFIG_ADDR A:0x282b004
y.create.l HWIO_PMIC_ARB3_CHNL134_CONFIG_ADDR A:0x2833004
y.create.l HWIO_PMIC_ARB3_CHNL135_CONFIG_ADDR A:0x283b004
y.create.l HWIO_PMIC_ARB3_CHNL136_CONFIG_ADDR A:0x2843004
y.create.l HWIO_PMIC_ARB3_CHNL137_CONFIG_ADDR A:0x284b004
y.create.l HWIO_PMIC_ARB3_CHNL138_CONFIG_ADDR A:0x2853004
y.create.l HWIO_PMIC_ARB3_CHNL139_CONFIG_ADDR A:0x285b004
y.create.l HWIO_PMIC_ARB3_CHNL140_CONFIG_ADDR A:0x2863004
y.create.l HWIO_PMIC_ARB3_CHNL141_CONFIG_ADDR A:0x286b004
y.create.l HWIO_PMIC_ARB3_CHNL142_CONFIG_ADDR A:0x2873004
y.create.l HWIO_PMIC_ARB3_CHNL143_CONFIG_ADDR A:0x287b004
y.create.l HWIO_PMIC_ARB3_CHNL144_CONFIG_ADDR A:0x2883004
y.create.l HWIO_PMIC_ARB3_CHNL145_CONFIG_ADDR A:0x288b004
y.create.l HWIO_PMIC_ARB3_CHNL146_CONFIG_ADDR A:0x2893004
y.create.l HWIO_PMIC_ARB3_CHNL147_CONFIG_ADDR A:0x289b004
y.create.l HWIO_PMIC_ARB3_CHNL148_CONFIG_ADDR A:0x28a3004
y.create.l HWIO_PMIC_ARB3_CHNL149_CONFIG_ADDR A:0x28ab004
y.create.l HWIO_PMIC_ARB3_CHNL150_CONFIG_ADDR A:0x28b3004
y.create.l HWIO_PMIC_ARB3_CHNL151_CONFIG_ADDR A:0x28bb004
y.create.l HWIO_PMIC_ARB3_CHNL152_CONFIG_ADDR A:0x28c3004
y.create.l HWIO_PMIC_ARB3_CHNL153_CONFIG_ADDR A:0x28cb004
y.create.l HWIO_PMIC_ARB3_CHNL154_CONFIG_ADDR A:0x28d3004
y.create.l HWIO_PMIC_ARB3_CHNL155_CONFIG_ADDR A:0x28db004
y.create.l HWIO_PMIC_ARB3_CHNL156_CONFIG_ADDR A:0x28e3004
y.create.l HWIO_PMIC_ARB3_CHNL157_CONFIG_ADDR A:0x28eb004
y.create.l HWIO_PMIC_ARB3_CHNL158_CONFIG_ADDR A:0x28f3004
y.create.l HWIO_PMIC_ARB3_CHNL159_CONFIG_ADDR A:0x28fb004
y.create.l HWIO_PMIC_ARB3_CHNL160_CONFIG_ADDR A:0x2903004
y.create.l HWIO_PMIC_ARB3_CHNL161_CONFIG_ADDR A:0x290b004
y.create.l HWIO_PMIC_ARB3_CHNL162_CONFIG_ADDR A:0x2913004
y.create.l HWIO_PMIC_ARB3_CHNL163_CONFIG_ADDR A:0x291b004
y.create.l HWIO_PMIC_ARB3_CHNL164_CONFIG_ADDR A:0x2923004
y.create.l HWIO_PMIC_ARB3_CHNL165_CONFIG_ADDR A:0x292b004
y.create.l HWIO_PMIC_ARB3_CHNL166_CONFIG_ADDR A:0x2933004
y.create.l HWIO_PMIC_ARB3_CHNL167_CONFIG_ADDR A:0x293b004
y.create.l HWIO_PMIC_ARB3_CHNL168_CONFIG_ADDR A:0x2943004
y.create.l HWIO_PMIC_ARB3_CHNL169_CONFIG_ADDR A:0x294b004
y.create.l HWIO_PMIC_ARB3_CHNL170_CONFIG_ADDR A:0x2953004
y.create.l HWIO_PMIC_ARB3_CHNL171_CONFIG_ADDR A:0x295b004
y.create.l HWIO_PMIC_ARB3_CHNL172_CONFIG_ADDR A:0x2963004
y.create.l HWIO_PMIC_ARB3_CHNL173_CONFIG_ADDR A:0x296b004
y.create.l HWIO_PMIC_ARB3_CHNL174_CONFIG_ADDR A:0x2973004
y.create.l HWIO_PMIC_ARB3_CHNL175_CONFIG_ADDR A:0x297b004
y.create.l HWIO_PMIC_ARB3_CHNL176_CONFIG_ADDR A:0x2983004
y.create.l HWIO_PMIC_ARB3_CHNL177_CONFIG_ADDR A:0x298b004
y.create.l HWIO_PMIC_ARB3_CHNL178_CONFIG_ADDR A:0x2993004
y.create.l HWIO_PMIC_ARB3_CHNL179_CONFIG_ADDR A:0x299b004
y.create.l HWIO_PMIC_ARB3_CHNL180_CONFIG_ADDR A:0x29a3004
y.create.l HWIO_PMIC_ARB3_CHNL181_CONFIG_ADDR A:0x29ab004
y.create.l HWIO_PMIC_ARB3_CHNL182_CONFIG_ADDR A:0x29b3004
y.create.l HWIO_PMIC_ARB3_CHNL183_CONFIG_ADDR A:0x29bb004
y.create.l HWIO_PMIC_ARB3_CHNL184_CONFIG_ADDR A:0x29c3004
y.create.l HWIO_PMIC_ARB3_CHNL185_CONFIG_ADDR A:0x29cb004
y.create.l HWIO_PMIC_ARB3_CHNL186_CONFIG_ADDR A:0x29d3004
y.create.l HWIO_PMIC_ARB3_CHNL187_CONFIG_ADDR A:0x29db004
y.create.l HWIO_PMIC_ARB3_CHNL188_CONFIG_ADDR A:0x29e3004
y.create.l HWIO_PMIC_ARB3_CHNL189_CONFIG_ADDR A:0x29eb004
y.create.l HWIO_PMIC_ARB3_CHNL190_CONFIG_ADDR A:0x29f3004
y.create.l HWIO_PMIC_ARB3_CHNL191_CONFIG_ADDR A:0x29fb004
y.create.l HWIO_PMIC_ARB3_CHNL192_CONFIG_ADDR A:0x2a03004
y.create.l HWIO_PMIC_ARB3_CHNL193_CONFIG_ADDR A:0x2a0b004
y.create.l HWIO_PMIC_ARB3_CHNL194_CONFIG_ADDR A:0x2a13004
y.create.l HWIO_PMIC_ARB3_CHNL195_CONFIG_ADDR A:0x2a1b004
y.create.l HWIO_PMIC_ARB3_CHNL196_CONFIG_ADDR A:0x2a23004
y.create.l HWIO_PMIC_ARB3_CHNL197_CONFIG_ADDR A:0x2a2b004
y.create.l HWIO_PMIC_ARB3_CHNL198_CONFIG_ADDR A:0x2a33004
y.create.l HWIO_PMIC_ARB3_CHNL199_CONFIG_ADDR A:0x2a3b004
y.create.l HWIO_PMIC_ARB3_CHNL200_CONFIG_ADDR A:0x2a43004
y.create.l HWIO_PMIC_ARB3_CHNL201_CONFIG_ADDR A:0x2a4b004
y.create.l HWIO_PMIC_ARB3_CHNL202_CONFIG_ADDR A:0x2a53004
y.create.l HWIO_PMIC_ARB3_CHNL203_CONFIG_ADDR A:0x2a5b004
y.create.l HWIO_PMIC_ARB3_CHNL204_CONFIG_ADDR A:0x2a63004
y.create.l HWIO_PMIC_ARB3_CHNL205_CONFIG_ADDR A:0x2a6b004
y.create.l HWIO_PMIC_ARB3_CHNL206_CONFIG_ADDR A:0x2a73004
y.create.l HWIO_PMIC_ARB3_CHNL207_CONFIG_ADDR A:0x2a7b004
y.create.l HWIO_PMIC_ARB3_CHNL208_CONFIG_ADDR A:0x2a83004
y.create.l HWIO_PMIC_ARB3_CHNL209_CONFIG_ADDR A:0x2a8b004
y.create.l HWIO_PMIC_ARB3_CHNL210_CONFIG_ADDR A:0x2a93004
y.create.l HWIO_PMIC_ARB3_CHNL211_CONFIG_ADDR A:0x2a9b004
y.create.l HWIO_PMIC_ARB3_CHNL212_CONFIG_ADDR A:0x2aa3004
y.create.l HWIO_PMIC_ARB3_CHNL213_CONFIG_ADDR A:0x2aab004
y.create.l HWIO_PMIC_ARB3_CHNL214_CONFIG_ADDR A:0x2ab3004
y.create.l HWIO_PMIC_ARB3_CHNL215_CONFIG_ADDR A:0x2abb004
y.create.l HWIO_PMIC_ARB3_CHNL216_CONFIG_ADDR A:0x2ac3004
y.create.l HWIO_PMIC_ARB3_CHNL217_CONFIG_ADDR A:0x2acb004
y.create.l HWIO_PMIC_ARB3_CHNL218_CONFIG_ADDR A:0x2ad3004
y.create.l HWIO_PMIC_ARB3_CHNL219_CONFIG_ADDR A:0x2adb004
y.create.l HWIO_PMIC_ARB3_CHNL220_CONFIG_ADDR A:0x2ae3004
y.create.l HWIO_PMIC_ARB3_CHNL221_CONFIG_ADDR A:0x2aeb004
y.create.l HWIO_PMIC_ARB3_CHNL222_CONFIG_ADDR A:0x2af3004
y.create.l HWIO_PMIC_ARB3_CHNL223_CONFIG_ADDR A:0x2afb004
y.create.l HWIO_PMIC_ARB3_CHNL224_CONFIG_ADDR A:0x2b03004
y.create.l HWIO_PMIC_ARB3_CHNL225_CONFIG_ADDR A:0x2b0b004
y.create.l HWIO_PMIC_ARB3_CHNL226_CONFIG_ADDR A:0x2b13004
y.create.l HWIO_PMIC_ARB3_CHNL227_CONFIG_ADDR A:0x2b1b004
y.create.l HWIO_PMIC_ARB3_CHNL228_CONFIG_ADDR A:0x2b23004
y.create.l HWIO_PMIC_ARB3_CHNL229_CONFIG_ADDR A:0x2b2b004
y.create.l HWIO_PMIC_ARB3_CHNL230_CONFIG_ADDR A:0x2b33004
y.create.l HWIO_PMIC_ARB3_CHNL231_CONFIG_ADDR A:0x2b3b004
y.create.l HWIO_PMIC_ARB3_CHNL232_CONFIG_ADDR A:0x2b43004
y.create.l HWIO_PMIC_ARB3_CHNL233_CONFIG_ADDR A:0x2b4b004
y.create.l HWIO_PMIC_ARB3_CHNL234_CONFIG_ADDR A:0x2b53004
y.create.l HWIO_PMIC_ARB3_CHNL235_CONFIG_ADDR A:0x2b5b004
y.create.l HWIO_PMIC_ARB3_CHNL236_CONFIG_ADDR A:0x2b63004
y.create.l HWIO_PMIC_ARB3_CHNL237_CONFIG_ADDR A:0x2b6b004
y.create.l HWIO_PMIC_ARB3_CHNL238_CONFIG_ADDR A:0x2b73004
y.create.l HWIO_PMIC_ARB3_CHNL239_CONFIG_ADDR A:0x2b7b004
y.create.l HWIO_PMIC_ARB3_CHNL240_CONFIG_ADDR A:0x2b83004
y.create.l HWIO_PMIC_ARB3_CHNL241_CONFIG_ADDR A:0x2b8b004
y.create.l HWIO_PMIC_ARB3_CHNL242_CONFIG_ADDR A:0x2b93004
y.create.l HWIO_PMIC_ARB3_CHNL243_CONFIG_ADDR A:0x2b9b004
y.create.l HWIO_PMIC_ARB3_CHNL244_CONFIG_ADDR A:0x2ba3004
y.create.l HWIO_PMIC_ARB3_CHNL245_CONFIG_ADDR A:0x2bab004
y.create.l HWIO_PMIC_ARB3_CHNL246_CONFIG_ADDR A:0x2bb3004
y.create.l HWIO_PMIC_ARB3_CHNL247_CONFIG_ADDR A:0x2bbb004
y.create.l HWIO_PMIC_ARB3_CHNL248_CONFIG_ADDR A:0x2bc3004
y.create.l HWIO_PMIC_ARB3_CHNL249_CONFIG_ADDR A:0x2bcb004
y.create.l HWIO_PMIC_ARB3_CHNL250_CONFIG_ADDR A:0x2bd3004
y.create.l HWIO_PMIC_ARB3_CHNL251_CONFIG_ADDR A:0x2bdb004
y.create.l HWIO_PMIC_ARB3_CHNL252_CONFIG_ADDR A:0x2be3004
y.create.l HWIO_PMIC_ARB3_CHNL253_CONFIG_ADDR A:0x2beb004
y.create.l HWIO_PMIC_ARB3_CHNL254_CONFIG_ADDR A:0x2bf3004
y.create.l HWIO_PMIC_ARB3_CHNL255_CONFIG_ADDR A:0x2bfb004
y.create.l HWIO_PMIC_ARB4_CHNL0_CONFIG_ADDR A:0x2404004
y.create.l HWIO_PMIC_ARB4_CHNL1_CONFIG_ADDR A:0x240c004
y.create.l HWIO_PMIC_ARB4_CHNL2_CONFIG_ADDR A:0x2414004
y.create.l HWIO_PMIC_ARB4_CHNL3_CONFIG_ADDR A:0x241c004
y.create.l HWIO_PMIC_ARB4_CHNL4_CONFIG_ADDR A:0x2424004
y.create.l HWIO_PMIC_ARB4_CHNL5_CONFIG_ADDR A:0x242c004
y.create.l HWIO_PMIC_ARB4_CHNL6_CONFIG_ADDR A:0x2434004
y.create.l HWIO_PMIC_ARB4_CHNL7_CONFIG_ADDR A:0x243c004
y.create.l HWIO_PMIC_ARB4_CHNL8_CONFIG_ADDR A:0x2444004
y.create.l HWIO_PMIC_ARB4_CHNL9_CONFIG_ADDR A:0x244c004
y.create.l HWIO_PMIC_ARB4_CHNL10_CONFIG_ADDR A:0x2454004
y.create.l HWIO_PMIC_ARB4_CHNL11_CONFIG_ADDR A:0x245c004
y.create.l HWIO_PMIC_ARB4_CHNL12_CONFIG_ADDR A:0x2464004
y.create.l HWIO_PMIC_ARB4_CHNL13_CONFIG_ADDR A:0x246c004
y.create.l HWIO_PMIC_ARB4_CHNL14_CONFIG_ADDR A:0x2474004
y.create.l HWIO_PMIC_ARB4_CHNL15_CONFIG_ADDR A:0x247c004
y.create.l HWIO_PMIC_ARB4_CHNL16_CONFIG_ADDR A:0x2484004
y.create.l HWIO_PMIC_ARB4_CHNL17_CONFIG_ADDR A:0x248c004
y.create.l HWIO_PMIC_ARB4_CHNL18_CONFIG_ADDR A:0x2494004
y.create.l HWIO_PMIC_ARB4_CHNL19_CONFIG_ADDR A:0x249c004
y.create.l HWIO_PMIC_ARB4_CHNL20_CONFIG_ADDR A:0x24a4004
y.create.l HWIO_PMIC_ARB4_CHNL21_CONFIG_ADDR A:0x24ac004
y.create.l HWIO_PMIC_ARB4_CHNL22_CONFIG_ADDR A:0x24b4004
y.create.l HWIO_PMIC_ARB4_CHNL23_CONFIG_ADDR A:0x24bc004
y.create.l HWIO_PMIC_ARB4_CHNL24_CONFIG_ADDR A:0x24c4004
y.create.l HWIO_PMIC_ARB4_CHNL25_CONFIG_ADDR A:0x24cc004
y.create.l HWIO_PMIC_ARB4_CHNL26_CONFIG_ADDR A:0x24d4004
y.create.l HWIO_PMIC_ARB4_CHNL27_CONFIG_ADDR A:0x24dc004
y.create.l HWIO_PMIC_ARB4_CHNL28_CONFIG_ADDR A:0x24e4004
y.create.l HWIO_PMIC_ARB4_CHNL29_CONFIG_ADDR A:0x24ec004
y.create.l HWIO_PMIC_ARB4_CHNL30_CONFIG_ADDR A:0x24f4004
y.create.l HWIO_PMIC_ARB4_CHNL31_CONFIG_ADDR A:0x24fc004
y.create.l HWIO_PMIC_ARB4_CHNL32_CONFIG_ADDR A:0x2504004
y.create.l HWIO_PMIC_ARB4_CHNL33_CONFIG_ADDR A:0x250c004
y.create.l HWIO_PMIC_ARB4_CHNL34_CONFIG_ADDR A:0x2514004
y.create.l HWIO_PMIC_ARB4_CHNL35_CONFIG_ADDR A:0x251c004
y.create.l HWIO_PMIC_ARB4_CHNL36_CONFIG_ADDR A:0x2524004
y.create.l HWIO_PMIC_ARB4_CHNL37_CONFIG_ADDR A:0x252c004
y.create.l HWIO_PMIC_ARB4_CHNL38_CONFIG_ADDR A:0x2534004
y.create.l HWIO_PMIC_ARB4_CHNL39_CONFIG_ADDR A:0x253c004
y.create.l HWIO_PMIC_ARB4_CHNL40_CONFIG_ADDR A:0x2544004
y.create.l HWIO_PMIC_ARB4_CHNL41_CONFIG_ADDR A:0x254c004
y.create.l HWIO_PMIC_ARB4_CHNL42_CONFIG_ADDR A:0x2554004
y.create.l HWIO_PMIC_ARB4_CHNL43_CONFIG_ADDR A:0x255c004
y.create.l HWIO_PMIC_ARB4_CHNL44_CONFIG_ADDR A:0x2564004
y.create.l HWIO_PMIC_ARB4_CHNL45_CONFIG_ADDR A:0x256c004
y.create.l HWIO_PMIC_ARB4_CHNL46_CONFIG_ADDR A:0x2574004
y.create.l HWIO_PMIC_ARB4_CHNL47_CONFIG_ADDR A:0x257c004
y.create.l HWIO_PMIC_ARB4_CHNL48_CONFIG_ADDR A:0x2584004
y.create.l HWIO_PMIC_ARB4_CHNL49_CONFIG_ADDR A:0x258c004
y.create.l HWIO_PMIC_ARB4_CHNL50_CONFIG_ADDR A:0x2594004
y.create.l HWIO_PMIC_ARB4_CHNL51_CONFIG_ADDR A:0x259c004
y.create.l HWIO_PMIC_ARB4_CHNL52_CONFIG_ADDR A:0x25a4004
y.create.l HWIO_PMIC_ARB4_CHNL53_CONFIG_ADDR A:0x25ac004
y.create.l HWIO_PMIC_ARB4_CHNL54_CONFIG_ADDR A:0x25b4004
y.create.l HWIO_PMIC_ARB4_CHNL55_CONFIG_ADDR A:0x25bc004
y.create.l HWIO_PMIC_ARB4_CHNL56_CONFIG_ADDR A:0x25c4004
y.create.l HWIO_PMIC_ARB4_CHNL57_CONFIG_ADDR A:0x25cc004
y.create.l HWIO_PMIC_ARB4_CHNL58_CONFIG_ADDR A:0x25d4004
y.create.l HWIO_PMIC_ARB4_CHNL59_CONFIG_ADDR A:0x25dc004
y.create.l HWIO_PMIC_ARB4_CHNL60_CONFIG_ADDR A:0x25e4004
y.create.l HWIO_PMIC_ARB4_CHNL61_CONFIG_ADDR A:0x25ec004
y.create.l HWIO_PMIC_ARB4_CHNL62_CONFIG_ADDR A:0x25f4004
y.create.l HWIO_PMIC_ARB4_CHNL63_CONFIG_ADDR A:0x25fc004
y.create.l HWIO_PMIC_ARB4_CHNL64_CONFIG_ADDR A:0x2604004
y.create.l HWIO_PMIC_ARB4_CHNL65_CONFIG_ADDR A:0x260c004
y.create.l HWIO_PMIC_ARB4_CHNL66_CONFIG_ADDR A:0x2614004
y.create.l HWIO_PMIC_ARB4_CHNL67_CONFIG_ADDR A:0x261c004
y.create.l HWIO_PMIC_ARB4_CHNL68_CONFIG_ADDR A:0x2624004
y.create.l HWIO_PMIC_ARB4_CHNL69_CONFIG_ADDR A:0x262c004
y.create.l HWIO_PMIC_ARB4_CHNL70_CONFIG_ADDR A:0x2634004
y.create.l HWIO_PMIC_ARB4_CHNL71_CONFIG_ADDR A:0x263c004
y.create.l HWIO_PMIC_ARB4_CHNL72_CONFIG_ADDR A:0x2644004
y.create.l HWIO_PMIC_ARB4_CHNL73_CONFIG_ADDR A:0x264c004
y.create.l HWIO_PMIC_ARB4_CHNL74_CONFIG_ADDR A:0x2654004
y.create.l HWIO_PMIC_ARB4_CHNL75_CONFIG_ADDR A:0x265c004
y.create.l HWIO_PMIC_ARB4_CHNL76_CONFIG_ADDR A:0x2664004
y.create.l HWIO_PMIC_ARB4_CHNL77_CONFIG_ADDR A:0x266c004
y.create.l HWIO_PMIC_ARB4_CHNL78_CONFIG_ADDR A:0x2674004
y.create.l HWIO_PMIC_ARB4_CHNL79_CONFIG_ADDR A:0x267c004
y.create.l HWIO_PMIC_ARB4_CHNL80_CONFIG_ADDR A:0x2684004
y.create.l HWIO_PMIC_ARB4_CHNL81_CONFIG_ADDR A:0x268c004
y.create.l HWIO_PMIC_ARB4_CHNL82_CONFIG_ADDR A:0x2694004
y.create.l HWIO_PMIC_ARB4_CHNL83_CONFIG_ADDR A:0x269c004
y.create.l HWIO_PMIC_ARB4_CHNL84_CONFIG_ADDR A:0x26a4004
y.create.l HWIO_PMIC_ARB4_CHNL85_CONFIG_ADDR A:0x26ac004
y.create.l HWIO_PMIC_ARB4_CHNL86_CONFIG_ADDR A:0x26b4004
y.create.l HWIO_PMIC_ARB4_CHNL87_CONFIG_ADDR A:0x26bc004
y.create.l HWIO_PMIC_ARB4_CHNL88_CONFIG_ADDR A:0x26c4004
y.create.l HWIO_PMIC_ARB4_CHNL89_CONFIG_ADDR A:0x26cc004
y.create.l HWIO_PMIC_ARB4_CHNL90_CONFIG_ADDR A:0x26d4004
y.create.l HWIO_PMIC_ARB4_CHNL91_CONFIG_ADDR A:0x26dc004
y.create.l HWIO_PMIC_ARB4_CHNL92_CONFIG_ADDR A:0x26e4004
y.create.l HWIO_PMIC_ARB4_CHNL93_CONFIG_ADDR A:0x26ec004
y.create.l HWIO_PMIC_ARB4_CHNL94_CONFIG_ADDR A:0x26f4004
y.create.l HWIO_PMIC_ARB4_CHNL95_CONFIG_ADDR A:0x26fc004
y.create.l HWIO_PMIC_ARB4_CHNL96_CONFIG_ADDR A:0x2704004
y.create.l HWIO_PMIC_ARB4_CHNL97_CONFIG_ADDR A:0x270c004
y.create.l HWIO_PMIC_ARB4_CHNL98_CONFIG_ADDR A:0x2714004
y.create.l HWIO_PMIC_ARB4_CHNL99_CONFIG_ADDR A:0x271c004
y.create.l HWIO_PMIC_ARB4_CHNL100_CONFIG_ADDR A:0x2724004
y.create.l HWIO_PMIC_ARB4_CHNL101_CONFIG_ADDR A:0x272c004
y.create.l HWIO_PMIC_ARB4_CHNL102_CONFIG_ADDR A:0x2734004
y.create.l HWIO_PMIC_ARB4_CHNL103_CONFIG_ADDR A:0x273c004
y.create.l HWIO_PMIC_ARB4_CHNL104_CONFIG_ADDR A:0x2744004
y.create.l HWIO_PMIC_ARB4_CHNL105_CONFIG_ADDR A:0x274c004
y.create.l HWIO_PMIC_ARB4_CHNL106_CONFIG_ADDR A:0x2754004
y.create.l HWIO_PMIC_ARB4_CHNL107_CONFIG_ADDR A:0x275c004
y.create.l HWIO_PMIC_ARB4_CHNL108_CONFIG_ADDR A:0x2764004
y.create.l HWIO_PMIC_ARB4_CHNL109_CONFIG_ADDR A:0x276c004
y.create.l HWIO_PMIC_ARB4_CHNL110_CONFIG_ADDR A:0x2774004
y.create.l HWIO_PMIC_ARB4_CHNL111_CONFIG_ADDR A:0x277c004
y.create.l HWIO_PMIC_ARB4_CHNL112_CONFIG_ADDR A:0x2784004
y.create.l HWIO_PMIC_ARB4_CHNL113_CONFIG_ADDR A:0x278c004
y.create.l HWIO_PMIC_ARB4_CHNL114_CONFIG_ADDR A:0x2794004
y.create.l HWIO_PMIC_ARB4_CHNL115_CONFIG_ADDR A:0x279c004
y.create.l HWIO_PMIC_ARB4_CHNL116_CONFIG_ADDR A:0x27a4004
y.create.l HWIO_PMIC_ARB4_CHNL117_CONFIG_ADDR A:0x27ac004
y.create.l HWIO_PMIC_ARB4_CHNL118_CONFIG_ADDR A:0x27b4004
y.create.l HWIO_PMIC_ARB4_CHNL119_CONFIG_ADDR A:0x27bc004
y.create.l HWIO_PMIC_ARB4_CHNL120_CONFIG_ADDR A:0x27c4004
y.create.l HWIO_PMIC_ARB4_CHNL121_CONFIG_ADDR A:0x27cc004
y.create.l HWIO_PMIC_ARB4_CHNL122_CONFIG_ADDR A:0x27d4004
y.create.l HWIO_PMIC_ARB4_CHNL123_CONFIG_ADDR A:0x27dc004
y.create.l HWIO_PMIC_ARB4_CHNL124_CONFIG_ADDR A:0x27e4004
y.create.l HWIO_PMIC_ARB4_CHNL125_CONFIG_ADDR A:0x27ec004
y.create.l HWIO_PMIC_ARB4_CHNL126_CONFIG_ADDR A:0x27f4004
y.create.l HWIO_PMIC_ARB4_CHNL127_CONFIG_ADDR A:0x27fc004
y.create.l HWIO_PMIC_ARB4_CHNL128_CONFIG_ADDR A:0x2804004
y.create.l HWIO_PMIC_ARB4_CHNL129_CONFIG_ADDR A:0x280c004
y.create.l HWIO_PMIC_ARB4_CHNL130_CONFIG_ADDR A:0x2814004
y.create.l HWIO_PMIC_ARB4_CHNL131_CONFIG_ADDR A:0x281c004
y.create.l HWIO_PMIC_ARB4_CHNL132_CONFIG_ADDR A:0x2824004
y.create.l HWIO_PMIC_ARB4_CHNL133_CONFIG_ADDR A:0x282c004
y.create.l HWIO_PMIC_ARB4_CHNL134_CONFIG_ADDR A:0x2834004
y.create.l HWIO_PMIC_ARB4_CHNL135_CONFIG_ADDR A:0x283c004
y.create.l HWIO_PMIC_ARB4_CHNL136_CONFIG_ADDR A:0x2844004
y.create.l HWIO_PMIC_ARB4_CHNL137_CONFIG_ADDR A:0x284c004
y.create.l HWIO_PMIC_ARB4_CHNL138_CONFIG_ADDR A:0x2854004
y.create.l HWIO_PMIC_ARB4_CHNL139_CONFIG_ADDR A:0x285c004
y.create.l HWIO_PMIC_ARB4_CHNL140_CONFIG_ADDR A:0x2864004
y.create.l HWIO_PMIC_ARB4_CHNL141_CONFIG_ADDR A:0x286c004
y.create.l HWIO_PMIC_ARB4_CHNL142_CONFIG_ADDR A:0x2874004
y.create.l HWIO_PMIC_ARB4_CHNL143_CONFIG_ADDR A:0x287c004
y.create.l HWIO_PMIC_ARB4_CHNL144_CONFIG_ADDR A:0x2884004
y.create.l HWIO_PMIC_ARB4_CHNL145_CONFIG_ADDR A:0x288c004
y.create.l HWIO_PMIC_ARB4_CHNL146_CONFIG_ADDR A:0x2894004
y.create.l HWIO_PMIC_ARB4_CHNL147_CONFIG_ADDR A:0x289c004
y.create.l HWIO_PMIC_ARB4_CHNL148_CONFIG_ADDR A:0x28a4004
y.create.l HWIO_PMIC_ARB4_CHNL149_CONFIG_ADDR A:0x28ac004
y.create.l HWIO_PMIC_ARB4_CHNL150_CONFIG_ADDR A:0x28b4004
y.create.l HWIO_PMIC_ARB4_CHNL151_CONFIG_ADDR A:0x28bc004
y.create.l HWIO_PMIC_ARB4_CHNL152_CONFIG_ADDR A:0x28c4004
y.create.l HWIO_PMIC_ARB4_CHNL153_CONFIG_ADDR A:0x28cc004
y.create.l HWIO_PMIC_ARB4_CHNL154_CONFIG_ADDR A:0x28d4004
y.create.l HWIO_PMIC_ARB4_CHNL155_CONFIG_ADDR A:0x28dc004
y.create.l HWIO_PMIC_ARB4_CHNL156_CONFIG_ADDR A:0x28e4004
y.create.l HWIO_PMIC_ARB4_CHNL157_CONFIG_ADDR A:0x28ec004
y.create.l HWIO_PMIC_ARB4_CHNL158_CONFIG_ADDR A:0x28f4004
y.create.l HWIO_PMIC_ARB4_CHNL159_CONFIG_ADDR A:0x28fc004
y.create.l HWIO_PMIC_ARB4_CHNL160_CONFIG_ADDR A:0x2904004
y.create.l HWIO_PMIC_ARB4_CHNL161_CONFIG_ADDR A:0x290c004
y.create.l HWIO_PMIC_ARB4_CHNL162_CONFIG_ADDR A:0x2914004
y.create.l HWIO_PMIC_ARB4_CHNL163_CONFIG_ADDR A:0x291c004
y.create.l HWIO_PMIC_ARB4_CHNL164_CONFIG_ADDR A:0x2924004
y.create.l HWIO_PMIC_ARB4_CHNL165_CONFIG_ADDR A:0x292c004
y.create.l HWIO_PMIC_ARB4_CHNL166_CONFIG_ADDR A:0x2934004
y.create.l HWIO_PMIC_ARB4_CHNL167_CONFIG_ADDR A:0x293c004
y.create.l HWIO_PMIC_ARB4_CHNL168_CONFIG_ADDR A:0x2944004
y.create.l HWIO_PMIC_ARB4_CHNL169_CONFIG_ADDR A:0x294c004
y.create.l HWIO_PMIC_ARB4_CHNL170_CONFIG_ADDR A:0x2954004
y.create.l HWIO_PMIC_ARB4_CHNL171_CONFIG_ADDR A:0x295c004
y.create.l HWIO_PMIC_ARB4_CHNL172_CONFIG_ADDR A:0x2964004
y.create.l HWIO_PMIC_ARB4_CHNL173_CONFIG_ADDR A:0x296c004
y.create.l HWIO_PMIC_ARB4_CHNL174_CONFIG_ADDR A:0x2974004
y.create.l HWIO_PMIC_ARB4_CHNL175_CONFIG_ADDR A:0x297c004
y.create.l HWIO_PMIC_ARB4_CHNL176_CONFIG_ADDR A:0x2984004
y.create.l HWIO_PMIC_ARB4_CHNL177_CONFIG_ADDR A:0x298c004
y.create.l HWIO_PMIC_ARB4_CHNL178_CONFIG_ADDR A:0x2994004
y.create.l HWIO_PMIC_ARB4_CHNL179_CONFIG_ADDR A:0x299c004
y.create.l HWIO_PMIC_ARB4_CHNL180_CONFIG_ADDR A:0x29a4004
y.create.l HWIO_PMIC_ARB4_CHNL181_CONFIG_ADDR A:0x29ac004
y.create.l HWIO_PMIC_ARB4_CHNL182_CONFIG_ADDR A:0x29b4004
y.create.l HWIO_PMIC_ARB4_CHNL183_CONFIG_ADDR A:0x29bc004
y.create.l HWIO_PMIC_ARB4_CHNL184_CONFIG_ADDR A:0x29c4004
y.create.l HWIO_PMIC_ARB4_CHNL185_CONFIG_ADDR A:0x29cc004
y.create.l HWIO_PMIC_ARB4_CHNL186_CONFIG_ADDR A:0x29d4004
y.create.l HWIO_PMIC_ARB4_CHNL187_CONFIG_ADDR A:0x29dc004
y.create.l HWIO_PMIC_ARB4_CHNL188_CONFIG_ADDR A:0x29e4004
y.create.l HWIO_PMIC_ARB4_CHNL189_CONFIG_ADDR A:0x29ec004
y.create.l HWIO_PMIC_ARB4_CHNL190_CONFIG_ADDR A:0x29f4004
y.create.l HWIO_PMIC_ARB4_CHNL191_CONFIG_ADDR A:0x29fc004
y.create.l HWIO_PMIC_ARB4_CHNL192_CONFIG_ADDR A:0x2a04004
y.create.l HWIO_PMIC_ARB4_CHNL193_CONFIG_ADDR A:0x2a0c004
y.create.l HWIO_PMIC_ARB4_CHNL194_CONFIG_ADDR A:0x2a14004
y.create.l HWIO_PMIC_ARB4_CHNL195_CONFIG_ADDR A:0x2a1c004
y.create.l HWIO_PMIC_ARB4_CHNL196_CONFIG_ADDR A:0x2a24004
y.create.l HWIO_PMIC_ARB4_CHNL197_CONFIG_ADDR A:0x2a2c004
y.create.l HWIO_PMIC_ARB4_CHNL198_CONFIG_ADDR A:0x2a34004
y.create.l HWIO_PMIC_ARB4_CHNL199_CONFIG_ADDR A:0x2a3c004
y.create.l HWIO_PMIC_ARB4_CHNL200_CONFIG_ADDR A:0x2a44004
y.create.l HWIO_PMIC_ARB4_CHNL201_CONFIG_ADDR A:0x2a4c004
y.create.l HWIO_PMIC_ARB4_CHNL202_CONFIG_ADDR A:0x2a54004
y.create.l HWIO_PMIC_ARB4_CHNL203_CONFIG_ADDR A:0x2a5c004
y.create.l HWIO_PMIC_ARB4_CHNL204_CONFIG_ADDR A:0x2a64004
y.create.l HWIO_PMIC_ARB4_CHNL205_CONFIG_ADDR A:0x2a6c004
y.create.l HWIO_PMIC_ARB4_CHNL206_CONFIG_ADDR A:0x2a74004
y.create.l HWIO_PMIC_ARB4_CHNL207_CONFIG_ADDR A:0x2a7c004
y.create.l HWIO_PMIC_ARB4_CHNL208_CONFIG_ADDR A:0x2a84004
y.create.l HWIO_PMIC_ARB4_CHNL209_CONFIG_ADDR A:0x2a8c004
y.create.l HWIO_PMIC_ARB4_CHNL210_CONFIG_ADDR A:0x2a94004
y.create.l HWIO_PMIC_ARB4_CHNL211_CONFIG_ADDR A:0x2a9c004
y.create.l HWIO_PMIC_ARB4_CHNL212_CONFIG_ADDR A:0x2aa4004
y.create.l HWIO_PMIC_ARB4_CHNL213_CONFIG_ADDR A:0x2aac004
y.create.l HWIO_PMIC_ARB4_CHNL214_CONFIG_ADDR A:0x2ab4004
y.create.l HWIO_PMIC_ARB4_CHNL215_CONFIG_ADDR A:0x2abc004
y.create.l HWIO_PMIC_ARB4_CHNL216_CONFIG_ADDR A:0x2ac4004
y.create.l HWIO_PMIC_ARB4_CHNL217_CONFIG_ADDR A:0x2acc004
y.create.l HWIO_PMIC_ARB4_CHNL218_CONFIG_ADDR A:0x2ad4004
y.create.l HWIO_PMIC_ARB4_CHNL219_CONFIG_ADDR A:0x2adc004
y.create.l HWIO_PMIC_ARB4_CHNL220_CONFIG_ADDR A:0x2ae4004
y.create.l HWIO_PMIC_ARB4_CHNL221_CONFIG_ADDR A:0x2aec004
y.create.l HWIO_PMIC_ARB4_CHNL222_CONFIG_ADDR A:0x2af4004
y.create.l HWIO_PMIC_ARB4_CHNL223_CONFIG_ADDR A:0x2afc004
y.create.l HWIO_PMIC_ARB4_CHNL224_CONFIG_ADDR A:0x2b04004
y.create.l HWIO_PMIC_ARB4_CHNL225_CONFIG_ADDR A:0x2b0c004
y.create.l HWIO_PMIC_ARB4_CHNL226_CONFIG_ADDR A:0x2b14004
y.create.l HWIO_PMIC_ARB4_CHNL227_CONFIG_ADDR A:0x2b1c004
y.create.l HWIO_PMIC_ARB4_CHNL228_CONFIG_ADDR A:0x2b24004
y.create.l HWIO_PMIC_ARB4_CHNL229_CONFIG_ADDR A:0x2b2c004
y.create.l HWIO_PMIC_ARB4_CHNL230_CONFIG_ADDR A:0x2b34004
y.create.l HWIO_PMIC_ARB4_CHNL231_CONFIG_ADDR A:0x2b3c004
y.create.l HWIO_PMIC_ARB4_CHNL232_CONFIG_ADDR A:0x2b44004
y.create.l HWIO_PMIC_ARB4_CHNL233_CONFIG_ADDR A:0x2b4c004
y.create.l HWIO_PMIC_ARB4_CHNL234_CONFIG_ADDR A:0x2b54004
y.create.l HWIO_PMIC_ARB4_CHNL235_CONFIG_ADDR A:0x2b5c004
y.create.l HWIO_PMIC_ARB4_CHNL236_CONFIG_ADDR A:0x2b64004
y.create.l HWIO_PMIC_ARB4_CHNL237_CONFIG_ADDR A:0x2b6c004
y.create.l HWIO_PMIC_ARB4_CHNL238_CONFIG_ADDR A:0x2b74004
y.create.l HWIO_PMIC_ARB4_CHNL239_CONFIG_ADDR A:0x2b7c004
y.create.l HWIO_PMIC_ARB4_CHNL240_CONFIG_ADDR A:0x2b84004
y.create.l HWIO_PMIC_ARB4_CHNL241_CONFIG_ADDR A:0x2b8c004
y.create.l HWIO_PMIC_ARB4_CHNL242_CONFIG_ADDR A:0x2b94004
y.create.l HWIO_PMIC_ARB4_CHNL243_CONFIG_ADDR A:0x2b9c004
y.create.l HWIO_PMIC_ARB4_CHNL244_CONFIG_ADDR A:0x2ba4004
y.create.l HWIO_PMIC_ARB4_CHNL245_CONFIG_ADDR A:0x2bac004
y.create.l HWIO_PMIC_ARB4_CHNL246_CONFIG_ADDR A:0x2bb4004
y.create.l HWIO_PMIC_ARB4_CHNL247_CONFIG_ADDR A:0x2bbc004
y.create.l HWIO_PMIC_ARB4_CHNL248_CONFIG_ADDR A:0x2bc4004
y.create.l HWIO_PMIC_ARB4_CHNL249_CONFIG_ADDR A:0x2bcc004
y.create.l HWIO_PMIC_ARB4_CHNL250_CONFIG_ADDR A:0x2bd4004
y.create.l HWIO_PMIC_ARB4_CHNL251_CONFIG_ADDR A:0x2bdc004
y.create.l HWIO_PMIC_ARB4_CHNL252_CONFIG_ADDR A:0x2be4004
y.create.l HWIO_PMIC_ARB4_CHNL253_CONFIG_ADDR A:0x2bec004
y.create.l HWIO_PMIC_ARB4_CHNL254_CONFIG_ADDR A:0x2bf4004
y.create.l HWIO_PMIC_ARB4_CHNL255_CONFIG_ADDR A:0x2bfc004
y.create.l HWIO_PMIC_ARB5_CHNL0_CONFIG_ADDR A:0x2405004
y.create.l HWIO_PMIC_ARB5_CHNL1_CONFIG_ADDR A:0x240d004
y.create.l HWIO_PMIC_ARB5_CHNL2_CONFIG_ADDR A:0x2415004
y.create.l HWIO_PMIC_ARB5_CHNL3_CONFIG_ADDR A:0x241d004
y.create.l HWIO_PMIC_ARB5_CHNL4_CONFIG_ADDR A:0x2425004
y.create.l HWIO_PMIC_ARB5_CHNL5_CONFIG_ADDR A:0x242d004
y.create.l HWIO_PMIC_ARB5_CHNL6_CONFIG_ADDR A:0x2435004
y.create.l HWIO_PMIC_ARB5_CHNL7_CONFIG_ADDR A:0x243d004
y.create.l HWIO_PMIC_ARB5_CHNL8_CONFIG_ADDR A:0x2445004
y.create.l HWIO_PMIC_ARB5_CHNL9_CONFIG_ADDR A:0x244d004
y.create.l HWIO_PMIC_ARB5_CHNL10_CONFIG_ADDR A:0x2455004
y.create.l HWIO_PMIC_ARB5_CHNL11_CONFIG_ADDR A:0x245d004
y.create.l HWIO_PMIC_ARB5_CHNL12_CONFIG_ADDR A:0x2465004
y.create.l HWIO_PMIC_ARB5_CHNL13_CONFIG_ADDR A:0x246d004
y.create.l HWIO_PMIC_ARB5_CHNL14_CONFIG_ADDR A:0x2475004
y.create.l HWIO_PMIC_ARB5_CHNL15_CONFIG_ADDR A:0x247d004
y.create.l HWIO_PMIC_ARB5_CHNL16_CONFIG_ADDR A:0x2485004
y.create.l HWIO_PMIC_ARB5_CHNL17_CONFIG_ADDR A:0x248d004
y.create.l HWIO_PMIC_ARB5_CHNL18_CONFIG_ADDR A:0x2495004
y.create.l HWIO_PMIC_ARB5_CHNL19_CONFIG_ADDR A:0x249d004
y.create.l HWIO_PMIC_ARB5_CHNL20_CONFIG_ADDR A:0x24a5004
y.create.l HWIO_PMIC_ARB5_CHNL21_CONFIG_ADDR A:0x24ad004
y.create.l HWIO_PMIC_ARB5_CHNL22_CONFIG_ADDR A:0x24b5004
y.create.l HWIO_PMIC_ARB5_CHNL23_CONFIG_ADDR A:0x24bd004
y.create.l HWIO_PMIC_ARB5_CHNL24_CONFIG_ADDR A:0x24c5004
y.create.l HWIO_PMIC_ARB5_CHNL25_CONFIG_ADDR A:0x24cd004
y.create.l HWIO_PMIC_ARB5_CHNL26_CONFIG_ADDR A:0x24d5004
y.create.l HWIO_PMIC_ARB5_CHNL27_CONFIG_ADDR A:0x24dd004
y.create.l HWIO_PMIC_ARB5_CHNL28_CONFIG_ADDR A:0x24e5004
y.create.l HWIO_PMIC_ARB5_CHNL29_CONFIG_ADDR A:0x24ed004
y.create.l HWIO_PMIC_ARB5_CHNL30_CONFIG_ADDR A:0x24f5004
y.create.l HWIO_PMIC_ARB5_CHNL31_CONFIG_ADDR A:0x24fd004
y.create.l HWIO_PMIC_ARB5_CHNL32_CONFIG_ADDR A:0x2505004
y.create.l HWIO_PMIC_ARB5_CHNL33_CONFIG_ADDR A:0x250d004
y.create.l HWIO_PMIC_ARB5_CHNL34_CONFIG_ADDR A:0x2515004
y.create.l HWIO_PMIC_ARB5_CHNL35_CONFIG_ADDR A:0x251d004
y.create.l HWIO_PMIC_ARB5_CHNL36_CONFIG_ADDR A:0x2525004
y.create.l HWIO_PMIC_ARB5_CHNL37_CONFIG_ADDR A:0x252d004
y.create.l HWIO_PMIC_ARB5_CHNL38_CONFIG_ADDR A:0x2535004
y.create.l HWIO_PMIC_ARB5_CHNL39_CONFIG_ADDR A:0x253d004
y.create.l HWIO_PMIC_ARB5_CHNL40_CONFIG_ADDR A:0x2545004
y.create.l HWIO_PMIC_ARB5_CHNL41_CONFIG_ADDR A:0x254d004
y.create.l HWIO_PMIC_ARB5_CHNL42_CONFIG_ADDR A:0x2555004
y.create.l HWIO_PMIC_ARB5_CHNL43_CONFIG_ADDR A:0x255d004
y.create.l HWIO_PMIC_ARB5_CHNL44_CONFIG_ADDR A:0x2565004
y.create.l HWIO_PMIC_ARB5_CHNL45_CONFIG_ADDR A:0x256d004
y.create.l HWIO_PMIC_ARB5_CHNL46_CONFIG_ADDR A:0x2575004
y.create.l HWIO_PMIC_ARB5_CHNL47_CONFIG_ADDR A:0x257d004
y.create.l HWIO_PMIC_ARB5_CHNL48_CONFIG_ADDR A:0x2585004
y.create.l HWIO_PMIC_ARB5_CHNL49_CONFIG_ADDR A:0x258d004
y.create.l HWIO_PMIC_ARB5_CHNL50_CONFIG_ADDR A:0x2595004
y.create.l HWIO_PMIC_ARB5_CHNL51_CONFIG_ADDR A:0x259d004
y.create.l HWIO_PMIC_ARB5_CHNL52_CONFIG_ADDR A:0x25a5004
y.create.l HWIO_PMIC_ARB5_CHNL53_CONFIG_ADDR A:0x25ad004
y.create.l HWIO_PMIC_ARB5_CHNL54_CONFIG_ADDR A:0x25b5004
y.create.l HWIO_PMIC_ARB5_CHNL55_CONFIG_ADDR A:0x25bd004
y.create.l HWIO_PMIC_ARB5_CHNL56_CONFIG_ADDR A:0x25c5004
y.create.l HWIO_PMIC_ARB5_CHNL57_CONFIG_ADDR A:0x25cd004
y.create.l HWIO_PMIC_ARB5_CHNL58_CONFIG_ADDR A:0x25d5004
y.create.l HWIO_PMIC_ARB5_CHNL59_CONFIG_ADDR A:0x25dd004
y.create.l HWIO_PMIC_ARB5_CHNL60_CONFIG_ADDR A:0x25e5004
y.create.l HWIO_PMIC_ARB5_CHNL61_CONFIG_ADDR A:0x25ed004
y.create.l HWIO_PMIC_ARB5_CHNL62_CONFIG_ADDR A:0x25f5004
y.create.l HWIO_PMIC_ARB5_CHNL63_CONFIG_ADDR A:0x25fd004
y.create.l HWIO_PMIC_ARB5_CHNL64_CONFIG_ADDR A:0x2605004
y.create.l HWIO_PMIC_ARB5_CHNL65_CONFIG_ADDR A:0x260d004
y.create.l HWIO_PMIC_ARB5_CHNL66_CONFIG_ADDR A:0x2615004
y.create.l HWIO_PMIC_ARB5_CHNL67_CONFIG_ADDR A:0x261d004
y.create.l HWIO_PMIC_ARB5_CHNL68_CONFIG_ADDR A:0x2625004
y.create.l HWIO_PMIC_ARB5_CHNL69_CONFIG_ADDR A:0x262d004
y.create.l HWIO_PMIC_ARB5_CHNL70_CONFIG_ADDR A:0x2635004
y.create.l HWIO_PMIC_ARB5_CHNL71_CONFIG_ADDR A:0x263d004
y.create.l HWIO_PMIC_ARB5_CHNL72_CONFIG_ADDR A:0x2645004
y.create.l HWIO_PMIC_ARB5_CHNL73_CONFIG_ADDR A:0x264d004
y.create.l HWIO_PMIC_ARB5_CHNL74_CONFIG_ADDR A:0x2655004
y.create.l HWIO_PMIC_ARB5_CHNL75_CONFIG_ADDR A:0x265d004
y.create.l HWIO_PMIC_ARB5_CHNL76_CONFIG_ADDR A:0x2665004
y.create.l HWIO_PMIC_ARB5_CHNL77_CONFIG_ADDR A:0x266d004
y.create.l HWIO_PMIC_ARB5_CHNL78_CONFIG_ADDR A:0x2675004
y.create.l HWIO_PMIC_ARB5_CHNL79_CONFIG_ADDR A:0x267d004
y.create.l HWIO_PMIC_ARB5_CHNL80_CONFIG_ADDR A:0x2685004
y.create.l HWIO_PMIC_ARB5_CHNL81_CONFIG_ADDR A:0x268d004
y.create.l HWIO_PMIC_ARB5_CHNL82_CONFIG_ADDR A:0x2695004
y.create.l HWIO_PMIC_ARB5_CHNL83_CONFIG_ADDR A:0x269d004
y.create.l HWIO_PMIC_ARB5_CHNL84_CONFIG_ADDR A:0x26a5004
y.create.l HWIO_PMIC_ARB5_CHNL85_CONFIG_ADDR A:0x26ad004
y.create.l HWIO_PMIC_ARB5_CHNL86_CONFIG_ADDR A:0x26b5004
y.create.l HWIO_PMIC_ARB5_CHNL87_CONFIG_ADDR A:0x26bd004
y.create.l HWIO_PMIC_ARB5_CHNL88_CONFIG_ADDR A:0x26c5004
y.create.l HWIO_PMIC_ARB5_CHNL89_CONFIG_ADDR A:0x26cd004
y.create.l HWIO_PMIC_ARB5_CHNL90_CONFIG_ADDR A:0x26d5004
y.create.l HWIO_PMIC_ARB5_CHNL91_CONFIG_ADDR A:0x26dd004
y.create.l HWIO_PMIC_ARB5_CHNL92_CONFIG_ADDR A:0x26e5004
y.create.l HWIO_PMIC_ARB5_CHNL93_CONFIG_ADDR A:0x26ed004
y.create.l HWIO_PMIC_ARB5_CHNL94_CONFIG_ADDR A:0x26f5004
y.create.l HWIO_PMIC_ARB5_CHNL95_CONFIG_ADDR A:0x26fd004
y.create.l HWIO_PMIC_ARB5_CHNL96_CONFIG_ADDR A:0x2705004
y.create.l HWIO_PMIC_ARB5_CHNL97_CONFIG_ADDR A:0x270d004
y.create.l HWIO_PMIC_ARB5_CHNL98_CONFIG_ADDR A:0x2715004
y.create.l HWIO_PMIC_ARB5_CHNL99_CONFIG_ADDR A:0x271d004
y.create.l HWIO_PMIC_ARB5_CHNL100_CONFIG_ADDR A:0x2725004
y.create.l HWIO_PMIC_ARB5_CHNL101_CONFIG_ADDR A:0x272d004
y.create.l HWIO_PMIC_ARB5_CHNL102_CONFIG_ADDR A:0x2735004
y.create.l HWIO_PMIC_ARB5_CHNL103_CONFIG_ADDR A:0x273d004
y.create.l HWIO_PMIC_ARB5_CHNL104_CONFIG_ADDR A:0x2745004
y.create.l HWIO_PMIC_ARB5_CHNL105_CONFIG_ADDR A:0x274d004
y.create.l HWIO_PMIC_ARB5_CHNL106_CONFIG_ADDR A:0x2755004
y.create.l HWIO_PMIC_ARB5_CHNL107_CONFIG_ADDR A:0x275d004
y.create.l HWIO_PMIC_ARB5_CHNL108_CONFIG_ADDR A:0x2765004
y.create.l HWIO_PMIC_ARB5_CHNL109_CONFIG_ADDR A:0x276d004
y.create.l HWIO_PMIC_ARB5_CHNL110_CONFIG_ADDR A:0x2775004
y.create.l HWIO_PMIC_ARB5_CHNL111_CONFIG_ADDR A:0x277d004
y.create.l HWIO_PMIC_ARB5_CHNL112_CONFIG_ADDR A:0x2785004
y.create.l HWIO_PMIC_ARB5_CHNL113_CONFIG_ADDR A:0x278d004
y.create.l HWIO_PMIC_ARB5_CHNL114_CONFIG_ADDR A:0x2795004
y.create.l HWIO_PMIC_ARB5_CHNL115_CONFIG_ADDR A:0x279d004
y.create.l HWIO_PMIC_ARB5_CHNL116_CONFIG_ADDR A:0x27a5004
y.create.l HWIO_PMIC_ARB5_CHNL117_CONFIG_ADDR A:0x27ad004
y.create.l HWIO_PMIC_ARB5_CHNL118_CONFIG_ADDR A:0x27b5004
y.create.l HWIO_PMIC_ARB5_CHNL119_CONFIG_ADDR A:0x27bd004
y.create.l HWIO_PMIC_ARB5_CHNL120_CONFIG_ADDR A:0x27c5004
y.create.l HWIO_PMIC_ARB5_CHNL121_CONFIG_ADDR A:0x27cd004
y.create.l HWIO_PMIC_ARB5_CHNL122_CONFIG_ADDR A:0x27d5004
y.create.l HWIO_PMIC_ARB5_CHNL123_CONFIG_ADDR A:0x27dd004
y.create.l HWIO_PMIC_ARB5_CHNL124_CONFIG_ADDR A:0x27e5004
y.create.l HWIO_PMIC_ARB5_CHNL125_CONFIG_ADDR A:0x27ed004
y.create.l HWIO_PMIC_ARB5_CHNL126_CONFIG_ADDR A:0x27f5004
y.create.l HWIO_PMIC_ARB5_CHNL127_CONFIG_ADDR A:0x27fd004
y.create.l HWIO_PMIC_ARB5_CHNL128_CONFIG_ADDR A:0x2805004
y.create.l HWIO_PMIC_ARB5_CHNL129_CONFIG_ADDR A:0x280d004
y.create.l HWIO_PMIC_ARB5_CHNL130_CONFIG_ADDR A:0x2815004
y.create.l HWIO_PMIC_ARB5_CHNL131_CONFIG_ADDR A:0x281d004
y.create.l HWIO_PMIC_ARB5_CHNL132_CONFIG_ADDR A:0x2825004
y.create.l HWIO_PMIC_ARB5_CHNL133_CONFIG_ADDR A:0x282d004
y.create.l HWIO_PMIC_ARB5_CHNL134_CONFIG_ADDR A:0x2835004
y.create.l HWIO_PMIC_ARB5_CHNL135_CONFIG_ADDR A:0x283d004
y.create.l HWIO_PMIC_ARB5_CHNL136_CONFIG_ADDR A:0x2845004
y.create.l HWIO_PMIC_ARB5_CHNL137_CONFIG_ADDR A:0x284d004
y.create.l HWIO_PMIC_ARB5_CHNL138_CONFIG_ADDR A:0x2855004
y.create.l HWIO_PMIC_ARB5_CHNL139_CONFIG_ADDR A:0x285d004
y.create.l HWIO_PMIC_ARB5_CHNL140_CONFIG_ADDR A:0x2865004
y.create.l HWIO_PMIC_ARB5_CHNL141_CONFIG_ADDR A:0x286d004
y.create.l HWIO_PMIC_ARB5_CHNL142_CONFIG_ADDR A:0x2875004
y.create.l HWIO_PMIC_ARB5_CHNL143_CONFIG_ADDR A:0x287d004
y.create.l HWIO_PMIC_ARB5_CHNL144_CONFIG_ADDR A:0x2885004
y.create.l HWIO_PMIC_ARB5_CHNL145_CONFIG_ADDR A:0x288d004
y.create.l HWIO_PMIC_ARB5_CHNL146_CONFIG_ADDR A:0x2895004
y.create.l HWIO_PMIC_ARB5_CHNL147_CONFIG_ADDR A:0x289d004
y.create.l HWIO_PMIC_ARB5_CHNL148_CONFIG_ADDR A:0x28a5004
y.create.l HWIO_PMIC_ARB5_CHNL149_CONFIG_ADDR A:0x28ad004
y.create.l HWIO_PMIC_ARB5_CHNL150_CONFIG_ADDR A:0x28b5004
y.create.l HWIO_PMIC_ARB5_CHNL151_CONFIG_ADDR A:0x28bd004
y.create.l HWIO_PMIC_ARB5_CHNL152_CONFIG_ADDR A:0x28c5004
y.create.l HWIO_PMIC_ARB5_CHNL153_CONFIG_ADDR A:0x28cd004
y.create.l HWIO_PMIC_ARB5_CHNL154_CONFIG_ADDR A:0x28d5004
y.create.l HWIO_PMIC_ARB5_CHNL155_CONFIG_ADDR A:0x28dd004
y.create.l HWIO_PMIC_ARB5_CHNL156_CONFIG_ADDR A:0x28e5004
y.create.l HWIO_PMIC_ARB5_CHNL157_CONFIG_ADDR A:0x28ed004
y.create.l HWIO_PMIC_ARB5_CHNL158_CONFIG_ADDR A:0x28f5004
y.create.l HWIO_PMIC_ARB5_CHNL159_CONFIG_ADDR A:0x28fd004
y.create.l HWIO_PMIC_ARB5_CHNL160_CONFIG_ADDR A:0x2905004
y.create.l HWIO_PMIC_ARB5_CHNL161_CONFIG_ADDR A:0x290d004
y.create.l HWIO_PMIC_ARB5_CHNL162_CONFIG_ADDR A:0x2915004
y.create.l HWIO_PMIC_ARB5_CHNL163_CONFIG_ADDR A:0x291d004
y.create.l HWIO_PMIC_ARB5_CHNL164_CONFIG_ADDR A:0x2925004
y.create.l HWIO_PMIC_ARB5_CHNL165_CONFIG_ADDR A:0x292d004
y.create.l HWIO_PMIC_ARB5_CHNL166_CONFIG_ADDR A:0x2935004
y.create.l HWIO_PMIC_ARB5_CHNL167_CONFIG_ADDR A:0x293d004
y.create.l HWIO_PMIC_ARB5_CHNL168_CONFIG_ADDR A:0x2945004
y.create.l HWIO_PMIC_ARB5_CHNL169_CONFIG_ADDR A:0x294d004
y.create.l HWIO_PMIC_ARB5_CHNL170_CONFIG_ADDR A:0x2955004
y.create.l HWIO_PMIC_ARB5_CHNL171_CONFIG_ADDR A:0x295d004
y.create.l HWIO_PMIC_ARB5_CHNL172_CONFIG_ADDR A:0x2965004
y.create.l HWIO_PMIC_ARB5_CHNL173_CONFIG_ADDR A:0x296d004
y.create.l HWIO_PMIC_ARB5_CHNL174_CONFIG_ADDR A:0x2975004
y.create.l HWIO_PMIC_ARB5_CHNL175_CONFIG_ADDR A:0x297d004
y.create.l HWIO_PMIC_ARB5_CHNL176_CONFIG_ADDR A:0x2985004
y.create.l HWIO_PMIC_ARB5_CHNL177_CONFIG_ADDR A:0x298d004
y.create.l HWIO_PMIC_ARB5_CHNL178_CONFIG_ADDR A:0x2995004
y.create.l HWIO_PMIC_ARB5_CHNL179_CONFIG_ADDR A:0x299d004
y.create.l HWIO_PMIC_ARB5_CHNL180_CONFIG_ADDR A:0x29a5004
y.create.l HWIO_PMIC_ARB5_CHNL181_CONFIG_ADDR A:0x29ad004
y.create.l HWIO_PMIC_ARB5_CHNL182_CONFIG_ADDR A:0x29b5004
y.create.l HWIO_PMIC_ARB5_CHNL183_CONFIG_ADDR A:0x29bd004
y.create.l HWIO_PMIC_ARB5_CHNL184_CONFIG_ADDR A:0x29c5004
y.create.l HWIO_PMIC_ARB5_CHNL185_CONFIG_ADDR A:0x29cd004
y.create.l HWIO_PMIC_ARB5_CHNL186_CONFIG_ADDR A:0x29d5004
y.create.l HWIO_PMIC_ARB5_CHNL187_CONFIG_ADDR A:0x29dd004
y.create.l HWIO_PMIC_ARB5_CHNL188_CONFIG_ADDR A:0x29e5004
y.create.l HWIO_PMIC_ARB5_CHNL189_CONFIG_ADDR A:0x29ed004
y.create.l HWIO_PMIC_ARB5_CHNL190_CONFIG_ADDR A:0x29f5004
y.create.l HWIO_PMIC_ARB5_CHNL191_CONFIG_ADDR A:0x29fd004
y.create.l HWIO_PMIC_ARB5_CHNL192_CONFIG_ADDR A:0x2a05004
y.create.l HWIO_PMIC_ARB5_CHNL193_CONFIG_ADDR A:0x2a0d004
y.create.l HWIO_PMIC_ARB5_CHNL194_CONFIG_ADDR A:0x2a15004
y.create.l HWIO_PMIC_ARB5_CHNL195_CONFIG_ADDR A:0x2a1d004
y.create.l HWIO_PMIC_ARB5_CHNL196_CONFIG_ADDR A:0x2a25004
y.create.l HWIO_PMIC_ARB5_CHNL197_CONFIG_ADDR A:0x2a2d004
y.create.l HWIO_PMIC_ARB5_CHNL198_CONFIG_ADDR A:0x2a35004
y.create.l HWIO_PMIC_ARB5_CHNL199_CONFIG_ADDR A:0x2a3d004
y.create.l HWIO_PMIC_ARB5_CHNL200_CONFIG_ADDR A:0x2a45004
y.create.l HWIO_PMIC_ARB5_CHNL201_CONFIG_ADDR A:0x2a4d004
y.create.l HWIO_PMIC_ARB5_CHNL202_CONFIG_ADDR A:0x2a55004
y.create.l HWIO_PMIC_ARB5_CHNL203_CONFIG_ADDR A:0x2a5d004
y.create.l HWIO_PMIC_ARB5_CHNL204_CONFIG_ADDR A:0x2a65004
y.create.l HWIO_PMIC_ARB5_CHNL205_CONFIG_ADDR A:0x2a6d004
y.create.l HWIO_PMIC_ARB5_CHNL206_CONFIG_ADDR A:0x2a75004
y.create.l HWIO_PMIC_ARB5_CHNL207_CONFIG_ADDR A:0x2a7d004
y.create.l HWIO_PMIC_ARB5_CHNL208_CONFIG_ADDR A:0x2a85004
y.create.l HWIO_PMIC_ARB5_CHNL209_CONFIG_ADDR A:0x2a8d004
y.create.l HWIO_PMIC_ARB5_CHNL210_CONFIG_ADDR A:0x2a95004
y.create.l HWIO_PMIC_ARB5_CHNL211_CONFIG_ADDR A:0x2a9d004
y.create.l HWIO_PMIC_ARB5_CHNL212_CONFIG_ADDR A:0x2aa5004
y.create.l HWIO_PMIC_ARB5_CHNL213_CONFIG_ADDR A:0x2aad004
y.create.l HWIO_PMIC_ARB5_CHNL214_CONFIG_ADDR A:0x2ab5004
y.create.l HWIO_PMIC_ARB5_CHNL215_CONFIG_ADDR A:0x2abd004
y.create.l HWIO_PMIC_ARB5_CHNL216_CONFIG_ADDR A:0x2ac5004
y.create.l HWIO_PMIC_ARB5_CHNL217_CONFIG_ADDR A:0x2acd004
y.create.l HWIO_PMIC_ARB5_CHNL218_CONFIG_ADDR A:0x2ad5004
y.create.l HWIO_PMIC_ARB5_CHNL219_CONFIG_ADDR A:0x2add004
y.create.l HWIO_PMIC_ARB5_CHNL220_CONFIG_ADDR A:0x2ae5004
y.create.l HWIO_PMIC_ARB5_CHNL221_CONFIG_ADDR A:0x2aed004
y.create.l HWIO_PMIC_ARB5_CHNL222_CONFIG_ADDR A:0x2af5004
y.create.l HWIO_PMIC_ARB5_CHNL223_CONFIG_ADDR A:0x2afd004
y.create.l HWIO_PMIC_ARB5_CHNL224_CONFIG_ADDR A:0x2b05004
y.create.l HWIO_PMIC_ARB5_CHNL225_CONFIG_ADDR A:0x2b0d004
y.create.l HWIO_PMIC_ARB5_CHNL226_CONFIG_ADDR A:0x2b15004
y.create.l HWIO_PMIC_ARB5_CHNL227_CONFIG_ADDR A:0x2b1d004
y.create.l HWIO_PMIC_ARB5_CHNL228_CONFIG_ADDR A:0x2b25004
y.create.l HWIO_PMIC_ARB5_CHNL229_CONFIG_ADDR A:0x2b2d004
y.create.l HWIO_PMIC_ARB5_CHNL230_CONFIG_ADDR A:0x2b35004
y.create.l HWIO_PMIC_ARB5_CHNL231_CONFIG_ADDR A:0x2b3d004
y.create.l HWIO_PMIC_ARB5_CHNL232_CONFIG_ADDR A:0x2b45004
y.create.l HWIO_PMIC_ARB5_CHNL233_CONFIG_ADDR A:0x2b4d004
y.create.l HWIO_PMIC_ARB5_CHNL234_CONFIG_ADDR A:0x2b55004
y.create.l HWIO_PMIC_ARB5_CHNL235_CONFIG_ADDR A:0x2b5d004
y.create.l HWIO_PMIC_ARB5_CHNL236_CONFIG_ADDR A:0x2b65004
y.create.l HWIO_PMIC_ARB5_CHNL237_CONFIG_ADDR A:0x2b6d004
y.create.l HWIO_PMIC_ARB5_CHNL238_CONFIG_ADDR A:0x2b75004
y.create.l HWIO_PMIC_ARB5_CHNL239_CONFIG_ADDR A:0x2b7d004
y.create.l HWIO_PMIC_ARB5_CHNL240_CONFIG_ADDR A:0x2b85004
y.create.l HWIO_PMIC_ARB5_CHNL241_CONFIG_ADDR A:0x2b8d004
y.create.l HWIO_PMIC_ARB5_CHNL242_CONFIG_ADDR A:0x2b95004
y.create.l HWIO_PMIC_ARB5_CHNL243_CONFIG_ADDR A:0x2b9d004
y.create.l HWIO_PMIC_ARB5_CHNL244_CONFIG_ADDR A:0x2ba5004
y.create.l HWIO_PMIC_ARB5_CHNL245_CONFIG_ADDR A:0x2bad004
y.create.l HWIO_PMIC_ARB5_CHNL246_CONFIG_ADDR A:0x2bb5004
y.create.l HWIO_PMIC_ARB5_CHNL247_CONFIG_ADDR A:0x2bbd004
y.create.l HWIO_PMIC_ARB5_CHNL248_CONFIG_ADDR A:0x2bc5004
y.create.l HWIO_PMIC_ARB5_CHNL249_CONFIG_ADDR A:0x2bcd004
y.create.l HWIO_PMIC_ARB5_CHNL250_CONFIG_ADDR A:0x2bd5004
y.create.l HWIO_PMIC_ARB5_CHNL251_CONFIG_ADDR A:0x2bdd004
y.create.l HWIO_PMIC_ARB5_CHNL252_CONFIG_ADDR A:0x2be5004
y.create.l HWIO_PMIC_ARB5_CHNL253_CONFIG_ADDR A:0x2bed004
y.create.l HWIO_PMIC_ARB5_CHNL254_CONFIG_ADDR A:0x2bf5004
y.create.l HWIO_PMIC_ARB5_CHNL255_CONFIG_ADDR A:0x2bfd004
y.create.l HWIO_PMIC_ARB6_CHNL0_CONFIG_ADDR A:0x2406004
y.create.l HWIO_PMIC_ARB6_CHNL1_CONFIG_ADDR A:0x240e004
y.create.l HWIO_PMIC_ARB6_CHNL2_CONFIG_ADDR A:0x2416004
y.create.l HWIO_PMIC_ARB6_CHNL3_CONFIG_ADDR A:0x241e004
y.create.l HWIO_PMIC_ARB6_CHNL4_CONFIG_ADDR A:0x2426004
y.create.l HWIO_PMIC_ARB6_CHNL5_CONFIG_ADDR A:0x242e004
y.create.l HWIO_PMIC_ARB6_CHNL6_CONFIG_ADDR A:0x2436004
y.create.l HWIO_PMIC_ARB6_CHNL7_CONFIG_ADDR A:0x243e004
y.create.l HWIO_PMIC_ARB6_CHNL8_CONFIG_ADDR A:0x2446004
y.create.l HWIO_PMIC_ARB6_CHNL9_CONFIG_ADDR A:0x244e004
y.create.l HWIO_PMIC_ARB6_CHNL10_CONFIG_ADDR A:0x2456004
y.create.l HWIO_PMIC_ARB6_CHNL11_CONFIG_ADDR A:0x245e004
y.create.l HWIO_PMIC_ARB6_CHNL12_CONFIG_ADDR A:0x2466004
y.create.l HWIO_PMIC_ARB6_CHNL13_CONFIG_ADDR A:0x246e004
y.create.l HWIO_PMIC_ARB6_CHNL14_CONFIG_ADDR A:0x2476004
y.create.l HWIO_PMIC_ARB6_CHNL15_CONFIG_ADDR A:0x247e004
y.create.l HWIO_PMIC_ARB6_CHNL16_CONFIG_ADDR A:0x2486004
y.create.l HWIO_PMIC_ARB6_CHNL17_CONFIG_ADDR A:0x248e004
y.create.l HWIO_PMIC_ARB6_CHNL18_CONFIG_ADDR A:0x2496004
y.create.l HWIO_PMIC_ARB6_CHNL19_CONFIG_ADDR A:0x249e004
y.create.l HWIO_PMIC_ARB6_CHNL20_CONFIG_ADDR A:0x24a6004
y.create.l HWIO_PMIC_ARB6_CHNL21_CONFIG_ADDR A:0x24ae004
y.create.l HWIO_PMIC_ARB6_CHNL22_CONFIG_ADDR A:0x24b6004
y.create.l HWIO_PMIC_ARB6_CHNL23_CONFIG_ADDR A:0x24be004
y.create.l HWIO_PMIC_ARB6_CHNL24_CONFIG_ADDR A:0x24c6004
y.create.l HWIO_PMIC_ARB6_CHNL25_CONFIG_ADDR A:0x24ce004
y.create.l HWIO_PMIC_ARB6_CHNL26_CONFIG_ADDR A:0x24d6004
y.create.l HWIO_PMIC_ARB6_CHNL27_CONFIG_ADDR A:0x24de004
y.create.l HWIO_PMIC_ARB6_CHNL28_CONFIG_ADDR A:0x24e6004
y.create.l HWIO_PMIC_ARB6_CHNL29_CONFIG_ADDR A:0x24ee004
y.create.l HWIO_PMIC_ARB6_CHNL30_CONFIG_ADDR A:0x24f6004
y.create.l HWIO_PMIC_ARB6_CHNL31_CONFIG_ADDR A:0x24fe004
y.create.l HWIO_PMIC_ARB6_CHNL32_CONFIG_ADDR A:0x2506004
y.create.l HWIO_PMIC_ARB6_CHNL33_CONFIG_ADDR A:0x250e004
y.create.l HWIO_PMIC_ARB6_CHNL34_CONFIG_ADDR A:0x2516004
y.create.l HWIO_PMIC_ARB6_CHNL35_CONFIG_ADDR A:0x251e004
y.create.l HWIO_PMIC_ARB6_CHNL36_CONFIG_ADDR A:0x2526004
y.create.l HWIO_PMIC_ARB6_CHNL37_CONFIG_ADDR A:0x252e004
y.create.l HWIO_PMIC_ARB6_CHNL38_CONFIG_ADDR A:0x2536004
y.create.l HWIO_PMIC_ARB6_CHNL39_CONFIG_ADDR A:0x253e004
y.create.l HWIO_PMIC_ARB6_CHNL40_CONFIG_ADDR A:0x2546004
y.create.l HWIO_PMIC_ARB6_CHNL41_CONFIG_ADDR A:0x254e004
y.create.l HWIO_PMIC_ARB6_CHNL42_CONFIG_ADDR A:0x2556004
y.create.l HWIO_PMIC_ARB6_CHNL43_CONFIG_ADDR A:0x255e004
y.create.l HWIO_PMIC_ARB6_CHNL44_CONFIG_ADDR A:0x2566004
y.create.l HWIO_PMIC_ARB6_CHNL45_CONFIG_ADDR A:0x256e004
y.create.l HWIO_PMIC_ARB6_CHNL46_CONFIG_ADDR A:0x2576004
y.create.l HWIO_PMIC_ARB6_CHNL47_CONFIG_ADDR A:0x257e004
y.create.l HWIO_PMIC_ARB6_CHNL48_CONFIG_ADDR A:0x2586004
y.create.l HWIO_PMIC_ARB6_CHNL49_CONFIG_ADDR A:0x258e004
y.create.l HWIO_PMIC_ARB6_CHNL50_CONFIG_ADDR A:0x2596004
y.create.l HWIO_PMIC_ARB6_CHNL51_CONFIG_ADDR A:0x259e004
y.create.l HWIO_PMIC_ARB6_CHNL52_CONFIG_ADDR A:0x25a6004
y.create.l HWIO_PMIC_ARB6_CHNL53_CONFIG_ADDR A:0x25ae004
y.create.l HWIO_PMIC_ARB6_CHNL54_CONFIG_ADDR A:0x25b6004
y.create.l HWIO_PMIC_ARB6_CHNL55_CONFIG_ADDR A:0x25be004
y.create.l HWIO_PMIC_ARB6_CHNL56_CONFIG_ADDR A:0x25c6004
y.create.l HWIO_PMIC_ARB6_CHNL57_CONFIG_ADDR A:0x25ce004
y.create.l HWIO_PMIC_ARB6_CHNL58_CONFIG_ADDR A:0x25d6004
y.create.l HWIO_PMIC_ARB6_CHNL59_CONFIG_ADDR A:0x25de004
y.create.l HWIO_PMIC_ARB6_CHNL60_CONFIG_ADDR A:0x25e6004
y.create.l HWIO_PMIC_ARB6_CHNL61_CONFIG_ADDR A:0x25ee004
y.create.l HWIO_PMIC_ARB6_CHNL62_CONFIG_ADDR A:0x25f6004
y.create.l HWIO_PMIC_ARB6_CHNL63_CONFIG_ADDR A:0x25fe004
y.create.l HWIO_PMIC_ARB6_CHNL64_CONFIG_ADDR A:0x2606004
y.create.l HWIO_PMIC_ARB6_CHNL65_CONFIG_ADDR A:0x260e004
y.create.l HWIO_PMIC_ARB6_CHNL66_CONFIG_ADDR A:0x2616004
y.create.l HWIO_PMIC_ARB6_CHNL67_CONFIG_ADDR A:0x261e004
y.create.l HWIO_PMIC_ARB6_CHNL68_CONFIG_ADDR A:0x2626004
y.create.l HWIO_PMIC_ARB6_CHNL69_CONFIG_ADDR A:0x262e004
y.create.l HWIO_PMIC_ARB6_CHNL70_CONFIG_ADDR A:0x2636004
y.create.l HWIO_PMIC_ARB6_CHNL71_CONFIG_ADDR A:0x263e004
y.create.l HWIO_PMIC_ARB6_CHNL72_CONFIG_ADDR A:0x2646004
y.create.l HWIO_PMIC_ARB6_CHNL73_CONFIG_ADDR A:0x264e004
y.create.l HWIO_PMIC_ARB6_CHNL74_CONFIG_ADDR A:0x2656004
y.create.l HWIO_PMIC_ARB6_CHNL75_CONFIG_ADDR A:0x265e004
y.create.l HWIO_PMIC_ARB6_CHNL76_CONFIG_ADDR A:0x2666004
y.create.l HWIO_PMIC_ARB6_CHNL77_CONFIG_ADDR A:0x266e004
y.create.l HWIO_PMIC_ARB6_CHNL78_CONFIG_ADDR A:0x2676004
y.create.l HWIO_PMIC_ARB6_CHNL79_CONFIG_ADDR A:0x267e004
y.create.l HWIO_PMIC_ARB6_CHNL80_CONFIG_ADDR A:0x2686004
y.create.l HWIO_PMIC_ARB6_CHNL81_CONFIG_ADDR A:0x268e004
y.create.l HWIO_PMIC_ARB6_CHNL82_CONFIG_ADDR A:0x2696004
y.create.l HWIO_PMIC_ARB6_CHNL83_CONFIG_ADDR A:0x269e004
y.create.l HWIO_PMIC_ARB6_CHNL84_CONFIG_ADDR A:0x26a6004
y.create.l HWIO_PMIC_ARB6_CHNL85_CONFIG_ADDR A:0x26ae004
y.create.l HWIO_PMIC_ARB6_CHNL86_CONFIG_ADDR A:0x26b6004
y.create.l HWIO_PMIC_ARB6_CHNL87_CONFIG_ADDR A:0x26be004
y.create.l HWIO_PMIC_ARB6_CHNL88_CONFIG_ADDR A:0x26c6004
y.create.l HWIO_PMIC_ARB6_CHNL89_CONFIG_ADDR A:0x26ce004
y.create.l HWIO_PMIC_ARB6_CHNL90_CONFIG_ADDR A:0x26d6004
y.create.l HWIO_PMIC_ARB6_CHNL91_CONFIG_ADDR A:0x26de004
y.create.l HWIO_PMIC_ARB6_CHNL92_CONFIG_ADDR A:0x26e6004
y.create.l HWIO_PMIC_ARB6_CHNL93_CONFIG_ADDR A:0x26ee004
y.create.l HWIO_PMIC_ARB6_CHNL94_CONFIG_ADDR A:0x26f6004
y.create.l HWIO_PMIC_ARB6_CHNL95_CONFIG_ADDR A:0x26fe004
y.create.l HWIO_PMIC_ARB6_CHNL96_CONFIG_ADDR A:0x2706004
y.create.l HWIO_PMIC_ARB6_CHNL97_CONFIG_ADDR A:0x270e004
y.create.l HWIO_PMIC_ARB6_CHNL98_CONFIG_ADDR A:0x2716004
y.create.l HWIO_PMIC_ARB6_CHNL99_CONFIG_ADDR A:0x271e004
y.create.l HWIO_PMIC_ARB6_CHNL100_CONFIG_ADDR A:0x2726004
y.create.l HWIO_PMIC_ARB6_CHNL101_CONFIG_ADDR A:0x272e004
y.create.l HWIO_PMIC_ARB6_CHNL102_CONFIG_ADDR A:0x2736004
y.create.l HWIO_PMIC_ARB6_CHNL103_CONFIG_ADDR A:0x273e004
y.create.l HWIO_PMIC_ARB6_CHNL104_CONFIG_ADDR A:0x2746004
y.create.l HWIO_PMIC_ARB6_CHNL105_CONFIG_ADDR A:0x274e004
y.create.l HWIO_PMIC_ARB6_CHNL106_CONFIG_ADDR A:0x2756004
y.create.l HWIO_PMIC_ARB6_CHNL107_CONFIG_ADDR A:0x275e004
y.create.l HWIO_PMIC_ARB6_CHNL108_CONFIG_ADDR A:0x2766004
y.create.l HWIO_PMIC_ARB6_CHNL109_CONFIG_ADDR A:0x276e004
y.create.l HWIO_PMIC_ARB6_CHNL110_CONFIG_ADDR A:0x2776004
y.create.l HWIO_PMIC_ARB6_CHNL111_CONFIG_ADDR A:0x277e004
y.create.l HWIO_PMIC_ARB6_CHNL112_CONFIG_ADDR A:0x2786004
y.create.l HWIO_PMIC_ARB6_CHNL113_CONFIG_ADDR A:0x278e004
y.create.l HWIO_PMIC_ARB6_CHNL114_CONFIG_ADDR A:0x2796004
y.create.l HWIO_PMIC_ARB6_CHNL115_CONFIG_ADDR A:0x279e004
y.create.l HWIO_PMIC_ARB6_CHNL116_CONFIG_ADDR A:0x27a6004
y.create.l HWIO_PMIC_ARB6_CHNL117_CONFIG_ADDR A:0x27ae004
y.create.l HWIO_PMIC_ARB6_CHNL118_CONFIG_ADDR A:0x27b6004
y.create.l HWIO_PMIC_ARB6_CHNL119_CONFIG_ADDR A:0x27be004
y.create.l HWIO_PMIC_ARB6_CHNL120_CONFIG_ADDR A:0x27c6004
y.create.l HWIO_PMIC_ARB6_CHNL121_CONFIG_ADDR A:0x27ce004
y.create.l HWIO_PMIC_ARB6_CHNL122_CONFIG_ADDR A:0x27d6004
y.create.l HWIO_PMIC_ARB6_CHNL123_CONFIG_ADDR A:0x27de004
y.create.l HWIO_PMIC_ARB6_CHNL124_CONFIG_ADDR A:0x27e6004
y.create.l HWIO_PMIC_ARB6_CHNL125_CONFIG_ADDR A:0x27ee004
y.create.l HWIO_PMIC_ARB6_CHNL126_CONFIG_ADDR A:0x27f6004
y.create.l HWIO_PMIC_ARB6_CHNL127_CONFIG_ADDR A:0x27fe004
y.create.l HWIO_PMIC_ARB6_CHNL128_CONFIG_ADDR A:0x2806004
y.create.l HWIO_PMIC_ARB6_CHNL129_CONFIG_ADDR A:0x280e004
y.create.l HWIO_PMIC_ARB6_CHNL130_CONFIG_ADDR A:0x2816004
y.create.l HWIO_PMIC_ARB6_CHNL131_CONFIG_ADDR A:0x281e004
y.create.l HWIO_PMIC_ARB6_CHNL132_CONFIG_ADDR A:0x2826004
y.create.l HWIO_PMIC_ARB6_CHNL133_CONFIG_ADDR A:0x282e004
y.create.l HWIO_PMIC_ARB6_CHNL134_CONFIG_ADDR A:0x2836004
y.create.l HWIO_PMIC_ARB6_CHNL135_CONFIG_ADDR A:0x283e004
y.create.l HWIO_PMIC_ARB6_CHNL136_CONFIG_ADDR A:0x2846004
y.create.l HWIO_PMIC_ARB6_CHNL137_CONFIG_ADDR A:0x284e004
y.create.l HWIO_PMIC_ARB6_CHNL138_CONFIG_ADDR A:0x2856004
y.create.l HWIO_PMIC_ARB6_CHNL139_CONFIG_ADDR A:0x285e004
y.create.l HWIO_PMIC_ARB6_CHNL140_CONFIG_ADDR A:0x2866004
y.create.l HWIO_PMIC_ARB6_CHNL141_CONFIG_ADDR A:0x286e004
y.create.l HWIO_PMIC_ARB6_CHNL142_CONFIG_ADDR A:0x2876004
y.create.l HWIO_PMIC_ARB6_CHNL143_CONFIG_ADDR A:0x287e004
y.create.l HWIO_PMIC_ARB6_CHNL144_CONFIG_ADDR A:0x2886004
y.create.l HWIO_PMIC_ARB6_CHNL145_CONFIG_ADDR A:0x288e004
y.create.l HWIO_PMIC_ARB6_CHNL146_CONFIG_ADDR A:0x2896004
y.create.l HWIO_PMIC_ARB6_CHNL147_CONFIG_ADDR A:0x289e004
y.create.l HWIO_PMIC_ARB6_CHNL148_CONFIG_ADDR A:0x28a6004
y.create.l HWIO_PMIC_ARB6_CHNL149_CONFIG_ADDR A:0x28ae004
y.create.l HWIO_PMIC_ARB6_CHNL150_CONFIG_ADDR A:0x28b6004
y.create.l HWIO_PMIC_ARB6_CHNL151_CONFIG_ADDR A:0x28be004
y.create.l HWIO_PMIC_ARB6_CHNL152_CONFIG_ADDR A:0x28c6004
y.create.l HWIO_PMIC_ARB6_CHNL153_CONFIG_ADDR A:0x28ce004
y.create.l HWIO_PMIC_ARB6_CHNL154_CONFIG_ADDR A:0x28d6004
y.create.l HWIO_PMIC_ARB6_CHNL155_CONFIG_ADDR A:0x28de004
y.create.l HWIO_PMIC_ARB6_CHNL156_CONFIG_ADDR A:0x28e6004
y.create.l HWIO_PMIC_ARB6_CHNL157_CONFIG_ADDR A:0x28ee004
y.create.l HWIO_PMIC_ARB6_CHNL158_CONFIG_ADDR A:0x28f6004
y.create.l HWIO_PMIC_ARB6_CHNL159_CONFIG_ADDR A:0x28fe004
y.create.l HWIO_PMIC_ARB6_CHNL160_CONFIG_ADDR A:0x2906004
y.create.l HWIO_PMIC_ARB6_CHNL161_CONFIG_ADDR A:0x290e004
y.create.l HWIO_PMIC_ARB6_CHNL162_CONFIG_ADDR A:0x2916004
y.create.l HWIO_PMIC_ARB6_CHNL163_CONFIG_ADDR A:0x291e004
y.create.l HWIO_PMIC_ARB6_CHNL164_CONFIG_ADDR A:0x2926004
y.create.l HWIO_PMIC_ARB6_CHNL165_CONFIG_ADDR A:0x292e004
y.create.l HWIO_PMIC_ARB6_CHNL166_CONFIG_ADDR A:0x2936004
y.create.l HWIO_PMIC_ARB6_CHNL167_CONFIG_ADDR A:0x293e004
y.create.l HWIO_PMIC_ARB6_CHNL168_CONFIG_ADDR A:0x2946004
y.create.l HWIO_PMIC_ARB6_CHNL169_CONFIG_ADDR A:0x294e004
y.create.l HWIO_PMIC_ARB6_CHNL170_CONFIG_ADDR A:0x2956004
y.create.l HWIO_PMIC_ARB6_CHNL171_CONFIG_ADDR A:0x295e004
y.create.l HWIO_PMIC_ARB6_CHNL172_CONFIG_ADDR A:0x2966004
y.create.l HWIO_PMIC_ARB6_CHNL173_CONFIG_ADDR A:0x296e004
y.create.l HWIO_PMIC_ARB6_CHNL174_CONFIG_ADDR A:0x2976004
y.create.l HWIO_PMIC_ARB6_CHNL175_CONFIG_ADDR A:0x297e004
y.create.l HWIO_PMIC_ARB6_CHNL176_CONFIG_ADDR A:0x2986004
y.create.l HWIO_PMIC_ARB6_CHNL177_CONFIG_ADDR A:0x298e004
y.create.l HWIO_PMIC_ARB6_CHNL178_CONFIG_ADDR A:0x2996004
y.create.l HWIO_PMIC_ARB6_CHNL179_CONFIG_ADDR A:0x299e004
y.create.l HWIO_PMIC_ARB6_CHNL180_CONFIG_ADDR A:0x29a6004
y.create.l HWIO_PMIC_ARB6_CHNL181_CONFIG_ADDR A:0x29ae004
y.create.l HWIO_PMIC_ARB6_CHNL182_CONFIG_ADDR A:0x29b6004
y.create.l HWIO_PMIC_ARB6_CHNL183_CONFIG_ADDR A:0x29be004
y.create.l HWIO_PMIC_ARB6_CHNL184_CONFIG_ADDR A:0x29c6004
y.create.l HWIO_PMIC_ARB6_CHNL185_CONFIG_ADDR A:0x29ce004
y.create.l HWIO_PMIC_ARB6_CHNL186_CONFIG_ADDR A:0x29d6004
y.create.l HWIO_PMIC_ARB6_CHNL187_CONFIG_ADDR A:0x29de004
y.create.l HWIO_PMIC_ARB6_CHNL188_CONFIG_ADDR A:0x29e6004
y.create.l HWIO_PMIC_ARB6_CHNL189_CONFIG_ADDR A:0x29ee004
y.create.l HWIO_PMIC_ARB6_CHNL190_CONFIG_ADDR A:0x29f6004
y.create.l HWIO_PMIC_ARB6_CHNL191_CONFIG_ADDR A:0x29fe004
y.create.l HWIO_PMIC_ARB6_CHNL192_CONFIG_ADDR A:0x2a06004
y.create.l HWIO_PMIC_ARB6_CHNL193_CONFIG_ADDR A:0x2a0e004
y.create.l HWIO_PMIC_ARB6_CHNL194_CONFIG_ADDR A:0x2a16004
y.create.l HWIO_PMIC_ARB6_CHNL195_CONFIG_ADDR A:0x2a1e004
y.create.l HWIO_PMIC_ARB6_CHNL196_CONFIG_ADDR A:0x2a26004
y.create.l HWIO_PMIC_ARB6_CHNL197_CONFIG_ADDR A:0x2a2e004
y.create.l HWIO_PMIC_ARB6_CHNL198_CONFIG_ADDR A:0x2a36004
y.create.l HWIO_PMIC_ARB6_CHNL199_CONFIG_ADDR A:0x2a3e004
y.create.l HWIO_PMIC_ARB6_CHNL200_CONFIG_ADDR A:0x2a46004
y.create.l HWIO_PMIC_ARB6_CHNL201_CONFIG_ADDR A:0x2a4e004
y.create.l HWIO_PMIC_ARB6_CHNL202_CONFIG_ADDR A:0x2a56004
y.create.l HWIO_PMIC_ARB6_CHNL203_CONFIG_ADDR A:0x2a5e004
y.create.l HWIO_PMIC_ARB6_CHNL204_CONFIG_ADDR A:0x2a66004
y.create.l HWIO_PMIC_ARB6_CHNL205_CONFIG_ADDR A:0x2a6e004
y.create.l HWIO_PMIC_ARB6_CHNL206_CONFIG_ADDR A:0x2a76004
y.create.l HWIO_PMIC_ARB6_CHNL207_CONFIG_ADDR A:0x2a7e004
y.create.l HWIO_PMIC_ARB6_CHNL208_CONFIG_ADDR A:0x2a86004
y.create.l HWIO_PMIC_ARB6_CHNL209_CONFIG_ADDR A:0x2a8e004
y.create.l HWIO_PMIC_ARB6_CHNL210_CONFIG_ADDR A:0x2a96004
y.create.l HWIO_PMIC_ARB6_CHNL211_CONFIG_ADDR A:0x2a9e004
y.create.l HWIO_PMIC_ARB6_CHNL212_CONFIG_ADDR A:0x2aa6004
y.create.l HWIO_PMIC_ARB6_CHNL213_CONFIG_ADDR A:0x2aae004
y.create.l HWIO_PMIC_ARB6_CHNL214_CONFIG_ADDR A:0x2ab6004
y.create.l HWIO_PMIC_ARB6_CHNL215_CONFIG_ADDR A:0x2abe004
y.create.l HWIO_PMIC_ARB6_CHNL216_CONFIG_ADDR A:0x2ac6004
y.create.l HWIO_PMIC_ARB6_CHNL217_CONFIG_ADDR A:0x2ace004
y.create.l HWIO_PMIC_ARB6_CHNL218_CONFIG_ADDR A:0x2ad6004
y.create.l HWIO_PMIC_ARB6_CHNL219_CONFIG_ADDR A:0x2ade004
y.create.l HWIO_PMIC_ARB6_CHNL220_CONFIG_ADDR A:0x2ae6004
y.create.l HWIO_PMIC_ARB6_CHNL221_CONFIG_ADDR A:0x2aee004
y.create.l HWIO_PMIC_ARB6_CHNL222_CONFIG_ADDR A:0x2af6004
y.create.l HWIO_PMIC_ARB6_CHNL223_CONFIG_ADDR A:0x2afe004
y.create.l HWIO_PMIC_ARB6_CHNL224_CONFIG_ADDR A:0x2b06004
y.create.l HWIO_PMIC_ARB6_CHNL225_CONFIG_ADDR A:0x2b0e004
y.create.l HWIO_PMIC_ARB6_CHNL226_CONFIG_ADDR A:0x2b16004
y.create.l HWIO_PMIC_ARB6_CHNL227_CONFIG_ADDR A:0x2b1e004
y.create.l HWIO_PMIC_ARB6_CHNL228_CONFIG_ADDR A:0x2b26004
y.create.l HWIO_PMIC_ARB6_CHNL229_CONFIG_ADDR A:0x2b2e004
y.create.l HWIO_PMIC_ARB6_CHNL230_CONFIG_ADDR A:0x2b36004
y.create.l HWIO_PMIC_ARB6_CHNL231_CONFIG_ADDR A:0x2b3e004
y.create.l HWIO_PMIC_ARB6_CHNL232_CONFIG_ADDR A:0x2b46004
y.create.l HWIO_PMIC_ARB6_CHNL233_CONFIG_ADDR A:0x2b4e004
y.create.l HWIO_PMIC_ARB6_CHNL234_CONFIG_ADDR A:0x2b56004
y.create.l HWIO_PMIC_ARB6_CHNL235_CONFIG_ADDR A:0x2b5e004
y.create.l HWIO_PMIC_ARB6_CHNL236_CONFIG_ADDR A:0x2b66004
y.create.l HWIO_PMIC_ARB6_CHNL237_CONFIG_ADDR A:0x2b6e004
y.create.l HWIO_PMIC_ARB6_CHNL238_CONFIG_ADDR A:0x2b76004
y.create.l HWIO_PMIC_ARB6_CHNL239_CONFIG_ADDR A:0x2b7e004
y.create.l HWIO_PMIC_ARB6_CHNL240_CONFIG_ADDR A:0x2b86004
y.create.l HWIO_PMIC_ARB6_CHNL241_CONFIG_ADDR A:0x2b8e004
y.create.l HWIO_PMIC_ARB6_CHNL242_CONFIG_ADDR A:0x2b96004
y.create.l HWIO_PMIC_ARB6_CHNL243_CONFIG_ADDR A:0x2b9e004
y.create.l HWIO_PMIC_ARB6_CHNL244_CONFIG_ADDR A:0x2ba6004
y.create.l HWIO_PMIC_ARB6_CHNL245_CONFIG_ADDR A:0x2bae004
y.create.l HWIO_PMIC_ARB6_CHNL246_CONFIG_ADDR A:0x2bb6004
y.create.l HWIO_PMIC_ARB6_CHNL247_CONFIG_ADDR A:0x2bbe004
y.create.l HWIO_PMIC_ARB6_CHNL248_CONFIG_ADDR A:0x2bc6004
y.create.l HWIO_PMIC_ARB6_CHNL249_CONFIG_ADDR A:0x2bce004
y.create.l HWIO_PMIC_ARB6_CHNL250_CONFIG_ADDR A:0x2bd6004
y.create.l HWIO_PMIC_ARB6_CHNL251_CONFIG_ADDR A:0x2bde004
y.create.l HWIO_PMIC_ARB6_CHNL252_CONFIG_ADDR A:0x2be6004
y.create.l HWIO_PMIC_ARB6_CHNL253_CONFIG_ADDR A:0x2bee004
y.create.l HWIO_PMIC_ARB6_CHNL254_CONFIG_ADDR A:0x2bf6004
y.create.l HWIO_PMIC_ARB6_CHNL255_CONFIG_ADDR A:0x2bfe004
y.create.l HWIO_PMIC_ARB0_CHNL0_STATUS_ADDR A:0x2400008
y.create.l HWIO_PMIC_ARB0_CHNL1_STATUS_ADDR A:0x2408008
y.create.l HWIO_PMIC_ARB0_CHNL2_STATUS_ADDR A:0x2410008
y.create.l HWIO_PMIC_ARB0_CHNL3_STATUS_ADDR A:0x2418008
y.create.l HWIO_PMIC_ARB0_CHNL4_STATUS_ADDR A:0x2420008
y.create.l HWIO_PMIC_ARB0_CHNL5_STATUS_ADDR A:0x2428008
y.create.l HWIO_PMIC_ARB0_CHNL6_STATUS_ADDR A:0x2430008
y.create.l HWIO_PMIC_ARB0_CHNL7_STATUS_ADDR A:0x2438008
y.create.l HWIO_PMIC_ARB0_CHNL8_STATUS_ADDR A:0x2440008
y.create.l HWIO_PMIC_ARB0_CHNL9_STATUS_ADDR A:0x2448008
y.create.l HWIO_PMIC_ARB0_CHNL10_STATUS_ADDR A:0x2450008
y.create.l HWIO_PMIC_ARB0_CHNL11_STATUS_ADDR A:0x2458008
y.create.l HWIO_PMIC_ARB0_CHNL12_STATUS_ADDR A:0x2460008
y.create.l HWIO_PMIC_ARB0_CHNL13_STATUS_ADDR A:0x2468008
y.create.l HWIO_PMIC_ARB0_CHNL14_STATUS_ADDR A:0x2470008
y.create.l HWIO_PMIC_ARB0_CHNL15_STATUS_ADDR A:0x2478008
y.create.l HWIO_PMIC_ARB0_CHNL16_STATUS_ADDR A:0x2480008
y.create.l HWIO_PMIC_ARB0_CHNL17_STATUS_ADDR A:0x2488008
y.create.l HWIO_PMIC_ARB0_CHNL18_STATUS_ADDR A:0x2490008
y.create.l HWIO_PMIC_ARB0_CHNL19_STATUS_ADDR A:0x2498008
y.create.l HWIO_PMIC_ARB0_CHNL20_STATUS_ADDR A:0x24a0008
y.create.l HWIO_PMIC_ARB0_CHNL21_STATUS_ADDR A:0x24a8008
y.create.l HWIO_PMIC_ARB0_CHNL22_STATUS_ADDR A:0x24b0008
y.create.l HWIO_PMIC_ARB0_CHNL23_STATUS_ADDR A:0x24b8008
y.create.l HWIO_PMIC_ARB0_CHNL24_STATUS_ADDR A:0x24c0008
y.create.l HWIO_PMIC_ARB0_CHNL25_STATUS_ADDR A:0x24c8008
y.create.l HWIO_PMIC_ARB0_CHNL26_STATUS_ADDR A:0x24d0008
y.create.l HWIO_PMIC_ARB0_CHNL27_STATUS_ADDR A:0x24d8008
y.create.l HWIO_PMIC_ARB0_CHNL28_STATUS_ADDR A:0x24e0008
y.create.l HWIO_PMIC_ARB0_CHNL29_STATUS_ADDR A:0x24e8008
y.create.l HWIO_PMIC_ARB0_CHNL30_STATUS_ADDR A:0x24f0008
y.create.l HWIO_PMIC_ARB0_CHNL31_STATUS_ADDR A:0x24f8008
y.create.l HWIO_PMIC_ARB0_CHNL32_STATUS_ADDR A:0x2500008
y.create.l HWIO_PMIC_ARB0_CHNL33_STATUS_ADDR A:0x2508008
y.create.l HWIO_PMIC_ARB0_CHNL34_STATUS_ADDR A:0x2510008
y.create.l HWIO_PMIC_ARB0_CHNL35_STATUS_ADDR A:0x2518008
y.create.l HWIO_PMIC_ARB0_CHNL36_STATUS_ADDR A:0x2520008
y.create.l HWIO_PMIC_ARB0_CHNL37_STATUS_ADDR A:0x2528008
y.create.l HWIO_PMIC_ARB0_CHNL38_STATUS_ADDR A:0x2530008
y.create.l HWIO_PMIC_ARB0_CHNL39_STATUS_ADDR A:0x2538008
y.create.l HWIO_PMIC_ARB0_CHNL40_STATUS_ADDR A:0x2540008
y.create.l HWIO_PMIC_ARB0_CHNL41_STATUS_ADDR A:0x2548008
y.create.l HWIO_PMIC_ARB0_CHNL42_STATUS_ADDR A:0x2550008
y.create.l HWIO_PMIC_ARB0_CHNL43_STATUS_ADDR A:0x2558008
y.create.l HWIO_PMIC_ARB0_CHNL44_STATUS_ADDR A:0x2560008
y.create.l HWIO_PMIC_ARB0_CHNL45_STATUS_ADDR A:0x2568008
y.create.l HWIO_PMIC_ARB0_CHNL46_STATUS_ADDR A:0x2570008
y.create.l HWIO_PMIC_ARB0_CHNL47_STATUS_ADDR A:0x2578008
y.create.l HWIO_PMIC_ARB0_CHNL48_STATUS_ADDR A:0x2580008
y.create.l HWIO_PMIC_ARB0_CHNL49_STATUS_ADDR A:0x2588008
y.create.l HWIO_PMIC_ARB0_CHNL50_STATUS_ADDR A:0x2590008
y.create.l HWIO_PMIC_ARB0_CHNL51_STATUS_ADDR A:0x2598008
y.create.l HWIO_PMIC_ARB0_CHNL52_STATUS_ADDR A:0x25a0008
y.create.l HWIO_PMIC_ARB0_CHNL53_STATUS_ADDR A:0x25a8008
y.create.l HWIO_PMIC_ARB0_CHNL54_STATUS_ADDR A:0x25b0008
y.create.l HWIO_PMIC_ARB0_CHNL55_STATUS_ADDR A:0x25b8008
y.create.l HWIO_PMIC_ARB0_CHNL56_STATUS_ADDR A:0x25c0008
y.create.l HWIO_PMIC_ARB0_CHNL57_STATUS_ADDR A:0x25c8008
y.create.l HWIO_PMIC_ARB0_CHNL58_STATUS_ADDR A:0x25d0008
y.create.l HWIO_PMIC_ARB0_CHNL59_STATUS_ADDR A:0x25d8008
y.create.l HWIO_PMIC_ARB0_CHNL60_STATUS_ADDR A:0x25e0008
y.create.l HWIO_PMIC_ARB0_CHNL61_STATUS_ADDR A:0x25e8008
y.create.l HWIO_PMIC_ARB0_CHNL62_STATUS_ADDR A:0x25f0008
y.create.l HWIO_PMIC_ARB0_CHNL63_STATUS_ADDR A:0x25f8008
y.create.l HWIO_PMIC_ARB0_CHNL64_STATUS_ADDR A:0x2600008
y.create.l HWIO_PMIC_ARB0_CHNL65_STATUS_ADDR A:0x2608008
y.create.l HWIO_PMIC_ARB0_CHNL66_STATUS_ADDR A:0x2610008
y.create.l HWIO_PMIC_ARB0_CHNL67_STATUS_ADDR A:0x2618008
y.create.l HWIO_PMIC_ARB0_CHNL68_STATUS_ADDR A:0x2620008
y.create.l HWIO_PMIC_ARB0_CHNL69_STATUS_ADDR A:0x2628008
y.create.l HWIO_PMIC_ARB0_CHNL70_STATUS_ADDR A:0x2630008
y.create.l HWIO_PMIC_ARB0_CHNL71_STATUS_ADDR A:0x2638008
y.create.l HWIO_PMIC_ARB0_CHNL72_STATUS_ADDR A:0x2640008
y.create.l HWIO_PMIC_ARB0_CHNL73_STATUS_ADDR A:0x2648008
y.create.l HWIO_PMIC_ARB0_CHNL74_STATUS_ADDR A:0x2650008
y.create.l HWIO_PMIC_ARB0_CHNL75_STATUS_ADDR A:0x2658008
y.create.l HWIO_PMIC_ARB0_CHNL76_STATUS_ADDR A:0x2660008
y.create.l HWIO_PMIC_ARB0_CHNL77_STATUS_ADDR A:0x2668008
y.create.l HWIO_PMIC_ARB0_CHNL78_STATUS_ADDR A:0x2670008
y.create.l HWIO_PMIC_ARB0_CHNL79_STATUS_ADDR A:0x2678008
y.create.l HWIO_PMIC_ARB0_CHNL80_STATUS_ADDR A:0x2680008
y.create.l HWIO_PMIC_ARB0_CHNL81_STATUS_ADDR A:0x2688008
y.create.l HWIO_PMIC_ARB0_CHNL82_STATUS_ADDR A:0x2690008
y.create.l HWIO_PMIC_ARB0_CHNL83_STATUS_ADDR A:0x2698008
y.create.l HWIO_PMIC_ARB0_CHNL84_STATUS_ADDR A:0x26a0008
y.create.l HWIO_PMIC_ARB0_CHNL85_STATUS_ADDR A:0x26a8008
y.create.l HWIO_PMIC_ARB0_CHNL86_STATUS_ADDR A:0x26b0008
y.create.l HWIO_PMIC_ARB0_CHNL87_STATUS_ADDR A:0x26b8008
y.create.l HWIO_PMIC_ARB0_CHNL88_STATUS_ADDR A:0x26c0008
y.create.l HWIO_PMIC_ARB0_CHNL89_STATUS_ADDR A:0x26c8008
y.create.l HWIO_PMIC_ARB0_CHNL90_STATUS_ADDR A:0x26d0008
y.create.l HWIO_PMIC_ARB0_CHNL91_STATUS_ADDR A:0x26d8008
y.create.l HWIO_PMIC_ARB0_CHNL92_STATUS_ADDR A:0x26e0008
y.create.l HWIO_PMIC_ARB0_CHNL93_STATUS_ADDR A:0x26e8008
y.create.l HWIO_PMIC_ARB0_CHNL94_STATUS_ADDR A:0x26f0008
y.create.l HWIO_PMIC_ARB0_CHNL95_STATUS_ADDR A:0x26f8008
y.create.l HWIO_PMIC_ARB0_CHNL96_STATUS_ADDR A:0x2700008
y.create.l HWIO_PMIC_ARB0_CHNL97_STATUS_ADDR A:0x2708008
y.create.l HWIO_PMIC_ARB0_CHNL98_STATUS_ADDR A:0x2710008
y.create.l HWIO_PMIC_ARB0_CHNL99_STATUS_ADDR A:0x2718008
y.create.l HWIO_PMIC_ARB0_CHNL100_STATUS_ADDR A:0x2720008
y.create.l HWIO_PMIC_ARB0_CHNL101_STATUS_ADDR A:0x2728008
y.create.l HWIO_PMIC_ARB0_CHNL102_STATUS_ADDR A:0x2730008
y.create.l HWIO_PMIC_ARB0_CHNL103_STATUS_ADDR A:0x2738008
y.create.l HWIO_PMIC_ARB0_CHNL104_STATUS_ADDR A:0x2740008
y.create.l HWIO_PMIC_ARB0_CHNL105_STATUS_ADDR A:0x2748008
y.create.l HWIO_PMIC_ARB0_CHNL106_STATUS_ADDR A:0x2750008
y.create.l HWIO_PMIC_ARB0_CHNL107_STATUS_ADDR A:0x2758008
y.create.l HWIO_PMIC_ARB0_CHNL108_STATUS_ADDR A:0x2760008
y.create.l HWIO_PMIC_ARB0_CHNL109_STATUS_ADDR A:0x2768008
y.create.l HWIO_PMIC_ARB0_CHNL110_STATUS_ADDR A:0x2770008
y.create.l HWIO_PMIC_ARB0_CHNL111_STATUS_ADDR A:0x2778008
y.create.l HWIO_PMIC_ARB0_CHNL112_STATUS_ADDR A:0x2780008
y.create.l HWIO_PMIC_ARB0_CHNL113_STATUS_ADDR A:0x2788008
y.create.l HWIO_PMIC_ARB0_CHNL114_STATUS_ADDR A:0x2790008
y.create.l HWIO_PMIC_ARB0_CHNL115_STATUS_ADDR A:0x2798008
y.create.l HWIO_PMIC_ARB0_CHNL116_STATUS_ADDR A:0x27a0008
y.create.l HWIO_PMIC_ARB0_CHNL117_STATUS_ADDR A:0x27a8008
y.create.l HWIO_PMIC_ARB0_CHNL118_STATUS_ADDR A:0x27b0008
y.create.l HWIO_PMIC_ARB0_CHNL119_STATUS_ADDR A:0x27b8008
y.create.l HWIO_PMIC_ARB0_CHNL120_STATUS_ADDR A:0x27c0008
y.create.l HWIO_PMIC_ARB0_CHNL121_STATUS_ADDR A:0x27c8008
y.create.l HWIO_PMIC_ARB0_CHNL122_STATUS_ADDR A:0x27d0008
y.create.l HWIO_PMIC_ARB0_CHNL123_STATUS_ADDR A:0x27d8008
y.create.l HWIO_PMIC_ARB0_CHNL124_STATUS_ADDR A:0x27e0008
y.create.l HWIO_PMIC_ARB0_CHNL125_STATUS_ADDR A:0x27e8008
y.create.l HWIO_PMIC_ARB0_CHNL126_STATUS_ADDR A:0x27f0008
y.create.l HWIO_PMIC_ARB0_CHNL127_STATUS_ADDR A:0x27f8008
y.create.l HWIO_PMIC_ARB0_CHNL128_STATUS_ADDR A:0x2800008
y.create.l HWIO_PMIC_ARB0_CHNL129_STATUS_ADDR A:0x2808008
y.create.l HWIO_PMIC_ARB0_CHNL130_STATUS_ADDR A:0x2810008
y.create.l HWIO_PMIC_ARB0_CHNL131_STATUS_ADDR A:0x2818008
y.create.l HWIO_PMIC_ARB0_CHNL132_STATUS_ADDR A:0x2820008
y.create.l HWIO_PMIC_ARB0_CHNL133_STATUS_ADDR A:0x2828008
y.create.l HWIO_PMIC_ARB0_CHNL134_STATUS_ADDR A:0x2830008
y.create.l HWIO_PMIC_ARB0_CHNL135_STATUS_ADDR A:0x2838008
y.create.l HWIO_PMIC_ARB0_CHNL136_STATUS_ADDR A:0x2840008
y.create.l HWIO_PMIC_ARB0_CHNL137_STATUS_ADDR A:0x2848008
y.create.l HWIO_PMIC_ARB0_CHNL138_STATUS_ADDR A:0x2850008
y.create.l HWIO_PMIC_ARB0_CHNL139_STATUS_ADDR A:0x2858008
y.create.l HWIO_PMIC_ARB0_CHNL140_STATUS_ADDR A:0x2860008
y.create.l HWIO_PMIC_ARB0_CHNL141_STATUS_ADDR A:0x2868008
y.create.l HWIO_PMIC_ARB0_CHNL142_STATUS_ADDR A:0x2870008
y.create.l HWIO_PMIC_ARB0_CHNL143_STATUS_ADDR A:0x2878008
y.create.l HWIO_PMIC_ARB0_CHNL144_STATUS_ADDR A:0x2880008
y.create.l HWIO_PMIC_ARB0_CHNL145_STATUS_ADDR A:0x2888008
y.create.l HWIO_PMIC_ARB0_CHNL146_STATUS_ADDR A:0x2890008
y.create.l HWIO_PMIC_ARB0_CHNL147_STATUS_ADDR A:0x2898008
y.create.l HWIO_PMIC_ARB0_CHNL148_STATUS_ADDR A:0x28a0008
y.create.l HWIO_PMIC_ARB0_CHNL149_STATUS_ADDR A:0x28a8008
y.create.l HWIO_PMIC_ARB0_CHNL150_STATUS_ADDR A:0x28b0008
y.create.l HWIO_PMIC_ARB0_CHNL151_STATUS_ADDR A:0x28b8008
y.create.l HWIO_PMIC_ARB0_CHNL152_STATUS_ADDR A:0x28c0008
y.create.l HWIO_PMIC_ARB0_CHNL153_STATUS_ADDR A:0x28c8008
y.create.l HWIO_PMIC_ARB0_CHNL154_STATUS_ADDR A:0x28d0008
y.create.l HWIO_PMIC_ARB0_CHNL155_STATUS_ADDR A:0x28d8008
y.create.l HWIO_PMIC_ARB0_CHNL156_STATUS_ADDR A:0x28e0008
y.create.l HWIO_PMIC_ARB0_CHNL157_STATUS_ADDR A:0x28e8008
y.create.l HWIO_PMIC_ARB0_CHNL158_STATUS_ADDR A:0x28f0008
y.create.l HWIO_PMIC_ARB0_CHNL159_STATUS_ADDR A:0x28f8008
y.create.l HWIO_PMIC_ARB0_CHNL160_STATUS_ADDR A:0x2900008
y.create.l HWIO_PMIC_ARB0_CHNL161_STATUS_ADDR A:0x2908008
y.create.l HWIO_PMIC_ARB0_CHNL162_STATUS_ADDR A:0x2910008
y.create.l HWIO_PMIC_ARB0_CHNL163_STATUS_ADDR A:0x2918008
y.create.l HWIO_PMIC_ARB0_CHNL164_STATUS_ADDR A:0x2920008
y.create.l HWIO_PMIC_ARB0_CHNL165_STATUS_ADDR A:0x2928008
y.create.l HWIO_PMIC_ARB0_CHNL166_STATUS_ADDR A:0x2930008
y.create.l HWIO_PMIC_ARB0_CHNL167_STATUS_ADDR A:0x2938008
y.create.l HWIO_PMIC_ARB0_CHNL168_STATUS_ADDR A:0x2940008
y.create.l HWIO_PMIC_ARB0_CHNL169_STATUS_ADDR A:0x2948008
y.create.l HWIO_PMIC_ARB0_CHNL170_STATUS_ADDR A:0x2950008
y.create.l HWIO_PMIC_ARB0_CHNL171_STATUS_ADDR A:0x2958008
y.create.l HWIO_PMIC_ARB0_CHNL172_STATUS_ADDR A:0x2960008
y.create.l HWIO_PMIC_ARB0_CHNL173_STATUS_ADDR A:0x2968008
y.create.l HWIO_PMIC_ARB0_CHNL174_STATUS_ADDR A:0x2970008
y.create.l HWIO_PMIC_ARB0_CHNL175_STATUS_ADDR A:0x2978008
y.create.l HWIO_PMIC_ARB0_CHNL176_STATUS_ADDR A:0x2980008
y.create.l HWIO_PMIC_ARB0_CHNL177_STATUS_ADDR A:0x2988008
y.create.l HWIO_PMIC_ARB0_CHNL178_STATUS_ADDR A:0x2990008
y.create.l HWIO_PMIC_ARB0_CHNL179_STATUS_ADDR A:0x2998008
y.create.l HWIO_PMIC_ARB0_CHNL180_STATUS_ADDR A:0x29a0008
y.create.l HWIO_PMIC_ARB0_CHNL181_STATUS_ADDR A:0x29a8008
y.create.l HWIO_PMIC_ARB0_CHNL182_STATUS_ADDR A:0x29b0008
y.create.l HWIO_PMIC_ARB0_CHNL183_STATUS_ADDR A:0x29b8008
y.create.l HWIO_PMIC_ARB0_CHNL184_STATUS_ADDR A:0x29c0008
y.create.l HWIO_PMIC_ARB0_CHNL185_STATUS_ADDR A:0x29c8008
y.create.l HWIO_PMIC_ARB0_CHNL186_STATUS_ADDR A:0x29d0008
y.create.l HWIO_PMIC_ARB0_CHNL187_STATUS_ADDR A:0x29d8008
y.create.l HWIO_PMIC_ARB0_CHNL188_STATUS_ADDR A:0x29e0008
y.create.l HWIO_PMIC_ARB0_CHNL189_STATUS_ADDR A:0x29e8008
y.create.l HWIO_PMIC_ARB0_CHNL190_STATUS_ADDR A:0x29f0008
y.create.l HWIO_PMIC_ARB0_CHNL191_STATUS_ADDR A:0x29f8008
y.create.l HWIO_PMIC_ARB0_CHNL192_STATUS_ADDR A:0x2a00008
y.create.l HWIO_PMIC_ARB0_CHNL193_STATUS_ADDR A:0x2a08008
y.create.l HWIO_PMIC_ARB0_CHNL194_STATUS_ADDR A:0x2a10008
y.create.l HWIO_PMIC_ARB0_CHNL195_STATUS_ADDR A:0x2a18008
y.create.l HWIO_PMIC_ARB0_CHNL196_STATUS_ADDR A:0x2a20008
y.create.l HWIO_PMIC_ARB0_CHNL197_STATUS_ADDR A:0x2a28008
y.create.l HWIO_PMIC_ARB0_CHNL198_STATUS_ADDR A:0x2a30008
y.create.l HWIO_PMIC_ARB0_CHNL199_STATUS_ADDR A:0x2a38008
y.create.l HWIO_PMIC_ARB0_CHNL200_STATUS_ADDR A:0x2a40008
y.create.l HWIO_PMIC_ARB0_CHNL201_STATUS_ADDR A:0x2a48008
y.create.l HWIO_PMIC_ARB0_CHNL202_STATUS_ADDR A:0x2a50008
y.create.l HWIO_PMIC_ARB0_CHNL203_STATUS_ADDR A:0x2a58008
y.create.l HWIO_PMIC_ARB0_CHNL204_STATUS_ADDR A:0x2a60008
y.create.l HWIO_PMIC_ARB0_CHNL205_STATUS_ADDR A:0x2a68008
y.create.l HWIO_PMIC_ARB0_CHNL206_STATUS_ADDR A:0x2a70008
y.create.l HWIO_PMIC_ARB0_CHNL207_STATUS_ADDR A:0x2a78008
y.create.l HWIO_PMIC_ARB0_CHNL208_STATUS_ADDR A:0x2a80008
y.create.l HWIO_PMIC_ARB0_CHNL209_STATUS_ADDR A:0x2a88008
y.create.l HWIO_PMIC_ARB0_CHNL210_STATUS_ADDR A:0x2a90008
y.create.l HWIO_PMIC_ARB0_CHNL211_STATUS_ADDR A:0x2a98008
y.create.l HWIO_PMIC_ARB0_CHNL212_STATUS_ADDR A:0x2aa0008
y.create.l HWIO_PMIC_ARB0_CHNL213_STATUS_ADDR A:0x2aa8008
y.create.l HWIO_PMIC_ARB0_CHNL214_STATUS_ADDR A:0x2ab0008
y.create.l HWIO_PMIC_ARB0_CHNL215_STATUS_ADDR A:0x2ab8008
y.create.l HWIO_PMIC_ARB0_CHNL216_STATUS_ADDR A:0x2ac0008
y.create.l HWIO_PMIC_ARB0_CHNL217_STATUS_ADDR A:0x2ac8008
y.create.l HWIO_PMIC_ARB0_CHNL218_STATUS_ADDR A:0x2ad0008
y.create.l HWIO_PMIC_ARB0_CHNL219_STATUS_ADDR A:0x2ad8008
y.create.l HWIO_PMIC_ARB0_CHNL220_STATUS_ADDR A:0x2ae0008
y.create.l HWIO_PMIC_ARB0_CHNL221_STATUS_ADDR A:0x2ae8008
y.create.l HWIO_PMIC_ARB0_CHNL222_STATUS_ADDR A:0x2af0008
y.create.l HWIO_PMIC_ARB0_CHNL223_STATUS_ADDR A:0x2af8008
y.create.l HWIO_PMIC_ARB0_CHNL224_STATUS_ADDR A:0x2b00008
y.create.l HWIO_PMIC_ARB0_CHNL225_STATUS_ADDR A:0x2b08008
y.create.l HWIO_PMIC_ARB0_CHNL226_STATUS_ADDR A:0x2b10008
y.create.l HWIO_PMIC_ARB0_CHNL227_STATUS_ADDR A:0x2b18008
y.create.l HWIO_PMIC_ARB0_CHNL228_STATUS_ADDR A:0x2b20008
y.create.l HWIO_PMIC_ARB0_CHNL229_STATUS_ADDR A:0x2b28008
y.create.l HWIO_PMIC_ARB0_CHNL230_STATUS_ADDR A:0x2b30008
y.create.l HWIO_PMIC_ARB0_CHNL231_STATUS_ADDR A:0x2b38008
y.create.l HWIO_PMIC_ARB0_CHNL232_STATUS_ADDR A:0x2b40008
y.create.l HWIO_PMIC_ARB0_CHNL233_STATUS_ADDR A:0x2b48008
y.create.l HWIO_PMIC_ARB0_CHNL234_STATUS_ADDR A:0x2b50008
y.create.l HWIO_PMIC_ARB0_CHNL235_STATUS_ADDR A:0x2b58008
y.create.l HWIO_PMIC_ARB0_CHNL236_STATUS_ADDR A:0x2b60008
y.create.l HWIO_PMIC_ARB0_CHNL237_STATUS_ADDR A:0x2b68008
y.create.l HWIO_PMIC_ARB0_CHNL238_STATUS_ADDR A:0x2b70008
y.create.l HWIO_PMIC_ARB0_CHNL239_STATUS_ADDR A:0x2b78008
y.create.l HWIO_PMIC_ARB0_CHNL240_STATUS_ADDR A:0x2b80008
y.create.l HWIO_PMIC_ARB0_CHNL241_STATUS_ADDR A:0x2b88008
y.create.l HWIO_PMIC_ARB0_CHNL242_STATUS_ADDR A:0x2b90008
y.create.l HWIO_PMIC_ARB0_CHNL243_STATUS_ADDR A:0x2b98008
y.create.l HWIO_PMIC_ARB0_CHNL244_STATUS_ADDR A:0x2ba0008
y.create.l HWIO_PMIC_ARB0_CHNL245_STATUS_ADDR A:0x2ba8008
y.create.l HWIO_PMIC_ARB0_CHNL246_STATUS_ADDR A:0x2bb0008
y.create.l HWIO_PMIC_ARB0_CHNL247_STATUS_ADDR A:0x2bb8008
y.create.l HWIO_PMIC_ARB0_CHNL248_STATUS_ADDR A:0x2bc0008
y.create.l HWIO_PMIC_ARB0_CHNL249_STATUS_ADDR A:0x2bc8008
y.create.l HWIO_PMIC_ARB0_CHNL250_STATUS_ADDR A:0x2bd0008
y.create.l HWIO_PMIC_ARB0_CHNL251_STATUS_ADDR A:0x2bd8008
y.create.l HWIO_PMIC_ARB0_CHNL252_STATUS_ADDR A:0x2be0008
y.create.l HWIO_PMIC_ARB0_CHNL253_STATUS_ADDR A:0x2be8008
y.create.l HWIO_PMIC_ARB0_CHNL254_STATUS_ADDR A:0x2bf0008
y.create.l HWIO_PMIC_ARB0_CHNL255_STATUS_ADDR A:0x2bf8008
y.create.l HWIO_PMIC_ARB1_CHNL0_STATUS_ADDR A:0x2401008
y.create.l HWIO_PMIC_ARB1_CHNL1_STATUS_ADDR A:0x2409008
y.create.l HWIO_PMIC_ARB1_CHNL2_STATUS_ADDR A:0x2411008
y.create.l HWIO_PMIC_ARB1_CHNL3_STATUS_ADDR A:0x2419008
y.create.l HWIO_PMIC_ARB1_CHNL4_STATUS_ADDR A:0x2421008
y.create.l HWIO_PMIC_ARB1_CHNL5_STATUS_ADDR A:0x2429008
y.create.l HWIO_PMIC_ARB1_CHNL6_STATUS_ADDR A:0x2431008
y.create.l HWIO_PMIC_ARB1_CHNL7_STATUS_ADDR A:0x2439008
y.create.l HWIO_PMIC_ARB1_CHNL8_STATUS_ADDR A:0x2441008
y.create.l HWIO_PMIC_ARB1_CHNL9_STATUS_ADDR A:0x2449008
y.create.l HWIO_PMIC_ARB1_CHNL10_STATUS_ADDR A:0x2451008
y.create.l HWIO_PMIC_ARB1_CHNL11_STATUS_ADDR A:0x2459008
y.create.l HWIO_PMIC_ARB1_CHNL12_STATUS_ADDR A:0x2461008
y.create.l HWIO_PMIC_ARB1_CHNL13_STATUS_ADDR A:0x2469008
y.create.l HWIO_PMIC_ARB1_CHNL14_STATUS_ADDR A:0x2471008
y.create.l HWIO_PMIC_ARB1_CHNL15_STATUS_ADDR A:0x2479008
y.create.l HWIO_PMIC_ARB1_CHNL16_STATUS_ADDR A:0x2481008
y.create.l HWIO_PMIC_ARB1_CHNL17_STATUS_ADDR A:0x2489008
y.create.l HWIO_PMIC_ARB1_CHNL18_STATUS_ADDR A:0x2491008
y.create.l HWIO_PMIC_ARB1_CHNL19_STATUS_ADDR A:0x2499008
y.create.l HWIO_PMIC_ARB1_CHNL20_STATUS_ADDR A:0x24a1008
y.create.l HWIO_PMIC_ARB1_CHNL21_STATUS_ADDR A:0x24a9008
y.create.l HWIO_PMIC_ARB1_CHNL22_STATUS_ADDR A:0x24b1008
y.create.l HWIO_PMIC_ARB1_CHNL23_STATUS_ADDR A:0x24b9008
y.create.l HWIO_PMIC_ARB1_CHNL24_STATUS_ADDR A:0x24c1008
y.create.l HWIO_PMIC_ARB1_CHNL25_STATUS_ADDR A:0x24c9008
y.create.l HWIO_PMIC_ARB1_CHNL26_STATUS_ADDR A:0x24d1008
y.create.l HWIO_PMIC_ARB1_CHNL27_STATUS_ADDR A:0x24d9008
y.create.l HWIO_PMIC_ARB1_CHNL28_STATUS_ADDR A:0x24e1008
y.create.l HWIO_PMIC_ARB1_CHNL29_STATUS_ADDR A:0x24e9008
y.create.l HWIO_PMIC_ARB1_CHNL30_STATUS_ADDR A:0x24f1008
y.create.l HWIO_PMIC_ARB1_CHNL31_STATUS_ADDR A:0x24f9008
y.create.l HWIO_PMIC_ARB1_CHNL32_STATUS_ADDR A:0x2501008
y.create.l HWIO_PMIC_ARB1_CHNL33_STATUS_ADDR A:0x2509008
y.create.l HWIO_PMIC_ARB1_CHNL34_STATUS_ADDR A:0x2511008
y.create.l HWIO_PMIC_ARB1_CHNL35_STATUS_ADDR A:0x2519008
y.create.l HWIO_PMIC_ARB1_CHNL36_STATUS_ADDR A:0x2521008
y.create.l HWIO_PMIC_ARB1_CHNL37_STATUS_ADDR A:0x2529008
y.create.l HWIO_PMIC_ARB1_CHNL38_STATUS_ADDR A:0x2531008
y.create.l HWIO_PMIC_ARB1_CHNL39_STATUS_ADDR A:0x2539008
y.create.l HWIO_PMIC_ARB1_CHNL40_STATUS_ADDR A:0x2541008
y.create.l HWIO_PMIC_ARB1_CHNL41_STATUS_ADDR A:0x2549008
y.create.l HWIO_PMIC_ARB1_CHNL42_STATUS_ADDR A:0x2551008
y.create.l HWIO_PMIC_ARB1_CHNL43_STATUS_ADDR A:0x2559008
y.create.l HWIO_PMIC_ARB1_CHNL44_STATUS_ADDR A:0x2561008
y.create.l HWIO_PMIC_ARB1_CHNL45_STATUS_ADDR A:0x2569008
y.create.l HWIO_PMIC_ARB1_CHNL46_STATUS_ADDR A:0x2571008
y.create.l HWIO_PMIC_ARB1_CHNL47_STATUS_ADDR A:0x2579008
y.create.l HWIO_PMIC_ARB1_CHNL48_STATUS_ADDR A:0x2581008
y.create.l HWIO_PMIC_ARB1_CHNL49_STATUS_ADDR A:0x2589008
y.create.l HWIO_PMIC_ARB1_CHNL50_STATUS_ADDR A:0x2591008
y.create.l HWIO_PMIC_ARB1_CHNL51_STATUS_ADDR A:0x2599008
y.create.l HWIO_PMIC_ARB1_CHNL52_STATUS_ADDR A:0x25a1008
y.create.l HWIO_PMIC_ARB1_CHNL53_STATUS_ADDR A:0x25a9008
y.create.l HWIO_PMIC_ARB1_CHNL54_STATUS_ADDR A:0x25b1008
y.create.l HWIO_PMIC_ARB1_CHNL55_STATUS_ADDR A:0x25b9008
y.create.l HWIO_PMIC_ARB1_CHNL56_STATUS_ADDR A:0x25c1008
y.create.l HWIO_PMIC_ARB1_CHNL57_STATUS_ADDR A:0x25c9008
y.create.l HWIO_PMIC_ARB1_CHNL58_STATUS_ADDR A:0x25d1008
y.create.l HWIO_PMIC_ARB1_CHNL59_STATUS_ADDR A:0x25d9008
y.create.l HWIO_PMIC_ARB1_CHNL60_STATUS_ADDR A:0x25e1008
y.create.l HWIO_PMIC_ARB1_CHNL61_STATUS_ADDR A:0x25e9008
y.create.l HWIO_PMIC_ARB1_CHNL62_STATUS_ADDR A:0x25f1008
y.create.l HWIO_PMIC_ARB1_CHNL63_STATUS_ADDR A:0x25f9008
y.create.l HWIO_PMIC_ARB1_CHNL64_STATUS_ADDR A:0x2601008
y.create.l HWIO_PMIC_ARB1_CHNL65_STATUS_ADDR A:0x2609008
y.create.l HWIO_PMIC_ARB1_CHNL66_STATUS_ADDR A:0x2611008
y.create.l HWIO_PMIC_ARB1_CHNL67_STATUS_ADDR A:0x2619008
y.create.l HWIO_PMIC_ARB1_CHNL68_STATUS_ADDR A:0x2621008
y.create.l HWIO_PMIC_ARB1_CHNL69_STATUS_ADDR A:0x2629008
y.create.l HWIO_PMIC_ARB1_CHNL70_STATUS_ADDR A:0x2631008
y.create.l HWIO_PMIC_ARB1_CHNL71_STATUS_ADDR A:0x2639008
y.create.l HWIO_PMIC_ARB1_CHNL72_STATUS_ADDR A:0x2641008
y.create.l HWIO_PMIC_ARB1_CHNL73_STATUS_ADDR A:0x2649008
y.create.l HWIO_PMIC_ARB1_CHNL74_STATUS_ADDR A:0x2651008
y.create.l HWIO_PMIC_ARB1_CHNL75_STATUS_ADDR A:0x2659008
y.create.l HWIO_PMIC_ARB1_CHNL76_STATUS_ADDR A:0x2661008
y.create.l HWIO_PMIC_ARB1_CHNL77_STATUS_ADDR A:0x2669008
y.create.l HWIO_PMIC_ARB1_CHNL78_STATUS_ADDR A:0x2671008
y.create.l HWIO_PMIC_ARB1_CHNL79_STATUS_ADDR A:0x2679008
y.create.l HWIO_PMIC_ARB1_CHNL80_STATUS_ADDR A:0x2681008
y.create.l HWIO_PMIC_ARB1_CHNL81_STATUS_ADDR A:0x2689008
y.create.l HWIO_PMIC_ARB1_CHNL82_STATUS_ADDR A:0x2691008
y.create.l HWIO_PMIC_ARB1_CHNL83_STATUS_ADDR A:0x2699008
y.create.l HWIO_PMIC_ARB1_CHNL84_STATUS_ADDR A:0x26a1008
y.create.l HWIO_PMIC_ARB1_CHNL85_STATUS_ADDR A:0x26a9008
y.create.l HWIO_PMIC_ARB1_CHNL86_STATUS_ADDR A:0x26b1008
y.create.l HWIO_PMIC_ARB1_CHNL87_STATUS_ADDR A:0x26b9008
y.create.l HWIO_PMIC_ARB1_CHNL88_STATUS_ADDR A:0x26c1008
y.create.l HWIO_PMIC_ARB1_CHNL89_STATUS_ADDR A:0x26c9008
y.create.l HWIO_PMIC_ARB1_CHNL90_STATUS_ADDR A:0x26d1008
y.create.l HWIO_PMIC_ARB1_CHNL91_STATUS_ADDR A:0x26d9008
y.create.l HWIO_PMIC_ARB1_CHNL92_STATUS_ADDR A:0x26e1008
y.create.l HWIO_PMIC_ARB1_CHNL93_STATUS_ADDR A:0x26e9008
y.create.l HWIO_PMIC_ARB1_CHNL94_STATUS_ADDR A:0x26f1008
y.create.l HWIO_PMIC_ARB1_CHNL95_STATUS_ADDR A:0x26f9008
y.create.l HWIO_PMIC_ARB1_CHNL96_STATUS_ADDR A:0x2701008
y.create.l HWIO_PMIC_ARB1_CHNL97_STATUS_ADDR A:0x2709008
y.create.l HWIO_PMIC_ARB1_CHNL98_STATUS_ADDR A:0x2711008
y.create.l HWIO_PMIC_ARB1_CHNL99_STATUS_ADDR A:0x2719008
y.create.l HWIO_PMIC_ARB1_CHNL100_STATUS_ADDR A:0x2721008
y.create.l HWIO_PMIC_ARB1_CHNL101_STATUS_ADDR A:0x2729008
y.create.l HWIO_PMIC_ARB1_CHNL102_STATUS_ADDR A:0x2731008
y.create.l HWIO_PMIC_ARB1_CHNL103_STATUS_ADDR A:0x2739008
y.create.l HWIO_PMIC_ARB1_CHNL104_STATUS_ADDR A:0x2741008
y.create.l HWIO_PMIC_ARB1_CHNL105_STATUS_ADDR A:0x2749008
y.create.l HWIO_PMIC_ARB1_CHNL106_STATUS_ADDR A:0x2751008
y.create.l HWIO_PMIC_ARB1_CHNL107_STATUS_ADDR A:0x2759008
y.create.l HWIO_PMIC_ARB1_CHNL108_STATUS_ADDR A:0x2761008
y.create.l HWIO_PMIC_ARB1_CHNL109_STATUS_ADDR A:0x2769008
y.create.l HWIO_PMIC_ARB1_CHNL110_STATUS_ADDR A:0x2771008
y.create.l HWIO_PMIC_ARB1_CHNL111_STATUS_ADDR A:0x2779008
y.create.l HWIO_PMIC_ARB1_CHNL112_STATUS_ADDR A:0x2781008
y.create.l HWIO_PMIC_ARB1_CHNL113_STATUS_ADDR A:0x2789008
y.create.l HWIO_PMIC_ARB1_CHNL114_STATUS_ADDR A:0x2791008
y.create.l HWIO_PMIC_ARB1_CHNL115_STATUS_ADDR A:0x2799008
y.create.l HWIO_PMIC_ARB1_CHNL116_STATUS_ADDR A:0x27a1008
y.create.l HWIO_PMIC_ARB1_CHNL117_STATUS_ADDR A:0x27a9008
y.create.l HWIO_PMIC_ARB1_CHNL118_STATUS_ADDR A:0x27b1008
y.create.l HWIO_PMIC_ARB1_CHNL119_STATUS_ADDR A:0x27b9008
y.create.l HWIO_PMIC_ARB1_CHNL120_STATUS_ADDR A:0x27c1008
y.create.l HWIO_PMIC_ARB1_CHNL121_STATUS_ADDR A:0x27c9008
y.create.l HWIO_PMIC_ARB1_CHNL122_STATUS_ADDR A:0x27d1008
y.create.l HWIO_PMIC_ARB1_CHNL123_STATUS_ADDR A:0x27d9008
y.create.l HWIO_PMIC_ARB1_CHNL124_STATUS_ADDR A:0x27e1008
y.create.l HWIO_PMIC_ARB1_CHNL125_STATUS_ADDR A:0x27e9008
y.create.l HWIO_PMIC_ARB1_CHNL126_STATUS_ADDR A:0x27f1008
y.create.l HWIO_PMIC_ARB1_CHNL127_STATUS_ADDR A:0x27f9008
y.create.l HWIO_PMIC_ARB1_CHNL128_STATUS_ADDR A:0x2801008
y.create.l HWIO_PMIC_ARB1_CHNL129_STATUS_ADDR A:0x2809008
y.create.l HWIO_PMIC_ARB1_CHNL130_STATUS_ADDR A:0x2811008
y.create.l HWIO_PMIC_ARB1_CHNL131_STATUS_ADDR A:0x2819008
y.create.l HWIO_PMIC_ARB1_CHNL132_STATUS_ADDR A:0x2821008
y.create.l HWIO_PMIC_ARB1_CHNL133_STATUS_ADDR A:0x2829008
y.create.l HWIO_PMIC_ARB1_CHNL134_STATUS_ADDR A:0x2831008
y.create.l HWIO_PMIC_ARB1_CHNL135_STATUS_ADDR A:0x2839008
y.create.l HWIO_PMIC_ARB1_CHNL136_STATUS_ADDR A:0x2841008
y.create.l HWIO_PMIC_ARB1_CHNL137_STATUS_ADDR A:0x2849008
y.create.l HWIO_PMIC_ARB1_CHNL138_STATUS_ADDR A:0x2851008
y.create.l HWIO_PMIC_ARB1_CHNL139_STATUS_ADDR A:0x2859008
y.create.l HWIO_PMIC_ARB1_CHNL140_STATUS_ADDR A:0x2861008
y.create.l HWIO_PMIC_ARB1_CHNL141_STATUS_ADDR A:0x2869008
y.create.l HWIO_PMIC_ARB1_CHNL142_STATUS_ADDR A:0x2871008
y.create.l HWIO_PMIC_ARB1_CHNL143_STATUS_ADDR A:0x2879008
y.create.l HWIO_PMIC_ARB1_CHNL144_STATUS_ADDR A:0x2881008
y.create.l HWIO_PMIC_ARB1_CHNL145_STATUS_ADDR A:0x2889008
y.create.l HWIO_PMIC_ARB1_CHNL146_STATUS_ADDR A:0x2891008
y.create.l HWIO_PMIC_ARB1_CHNL147_STATUS_ADDR A:0x2899008
y.create.l HWIO_PMIC_ARB1_CHNL148_STATUS_ADDR A:0x28a1008
y.create.l HWIO_PMIC_ARB1_CHNL149_STATUS_ADDR A:0x28a9008
y.create.l HWIO_PMIC_ARB1_CHNL150_STATUS_ADDR A:0x28b1008
y.create.l HWIO_PMIC_ARB1_CHNL151_STATUS_ADDR A:0x28b9008
y.create.l HWIO_PMIC_ARB1_CHNL152_STATUS_ADDR A:0x28c1008
y.create.l HWIO_PMIC_ARB1_CHNL153_STATUS_ADDR A:0x28c9008
y.create.l HWIO_PMIC_ARB1_CHNL154_STATUS_ADDR A:0x28d1008
y.create.l HWIO_PMIC_ARB1_CHNL155_STATUS_ADDR A:0x28d9008
y.create.l HWIO_PMIC_ARB1_CHNL156_STATUS_ADDR A:0x28e1008
y.create.l HWIO_PMIC_ARB1_CHNL157_STATUS_ADDR A:0x28e9008
y.create.l HWIO_PMIC_ARB1_CHNL158_STATUS_ADDR A:0x28f1008
y.create.l HWIO_PMIC_ARB1_CHNL159_STATUS_ADDR A:0x28f9008
y.create.l HWIO_PMIC_ARB1_CHNL160_STATUS_ADDR A:0x2901008
y.create.l HWIO_PMIC_ARB1_CHNL161_STATUS_ADDR A:0x2909008
y.create.l HWIO_PMIC_ARB1_CHNL162_STATUS_ADDR A:0x2911008
y.create.l HWIO_PMIC_ARB1_CHNL163_STATUS_ADDR A:0x2919008
y.create.l HWIO_PMIC_ARB1_CHNL164_STATUS_ADDR A:0x2921008
y.create.l HWIO_PMIC_ARB1_CHNL165_STATUS_ADDR A:0x2929008
y.create.l HWIO_PMIC_ARB1_CHNL166_STATUS_ADDR A:0x2931008
y.create.l HWIO_PMIC_ARB1_CHNL167_STATUS_ADDR A:0x2939008
y.create.l HWIO_PMIC_ARB1_CHNL168_STATUS_ADDR A:0x2941008
y.create.l HWIO_PMIC_ARB1_CHNL169_STATUS_ADDR A:0x2949008
y.create.l HWIO_PMIC_ARB1_CHNL170_STATUS_ADDR A:0x2951008
y.create.l HWIO_PMIC_ARB1_CHNL171_STATUS_ADDR A:0x2959008
y.create.l HWIO_PMIC_ARB1_CHNL172_STATUS_ADDR A:0x2961008
y.create.l HWIO_PMIC_ARB1_CHNL173_STATUS_ADDR A:0x2969008
y.create.l HWIO_PMIC_ARB1_CHNL174_STATUS_ADDR A:0x2971008
y.create.l HWIO_PMIC_ARB1_CHNL175_STATUS_ADDR A:0x2979008
y.create.l HWIO_PMIC_ARB1_CHNL176_STATUS_ADDR A:0x2981008
y.create.l HWIO_PMIC_ARB1_CHNL177_STATUS_ADDR A:0x2989008
y.create.l HWIO_PMIC_ARB1_CHNL178_STATUS_ADDR A:0x2991008
y.create.l HWIO_PMIC_ARB1_CHNL179_STATUS_ADDR A:0x2999008
y.create.l HWIO_PMIC_ARB1_CHNL180_STATUS_ADDR A:0x29a1008
y.create.l HWIO_PMIC_ARB1_CHNL181_STATUS_ADDR A:0x29a9008
y.create.l HWIO_PMIC_ARB1_CHNL182_STATUS_ADDR A:0x29b1008
y.create.l HWIO_PMIC_ARB1_CHNL183_STATUS_ADDR A:0x29b9008
y.create.l HWIO_PMIC_ARB1_CHNL184_STATUS_ADDR A:0x29c1008
y.create.l HWIO_PMIC_ARB1_CHNL185_STATUS_ADDR A:0x29c9008
y.create.l HWIO_PMIC_ARB1_CHNL186_STATUS_ADDR A:0x29d1008
y.create.l HWIO_PMIC_ARB1_CHNL187_STATUS_ADDR A:0x29d9008
y.create.l HWIO_PMIC_ARB1_CHNL188_STATUS_ADDR A:0x29e1008
y.create.l HWIO_PMIC_ARB1_CHNL189_STATUS_ADDR A:0x29e9008
y.create.l HWIO_PMIC_ARB1_CHNL190_STATUS_ADDR A:0x29f1008
y.create.l HWIO_PMIC_ARB1_CHNL191_STATUS_ADDR A:0x29f9008
y.create.l HWIO_PMIC_ARB1_CHNL192_STATUS_ADDR A:0x2a01008
y.create.l HWIO_PMIC_ARB1_CHNL193_STATUS_ADDR A:0x2a09008
y.create.l HWIO_PMIC_ARB1_CHNL194_STATUS_ADDR A:0x2a11008
y.create.l HWIO_PMIC_ARB1_CHNL195_STATUS_ADDR A:0x2a19008
y.create.l HWIO_PMIC_ARB1_CHNL196_STATUS_ADDR A:0x2a21008
y.create.l HWIO_PMIC_ARB1_CHNL197_STATUS_ADDR A:0x2a29008
y.create.l HWIO_PMIC_ARB1_CHNL198_STATUS_ADDR A:0x2a31008
y.create.l HWIO_PMIC_ARB1_CHNL199_STATUS_ADDR A:0x2a39008
y.create.l HWIO_PMIC_ARB1_CHNL200_STATUS_ADDR A:0x2a41008
y.create.l HWIO_PMIC_ARB1_CHNL201_STATUS_ADDR A:0x2a49008
y.create.l HWIO_PMIC_ARB1_CHNL202_STATUS_ADDR A:0x2a51008
y.create.l HWIO_PMIC_ARB1_CHNL203_STATUS_ADDR A:0x2a59008
y.create.l HWIO_PMIC_ARB1_CHNL204_STATUS_ADDR A:0x2a61008
y.create.l HWIO_PMIC_ARB1_CHNL205_STATUS_ADDR A:0x2a69008
y.create.l HWIO_PMIC_ARB1_CHNL206_STATUS_ADDR A:0x2a71008
y.create.l HWIO_PMIC_ARB1_CHNL207_STATUS_ADDR A:0x2a79008
y.create.l HWIO_PMIC_ARB1_CHNL208_STATUS_ADDR A:0x2a81008
y.create.l HWIO_PMIC_ARB1_CHNL209_STATUS_ADDR A:0x2a89008
y.create.l HWIO_PMIC_ARB1_CHNL210_STATUS_ADDR A:0x2a91008
y.create.l HWIO_PMIC_ARB1_CHNL211_STATUS_ADDR A:0x2a99008
y.create.l HWIO_PMIC_ARB1_CHNL212_STATUS_ADDR A:0x2aa1008
y.create.l HWIO_PMIC_ARB1_CHNL213_STATUS_ADDR A:0x2aa9008
y.create.l HWIO_PMIC_ARB1_CHNL214_STATUS_ADDR A:0x2ab1008
y.create.l HWIO_PMIC_ARB1_CHNL215_STATUS_ADDR A:0x2ab9008
y.create.l HWIO_PMIC_ARB1_CHNL216_STATUS_ADDR A:0x2ac1008
y.create.l HWIO_PMIC_ARB1_CHNL217_STATUS_ADDR A:0x2ac9008
y.create.l HWIO_PMIC_ARB1_CHNL218_STATUS_ADDR A:0x2ad1008
y.create.l HWIO_PMIC_ARB1_CHNL219_STATUS_ADDR A:0x2ad9008
y.create.l HWIO_PMIC_ARB1_CHNL220_STATUS_ADDR A:0x2ae1008
y.create.l HWIO_PMIC_ARB1_CHNL221_STATUS_ADDR A:0x2ae9008
y.create.l HWIO_PMIC_ARB1_CHNL222_STATUS_ADDR A:0x2af1008
y.create.l HWIO_PMIC_ARB1_CHNL223_STATUS_ADDR A:0x2af9008
y.create.l HWIO_PMIC_ARB1_CHNL224_STATUS_ADDR A:0x2b01008
y.create.l HWIO_PMIC_ARB1_CHNL225_STATUS_ADDR A:0x2b09008
y.create.l HWIO_PMIC_ARB1_CHNL226_STATUS_ADDR A:0x2b11008
y.create.l HWIO_PMIC_ARB1_CHNL227_STATUS_ADDR A:0x2b19008
y.create.l HWIO_PMIC_ARB1_CHNL228_STATUS_ADDR A:0x2b21008
y.create.l HWIO_PMIC_ARB1_CHNL229_STATUS_ADDR A:0x2b29008
y.create.l HWIO_PMIC_ARB1_CHNL230_STATUS_ADDR A:0x2b31008
y.create.l HWIO_PMIC_ARB1_CHNL231_STATUS_ADDR A:0x2b39008
y.create.l HWIO_PMIC_ARB1_CHNL232_STATUS_ADDR A:0x2b41008
y.create.l HWIO_PMIC_ARB1_CHNL233_STATUS_ADDR A:0x2b49008
y.create.l HWIO_PMIC_ARB1_CHNL234_STATUS_ADDR A:0x2b51008
y.create.l HWIO_PMIC_ARB1_CHNL235_STATUS_ADDR A:0x2b59008
y.create.l HWIO_PMIC_ARB1_CHNL236_STATUS_ADDR A:0x2b61008
y.create.l HWIO_PMIC_ARB1_CHNL237_STATUS_ADDR A:0x2b69008
y.create.l HWIO_PMIC_ARB1_CHNL238_STATUS_ADDR A:0x2b71008
y.create.l HWIO_PMIC_ARB1_CHNL239_STATUS_ADDR A:0x2b79008
y.create.l HWIO_PMIC_ARB1_CHNL240_STATUS_ADDR A:0x2b81008
y.create.l HWIO_PMIC_ARB1_CHNL241_STATUS_ADDR A:0x2b89008
y.create.l HWIO_PMIC_ARB1_CHNL242_STATUS_ADDR A:0x2b91008
y.create.l HWIO_PMIC_ARB1_CHNL243_STATUS_ADDR A:0x2b99008
y.create.l HWIO_PMIC_ARB1_CHNL244_STATUS_ADDR A:0x2ba1008
y.create.l HWIO_PMIC_ARB1_CHNL245_STATUS_ADDR A:0x2ba9008
y.create.l HWIO_PMIC_ARB1_CHNL246_STATUS_ADDR A:0x2bb1008
y.create.l HWIO_PMIC_ARB1_CHNL247_STATUS_ADDR A:0x2bb9008
y.create.l HWIO_PMIC_ARB1_CHNL248_STATUS_ADDR A:0x2bc1008
y.create.l HWIO_PMIC_ARB1_CHNL249_STATUS_ADDR A:0x2bc9008
y.create.l HWIO_PMIC_ARB1_CHNL250_STATUS_ADDR A:0x2bd1008
y.create.l HWIO_PMIC_ARB1_CHNL251_STATUS_ADDR A:0x2bd9008
y.create.l HWIO_PMIC_ARB1_CHNL252_STATUS_ADDR A:0x2be1008
y.create.l HWIO_PMIC_ARB1_CHNL253_STATUS_ADDR A:0x2be9008
y.create.l HWIO_PMIC_ARB1_CHNL254_STATUS_ADDR A:0x2bf1008
y.create.l HWIO_PMIC_ARB1_CHNL255_STATUS_ADDR A:0x2bf9008
y.create.l HWIO_PMIC_ARB2_CHNL0_STATUS_ADDR A:0x2402008
y.create.l HWIO_PMIC_ARB2_CHNL1_STATUS_ADDR A:0x240a008
y.create.l HWIO_PMIC_ARB2_CHNL2_STATUS_ADDR A:0x2412008
y.create.l HWIO_PMIC_ARB2_CHNL3_STATUS_ADDR A:0x241a008
y.create.l HWIO_PMIC_ARB2_CHNL4_STATUS_ADDR A:0x2422008
y.create.l HWIO_PMIC_ARB2_CHNL5_STATUS_ADDR A:0x242a008
y.create.l HWIO_PMIC_ARB2_CHNL6_STATUS_ADDR A:0x2432008
y.create.l HWIO_PMIC_ARB2_CHNL7_STATUS_ADDR A:0x243a008
y.create.l HWIO_PMIC_ARB2_CHNL8_STATUS_ADDR A:0x2442008
y.create.l HWIO_PMIC_ARB2_CHNL9_STATUS_ADDR A:0x244a008
y.create.l HWIO_PMIC_ARB2_CHNL10_STATUS_ADDR A:0x2452008
y.create.l HWIO_PMIC_ARB2_CHNL11_STATUS_ADDR A:0x245a008
y.create.l HWIO_PMIC_ARB2_CHNL12_STATUS_ADDR A:0x2462008
y.create.l HWIO_PMIC_ARB2_CHNL13_STATUS_ADDR A:0x246a008
y.create.l HWIO_PMIC_ARB2_CHNL14_STATUS_ADDR A:0x2472008
y.create.l HWIO_PMIC_ARB2_CHNL15_STATUS_ADDR A:0x247a008
y.create.l HWIO_PMIC_ARB2_CHNL16_STATUS_ADDR A:0x2482008
y.create.l HWIO_PMIC_ARB2_CHNL17_STATUS_ADDR A:0x248a008
y.create.l HWIO_PMIC_ARB2_CHNL18_STATUS_ADDR A:0x2492008
y.create.l HWIO_PMIC_ARB2_CHNL19_STATUS_ADDR A:0x249a008
y.create.l HWIO_PMIC_ARB2_CHNL20_STATUS_ADDR A:0x24a2008
y.create.l HWIO_PMIC_ARB2_CHNL21_STATUS_ADDR A:0x24aa008
y.create.l HWIO_PMIC_ARB2_CHNL22_STATUS_ADDR A:0x24b2008
y.create.l HWIO_PMIC_ARB2_CHNL23_STATUS_ADDR A:0x24ba008
y.create.l HWIO_PMIC_ARB2_CHNL24_STATUS_ADDR A:0x24c2008
y.create.l HWIO_PMIC_ARB2_CHNL25_STATUS_ADDR A:0x24ca008
y.create.l HWIO_PMIC_ARB2_CHNL26_STATUS_ADDR A:0x24d2008
y.create.l HWIO_PMIC_ARB2_CHNL27_STATUS_ADDR A:0x24da008
y.create.l HWIO_PMIC_ARB2_CHNL28_STATUS_ADDR A:0x24e2008
y.create.l HWIO_PMIC_ARB2_CHNL29_STATUS_ADDR A:0x24ea008
y.create.l HWIO_PMIC_ARB2_CHNL30_STATUS_ADDR A:0x24f2008
y.create.l HWIO_PMIC_ARB2_CHNL31_STATUS_ADDR A:0x24fa008
y.create.l HWIO_PMIC_ARB2_CHNL32_STATUS_ADDR A:0x2502008
y.create.l HWIO_PMIC_ARB2_CHNL33_STATUS_ADDR A:0x250a008
y.create.l HWIO_PMIC_ARB2_CHNL34_STATUS_ADDR A:0x2512008
y.create.l HWIO_PMIC_ARB2_CHNL35_STATUS_ADDR A:0x251a008
y.create.l HWIO_PMIC_ARB2_CHNL36_STATUS_ADDR A:0x2522008
y.create.l HWIO_PMIC_ARB2_CHNL37_STATUS_ADDR A:0x252a008
y.create.l HWIO_PMIC_ARB2_CHNL38_STATUS_ADDR A:0x2532008
y.create.l HWIO_PMIC_ARB2_CHNL39_STATUS_ADDR A:0x253a008
y.create.l HWIO_PMIC_ARB2_CHNL40_STATUS_ADDR A:0x2542008
y.create.l HWIO_PMIC_ARB2_CHNL41_STATUS_ADDR A:0x254a008
y.create.l HWIO_PMIC_ARB2_CHNL42_STATUS_ADDR A:0x2552008
y.create.l HWIO_PMIC_ARB2_CHNL43_STATUS_ADDR A:0x255a008
y.create.l HWIO_PMIC_ARB2_CHNL44_STATUS_ADDR A:0x2562008
y.create.l HWIO_PMIC_ARB2_CHNL45_STATUS_ADDR A:0x256a008
y.create.l HWIO_PMIC_ARB2_CHNL46_STATUS_ADDR A:0x2572008
y.create.l HWIO_PMIC_ARB2_CHNL47_STATUS_ADDR A:0x257a008
y.create.l HWIO_PMIC_ARB2_CHNL48_STATUS_ADDR A:0x2582008
y.create.l HWIO_PMIC_ARB2_CHNL49_STATUS_ADDR A:0x258a008
y.create.l HWIO_PMIC_ARB2_CHNL50_STATUS_ADDR A:0x2592008
y.create.l HWIO_PMIC_ARB2_CHNL51_STATUS_ADDR A:0x259a008
y.create.l HWIO_PMIC_ARB2_CHNL52_STATUS_ADDR A:0x25a2008
y.create.l HWIO_PMIC_ARB2_CHNL53_STATUS_ADDR A:0x25aa008
y.create.l HWIO_PMIC_ARB2_CHNL54_STATUS_ADDR A:0x25b2008
y.create.l HWIO_PMIC_ARB2_CHNL55_STATUS_ADDR A:0x25ba008
y.create.l HWIO_PMIC_ARB2_CHNL56_STATUS_ADDR A:0x25c2008
y.create.l HWIO_PMIC_ARB2_CHNL57_STATUS_ADDR A:0x25ca008
y.create.l HWIO_PMIC_ARB2_CHNL58_STATUS_ADDR A:0x25d2008
y.create.l HWIO_PMIC_ARB2_CHNL59_STATUS_ADDR A:0x25da008
y.create.l HWIO_PMIC_ARB2_CHNL60_STATUS_ADDR A:0x25e2008
y.create.l HWIO_PMIC_ARB2_CHNL61_STATUS_ADDR A:0x25ea008
y.create.l HWIO_PMIC_ARB2_CHNL62_STATUS_ADDR A:0x25f2008
y.create.l HWIO_PMIC_ARB2_CHNL63_STATUS_ADDR A:0x25fa008
y.create.l HWIO_PMIC_ARB2_CHNL64_STATUS_ADDR A:0x2602008
y.create.l HWIO_PMIC_ARB2_CHNL65_STATUS_ADDR A:0x260a008
y.create.l HWIO_PMIC_ARB2_CHNL66_STATUS_ADDR A:0x2612008
y.create.l HWIO_PMIC_ARB2_CHNL67_STATUS_ADDR A:0x261a008
y.create.l HWIO_PMIC_ARB2_CHNL68_STATUS_ADDR A:0x2622008
y.create.l HWIO_PMIC_ARB2_CHNL69_STATUS_ADDR A:0x262a008
y.create.l HWIO_PMIC_ARB2_CHNL70_STATUS_ADDR A:0x2632008
y.create.l HWIO_PMIC_ARB2_CHNL71_STATUS_ADDR A:0x263a008
y.create.l HWIO_PMIC_ARB2_CHNL72_STATUS_ADDR A:0x2642008
y.create.l HWIO_PMIC_ARB2_CHNL73_STATUS_ADDR A:0x264a008
y.create.l HWIO_PMIC_ARB2_CHNL74_STATUS_ADDR A:0x2652008
y.create.l HWIO_PMIC_ARB2_CHNL75_STATUS_ADDR A:0x265a008
y.create.l HWIO_PMIC_ARB2_CHNL76_STATUS_ADDR A:0x2662008
y.create.l HWIO_PMIC_ARB2_CHNL77_STATUS_ADDR A:0x266a008
y.create.l HWIO_PMIC_ARB2_CHNL78_STATUS_ADDR A:0x2672008
y.create.l HWIO_PMIC_ARB2_CHNL79_STATUS_ADDR A:0x267a008
y.create.l HWIO_PMIC_ARB2_CHNL80_STATUS_ADDR A:0x2682008
y.create.l HWIO_PMIC_ARB2_CHNL81_STATUS_ADDR A:0x268a008
y.create.l HWIO_PMIC_ARB2_CHNL82_STATUS_ADDR A:0x2692008
y.create.l HWIO_PMIC_ARB2_CHNL83_STATUS_ADDR A:0x269a008
y.create.l HWIO_PMIC_ARB2_CHNL84_STATUS_ADDR A:0x26a2008
y.create.l HWIO_PMIC_ARB2_CHNL85_STATUS_ADDR A:0x26aa008
y.create.l HWIO_PMIC_ARB2_CHNL86_STATUS_ADDR A:0x26b2008
y.create.l HWIO_PMIC_ARB2_CHNL87_STATUS_ADDR A:0x26ba008
y.create.l HWIO_PMIC_ARB2_CHNL88_STATUS_ADDR A:0x26c2008
y.create.l HWIO_PMIC_ARB2_CHNL89_STATUS_ADDR A:0x26ca008
y.create.l HWIO_PMIC_ARB2_CHNL90_STATUS_ADDR A:0x26d2008
y.create.l HWIO_PMIC_ARB2_CHNL91_STATUS_ADDR A:0x26da008
y.create.l HWIO_PMIC_ARB2_CHNL92_STATUS_ADDR A:0x26e2008
y.create.l HWIO_PMIC_ARB2_CHNL93_STATUS_ADDR A:0x26ea008
y.create.l HWIO_PMIC_ARB2_CHNL94_STATUS_ADDR A:0x26f2008
y.create.l HWIO_PMIC_ARB2_CHNL95_STATUS_ADDR A:0x26fa008
y.create.l HWIO_PMIC_ARB2_CHNL96_STATUS_ADDR A:0x2702008
y.create.l HWIO_PMIC_ARB2_CHNL97_STATUS_ADDR A:0x270a008
y.create.l HWIO_PMIC_ARB2_CHNL98_STATUS_ADDR A:0x2712008
y.create.l HWIO_PMIC_ARB2_CHNL99_STATUS_ADDR A:0x271a008
y.create.l HWIO_PMIC_ARB2_CHNL100_STATUS_ADDR A:0x2722008
y.create.l HWIO_PMIC_ARB2_CHNL101_STATUS_ADDR A:0x272a008
y.create.l HWIO_PMIC_ARB2_CHNL102_STATUS_ADDR A:0x2732008
y.create.l HWIO_PMIC_ARB2_CHNL103_STATUS_ADDR A:0x273a008
y.create.l HWIO_PMIC_ARB2_CHNL104_STATUS_ADDR A:0x2742008
y.create.l HWIO_PMIC_ARB2_CHNL105_STATUS_ADDR A:0x274a008
y.create.l HWIO_PMIC_ARB2_CHNL106_STATUS_ADDR A:0x2752008
y.create.l HWIO_PMIC_ARB2_CHNL107_STATUS_ADDR A:0x275a008
y.create.l HWIO_PMIC_ARB2_CHNL108_STATUS_ADDR A:0x2762008
y.create.l HWIO_PMIC_ARB2_CHNL109_STATUS_ADDR A:0x276a008
y.create.l HWIO_PMIC_ARB2_CHNL110_STATUS_ADDR A:0x2772008
y.create.l HWIO_PMIC_ARB2_CHNL111_STATUS_ADDR A:0x277a008
y.create.l HWIO_PMIC_ARB2_CHNL112_STATUS_ADDR A:0x2782008
y.create.l HWIO_PMIC_ARB2_CHNL113_STATUS_ADDR A:0x278a008
y.create.l HWIO_PMIC_ARB2_CHNL114_STATUS_ADDR A:0x2792008
y.create.l HWIO_PMIC_ARB2_CHNL115_STATUS_ADDR A:0x279a008
y.create.l HWIO_PMIC_ARB2_CHNL116_STATUS_ADDR A:0x27a2008
y.create.l HWIO_PMIC_ARB2_CHNL117_STATUS_ADDR A:0x27aa008
y.create.l HWIO_PMIC_ARB2_CHNL118_STATUS_ADDR A:0x27b2008
y.create.l HWIO_PMIC_ARB2_CHNL119_STATUS_ADDR A:0x27ba008
y.create.l HWIO_PMIC_ARB2_CHNL120_STATUS_ADDR A:0x27c2008
y.create.l HWIO_PMIC_ARB2_CHNL121_STATUS_ADDR A:0x27ca008
y.create.l HWIO_PMIC_ARB2_CHNL122_STATUS_ADDR A:0x27d2008
y.create.l HWIO_PMIC_ARB2_CHNL123_STATUS_ADDR A:0x27da008
y.create.l HWIO_PMIC_ARB2_CHNL124_STATUS_ADDR A:0x27e2008
y.create.l HWIO_PMIC_ARB2_CHNL125_STATUS_ADDR A:0x27ea008
y.create.l HWIO_PMIC_ARB2_CHNL126_STATUS_ADDR A:0x27f2008
y.create.l HWIO_PMIC_ARB2_CHNL127_STATUS_ADDR A:0x27fa008
y.create.l HWIO_PMIC_ARB2_CHNL128_STATUS_ADDR A:0x2802008
y.create.l HWIO_PMIC_ARB2_CHNL129_STATUS_ADDR A:0x280a008
y.create.l HWIO_PMIC_ARB2_CHNL130_STATUS_ADDR A:0x2812008
y.create.l HWIO_PMIC_ARB2_CHNL131_STATUS_ADDR A:0x281a008
y.create.l HWIO_PMIC_ARB2_CHNL132_STATUS_ADDR A:0x2822008
y.create.l HWIO_PMIC_ARB2_CHNL133_STATUS_ADDR A:0x282a008
y.create.l HWIO_PMIC_ARB2_CHNL134_STATUS_ADDR A:0x2832008
y.create.l HWIO_PMIC_ARB2_CHNL135_STATUS_ADDR A:0x283a008
y.create.l HWIO_PMIC_ARB2_CHNL136_STATUS_ADDR A:0x2842008
y.create.l HWIO_PMIC_ARB2_CHNL137_STATUS_ADDR A:0x284a008
y.create.l HWIO_PMIC_ARB2_CHNL138_STATUS_ADDR A:0x2852008
y.create.l HWIO_PMIC_ARB2_CHNL139_STATUS_ADDR A:0x285a008
y.create.l HWIO_PMIC_ARB2_CHNL140_STATUS_ADDR A:0x2862008
y.create.l HWIO_PMIC_ARB2_CHNL141_STATUS_ADDR A:0x286a008
y.create.l HWIO_PMIC_ARB2_CHNL142_STATUS_ADDR A:0x2872008
y.create.l HWIO_PMIC_ARB2_CHNL143_STATUS_ADDR A:0x287a008
y.create.l HWIO_PMIC_ARB2_CHNL144_STATUS_ADDR A:0x2882008
y.create.l HWIO_PMIC_ARB2_CHNL145_STATUS_ADDR A:0x288a008
y.create.l HWIO_PMIC_ARB2_CHNL146_STATUS_ADDR A:0x2892008
y.create.l HWIO_PMIC_ARB2_CHNL147_STATUS_ADDR A:0x289a008
y.create.l HWIO_PMIC_ARB2_CHNL148_STATUS_ADDR A:0x28a2008
y.create.l HWIO_PMIC_ARB2_CHNL149_STATUS_ADDR A:0x28aa008
y.create.l HWIO_PMIC_ARB2_CHNL150_STATUS_ADDR A:0x28b2008
y.create.l HWIO_PMIC_ARB2_CHNL151_STATUS_ADDR A:0x28ba008
y.create.l HWIO_PMIC_ARB2_CHNL152_STATUS_ADDR A:0x28c2008
y.create.l HWIO_PMIC_ARB2_CHNL153_STATUS_ADDR A:0x28ca008
y.create.l HWIO_PMIC_ARB2_CHNL154_STATUS_ADDR A:0x28d2008
y.create.l HWIO_PMIC_ARB2_CHNL155_STATUS_ADDR A:0x28da008
y.create.l HWIO_PMIC_ARB2_CHNL156_STATUS_ADDR A:0x28e2008
y.create.l HWIO_PMIC_ARB2_CHNL157_STATUS_ADDR A:0x28ea008
y.create.l HWIO_PMIC_ARB2_CHNL158_STATUS_ADDR A:0x28f2008
y.create.l HWIO_PMIC_ARB2_CHNL159_STATUS_ADDR A:0x28fa008
y.create.l HWIO_PMIC_ARB2_CHNL160_STATUS_ADDR A:0x2902008
y.create.l HWIO_PMIC_ARB2_CHNL161_STATUS_ADDR A:0x290a008
y.create.l HWIO_PMIC_ARB2_CHNL162_STATUS_ADDR A:0x2912008
y.create.l HWIO_PMIC_ARB2_CHNL163_STATUS_ADDR A:0x291a008
y.create.l HWIO_PMIC_ARB2_CHNL164_STATUS_ADDR A:0x2922008
y.create.l HWIO_PMIC_ARB2_CHNL165_STATUS_ADDR A:0x292a008
y.create.l HWIO_PMIC_ARB2_CHNL166_STATUS_ADDR A:0x2932008
y.create.l HWIO_PMIC_ARB2_CHNL167_STATUS_ADDR A:0x293a008
y.create.l HWIO_PMIC_ARB2_CHNL168_STATUS_ADDR A:0x2942008
y.create.l HWIO_PMIC_ARB2_CHNL169_STATUS_ADDR A:0x294a008
y.create.l HWIO_PMIC_ARB2_CHNL170_STATUS_ADDR A:0x2952008
y.create.l HWIO_PMIC_ARB2_CHNL171_STATUS_ADDR A:0x295a008
y.create.l HWIO_PMIC_ARB2_CHNL172_STATUS_ADDR A:0x2962008
y.create.l HWIO_PMIC_ARB2_CHNL173_STATUS_ADDR A:0x296a008
y.create.l HWIO_PMIC_ARB2_CHNL174_STATUS_ADDR A:0x2972008
y.create.l HWIO_PMIC_ARB2_CHNL175_STATUS_ADDR A:0x297a008
y.create.l HWIO_PMIC_ARB2_CHNL176_STATUS_ADDR A:0x2982008
y.create.l HWIO_PMIC_ARB2_CHNL177_STATUS_ADDR A:0x298a008
y.create.l HWIO_PMIC_ARB2_CHNL178_STATUS_ADDR A:0x2992008
y.create.l HWIO_PMIC_ARB2_CHNL179_STATUS_ADDR A:0x299a008
y.create.l HWIO_PMIC_ARB2_CHNL180_STATUS_ADDR A:0x29a2008
y.create.l HWIO_PMIC_ARB2_CHNL181_STATUS_ADDR A:0x29aa008
y.create.l HWIO_PMIC_ARB2_CHNL182_STATUS_ADDR A:0x29b2008
y.create.l HWIO_PMIC_ARB2_CHNL183_STATUS_ADDR A:0x29ba008
y.create.l HWIO_PMIC_ARB2_CHNL184_STATUS_ADDR A:0x29c2008
y.create.l HWIO_PMIC_ARB2_CHNL185_STATUS_ADDR A:0x29ca008
y.create.l HWIO_PMIC_ARB2_CHNL186_STATUS_ADDR A:0x29d2008
y.create.l HWIO_PMIC_ARB2_CHNL187_STATUS_ADDR A:0x29da008
y.create.l HWIO_PMIC_ARB2_CHNL188_STATUS_ADDR A:0x29e2008
y.create.l HWIO_PMIC_ARB2_CHNL189_STATUS_ADDR A:0x29ea008
y.create.l HWIO_PMIC_ARB2_CHNL190_STATUS_ADDR A:0x29f2008
y.create.l HWIO_PMIC_ARB2_CHNL191_STATUS_ADDR A:0x29fa008
y.create.l HWIO_PMIC_ARB2_CHNL192_STATUS_ADDR A:0x2a02008
y.create.l HWIO_PMIC_ARB2_CHNL193_STATUS_ADDR A:0x2a0a008
y.create.l HWIO_PMIC_ARB2_CHNL194_STATUS_ADDR A:0x2a12008
y.create.l HWIO_PMIC_ARB2_CHNL195_STATUS_ADDR A:0x2a1a008
y.create.l HWIO_PMIC_ARB2_CHNL196_STATUS_ADDR A:0x2a22008
y.create.l HWIO_PMIC_ARB2_CHNL197_STATUS_ADDR A:0x2a2a008
y.create.l HWIO_PMIC_ARB2_CHNL198_STATUS_ADDR A:0x2a32008
y.create.l HWIO_PMIC_ARB2_CHNL199_STATUS_ADDR A:0x2a3a008
y.create.l HWIO_PMIC_ARB2_CHNL200_STATUS_ADDR A:0x2a42008
y.create.l HWIO_PMIC_ARB2_CHNL201_STATUS_ADDR A:0x2a4a008
y.create.l HWIO_PMIC_ARB2_CHNL202_STATUS_ADDR A:0x2a52008
y.create.l HWIO_PMIC_ARB2_CHNL203_STATUS_ADDR A:0x2a5a008
y.create.l HWIO_PMIC_ARB2_CHNL204_STATUS_ADDR A:0x2a62008
y.create.l HWIO_PMIC_ARB2_CHNL205_STATUS_ADDR A:0x2a6a008
y.create.l HWIO_PMIC_ARB2_CHNL206_STATUS_ADDR A:0x2a72008
y.create.l HWIO_PMIC_ARB2_CHNL207_STATUS_ADDR A:0x2a7a008
y.create.l HWIO_PMIC_ARB2_CHNL208_STATUS_ADDR A:0x2a82008
y.create.l HWIO_PMIC_ARB2_CHNL209_STATUS_ADDR A:0x2a8a008
y.create.l HWIO_PMIC_ARB2_CHNL210_STATUS_ADDR A:0x2a92008
y.create.l HWIO_PMIC_ARB2_CHNL211_STATUS_ADDR A:0x2a9a008
y.create.l HWIO_PMIC_ARB2_CHNL212_STATUS_ADDR A:0x2aa2008
y.create.l HWIO_PMIC_ARB2_CHNL213_STATUS_ADDR A:0x2aaa008
y.create.l HWIO_PMIC_ARB2_CHNL214_STATUS_ADDR A:0x2ab2008
y.create.l HWIO_PMIC_ARB2_CHNL215_STATUS_ADDR A:0x2aba008
y.create.l HWIO_PMIC_ARB2_CHNL216_STATUS_ADDR A:0x2ac2008
y.create.l HWIO_PMIC_ARB2_CHNL217_STATUS_ADDR A:0x2aca008
y.create.l HWIO_PMIC_ARB2_CHNL218_STATUS_ADDR A:0x2ad2008
y.create.l HWIO_PMIC_ARB2_CHNL219_STATUS_ADDR A:0x2ada008
y.create.l HWIO_PMIC_ARB2_CHNL220_STATUS_ADDR A:0x2ae2008
y.create.l HWIO_PMIC_ARB2_CHNL221_STATUS_ADDR A:0x2aea008
y.create.l HWIO_PMIC_ARB2_CHNL222_STATUS_ADDR A:0x2af2008
y.create.l HWIO_PMIC_ARB2_CHNL223_STATUS_ADDR A:0x2afa008
y.create.l HWIO_PMIC_ARB2_CHNL224_STATUS_ADDR A:0x2b02008
y.create.l HWIO_PMIC_ARB2_CHNL225_STATUS_ADDR A:0x2b0a008
y.create.l HWIO_PMIC_ARB2_CHNL226_STATUS_ADDR A:0x2b12008
y.create.l HWIO_PMIC_ARB2_CHNL227_STATUS_ADDR A:0x2b1a008
y.create.l HWIO_PMIC_ARB2_CHNL228_STATUS_ADDR A:0x2b22008
y.create.l HWIO_PMIC_ARB2_CHNL229_STATUS_ADDR A:0x2b2a008
y.create.l HWIO_PMIC_ARB2_CHNL230_STATUS_ADDR A:0x2b32008
y.create.l HWIO_PMIC_ARB2_CHNL231_STATUS_ADDR A:0x2b3a008
y.create.l HWIO_PMIC_ARB2_CHNL232_STATUS_ADDR A:0x2b42008
y.create.l HWIO_PMIC_ARB2_CHNL233_STATUS_ADDR A:0x2b4a008
y.create.l HWIO_PMIC_ARB2_CHNL234_STATUS_ADDR A:0x2b52008
y.create.l HWIO_PMIC_ARB2_CHNL235_STATUS_ADDR A:0x2b5a008
y.create.l HWIO_PMIC_ARB2_CHNL236_STATUS_ADDR A:0x2b62008
y.create.l HWIO_PMIC_ARB2_CHNL237_STATUS_ADDR A:0x2b6a008
y.create.l HWIO_PMIC_ARB2_CHNL238_STATUS_ADDR A:0x2b72008
y.create.l HWIO_PMIC_ARB2_CHNL239_STATUS_ADDR A:0x2b7a008
y.create.l HWIO_PMIC_ARB2_CHNL240_STATUS_ADDR A:0x2b82008
y.create.l HWIO_PMIC_ARB2_CHNL241_STATUS_ADDR A:0x2b8a008
y.create.l HWIO_PMIC_ARB2_CHNL242_STATUS_ADDR A:0x2b92008
y.create.l HWIO_PMIC_ARB2_CHNL243_STATUS_ADDR A:0x2b9a008
y.create.l HWIO_PMIC_ARB2_CHNL244_STATUS_ADDR A:0x2ba2008
y.create.l HWIO_PMIC_ARB2_CHNL245_STATUS_ADDR A:0x2baa008
y.create.l HWIO_PMIC_ARB2_CHNL246_STATUS_ADDR A:0x2bb2008
y.create.l HWIO_PMIC_ARB2_CHNL247_STATUS_ADDR A:0x2bba008
y.create.l HWIO_PMIC_ARB2_CHNL248_STATUS_ADDR A:0x2bc2008
y.create.l HWIO_PMIC_ARB2_CHNL249_STATUS_ADDR A:0x2bca008
y.create.l HWIO_PMIC_ARB2_CHNL250_STATUS_ADDR A:0x2bd2008
y.create.l HWIO_PMIC_ARB2_CHNL251_STATUS_ADDR A:0x2bda008
y.create.l HWIO_PMIC_ARB2_CHNL252_STATUS_ADDR A:0x2be2008
y.create.l HWIO_PMIC_ARB2_CHNL253_STATUS_ADDR A:0x2bea008
y.create.l HWIO_PMIC_ARB2_CHNL254_STATUS_ADDR A:0x2bf2008
y.create.l HWIO_PMIC_ARB2_CHNL255_STATUS_ADDR A:0x2bfa008
y.create.l HWIO_PMIC_ARB3_CHNL0_STATUS_ADDR A:0x2403008
y.create.l HWIO_PMIC_ARB3_CHNL1_STATUS_ADDR A:0x240b008
y.create.l HWIO_PMIC_ARB3_CHNL2_STATUS_ADDR A:0x2413008
y.create.l HWIO_PMIC_ARB3_CHNL3_STATUS_ADDR A:0x241b008
y.create.l HWIO_PMIC_ARB3_CHNL4_STATUS_ADDR A:0x2423008
y.create.l HWIO_PMIC_ARB3_CHNL5_STATUS_ADDR A:0x242b008
y.create.l HWIO_PMIC_ARB3_CHNL6_STATUS_ADDR A:0x2433008
y.create.l HWIO_PMIC_ARB3_CHNL7_STATUS_ADDR A:0x243b008
y.create.l HWIO_PMIC_ARB3_CHNL8_STATUS_ADDR A:0x2443008
y.create.l HWIO_PMIC_ARB3_CHNL9_STATUS_ADDR A:0x244b008
y.create.l HWIO_PMIC_ARB3_CHNL10_STATUS_ADDR A:0x2453008
y.create.l HWIO_PMIC_ARB3_CHNL11_STATUS_ADDR A:0x245b008
y.create.l HWIO_PMIC_ARB3_CHNL12_STATUS_ADDR A:0x2463008
y.create.l HWIO_PMIC_ARB3_CHNL13_STATUS_ADDR A:0x246b008
y.create.l HWIO_PMIC_ARB3_CHNL14_STATUS_ADDR A:0x2473008
y.create.l HWIO_PMIC_ARB3_CHNL15_STATUS_ADDR A:0x247b008
y.create.l HWIO_PMIC_ARB3_CHNL16_STATUS_ADDR A:0x2483008
y.create.l HWIO_PMIC_ARB3_CHNL17_STATUS_ADDR A:0x248b008
y.create.l HWIO_PMIC_ARB3_CHNL18_STATUS_ADDR A:0x2493008
y.create.l HWIO_PMIC_ARB3_CHNL19_STATUS_ADDR A:0x249b008
y.create.l HWIO_PMIC_ARB3_CHNL20_STATUS_ADDR A:0x24a3008
y.create.l HWIO_PMIC_ARB3_CHNL21_STATUS_ADDR A:0x24ab008
y.create.l HWIO_PMIC_ARB3_CHNL22_STATUS_ADDR A:0x24b3008
y.create.l HWIO_PMIC_ARB3_CHNL23_STATUS_ADDR A:0x24bb008
y.create.l HWIO_PMIC_ARB3_CHNL24_STATUS_ADDR A:0x24c3008
y.create.l HWIO_PMIC_ARB3_CHNL25_STATUS_ADDR A:0x24cb008
y.create.l HWIO_PMIC_ARB3_CHNL26_STATUS_ADDR A:0x24d3008
y.create.l HWIO_PMIC_ARB3_CHNL27_STATUS_ADDR A:0x24db008
y.create.l HWIO_PMIC_ARB3_CHNL28_STATUS_ADDR A:0x24e3008
y.create.l HWIO_PMIC_ARB3_CHNL29_STATUS_ADDR A:0x24eb008
y.create.l HWIO_PMIC_ARB3_CHNL30_STATUS_ADDR A:0x24f3008
y.create.l HWIO_PMIC_ARB3_CHNL31_STATUS_ADDR A:0x24fb008
y.create.l HWIO_PMIC_ARB3_CHNL32_STATUS_ADDR A:0x2503008
y.create.l HWIO_PMIC_ARB3_CHNL33_STATUS_ADDR A:0x250b008
y.create.l HWIO_PMIC_ARB3_CHNL34_STATUS_ADDR A:0x2513008
y.create.l HWIO_PMIC_ARB3_CHNL35_STATUS_ADDR A:0x251b008
y.create.l HWIO_PMIC_ARB3_CHNL36_STATUS_ADDR A:0x2523008
y.create.l HWIO_PMIC_ARB3_CHNL37_STATUS_ADDR A:0x252b008
y.create.l HWIO_PMIC_ARB3_CHNL38_STATUS_ADDR A:0x2533008
y.create.l HWIO_PMIC_ARB3_CHNL39_STATUS_ADDR A:0x253b008
y.create.l HWIO_PMIC_ARB3_CHNL40_STATUS_ADDR A:0x2543008
y.create.l HWIO_PMIC_ARB3_CHNL41_STATUS_ADDR A:0x254b008
y.create.l HWIO_PMIC_ARB3_CHNL42_STATUS_ADDR A:0x2553008
y.create.l HWIO_PMIC_ARB3_CHNL43_STATUS_ADDR A:0x255b008
y.create.l HWIO_PMIC_ARB3_CHNL44_STATUS_ADDR A:0x2563008
y.create.l HWIO_PMIC_ARB3_CHNL45_STATUS_ADDR A:0x256b008
y.create.l HWIO_PMIC_ARB3_CHNL46_STATUS_ADDR A:0x2573008
y.create.l HWIO_PMIC_ARB3_CHNL47_STATUS_ADDR A:0x257b008
y.create.l HWIO_PMIC_ARB3_CHNL48_STATUS_ADDR A:0x2583008
y.create.l HWIO_PMIC_ARB3_CHNL49_STATUS_ADDR A:0x258b008
y.create.l HWIO_PMIC_ARB3_CHNL50_STATUS_ADDR A:0x2593008
y.create.l HWIO_PMIC_ARB3_CHNL51_STATUS_ADDR A:0x259b008
y.create.l HWIO_PMIC_ARB3_CHNL52_STATUS_ADDR A:0x25a3008
y.create.l HWIO_PMIC_ARB3_CHNL53_STATUS_ADDR A:0x25ab008
y.create.l HWIO_PMIC_ARB3_CHNL54_STATUS_ADDR A:0x25b3008
y.create.l HWIO_PMIC_ARB3_CHNL55_STATUS_ADDR A:0x25bb008
y.create.l HWIO_PMIC_ARB3_CHNL56_STATUS_ADDR A:0x25c3008
y.create.l HWIO_PMIC_ARB3_CHNL57_STATUS_ADDR A:0x25cb008
y.create.l HWIO_PMIC_ARB3_CHNL58_STATUS_ADDR A:0x25d3008
y.create.l HWIO_PMIC_ARB3_CHNL59_STATUS_ADDR A:0x25db008
y.create.l HWIO_PMIC_ARB3_CHNL60_STATUS_ADDR A:0x25e3008
y.create.l HWIO_PMIC_ARB3_CHNL61_STATUS_ADDR A:0x25eb008
y.create.l HWIO_PMIC_ARB3_CHNL62_STATUS_ADDR A:0x25f3008
y.create.l HWIO_PMIC_ARB3_CHNL63_STATUS_ADDR A:0x25fb008
y.create.l HWIO_PMIC_ARB3_CHNL64_STATUS_ADDR A:0x2603008
y.create.l HWIO_PMIC_ARB3_CHNL65_STATUS_ADDR A:0x260b008
y.create.l HWIO_PMIC_ARB3_CHNL66_STATUS_ADDR A:0x2613008
y.create.l HWIO_PMIC_ARB3_CHNL67_STATUS_ADDR A:0x261b008
y.create.l HWIO_PMIC_ARB3_CHNL68_STATUS_ADDR A:0x2623008
y.create.l HWIO_PMIC_ARB3_CHNL69_STATUS_ADDR A:0x262b008
y.create.l HWIO_PMIC_ARB3_CHNL70_STATUS_ADDR A:0x2633008
y.create.l HWIO_PMIC_ARB3_CHNL71_STATUS_ADDR A:0x263b008
y.create.l HWIO_PMIC_ARB3_CHNL72_STATUS_ADDR A:0x2643008
y.create.l HWIO_PMIC_ARB3_CHNL73_STATUS_ADDR A:0x264b008
y.create.l HWIO_PMIC_ARB3_CHNL74_STATUS_ADDR A:0x2653008
y.create.l HWIO_PMIC_ARB3_CHNL75_STATUS_ADDR A:0x265b008
y.create.l HWIO_PMIC_ARB3_CHNL76_STATUS_ADDR A:0x2663008
y.create.l HWIO_PMIC_ARB3_CHNL77_STATUS_ADDR A:0x266b008
y.create.l HWIO_PMIC_ARB3_CHNL78_STATUS_ADDR A:0x2673008
y.create.l HWIO_PMIC_ARB3_CHNL79_STATUS_ADDR A:0x267b008
y.create.l HWIO_PMIC_ARB3_CHNL80_STATUS_ADDR A:0x2683008
y.create.l HWIO_PMIC_ARB3_CHNL81_STATUS_ADDR A:0x268b008
y.create.l HWIO_PMIC_ARB3_CHNL82_STATUS_ADDR A:0x2693008
y.create.l HWIO_PMIC_ARB3_CHNL83_STATUS_ADDR A:0x269b008
y.create.l HWIO_PMIC_ARB3_CHNL84_STATUS_ADDR A:0x26a3008
y.create.l HWIO_PMIC_ARB3_CHNL85_STATUS_ADDR A:0x26ab008
y.create.l HWIO_PMIC_ARB3_CHNL86_STATUS_ADDR A:0x26b3008
y.create.l HWIO_PMIC_ARB3_CHNL87_STATUS_ADDR A:0x26bb008
y.create.l HWIO_PMIC_ARB3_CHNL88_STATUS_ADDR A:0x26c3008
y.create.l HWIO_PMIC_ARB3_CHNL89_STATUS_ADDR A:0x26cb008
y.create.l HWIO_PMIC_ARB3_CHNL90_STATUS_ADDR A:0x26d3008
y.create.l HWIO_PMIC_ARB3_CHNL91_STATUS_ADDR A:0x26db008
y.create.l HWIO_PMIC_ARB3_CHNL92_STATUS_ADDR A:0x26e3008
y.create.l HWIO_PMIC_ARB3_CHNL93_STATUS_ADDR A:0x26eb008
y.create.l HWIO_PMIC_ARB3_CHNL94_STATUS_ADDR A:0x26f3008
y.create.l HWIO_PMIC_ARB3_CHNL95_STATUS_ADDR A:0x26fb008
y.create.l HWIO_PMIC_ARB3_CHNL96_STATUS_ADDR A:0x2703008
y.create.l HWIO_PMIC_ARB3_CHNL97_STATUS_ADDR A:0x270b008
y.create.l HWIO_PMIC_ARB3_CHNL98_STATUS_ADDR A:0x2713008
y.create.l HWIO_PMIC_ARB3_CHNL99_STATUS_ADDR A:0x271b008
y.create.l HWIO_PMIC_ARB3_CHNL100_STATUS_ADDR A:0x2723008
y.create.l HWIO_PMIC_ARB3_CHNL101_STATUS_ADDR A:0x272b008
y.create.l HWIO_PMIC_ARB3_CHNL102_STATUS_ADDR A:0x2733008
y.create.l HWIO_PMIC_ARB3_CHNL103_STATUS_ADDR A:0x273b008
y.create.l HWIO_PMIC_ARB3_CHNL104_STATUS_ADDR A:0x2743008
y.create.l HWIO_PMIC_ARB3_CHNL105_STATUS_ADDR A:0x274b008
y.create.l HWIO_PMIC_ARB3_CHNL106_STATUS_ADDR A:0x2753008
y.create.l HWIO_PMIC_ARB3_CHNL107_STATUS_ADDR A:0x275b008
y.create.l HWIO_PMIC_ARB3_CHNL108_STATUS_ADDR A:0x2763008
y.create.l HWIO_PMIC_ARB3_CHNL109_STATUS_ADDR A:0x276b008
y.create.l HWIO_PMIC_ARB3_CHNL110_STATUS_ADDR A:0x2773008
y.create.l HWIO_PMIC_ARB3_CHNL111_STATUS_ADDR A:0x277b008
y.create.l HWIO_PMIC_ARB3_CHNL112_STATUS_ADDR A:0x2783008
y.create.l HWIO_PMIC_ARB3_CHNL113_STATUS_ADDR A:0x278b008
y.create.l HWIO_PMIC_ARB3_CHNL114_STATUS_ADDR A:0x2793008
y.create.l HWIO_PMIC_ARB3_CHNL115_STATUS_ADDR A:0x279b008
y.create.l HWIO_PMIC_ARB3_CHNL116_STATUS_ADDR A:0x27a3008
y.create.l HWIO_PMIC_ARB3_CHNL117_STATUS_ADDR A:0x27ab008
y.create.l HWIO_PMIC_ARB3_CHNL118_STATUS_ADDR A:0x27b3008
y.create.l HWIO_PMIC_ARB3_CHNL119_STATUS_ADDR A:0x27bb008
y.create.l HWIO_PMIC_ARB3_CHNL120_STATUS_ADDR A:0x27c3008
y.create.l HWIO_PMIC_ARB3_CHNL121_STATUS_ADDR A:0x27cb008
y.create.l HWIO_PMIC_ARB3_CHNL122_STATUS_ADDR A:0x27d3008
y.create.l HWIO_PMIC_ARB3_CHNL123_STATUS_ADDR A:0x27db008
y.create.l HWIO_PMIC_ARB3_CHNL124_STATUS_ADDR A:0x27e3008
y.create.l HWIO_PMIC_ARB3_CHNL125_STATUS_ADDR A:0x27eb008
y.create.l HWIO_PMIC_ARB3_CHNL126_STATUS_ADDR A:0x27f3008
y.create.l HWIO_PMIC_ARB3_CHNL127_STATUS_ADDR A:0x27fb008
y.create.l HWIO_PMIC_ARB3_CHNL128_STATUS_ADDR A:0x2803008
y.create.l HWIO_PMIC_ARB3_CHNL129_STATUS_ADDR A:0x280b008
y.create.l HWIO_PMIC_ARB3_CHNL130_STATUS_ADDR A:0x2813008
y.create.l HWIO_PMIC_ARB3_CHNL131_STATUS_ADDR A:0x281b008
y.create.l HWIO_PMIC_ARB3_CHNL132_STATUS_ADDR A:0x2823008
y.create.l HWIO_PMIC_ARB3_CHNL133_STATUS_ADDR A:0x282b008
y.create.l HWIO_PMIC_ARB3_CHNL134_STATUS_ADDR A:0x2833008
y.create.l HWIO_PMIC_ARB3_CHNL135_STATUS_ADDR A:0x283b008
y.create.l HWIO_PMIC_ARB3_CHNL136_STATUS_ADDR A:0x2843008
y.create.l HWIO_PMIC_ARB3_CHNL137_STATUS_ADDR A:0x284b008
y.create.l HWIO_PMIC_ARB3_CHNL138_STATUS_ADDR A:0x2853008
y.create.l HWIO_PMIC_ARB3_CHNL139_STATUS_ADDR A:0x285b008
y.create.l HWIO_PMIC_ARB3_CHNL140_STATUS_ADDR A:0x2863008
y.create.l HWIO_PMIC_ARB3_CHNL141_STATUS_ADDR A:0x286b008
y.create.l HWIO_PMIC_ARB3_CHNL142_STATUS_ADDR A:0x2873008
y.create.l HWIO_PMIC_ARB3_CHNL143_STATUS_ADDR A:0x287b008
y.create.l HWIO_PMIC_ARB3_CHNL144_STATUS_ADDR A:0x2883008
y.create.l HWIO_PMIC_ARB3_CHNL145_STATUS_ADDR A:0x288b008
y.create.l HWIO_PMIC_ARB3_CHNL146_STATUS_ADDR A:0x2893008
y.create.l HWIO_PMIC_ARB3_CHNL147_STATUS_ADDR A:0x289b008
y.create.l HWIO_PMIC_ARB3_CHNL148_STATUS_ADDR A:0x28a3008
y.create.l HWIO_PMIC_ARB3_CHNL149_STATUS_ADDR A:0x28ab008
y.create.l HWIO_PMIC_ARB3_CHNL150_STATUS_ADDR A:0x28b3008
y.create.l HWIO_PMIC_ARB3_CHNL151_STATUS_ADDR A:0x28bb008
y.create.l HWIO_PMIC_ARB3_CHNL152_STATUS_ADDR A:0x28c3008
y.create.l HWIO_PMIC_ARB3_CHNL153_STATUS_ADDR A:0x28cb008
y.create.l HWIO_PMIC_ARB3_CHNL154_STATUS_ADDR A:0x28d3008
y.create.l HWIO_PMIC_ARB3_CHNL155_STATUS_ADDR A:0x28db008
y.create.l HWIO_PMIC_ARB3_CHNL156_STATUS_ADDR A:0x28e3008
y.create.l HWIO_PMIC_ARB3_CHNL157_STATUS_ADDR A:0x28eb008
y.create.l HWIO_PMIC_ARB3_CHNL158_STATUS_ADDR A:0x28f3008
y.create.l HWIO_PMIC_ARB3_CHNL159_STATUS_ADDR A:0x28fb008
y.create.l HWIO_PMIC_ARB3_CHNL160_STATUS_ADDR A:0x2903008
y.create.l HWIO_PMIC_ARB3_CHNL161_STATUS_ADDR A:0x290b008
y.create.l HWIO_PMIC_ARB3_CHNL162_STATUS_ADDR A:0x2913008
y.create.l HWIO_PMIC_ARB3_CHNL163_STATUS_ADDR A:0x291b008
y.create.l HWIO_PMIC_ARB3_CHNL164_STATUS_ADDR A:0x2923008
y.create.l HWIO_PMIC_ARB3_CHNL165_STATUS_ADDR A:0x292b008
y.create.l HWIO_PMIC_ARB3_CHNL166_STATUS_ADDR A:0x2933008
y.create.l HWIO_PMIC_ARB3_CHNL167_STATUS_ADDR A:0x293b008
y.create.l HWIO_PMIC_ARB3_CHNL168_STATUS_ADDR A:0x2943008
y.create.l HWIO_PMIC_ARB3_CHNL169_STATUS_ADDR A:0x294b008
y.create.l HWIO_PMIC_ARB3_CHNL170_STATUS_ADDR A:0x2953008
y.create.l HWIO_PMIC_ARB3_CHNL171_STATUS_ADDR A:0x295b008
y.create.l HWIO_PMIC_ARB3_CHNL172_STATUS_ADDR A:0x2963008
y.create.l HWIO_PMIC_ARB3_CHNL173_STATUS_ADDR A:0x296b008
y.create.l HWIO_PMIC_ARB3_CHNL174_STATUS_ADDR A:0x2973008
y.create.l HWIO_PMIC_ARB3_CHNL175_STATUS_ADDR A:0x297b008
y.create.l HWIO_PMIC_ARB3_CHNL176_STATUS_ADDR A:0x2983008
y.create.l HWIO_PMIC_ARB3_CHNL177_STATUS_ADDR A:0x298b008
y.create.l HWIO_PMIC_ARB3_CHNL178_STATUS_ADDR A:0x2993008
y.create.l HWIO_PMIC_ARB3_CHNL179_STATUS_ADDR A:0x299b008
y.create.l HWIO_PMIC_ARB3_CHNL180_STATUS_ADDR A:0x29a3008
y.create.l HWIO_PMIC_ARB3_CHNL181_STATUS_ADDR A:0x29ab008
y.create.l HWIO_PMIC_ARB3_CHNL182_STATUS_ADDR A:0x29b3008
y.create.l HWIO_PMIC_ARB3_CHNL183_STATUS_ADDR A:0x29bb008
y.create.l HWIO_PMIC_ARB3_CHNL184_STATUS_ADDR A:0x29c3008
y.create.l HWIO_PMIC_ARB3_CHNL185_STATUS_ADDR A:0x29cb008
y.create.l HWIO_PMIC_ARB3_CHNL186_STATUS_ADDR A:0x29d3008
y.create.l HWIO_PMIC_ARB3_CHNL187_STATUS_ADDR A:0x29db008
y.create.l HWIO_PMIC_ARB3_CHNL188_STATUS_ADDR A:0x29e3008
y.create.l HWIO_PMIC_ARB3_CHNL189_STATUS_ADDR A:0x29eb008
y.create.l HWIO_PMIC_ARB3_CHNL190_STATUS_ADDR A:0x29f3008
y.create.l HWIO_PMIC_ARB3_CHNL191_STATUS_ADDR A:0x29fb008
y.create.l HWIO_PMIC_ARB3_CHNL192_STATUS_ADDR A:0x2a03008
y.create.l HWIO_PMIC_ARB3_CHNL193_STATUS_ADDR A:0x2a0b008
y.create.l HWIO_PMIC_ARB3_CHNL194_STATUS_ADDR A:0x2a13008
y.create.l HWIO_PMIC_ARB3_CHNL195_STATUS_ADDR A:0x2a1b008
y.create.l HWIO_PMIC_ARB3_CHNL196_STATUS_ADDR A:0x2a23008
y.create.l HWIO_PMIC_ARB3_CHNL197_STATUS_ADDR A:0x2a2b008
y.create.l HWIO_PMIC_ARB3_CHNL198_STATUS_ADDR A:0x2a33008
y.create.l HWIO_PMIC_ARB3_CHNL199_STATUS_ADDR A:0x2a3b008
y.create.l HWIO_PMIC_ARB3_CHNL200_STATUS_ADDR A:0x2a43008
y.create.l HWIO_PMIC_ARB3_CHNL201_STATUS_ADDR A:0x2a4b008
y.create.l HWIO_PMIC_ARB3_CHNL202_STATUS_ADDR A:0x2a53008
y.create.l HWIO_PMIC_ARB3_CHNL203_STATUS_ADDR A:0x2a5b008
y.create.l HWIO_PMIC_ARB3_CHNL204_STATUS_ADDR A:0x2a63008
y.create.l HWIO_PMIC_ARB3_CHNL205_STATUS_ADDR A:0x2a6b008
y.create.l HWIO_PMIC_ARB3_CHNL206_STATUS_ADDR A:0x2a73008
y.create.l HWIO_PMIC_ARB3_CHNL207_STATUS_ADDR A:0x2a7b008
y.create.l HWIO_PMIC_ARB3_CHNL208_STATUS_ADDR A:0x2a83008
y.create.l HWIO_PMIC_ARB3_CHNL209_STATUS_ADDR A:0x2a8b008
y.create.l HWIO_PMIC_ARB3_CHNL210_STATUS_ADDR A:0x2a93008
y.create.l HWIO_PMIC_ARB3_CHNL211_STATUS_ADDR A:0x2a9b008
y.create.l HWIO_PMIC_ARB3_CHNL212_STATUS_ADDR A:0x2aa3008
y.create.l HWIO_PMIC_ARB3_CHNL213_STATUS_ADDR A:0x2aab008
y.create.l HWIO_PMIC_ARB3_CHNL214_STATUS_ADDR A:0x2ab3008
y.create.l HWIO_PMIC_ARB3_CHNL215_STATUS_ADDR A:0x2abb008
y.create.l HWIO_PMIC_ARB3_CHNL216_STATUS_ADDR A:0x2ac3008
y.create.l HWIO_PMIC_ARB3_CHNL217_STATUS_ADDR A:0x2acb008
y.create.l HWIO_PMIC_ARB3_CHNL218_STATUS_ADDR A:0x2ad3008
y.create.l HWIO_PMIC_ARB3_CHNL219_STATUS_ADDR A:0x2adb008
y.create.l HWIO_PMIC_ARB3_CHNL220_STATUS_ADDR A:0x2ae3008
y.create.l HWIO_PMIC_ARB3_CHNL221_STATUS_ADDR A:0x2aeb008
y.create.l HWIO_PMIC_ARB3_CHNL222_STATUS_ADDR A:0x2af3008
y.create.l HWIO_PMIC_ARB3_CHNL223_STATUS_ADDR A:0x2afb008
y.create.l HWIO_PMIC_ARB3_CHNL224_STATUS_ADDR A:0x2b03008
y.create.l HWIO_PMIC_ARB3_CHNL225_STATUS_ADDR A:0x2b0b008
y.create.l HWIO_PMIC_ARB3_CHNL226_STATUS_ADDR A:0x2b13008
y.create.l HWIO_PMIC_ARB3_CHNL227_STATUS_ADDR A:0x2b1b008
y.create.l HWIO_PMIC_ARB3_CHNL228_STATUS_ADDR A:0x2b23008
y.create.l HWIO_PMIC_ARB3_CHNL229_STATUS_ADDR A:0x2b2b008
y.create.l HWIO_PMIC_ARB3_CHNL230_STATUS_ADDR A:0x2b33008
y.create.l HWIO_PMIC_ARB3_CHNL231_STATUS_ADDR A:0x2b3b008
y.create.l HWIO_PMIC_ARB3_CHNL232_STATUS_ADDR A:0x2b43008
y.create.l HWIO_PMIC_ARB3_CHNL233_STATUS_ADDR A:0x2b4b008
y.create.l HWIO_PMIC_ARB3_CHNL234_STATUS_ADDR A:0x2b53008
y.create.l HWIO_PMIC_ARB3_CHNL235_STATUS_ADDR A:0x2b5b008
y.create.l HWIO_PMIC_ARB3_CHNL236_STATUS_ADDR A:0x2b63008
y.create.l HWIO_PMIC_ARB3_CHNL237_STATUS_ADDR A:0x2b6b008
y.create.l HWIO_PMIC_ARB3_CHNL238_STATUS_ADDR A:0x2b73008
y.create.l HWIO_PMIC_ARB3_CHNL239_STATUS_ADDR A:0x2b7b008
y.create.l HWIO_PMIC_ARB3_CHNL240_STATUS_ADDR A:0x2b83008
y.create.l HWIO_PMIC_ARB3_CHNL241_STATUS_ADDR A:0x2b8b008
y.create.l HWIO_PMIC_ARB3_CHNL242_STATUS_ADDR A:0x2b93008
y.create.l HWIO_PMIC_ARB3_CHNL243_STATUS_ADDR A:0x2b9b008
y.create.l HWIO_PMIC_ARB3_CHNL244_STATUS_ADDR A:0x2ba3008
y.create.l HWIO_PMIC_ARB3_CHNL245_STATUS_ADDR A:0x2bab008
y.create.l HWIO_PMIC_ARB3_CHNL246_STATUS_ADDR A:0x2bb3008
y.create.l HWIO_PMIC_ARB3_CHNL247_STATUS_ADDR A:0x2bbb008
y.create.l HWIO_PMIC_ARB3_CHNL248_STATUS_ADDR A:0x2bc3008
y.create.l HWIO_PMIC_ARB3_CHNL249_STATUS_ADDR A:0x2bcb008
y.create.l HWIO_PMIC_ARB3_CHNL250_STATUS_ADDR A:0x2bd3008
y.create.l HWIO_PMIC_ARB3_CHNL251_STATUS_ADDR A:0x2bdb008
y.create.l HWIO_PMIC_ARB3_CHNL252_STATUS_ADDR A:0x2be3008
y.create.l HWIO_PMIC_ARB3_CHNL253_STATUS_ADDR A:0x2beb008
y.create.l HWIO_PMIC_ARB3_CHNL254_STATUS_ADDR A:0x2bf3008
y.create.l HWIO_PMIC_ARB3_CHNL255_STATUS_ADDR A:0x2bfb008
y.create.l HWIO_PMIC_ARB4_CHNL0_STATUS_ADDR A:0x2404008
y.create.l HWIO_PMIC_ARB4_CHNL1_STATUS_ADDR A:0x240c008
y.create.l HWIO_PMIC_ARB4_CHNL2_STATUS_ADDR A:0x2414008
y.create.l HWIO_PMIC_ARB4_CHNL3_STATUS_ADDR A:0x241c008
y.create.l HWIO_PMIC_ARB4_CHNL4_STATUS_ADDR A:0x2424008
y.create.l HWIO_PMIC_ARB4_CHNL5_STATUS_ADDR A:0x242c008
y.create.l HWIO_PMIC_ARB4_CHNL6_STATUS_ADDR A:0x2434008
y.create.l HWIO_PMIC_ARB4_CHNL7_STATUS_ADDR A:0x243c008
y.create.l HWIO_PMIC_ARB4_CHNL8_STATUS_ADDR A:0x2444008
y.create.l HWIO_PMIC_ARB4_CHNL9_STATUS_ADDR A:0x244c008
y.create.l HWIO_PMIC_ARB4_CHNL10_STATUS_ADDR A:0x2454008
y.create.l HWIO_PMIC_ARB4_CHNL11_STATUS_ADDR A:0x245c008
y.create.l HWIO_PMIC_ARB4_CHNL12_STATUS_ADDR A:0x2464008
y.create.l HWIO_PMIC_ARB4_CHNL13_STATUS_ADDR A:0x246c008
y.create.l HWIO_PMIC_ARB4_CHNL14_STATUS_ADDR A:0x2474008
y.create.l HWIO_PMIC_ARB4_CHNL15_STATUS_ADDR A:0x247c008
y.create.l HWIO_PMIC_ARB4_CHNL16_STATUS_ADDR A:0x2484008
y.create.l HWIO_PMIC_ARB4_CHNL17_STATUS_ADDR A:0x248c008
y.create.l HWIO_PMIC_ARB4_CHNL18_STATUS_ADDR A:0x2494008
y.create.l HWIO_PMIC_ARB4_CHNL19_STATUS_ADDR A:0x249c008
y.create.l HWIO_PMIC_ARB4_CHNL20_STATUS_ADDR A:0x24a4008
y.create.l HWIO_PMIC_ARB4_CHNL21_STATUS_ADDR A:0x24ac008
y.create.l HWIO_PMIC_ARB4_CHNL22_STATUS_ADDR A:0x24b4008
y.create.l HWIO_PMIC_ARB4_CHNL23_STATUS_ADDR A:0x24bc008
y.create.l HWIO_PMIC_ARB4_CHNL24_STATUS_ADDR A:0x24c4008
y.create.l HWIO_PMIC_ARB4_CHNL25_STATUS_ADDR A:0x24cc008
y.create.l HWIO_PMIC_ARB4_CHNL26_STATUS_ADDR A:0x24d4008
y.create.l HWIO_PMIC_ARB4_CHNL27_STATUS_ADDR A:0x24dc008
y.create.l HWIO_PMIC_ARB4_CHNL28_STATUS_ADDR A:0x24e4008
y.create.l HWIO_PMIC_ARB4_CHNL29_STATUS_ADDR A:0x24ec008
y.create.l HWIO_PMIC_ARB4_CHNL30_STATUS_ADDR A:0x24f4008
y.create.l HWIO_PMIC_ARB4_CHNL31_STATUS_ADDR A:0x24fc008
y.create.l HWIO_PMIC_ARB4_CHNL32_STATUS_ADDR A:0x2504008
y.create.l HWIO_PMIC_ARB4_CHNL33_STATUS_ADDR A:0x250c008
y.create.l HWIO_PMIC_ARB4_CHNL34_STATUS_ADDR A:0x2514008
y.create.l HWIO_PMIC_ARB4_CHNL35_STATUS_ADDR A:0x251c008
y.create.l HWIO_PMIC_ARB4_CHNL36_STATUS_ADDR A:0x2524008
y.create.l HWIO_PMIC_ARB4_CHNL37_STATUS_ADDR A:0x252c008
y.create.l HWIO_PMIC_ARB4_CHNL38_STATUS_ADDR A:0x2534008
y.create.l HWIO_PMIC_ARB4_CHNL39_STATUS_ADDR A:0x253c008
y.create.l HWIO_PMIC_ARB4_CHNL40_STATUS_ADDR A:0x2544008
y.create.l HWIO_PMIC_ARB4_CHNL41_STATUS_ADDR A:0x254c008
y.create.l HWIO_PMIC_ARB4_CHNL42_STATUS_ADDR A:0x2554008
y.create.l HWIO_PMIC_ARB4_CHNL43_STATUS_ADDR A:0x255c008
y.create.l HWIO_PMIC_ARB4_CHNL44_STATUS_ADDR A:0x2564008
y.create.l HWIO_PMIC_ARB4_CHNL45_STATUS_ADDR A:0x256c008
y.create.l HWIO_PMIC_ARB4_CHNL46_STATUS_ADDR A:0x2574008
y.create.l HWIO_PMIC_ARB4_CHNL47_STATUS_ADDR A:0x257c008
y.create.l HWIO_PMIC_ARB4_CHNL48_STATUS_ADDR A:0x2584008
y.create.l HWIO_PMIC_ARB4_CHNL49_STATUS_ADDR A:0x258c008
y.create.l HWIO_PMIC_ARB4_CHNL50_STATUS_ADDR A:0x2594008
y.create.l HWIO_PMIC_ARB4_CHNL51_STATUS_ADDR A:0x259c008
y.create.l HWIO_PMIC_ARB4_CHNL52_STATUS_ADDR A:0x25a4008
y.create.l HWIO_PMIC_ARB4_CHNL53_STATUS_ADDR A:0x25ac008
y.create.l HWIO_PMIC_ARB4_CHNL54_STATUS_ADDR A:0x25b4008
y.create.l HWIO_PMIC_ARB4_CHNL55_STATUS_ADDR A:0x25bc008
y.create.l HWIO_PMIC_ARB4_CHNL56_STATUS_ADDR A:0x25c4008
y.create.l HWIO_PMIC_ARB4_CHNL57_STATUS_ADDR A:0x25cc008
y.create.l HWIO_PMIC_ARB4_CHNL58_STATUS_ADDR A:0x25d4008
y.create.l HWIO_PMIC_ARB4_CHNL59_STATUS_ADDR A:0x25dc008
y.create.l HWIO_PMIC_ARB4_CHNL60_STATUS_ADDR A:0x25e4008
y.create.l HWIO_PMIC_ARB4_CHNL61_STATUS_ADDR A:0x25ec008
y.create.l HWIO_PMIC_ARB4_CHNL62_STATUS_ADDR A:0x25f4008
y.create.l HWIO_PMIC_ARB4_CHNL63_STATUS_ADDR A:0x25fc008
y.create.l HWIO_PMIC_ARB4_CHNL64_STATUS_ADDR A:0x2604008
y.create.l HWIO_PMIC_ARB4_CHNL65_STATUS_ADDR A:0x260c008
y.create.l HWIO_PMIC_ARB4_CHNL66_STATUS_ADDR A:0x2614008
y.create.l HWIO_PMIC_ARB4_CHNL67_STATUS_ADDR A:0x261c008
y.create.l HWIO_PMIC_ARB4_CHNL68_STATUS_ADDR A:0x2624008
y.create.l HWIO_PMIC_ARB4_CHNL69_STATUS_ADDR A:0x262c008
y.create.l HWIO_PMIC_ARB4_CHNL70_STATUS_ADDR A:0x2634008
y.create.l HWIO_PMIC_ARB4_CHNL71_STATUS_ADDR A:0x263c008
y.create.l HWIO_PMIC_ARB4_CHNL72_STATUS_ADDR A:0x2644008
y.create.l HWIO_PMIC_ARB4_CHNL73_STATUS_ADDR A:0x264c008
y.create.l HWIO_PMIC_ARB4_CHNL74_STATUS_ADDR A:0x2654008
y.create.l HWIO_PMIC_ARB4_CHNL75_STATUS_ADDR A:0x265c008
y.create.l HWIO_PMIC_ARB4_CHNL76_STATUS_ADDR A:0x2664008
y.create.l HWIO_PMIC_ARB4_CHNL77_STATUS_ADDR A:0x266c008
y.create.l HWIO_PMIC_ARB4_CHNL78_STATUS_ADDR A:0x2674008
y.create.l HWIO_PMIC_ARB4_CHNL79_STATUS_ADDR A:0x267c008
y.create.l HWIO_PMIC_ARB4_CHNL80_STATUS_ADDR A:0x2684008
y.create.l HWIO_PMIC_ARB4_CHNL81_STATUS_ADDR A:0x268c008
y.create.l HWIO_PMIC_ARB4_CHNL82_STATUS_ADDR A:0x2694008
y.create.l HWIO_PMIC_ARB4_CHNL83_STATUS_ADDR A:0x269c008
y.create.l HWIO_PMIC_ARB4_CHNL84_STATUS_ADDR A:0x26a4008
y.create.l HWIO_PMIC_ARB4_CHNL85_STATUS_ADDR A:0x26ac008
y.create.l HWIO_PMIC_ARB4_CHNL86_STATUS_ADDR A:0x26b4008
y.create.l HWIO_PMIC_ARB4_CHNL87_STATUS_ADDR A:0x26bc008
y.create.l HWIO_PMIC_ARB4_CHNL88_STATUS_ADDR A:0x26c4008
y.create.l HWIO_PMIC_ARB4_CHNL89_STATUS_ADDR A:0x26cc008
y.create.l HWIO_PMIC_ARB4_CHNL90_STATUS_ADDR A:0x26d4008
y.create.l HWIO_PMIC_ARB4_CHNL91_STATUS_ADDR A:0x26dc008
y.create.l HWIO_PMIC_ARB4_CHNL92_STATUS_ADDR A:0x26e4008
y.create.l HWIO_PMIC_ARB4_CHNL93_STATUS_ADDR A:0x26ec008
y.create.l HWIO_PMIC_ARB4_CHNL94_STATUS_ADDR A:0x26f4008
y.create.l HWIO_PMIC_ARB4_CHNL95_STATUS_ADDR A:0x26fc008
y.create.l HWIO_PMIC_ARB4_CHNL96_STATUS_ADDR A:0x2704008
y.create.l HWIO_PMIC_ARB4_CHNL97_STATUS_ADDR A:0x270c008
y.create.l HWIO_PMIC_ARB4_CHNL98_STATUS_ADDR A:0x2714008
y.create.l HWIO_PMIC_ARB4_CHNL99_STATUS_ADDR A:0x271c008
y.create.l HWIO_PMIC_ARB4_CHNL100_STATUS_ADDR A:0x2724008
y.create.l HWIO_PMIC_ARB4_CHNL101_STATUS_ADDR A:0x272c008
y.create.l HWIO_PMIC_ARB4_CHNL102_STATUS_ADDR A:0x2734008
y.create.l HWIO_PMIC_ARB4_CHNL103_STATUS_ADDR A:0x273c008
y.create.l HWIO_PMIC_ARB4_CHNL104_STATUS_ADDR A:0x2744008
y.create.l HWIO_PMIC_ARB4_CHNL105_STATUS_ADDR A:0x274c008
y.create.l HWIO_PMIC_ARB4_CHNL106_STATUS_ADDR A:0x2754008
y.create.l HWIO_PMIC_ARB4_CHNL107_STATUS_ADDR A:0x275c008
y.create.l HWIO_PMIC_ARB4_CHNL108_STATUS_ADDR A:0x2764008
y.create.l HWIO_PMIC_ARB4_CHNL109_STATUS_ADDR A:0x276c008
y.create.l HWIO_PMIC_ARB4_CHNL110_STATUS_ADDR A:0x2774008
y.create.l HWIO_PMIC_ARB4_CHNL111_STATUS_ADDR A:0x277c008
y.create.l HWIO_PMIC_ARB4_CHNL112_STATUS_ADDR A:0x2784008
y.create.l HWIO_PMIC_ARB4_CHNL113_STATUS_ADDR A:0x278c008
y.create.l HWIO_PMIC_ARB4_CHNL114_STATUS_ADDR A:0x2794008
y.create.l HWIO_PMIC_ARB4_CHNL115_STATUS_ADDR A:0x279c008
y.create.l HWIO_PMIC_ARB4_CHNL116_STATUS_ADDR A:0x27a4008
y.create.l HWIO_PMIC_ARB4_CHNL117_STATUS_ADDR A:0x27ac008
y.create.l HWIO_PMIC_ARB4_CHNL118_STATUS_ADDR A:0x27b4008
y.create.l HWIO_PMIC_ARB4_CHNL119_STATUS_ADDR A:0x27bc008
y.create.l HWIO_PMIC_ARB4_CHNL120_STATUS_ADDR A:0x27c4008
y.create.l HWIO_PMIC_ARB4_CHNL121_STATUS_ADDR A:0x27cc008
y.create.l HWIO_PMIC_ARB4_CHNL122_STATUS_ADDR A:0x27d4008
y.create.l HWIO_PMIC_ARB4_CHNL123_STATUS_ADDR A:0x27dc008
y.create.l HWIO_PMIC_ARB4_CHNL124_STATUS_ADDR A:0x27e4008
y.create.l HWIO_PMIC_ARB4_CHNL125_STATUS_ADDR A:0x27ec008
y.create.l HWIO_PMIC_ARB4_CHNL126_STATUS_ADDR A:0x27f4008
y.create.l HWIO_PMIC_ARB4_CHNL127_STATUS_ADDR A:0x27fc008
y.create.l HWIO_PMIC_ARB4_CHNL128_STATUS_ADDR A:0x2804008
y.create.l HWIO_PMIC_ARB4_CHNL129_STATUS_ADDR A:0x280c008
y.create.l HWIO_PMIC_ARB4_CHNL130_STATUS_ADDR A:0x2814008
y.create.l HWIO_PMIC_ARB4_CHNL131_STATUS_ADDR A:0x281c008
y.create.l HWIO_PMIC_ARB4_CHNL132_STATUS_ADDR A:0x2824008
y.create.l HWIO_PMIC_ARB4_CHNL133_STATUS_ADDR A:0x282c008
y.create.l HWIO_PMIC_ARB4_CHNL134_STATUS_ADDR A:0x2834008
y.create.l HWIO_PMIC_ARB4_CHNL135_STATUS_ADDR A:0x283c008
y.create.l HWIO_PMIC_ARB4_CHNL136_STATUS_ADDR A:0x2844008
y.create.l HWIO_PMIC_ARB4_CHNL137_STATUS_ADDR A:0x284c008
y.create.l HWIO_PMIC_ARB4_CHNL138_STATUS_ADDR A:0x2854008
y.create.l HWIO_PMIC_ARB4_CHNL139_STATUS_ADDR A:0x285c008
y.create.l HWIO_PMIC_ARB4_CHNL140_STATUS_ADDR A:0x2864008
y.create.l HWIO_PMIC_ARB4_CHNL141_STATUS_ADDR A:0x286c008
y.create.l HWIO_PMIC_ARB4_CHNL142_STATUS_ADDR A:0x2874008
y.create.l HWIO_PMIC_ARB4_CHNL143_STATUS_ADDR A:0x287c008
y.create.l HWIO_PMIC_ARB4_CHNL144_STATUS_ADDR A:0x2884008
y.create.l HWIO_PMIC_ARB4_CHNL145_STATUS_ADDR A:0x288c008
y.create.l HWIO_PMIC_ARB4_CHNL146_STATUS_ADDR A:0x2894008
y.create.l HWIO_PMIC_ARB4_CHNL147_STATUS_ADDR A:0x289c008
y.create.l HWIO_PMIC_ARB4_CHNL148_STATUS_ADDR A:0x28a4008
y.create.l HWIO_PMIC_ARB4_CHNL149_STATUS_ADDR A:0x28ac008
y.create.l HWIO_PMIC_ARB4_CHNL150_STATUS_ADDR A:0x28b4008
y.create.l HWIO_PMIC_ARB4_CHNL151_STATUS_ADDR A:0x28bc008
y.create.l HWIO_PMIC_ARB4_CHNL152_STATUS_ADDR A:0x28c4008
y.create.l HWIO_PMIC_ARB4_CHNL153_STATUS_ADDR A:0x28cc008
y.create.l HWIO_PMIC_ARB4_CHNL154_STATUS_ADDR A:0x28d4008
y.create.l HWIO_PMIC_ARB4_CHNL155_STATUS_ADDR A:0x28dc008
y.create.l HWIO_PMIC_ARB4_CHNL156_STATUS_ADDR A:0x28e4008
y.create.l HWIO_PMIC_ARB4_CHNL157_STATUS_ADDR A:0x28ec008
y.create.l HWIO_PMIC_ARB4_CHNL158_STATUS_ADDR A:0x28f4008
y.create.l HWIO_PMIC_ARB4_CHNL159_STATUS_ADDR A:0x28fc008
y.create.l HWIO_PMIC_ARB4_CHNL160_STATUS_ADDR A:0x2904008
y.create.l HWIO_PMIC_ARB4_CHNL161_STATUS_ADDR A:0x290c008
y.create.l HWIO_PMIC_ARB4_CHNL162_STATUS_ADDR A:0x2914008
y.create.l HWIO_PMIC_ARB4_CHNL163_STATUS_ADDR A:0x291c008
y.create.l HWIO_PMIC_ARB4_CHNL164_STATUS_ADDR A:0x2924008
y.create.l HWIO_PMIC_ARB4_CHNL165_STATUS_ADDR A:0x292c008
y.create.l HWIO_PMIC_ARB4_CHNL166_STATUS_ADDR A:0x2934008
y.create.l HWIO_PMIC_ARB4_CHNL167_STATUS_ADDR A:0x293c008
y.create.l HWIO_PMIC_ARB4_CHNL168_STATUS_ADDR A:0x2944008
y.create.l HWIO_PMIC_ARB4_CHNL169_STATUS_ADDR A:0x294c008
y.create.l HWIO_PMIC_ARB4_CHNL170_STATUS_ADDR A:0x2954008
y.create.l HWIO_PMIC_ARB4_CHNL171_STATUS_ADDR A:0x295c008
y.create.l HWIO_PMIC_ARB4_CHNL172_STATUS_ADDR A:0x2964008
y.create.l HWIO_PMIC_ARB4_CHNL173_STATUS_ADDR A:0x296c008
y.create.l HWIO_PMIC_ARB4_CHNL174_STATUS_ADDR A:0x2974008
y.create.l HWIO_PMIC_ARB4_CHNL175_STATUS_ADDR A:0x297c008
y.create.l HWIO_PMIC_ARB4_CHNL176_STATUS_ADDR A:0x2984008
y.create.l HWIO_PMIC_ARB4_CHNL177_STATUS_ADDR A:0x298c008
y.create.l HWIO_PMIC_ARB4_CHNL178_STATUS_ADDR A:0x2994008
y.create.l HWIO_PMIC_ARB4_CHNL179_STATUS_ADDR A:0x299c008
y.create.l HWIO_PMIC_ARB4_CHNL180_STATUS_ADDR A:0x29a4008
y.create.l HWIO_PMIC_ARB4_CHNL181_STATUS_ADDR A:0x29ac008
y.create.l HWIO_PMIC_ARB4_CHNL182_STATUS_ADDR A:0x29b4008
y.create.l HWIO_PMIC_ARB4_CHNL183_STATUS_ADDR A:0x29bc008
y.create.l HWIO_PMIC_ARB4_CHNL184_STATUS_ADDR A:0x29c4008
y.create.l HWIO_PMIC_ARB4_CHNL185_STATUS_ADDR A:0x29cc008
y.create.l HWIO_PMIC_ARB4_CHNL186_STATUS_ADDR A:0x29d4008
y.create.l HWIO_PMIC_ARB4_CHNL187_STATUS_ADDR A:0x29dc008
y.create.l HWIO_PMIC_ARB4_CHNL188_STATUS_ADDR A:0x29e4008
y.create.l HWIO_PMIC_ARB4_CHNL189_STATUS_ADDR A:0x29ec008
y.create.l HWIO_PMIC_ARB4_CHNL190_STATUS_ADDR A:0x29f4008
y.create.l HWIO_PMIC_ARB4_CHNL191_STATUS_ADDR A:0x29fc008
y.create.l HWIO_PMIC_ARB4_CHNL192_STATUS_ADDR A:0x2a04008
y.create.l HWIO_PMIC_ARB4_CHNL193_STATUS_ADDR A:0x2a0c008
y.create.l HWIO_PMIC_ARB4_CHNL194_STATUS_ADDR A:0x2a14008
y.create.l HWIO_PMIC_ARB4_CHNL195_STATUS_ADDR A:0x2a1c008
y.create.l HWIO_PMIC_ARB4_CHNL196_STATUS_ADDR A:0x2a24008
y.create.l HWIO_PMIC_ARB4_CHNL197_STATUS_ADDR A:0x2a2c008
y.create.l HWIO_PMIC_ARB4_CHNL198_STATUS_ADDR A:0x2a34008
y.create.l HWIO_PMIC_ARB4_CHNL199_STATUS_ADDR A:0x2a3c008
y.create.l HWIO_PMIC_ARB4_CHNL200_STATUS_ADDR A:0x2a44008
y.create.l HWIO_PMIC_ARB4_CHNL201_STATUS_ADDR A:0x2a4c008
y.create.l HWIO_PMIC_ARB4_CHNL202_STATUS_ADDR A:0x2a54008
y.create.l HWIO_PMIC_ARB4_CHNL203_STATUS_ADDR A:0x2a5c008
y.create.l HWIO_PMIC_ARB4_CHNL204_STATUS_ADDR A:0x2a64008
y.create.l HWIO_PMIC_ARB4_CHNL205_STATUS_ADDR A:0x2a6c008
y.create.l HWIO_PMIC_ARB4_CHNL206_STATUS_ADDR A:0x2a74008
y.create.l HWIO_PMIC_ARB4_CHNL207_STATUS_ADDR A:0x2a7c008
y.create.l HWIO_PMIC_ARB4_CHNL208_STATUS_ADDR A:0x2a84008
y.create.l HWIO_PMIC_ARB4_CHNL209_STATUS_ADDR A:0x2a8c008
y.create.l HWIO_PMIC_ARB4_CHNL210_STATUS_ADDR A:0x2a94008
y.create.l HWIO_PMIC_ARB4_CHNL211_STATUS_ADDR A:0x2a9c008
y.create.l HWIO_PMIC_ARB4_CHNL212_STATUS_ADDR A:0x2aa4008
y.create.l HWIO_PMIC_ARB4_CHNL213_STATUS_ADDR A:0x2aac008
y.create.l HWIO_PMIC_ARB4_CHNL214_STATUS_ADDR A:0x2ab4008
y.create.l HWIO_PMIC_ARB4_CHNL215_STATUS_ADDR A:0x2abc008
y.create.l HWIO_PMIC_ARB4_CHNL216_STATUS_ADDR A:0x2ac4008
y.create.l HWIO_PMIC_ARB4_CHNL217_STATUS_ADDR A:0x2acc008
y.create.l HWIO_PMIC_ARB4_CHNL218_STATUS_ADDR A:0x2ad4008
y.create.l HWIO_PMIC_ARB4_CHNL219_STATUS_ADDR A:0x2adc008
y.create.l HWIO_PMIC_ARB4_CHNL220_STATUS_ADDR A:0x2ae4008
y.create.l HWIO_PMIC_ARB4_CHNL221_STATUS_ADDR A:0x2aec008
y.create.l HWIO_PMIC_ARB4_CHNL222_STATUS_ADDR A:0x2af4008
y.create.l HWIO_PMIC_ARB4_CHNL223_STATUS_ADDR A:0x2afc008
y.create.l HWIO_PMIC_ARB4_CHNL224_STATUS_ADDR A:0x2b04008
y.create.l HWIO_PMIC_ARB4_CHNL225_STATUS_ADDR A:0x2b0c008
y.create.l HWIO_PMIC_ARB4_CHNL226_STATUS_ADDR A:0x2b14008
y.create.l HWIO_PMIC_ARB4_CHNL227_STATUS_ADDR A:0x2b1c008
y.create.l HWIO_PMIC_ARB4_CHNL228_STATUS_ADDR A:0x2b24008
y.create.l HWIO_PMIC_ARB4_CHNL229_STATUS_ADDR A:0x2b2c008
y.create.l HWIO_PMIC_ARB4_CHNL230_STATUS_ADDR A:0x2b34008
y.create.l HWIO_PMIC_ARB4_CHNL231_STATUS_ADDR A:0x2b3c008
y.create.l HWIO_PMIC_ARB4_CHNL232_STATUS_ADDR A:0x2b44008
y.create.l HWIO_PMIC_ARB4_CHNL233_STATUS_ADDR A:0x2b4c008
y.create.l HWIO_PMIC_ARB4_CHNL234_STATUS_ADDR A:0x2b54008
y.create.l HWIO_PMIC_ARB4_CHNL235_STATUS_ADDR A:0x2b5c008
y.create.l HWIO_PMIC_ARB4_CHNL236_STATUS_ADDR A:0x2b64008
y.create.l HWIO_PMIC_ARB4_CHNL237_STATUS_ADDR A:0x2b6c008
y.create.l HWIO_PMIC_ARB4_CHNL238_STATUS_ADDR A:0x2b74008
y.create.l HWIO_PMIC_ARB4_CHNL239_STATUS_ADDR A:0x2b7c008
y.create.l HWIO_PMIC_ARB4_CHNL240_STATUS_ADDR A:0x2b84008
y.create.l HWIO_PMIC_ARB4_CHNL241_STATUS_ADDR A:0x2b8c008
y.create.l HWIO_PMIC_ARB4_CHNL242_STATUS_ADDR A:0x2b94008
y.create.l HWIO_PMIC_ARB4_CHNL243_STATUS_ADDR A:0x2b9c008
y.create.l HWIO_PMIC_ARB4_CHNL244_STATUS_ADDR A:0x2ba4008
y.create.l HWIO_PMIC_ARB4_CHNL245_STATUS_ADDR A:0x2bac008
y.create.l HWIO_PMIC_ARB4_CHNL246_STATUS_ADDR A:0x2bb4008
y.create.l HWIO_PMIC_ARB4_CHNL247_STATUS_ADDR A:0x2bbc008
y.create.l HWIO_PMIC_ARB4_CHNL248_STATUS_ADDR A:0x2bc4008
y.create.l HWIO_PMIC_ARB4_CHNL249_STATUS_ADDR A:0x2bcc008
y.create.l HWIO_PMIC_ARB4_CHNL250_STATUS_ADDR A:0x2bd4008
y.create.l HWIO_PMIC_ARB4_CHNL251_STATUS_ADDR A:0x2bdc008
y.create.l HWIO_PMIC_ARB4_CHNL252_STATUS_ADDR A:0x2be4008
y.create.l HWIO_PMIC_ARB4_CHNL253_STATUS_ADDR A:0x2bec008
y.create.l HWIO_PMIC_ARB4_CHNL254_STATUS_ADDR A:0x2bf4008
y.create.l HWIO_PMIC_ARB4_CHNL255_STATUS_ADDR A:0x2bfc008
y.create.l HWIO_PMIC_ARB5_CHNL0_STATUS_ADDR A:0x2405008
y.create.l HWIO_PMIC_ARB5_CHNL1_STATUS_ADDR A:0x240d008
y.create.l HWIO_PMIC_ARB5_CHNL2_STATUS_ADDR A:0x2415008
y.create.l HWIO_PMIC_ARB5_CHNL3_STATUS_ADDR A:0x241d008
y.create.l HWIO_PMIC_ARB5_CHNL4_STATUS_ADDR A:0x2425008
y.create.l HWIO_PMIC_ARB5_CHNL5_STATUS_ADDR A:0x242d008
y.create.l HWIO_PMIC_ARB5_CHNL6_STATUS_ADDR A:0x2435008
y.create.l HWIO_PMIC_ARB5_CHNL7_STATUS_ADDR A:0x243d008
y.create.l HWIO_PMIC_ARB5_CHNL8_STATUS_ADDR A:0x2445008
y.create.l HWIO_PMIC_ARB5_CHNL9_STATUS_ADDR A:0x244d008
y.create.l HWIO_PMIC_ARB5_CHNL10_STATUS_ADDR A:0x2455008
y.create.l HWIO_PMIC_ARB5_CHNL11_STATUS_ADDR A:0x245d008
y.create.l HWIO_PMIC_ARB5_CHNL12_STATUS_ADDR A:0x2465008
y.create.l HWIO_PMIC_ARB5_CHNL13_STATUS_ADDR A:0x246d008
y.create.l HWIO_PMIC_ARB5_CHNL14_STATUS_ADDR A:0x2475008
y.create.l HWIO_PMIC_ARB5_CHNL15_STATUS_ADDR A:0x247d008
y.create.l HWIO_PMIC_ARB5_CHNL16_STATUS_ADDR A:0x2485008
y.create.l HWIO_PMIC_ARB5_CHNL17_STATUS_ADDR A:0x248d008
y.create.l HWIO_PMIC_ARB5_CHNL18_STATUS_ADDR A:0x2495008
y.create.l HWIO_PMIC_ARB5_CHNL19_STATUS_ADDR A:0x249d008
y.create.l HWIO_PMIC_ARB5_CHNL20_STATUS_ADDR A:0x24a5008
y.create.l HWIO_PMIC_ARB5_CHNL21_STATUS_ADDR A:0x24ad008
y.create.l HWIO_PMIC_ARB5_CHNL22_STATUS_ADDR A:0x24b5008
y.create.l HWIO_PMIC_ARB5_CHNL23_STATUS_ADDR A:0x24bd008
y.create.l HWIO_PMIC_ARB5_CHNL24_STATUS_ADDR A:0x24c5008
y.create.l HWIO_PMIC_ARB5_CHNL25_STATUS_ADDR A:0x24cd008
y.create.l HWIO_PMIC_ARB5_CHNL26_STATUS_ADDR A:0x24d5008
y.create.l HWIO_PMIC_ARB5_CHNL27_STATUS_ADDR A:0x24dd008
y.create.l HWIO_PMIC_ARB5_CHNL28_STATUS_ADDR A:0x24e5008
y.create.l HWIO_PMIC_ARB5_CHNL29_STATUS_ADDR A:0x24ed008
y.create.l HWIO_PMIC_ARB5_CHNL30_STATUS_ADDR A:0x24f5008
y.create.l HWIO_PMIC_ARB5_CHNL31_STATUS_ADDR A:0x24fd008
y.create.l HWIO_PMIC_ARB5_CHNL32_STATUS_ADDR A:0x2505008
y.create.l HWIO_PMIC_ARB5_CHNL33_STATUS_ADDR A:0x250d008
y.create.l HWIO_PMIC_ARB5_CHNL34_STATUS_ADDR A:0x2515008
y.create.l HWIO_PMIC_ARB5_CHNL35_STATUS_ADDR A:0x251d008
y.create.l HWIO_PMIC_ARB5_CHNL36_STATUS_ADDR A:0x2525008
y.create.l HWIO_PMIC_ARB5_CHNL37_STATUS_ADDR A:0x252d008
y.create.l HWIO_PMIC_ARB5_CHNL38_STATUS_ADDR A:0x2535008
y.create.l HWIO_PMIC_ARB5_CHNL39_STATUS_ADDR A:0x253d008
y.create.l HWIO_PMIC_ARB5_CHNL40_STATUS_ADDR A:0x2545008
y.create.l HWIO_PMIC_ARB5_CHNL41_STATUS_ADDR A:0x254d008
y.create.l HWIO_PMIC_ARB5_CHNL42_STATUS_ADDR A:0x2555008
y.create.l HWIO_PMIC_ARB5_CHNL43_STATUS_ADDR A:0x255d008
y.create.l HWIO_PMIC_ARB5_CHNL44_STATUS_ADDR A:0x2565008
y.create.l HWIO_PMIC_ARB5_CHNL45_STATUS_ADDR A:0x256d008
y.create.l HWIO_PMIC_ARB5_CHNL46_STATUS_ADDR A:0x2575008
y.create.l HWIO_PMIC_ARB5_CHNL47_STATUS_ADDR A:0x257d008
y.create.l HWIO_PMIC_ARB5_CHNL48_STATUS_ADDR A:0x2585008
y.create.l HWIO_PMIC_ARB5_CHNL49_STATUS_ADDR A:0x258d008
y.create.l HWIO_PMIC_ARB5_CHNL50_STATUS_ADDR A:0x2595008
y.create.l HWIO_PMIC_ARB5_CHNL51_STATUS_ADDR A:0x259d008
y.create.l HWIO_PMIC_ARB5_CHNL52_STATUS_ADDR A:0x25a5008
y.create.l HWIO_PMIC_ARB5_CHNL53_STATUS_ADDR A:0x25ad008
y.create.l HWIO_PMIC_ARB5_CHNL54_STATUS_ADDR A:0x25b5008
y.create.l HWIO_PMIC_ARB5_CHNL55_STATUS_ADDR A:0x25bd008
y.create.l HWIO_PMIC_ARB5_CHNL56_STATUS_ADDR A:0x25c5008
y.create.l HWIO_PMIC_ARB5_CHNL57_STATUS_ADDR A:0x25cd008
y.create.l HWIO_PMIC_ARB5_CHNL58_STATUS_ADDR A:0x25d5008
y.create.l HWIO_PMIC_ARB5_CHNL59_STATUS_ADDR A:0x25dd008
y.create.l HWIO_PMIC_ARB5_CHNL60_STATUS_ADDR A:0x25e5008
y.create.l HWIO_PMIC_ARB5_CHNL61_STATUS_ADDR A:0x25ed008
y.create.l HWIO_PMIC_ARB5_CHNL62_STATUS_ADDR A:0x25f5008
y.create.l HWIO_PMIC_ARB5_CHNL63_STATUS_ADDR A:0x25fd008
y.create.l HWIO_PMIC_ARB5_CHNL64_STATUS_ADDR A:0x2605008
y.create.l HWIO_PMIC_ARB5_CHNL65_STATUS_ADDR A:0x260d008
y.create.l HWIO_PMIC_ARB5_CHNL66_STATUS_ADDR A:0x2615008
y.create.l HWIO_PMIC_ARB5_CHNL67_STATUS_ADDR A:0x261d008
y.create.l HWIO_PMIC_ARB5_CHNL68_STATUS_ADDR A:0x2625008
y.create.l HWIO_PMIC_ARB5_CHNL69_STATUS_ADDR A:0x262d008
y.create.l HWIO_PMIC_ARB5_CHNL70_STATUS_ADDR A:0x2635008
y.create.l HWIO_PMIC_ARB5_CHNL71_STATUS_ADDR A:0x263d008
y.create.l HWIO_PMIC_ARB5_CHNL72_STATUS_ADDR A:0x2645008
y.create.l HWIO_PMIC_ARB5_CHNL73_STATUS_ADDR A:0x264d008
y.create.l HWIO_PMIC_ARB5_CHNL74_STATUS_ADDR A:0x2655008
y.create.l HWIO_PMIC_ARB5_CHNL75_STATUS_ADDR A:0x265d008
y.create.l HWIO_PMIC_ARB5_CHNL76_STATUS_ADDR A:0x2665008
y.create.l HWIO_PMIC_ARB5_CHNL77_STATUS_ADDR A:0x266d008
y.create.l HWIO_PMIC_ARB5_CHNL78_STATUS_ADDR A:0x2675008
y.create.l HWIO_PMIC_ARB5_CHNL79_STATUS_ADDR A:0x267d008
y.create.l HWIO_PMIC_ARB5_CHNL80_STATUS_ADDR A:0x2685008
y.create.l HWIO_PMIC_ARB5_CHNL81_STATUS_ADDR A:0x268d008
y.create.l HWIO_PMIC_ARB5_CHNL82_STATUS_ADDR A:0x2695008
y.create.l HWIO_PMIC_ARB5_CHNL83_STATUS_ADDR A:0x269d008
y.create.l HWIO_PMIC_ARB5_CHNL84_STATUS_ADDR A:0x26a5008
y.create.l HWIO_PMIC_ARB5_CHNL85_STATUS_ADDR A:0x26ad008
y.create.l HWIO_PMIC_ARB5_CHNL86_STATUS_ADDR A:0x26b5008
y.create.l HWIO_PMIC_ARB5_CHNL87_STATUS_ADDR A:0x26bd008
y.create.l HWIO_PMIC_ARB5_CHNL88_STATUS_ADDR A:0x26c5008
y.create.l HWIO_PMIC_ARB5_CHNL89_STATUS_ADDR A:0x26cd008
y.create.l HWIO_PMIC_ARB5_CHNL90_STATUS_ADDR A:0x26d5008
y.create.l HWIO_PMIC_ARB5_CHNL91_STATUS_ADDR A:0x26dd008
y.create.l HWIO_PMIC_ARB5_CHNL92_STATUS_ADDR A:0x26e5008
y.create.l HWIO_PMIC_ARB5_CHNL93_STATUS_ADDR A:0x26ed008
y.create.l HWIO_PMIC_ARB5_CHNL94_STATUS_ADDR A:0x26f5008
y.create.l HWIO_PMIC_ARB5_CHNL95_STATUS_ADDR A:0x26fd008
y.create.l HWIO_PMIC_ARB5_CHNL96_STATUS_ADDR A:0x2705008
y.create.l HWIO_PMIC_ARB5_CHNL97_STATUS_ADDR A:0x270d008
y.create.l HWIO_PMIC_ARB5_CHNL98_STATUS_ADDR A:0x2715008
y.create.l HWIO_PMIC_ARB5_CHNL99_STATUS_ADDR A:0x271d008
y.create.l HWIO_PMIC_ARB5_CHNL100_STATUS_ADDR A:0x2725008
y.create.l HWIO_PMIC_ARB5_CHNL101_STATUS_ADDR A:0x272d008
y.create.l HWIO_PMIC_ARB5_CHNL102_STATUS_ADDR A:0x2735008
y.create.l HWIO_PMIC_ARB5_CHNL103_STATUS_ADDR A:0x273d008
y.create.l HWIO_PMIC_ARB5_CHNL104_STATUS_ADDR A:0x2745008
y.create.l HWIO_PMIC_ARB5_CHNL105_STATUS_ADDR A:0x274d008
y.create.l HWIO_PMIC_ARB5_CHNL106_STATUS_ADDR A:0x2755008
y.create.l HWIO_PMIC_ARB5_CHNL107_STATUS_ADDR A:0x275d008
y.create.l HWIO_PMIC_ARB5_CHNL108_STATUS_ADDR A:0x2765008
y.create.l HWIO_PMIC_ARB5_CHNL109_STATUS_ADDR A:0x276d008
y.create.l HWIO_PMIC_ARB5_CHNL110_STATUS_ADDR A:0x2775008
y.create.l HWIO_PMIC_ARB5_CHNL111_STATUS_ADDR A:0x277d008
y.create.l HWIO_PMIC_ARB5_CHNL112_STATUS_ADDR A:0x2785008
y.create.l HWIO_PMIC_ARB5_CHNL113_STATUS_ADDR A:0x278d008
y.create.l HWIO_PMIC_ARB5_CHNL114_STATUS_ADDR A:0x2795008
y.create.l HWIO_PMIC_ARB5_CHNL115_STATUS_ADDR A:0x279d008
y.create.l HWIO_PMIC_ARB5_CHNL116_STATUS_ADDR A:0x27a5008
y.create.l HWIO_PMIC_ARB5_CHNL117_STATUS_ADDR A:0x27ad008
y.create.l HWIO_PMIC_ARB5_CHNL118_STATUS_ADDR A:0x27b5008
y.create.l HWIO_PMIC_ARB5_CHNL119_STATUS_ADDR A:0x27bd008
y.create.l HWIO_PMIC_ARB5_CHNL120_STATUS_ADDR A:0x27c5008
y.create.l HWIO_PMIC_ARB5_CHNL121_STATUS_ADDR A:0x27cd008
y.create.l HWIO_PMIC_ARB5_CHNL122_STATUS_ADDR A:0x27d5008
y.create.l HWIO_PMIC_ARB5_CHNL123_STATUS_ADDR A:0x27dd008
y.create.l HWIO_PMIC_ARB5_CHNL124_STATUS_ADDR A:0x27e5008
y.create.l HWIO_PMIC_ARB5_CHNL125_STATUS_ADDR A:0x27ed008
y.create.l HWIO_PMIC_ARB5_CHNL126_STATUS_ADDR A:0x27f5008
y.create.l HWIO_PMIC_ARB5_CHNL127_STATUS_ADDR A:0x27fd008
y.create.l HWIO_PMIC_ARB5_CHNL128_STATUS_ADDR A:0x2805008
y.create.l HWIO_PMIC_ARB5_CHNL129_STATUS_ADDR A:0x280d008
y.create.l HWIO_PMIC_ARB5_CHNL130_STATUS_ADDR A:0x2815008
y.create.l HWIO_PMIC_ARB5_CHNL131_STATUS_ADDR A:0x281d008
y.create.l HWIO_PMIC_ARB5_CHNL132_STATUS_ADDR A:0x2825008
y.create.l HWIO_PMIC_ARB5_CHNL133_STATUS_ADDR A:0x282d008
y.create.l HWIO_PMIC_ARB5_CHNL134_STATUS_ADDR A:0x2835008
y.create.l HWIO_PMIC_ARB5_CHNL135_STATUS_ADDR A:0x283d008
y.create.l HWIO_PMIC_ARB5_CHNL136_STATUS_ADDR A:0x2845008
y.create.l HWIO_PMIC_ARB5_CHNL137_STATUS_ADDR A:0x284d008
y.create.l HWIO_PMIC_ARB5_CHNL138_STATUS_ADDR A:0x2855008
y.create.l HWIO_PMIC_ARB5_CHNL139_STATUS_ADDR A:0x285d008
y.create.l HWIO_PMIC_ARB5_CHNL140_STATUS_ADDR A:0x2865008
y.create.l HWIO_PMIC_ARB5_CHNL141_STATUS_ADDR A:0x286d008
y.create.l HWIO_PMIC_ARB5_CHNL142_STATUS_ADDR A:0x2875008
y.create.l HWIO_PMIC_ARB5_CHNL143_STATUS_ADDR A:0x287d008
y.create.l HWIO_PMIC_ARB5_CHNL144_STATUS_ADDR A:0x2885008
y.create.l HWIO_PMIC_ARB5_CHNL145_STATUS_ADDR A:0x288d008
y.create.l HWIO_PMIC_ARB5_CHNL146_STATUS_ADDR A:0x2895008
y.create.l HWIO_PMIC_ARB5_CHNL147_STATUS_ADDR A:0x289d008
y.create.l HWIO_PMIC_ARB5_CHNL148_STATUS_ADDR A:0x28a5008
y.create.l HWIO_PMIC_ARB5_CHNL149_STATUS_ADDR A:0x28ad008
y.create.l HWIO_PMIC_ARB5_CHNL150_STATUS_ADDR A:0x28b5008
y.create.l HWIO_PMIC_ARB5_CHNL151_STATUS_ADDR A:0x28bd008
y.create.l HWIO_PMIC_ARB5_CHNL152_STATUS_ADDR A:0x28c5008
y.create.l HWIO_PMIC_ARB5_CHNL153_STATUS_ADDR A:0x28cd008
y.create.l HWIO_PMIC_ARB5_CHNL154_STATUS_ADDR A:0x28d5008
y.create.l HWIO_PMIC_ARB5_CHNL155_STATUS_ADDR A:0x28dd008
y.create.l HWIO_PMIC_ARB5_CHNL156_STATUS_ADDR A:0x28e5008
y.create.l HWIO_PMIC_ARB5_CHNL157_STATUS_ADDR A:0x28ed008
y.create.l HWIO_PMIC_ARB5_CHNL158_STATUS_ADDR A:0x28f5008
y.create.l HWIO_PMIC_ARB5_CHNL159_STATUS_ADDR A:0x28fd008
y.create.l HWIO_PMIC_ARB5_CHNL160_STATUS_ADDR A:0x2905008
y.create.l HWIO_PMIC_ARB5_CHNL161_STATUS_ADDR A:0x290d008
y.create.l HWIO_PMIC_ARB5_CHNL162_STATUS_ADDR A:0x2915008
y.create.l HWIO_PMIC_ARB5_CHNL163_STATUS_ADDR A:0x291d008
y.create.l HWIO_PMIC_ARB5_CHNL164_STATUS_ADDR A:0x2925008
y.create.l HWIO_PMIC_ARB5_CHNL165_STATUS_ADDR A:0x292d008
y.create.l HWIO_PMIC_ARB5_CHNL166_STATUS_ADDR A:0x2935008
y.create.l HWIO_PMIC_ARB5_CHNL167_STATUS_ADDR A:0x293d008
y.create.l HWIO_PMIC_ARB5_CHNL168_STATUS_ADDR A:0x2945008
y.create.l HWIO_PMIC_ARB5_CHNL169_STATUS_ADDR A:0x294d008
y.create.l HWIO_PMIC_ARB5_CHNL170_STATUS_ADDR A:0x2955008
y.create.l HWIO_PMIC_ARB5_CHNL171_STATUS_ADDR A:0x295d008
y.create.l HWIO_PMIC_ARB5_CHNL172_STATUS_ADDR A:0x2965008
y.create.l HWIO_PMIC_ARB5_CHNL173_STATUS_ADDR A:0x296d008
y.create.l HWIO_PMIC_ARB5_CHNL174_STATUS_ADDR A:0x2975008
y.create.l HWIO_PMIC_ARB5_CHNL175_STATUS_ADDR A:0x297d008
y.create.l HWIO_PMIC_ARB5_CHNL176_STATUS_ADDR A:0x2985008
y.create.l HWIO_PMIC_ARB5_CHNL177_STATUS_ADDR A:0x298d008
y.create.l HWIO_PMIC_ARB5_CHNL178_STATUS_ADDR A:0x2995008
y.create.l HWIO_PMIC_ARB5_CHNL179_STATUS_ADDR A:0x299d008
y.create.l HWIO_PMIC_ARB5_CHNL180_STATUS_ADDR A:0x29a5008
y.create.l HWIO_PMIC_ARB5_CHNL181_STATUS_ADDR A:0x29ad008
y.create.l HWIO_PMIC_ARB5_CHNL182_STATUS_ADDR A:0x29b5008
y.create.l HWIO_PMIC_ARB5_CHNL183_STATUS_ADDR A:0x29bd008
y.create.l HWIO_PMIC_ARB5_CHNL184_STATUS_ADDR A:0x29c5008
y.create.l HWIO_PMIC_ARB5_CHNL185_STATUS_ADDR A:0x29cd008
y.create.l HWIO_PMIC_ARB5_CHNL186_STATUS_ADDR A:0x29d5008
y.create.l HWIO_PMIC_ARB5_CHNL187_STATUS_ADDR A:0x29dd008
y.create.l HWIO_PMIC_ARB5_CHNL188_STATUS_ADDR A:0x29e5008
y.create.l HWIO_PMIC_ARB5_CHNL189_STATUS_ADDR A:0x29ed008
y.create.l HWIO_PMIC_ARB5_CHNL190_STATUS_ADDR A:0x29f5008
y.create.l HWIO_PMIC_ARB5_CHNL191_STATUS_ADDR A:0x29fd008
y.create.l HWIO_PMIC_ARB5_CHNL192_STATUS_ADDR A:0x2a05008
y.create.l HWIO_PMIC_ARB5_CHNL193_STATUS_ADDR A:0x2a0d008
y.create.l HWIO_PMIC_ARB5_CHNL194_STATUS_ADDR A:0x2a15008
y.create.l HWIO_PMIC_ARB5_CHNL195_STATUS_ADDR A:0x2a1d008
y.create.l HWIO_PMIC_ARB5_CHNL196_STATUS_ADDR A:0x2a25008
y.create.l HWIO_PMIC_ARB5_CHNL197_STATUS_ADDR A:0x2a2d008
y.create.l HWIO_PMIC_ARB5_CHNL198_STATUS_ADDR A:0x2a35008
y.create.l HWIO_PMIC_ARB5_CHNL199_STATUS_ADDR A:0x2a3d008
y.create.l HWIO_PMIC_ARB5_CHNL200_STATUS_ADDR A:0x2a45008
y.create.l HWIO_PMIC_ARB5_CHNL201_STATUS_ADDR A:0x2a4d008
y.create.l HWIO_PMIC_ARB5_CHNL202_STATUS_ADDR A:0x2a55008
y.create.l HWIO_PMIC_ARB5_CHNL203_STATUS_ADDR A:0x2a5d008
y.create.l HWIO_PMIC_ARB5_CHNL204_STATUS_ADDR A:0x2a65008
y.create.l HWIO_PMIC_ARB5_CHNL205_STATUS_ADDR A:0x2a6d008
y.create.l HWIO_PMIC_ARB5_CHNL206_STATUS_ADDR A:0x2a75008
y.create.l HWIO_PMIC_ARB5_CHNL207_STATUS_ADDR A:0x2a7d008
y.create.l HWIO_PMIC_ARB5_CHNL208_STATUS_ADDR A:0x2a85008
y.create.l HWIO_PMIC_ARB5_CHNL209_STATUS_ADDR A:0x2a8d008
y.create.l HWIO_PMIC_ARB5_CHNL210_STATUS_ADDR A:0x2a95008
y.create.l HWIO_PMIC_ARB5_CHNL211_STATUS_ADDR A:0x2a9d008
y.create.l HWIO_PMIC_ARB5_CHNL212_STATUS_ADDR A:0x2aa5008
y.create.l HWIO_PMIC_ARB5_CHNL213_STATUS_ADDR A:0x2aad008
y.create.l HWIO_PMIC_ARB5_CHNL214_STATUS_ADDR A:0x2ab5008
y.create.l HWIO_PMIC_ARB5_CHNL215_STATUS_ADDR A:0x2abd008
y.create.l HWIO_PMIC_ARB5_CHNL216_STATUS_ADDR A:0x2ac5008
y.create.l HWIO_PMIC_ARB5_CHNL217_STATUS_ADDR A:0x2acd008
y.create.l HWIO_PMIC_ARB5_CHNL218_STATUS_ADDR A:0x2ad5008
y.create.l HWIO_PMIC_ARB5_CHNL219_STATUS_ADDR A:0x2add008
y.create.l HWIO_PMIC_ARB5_CHNL220_STATUS_ADDR A:0x2ae5008
y.create.l HWIO_PMIC_ARB5_CHNL221_STATUS_ADDR A:0x2aed008
y.create.l HWIO_PMIC_ARB5_CHNL222_STATUS_ADDR A:0x2af5008
y.create.l HWIO_PMIC_ARB5_CHNL223_STATUS_ADDR A:0x2afd008
y.create.l HWIO_PMIC_ARB5_CHNL224_STATUS_ADDR A:0x2b05008
y.create.l HWIO_PMIC_ARB5_CHNL225_STATUS_ADDR A:0x2b0d008
y.create.l HWIO_PMIC_ARB5_CHNL226_STATUS_ADDR A:0x2b15008
y.create.l HWIO_PMIC_ARB5_CHNL227_STATUS_ADDR A:0x2b1d008
y.create.l HWIO_PMIC_ARB5_CHNL228_STATUS_ADDR A:0x2b25008
y.create.l HWIO_PMIC_ARB5_CHNL229_STATUS_ADDR A:0x2b2d008
y.create.l HWIO_PMIC_ARB5_CHNL230_STATUS_ADDR A:0x2b35008
y.create.l HWIO_PMIC_ARB5_CHNL231_STATUS_ADDR A:0x2b3d008
y.create.l HWIO_PMIC_ARB5_CHNL232_STATUS_ADDR A:0x2b45008
y.create.l HWIO_PMIC_ARB5_CHNL233_STATUS_ADDR A:0x2b4d008
y.create.l HWIO_PMIC_ARB5_CHNL234_STATUS_ADDR A:0x2b55008
y.create.l HWIO_PMIC_ARB5_CHNL235_STATUS_ADDR A:0x2b5d008
y.create.l HWIO_PMIC_ARB5_CHNL236_STATUS_ADDR A:0x2b65008
y.create.l HWIO_PMIC_ARB5_CHNL237_STATUS_ADDR A:0x2b6d008
y.create.l HWIO_PMIC_ARB5_CHNL238_STATUS_ADDR A:0x2b75008
y.create.l HWIO_PMIC_ARB5_CHNL239_STATUS_ADDR A:0x2b7d008
y.create.l HWIO_PMIC_ARB5_CHNL240_STATUS_ADDR A:0x2b85008
y.create.l HWIO_PMIC_ARB5_CHNL241_STATUS_ADDR A:0x2b8d008
y.create.l HWIO_PMIC_ARB5_CHNL242_STATUS_ADDR A:0x2b95008
y.create.l HWIO_PMIC_ARB5_CHNL243_STATUS_ADDR A:0x2b9d008
y.create.l HWIO_PMIC_ARB5_CHNL244_STATUS_ADDR A:0x2ba5008
y.create.l HWIO_PMIC_ARB5_CHNL245_STATUS_ADDR A:0x2bad008
y.create.l HWIO_PMIC_ARB5_CHNL246_STATUS_ADDR A:0x2bb5008
y.create.l HWIO_PMIC_ARB5_CHNL247_STATUS_ADDR A:0x2bbd008
y.create.l HWIO_PMIC_ARB5_CHNL248_STATUS_ADDR A:0x2bc5008
y.create.l HWIO_PMIC_ARB5_CHNL249_STATUS_ADDR A:0x2bcd008
y.create.l HWIO_PMIC_ARB5_CHNL250_STATUS_ADDR A:0x2bd5008
y.create.l HWIO_PMIC_ARB5_CHNL251_STATUS_ADDR A:0x2bdd008
y.create.l HWIO_PMIC_ARB5_CHNL252_STATUS_ADDR A:0x2be5008
y.create.l HWIO_PMIC_ARB5_CHNL253_STATUS_ADDR A:0x2bed008
y.create.l HWIO_PMIC_ARB5_CHNL254_STATUS_ADDR A:0x2bf5008
y.create.l HWIO_PMIC_ARB5_CHNL255_STATUS_ADDR A:0x2bfd008
y.create.l HWIO_PMIC_ARB6_CHNL0_STATUS_ADDR A:0x2406008
y.create.l HWIO_PMIC_ARB6_CHNL1_STATUS_ADDR A:0x240e008
y.create.l HWIO_PMIC_ARB6_CHNL2_STATUS_ADDR A:0x2416008
y.create.l HWIO_PMIC_ARB6_CHNL3_STATUS_ADDR A:0x241e008
y.create.l HWIO_PMIC_ARB6_CHNL4_STATUS_ADDR A:0x2426008
y.create.l HWIO_PMIC_ARB6_CHNL5_STATUS_ADDR A:0x242e008
y.create.l HWIO_PMIC_ARB6_CHNL6_STATUS_ADDR A:0x2436008
y.create.l HWIO_PMIC_ARB6_CHNL7_STATUS_ADDR A:0x243e008
y.create.l HWIO_PMIC_ARB6_CHNL8_STATUS_ADDR A:0x2446008
y.create.l HWIO_PMIC_ARB6_CHNL9_STATUS_ADDR A:0x244e008
y.create.l HWIO_PMIC_ARB6_CHNL10_STATUS_ADDR A:0x2456008
y.create.l HWIO_PMIC_ARB6_CHNL11_STATUS_ADDR A:0x245e008
y.create.l HWIO_PMIC_ARB6_CHNL12_STATUS_ADDR A:0x2466008
y.create.l HWIO_PMIC_ARB6_CHNL13_STATUS_ADDR A:0x246e008
y.create.l HWIO_PMIC_ARB6_CHNL14_STATUS_ADDR A:0x2476008
y.create.l HWIO_PMIC_ARB6_CHNL15_STATUS_ADDR A:0x247e008
y.create.l HWIO_PMIC_ARB6_CHNL16_STATUS_ADDR A:0x2486008
y.create.l HWIO_PMIC_ARB6_CHNL17_STATUS_ADDR A:0x248e008
y.create.l HWIO_PMIC_ARB6_CHNL18_STATUS_ADDR A:0x2496008
y.create.l HWIO_PMIC_ARB6_CHNL19_STATUS_ADDR A:0x249e008
y.create.l HWIO_PMIC_ARB6_CHNL20_STATUS_ADDR A:0x24a6008
y.create.l HWIO_PMIC_ARB6_CHNL21_STATUS_ADDR A:0x24ae008
y.create.l HWIO_PMIC_ARB6_CHNL22_STATUS_ADDR A:0x24b6008
y.create.l HWIO_PMIC_ARB6_CHNL23_STATUS_ADDR A:0x24be008
y.create.l HWIO_PMIC_ARB6_CHNL24_STATUS_ADDR A:0x24c6008
y.create.l HWIO_PMIC_ARB6_CHNL25_STATUS_ADDR A:0x24ce008
y.create.l HWIO_PMIC_ARB6_CHNL26_STATUS_ADDR A:0x24d6008
y.create.l HWIO_PMIC_ARB6_CHNL27_STATUS_ADDR A:0x24de008
y.create.l HWIO_PMIC_ARB6_CHNL28_STATUS_ADDR A:0x24e6008
y.create.l HWIO_PMIC_ARB6_CHNL29_STATUS_ADDR A:0x24ee008
y.create.l HWIO_PMIC_ARB6_CHNL30_STATUS_ADDR A:0x24f6008
y.create.l HWIO_PMIC_ARB6_CHNL31_STATUS_ADDR A:0x24fe008
y.create.l HWIO_PMIC_ARB6_CHNL32_STATUS_ADDR A:0x2506008
y.create.l HWIO_PMIC_ARB6_CHNL33_STATUS_ADDR A:0x250e008
y.create.l HWIO_PMIC_ARB6_CHNL34_STATUS_ADDR A:0x2516008
y.create.l HWIO_PMIC_ARB6_CHNL35_STATUS_ADDR A:0x251e008
y.create.l HWIO_PMIC_ARB6_CHNL36_STATUS_ADDR A:0x2526008
y.create.l HWIO_PMIC_ARB6_CHNL37_STATUS_ADDR A:0x252e008
y.create.l HWIO_PMIC_ARB6_CHNL38_STATUS_ADDR A:0x2536008
y.create.l HWIO_PMIC_ARB6_CHNL39_STATUS_ADDR A:0x253e008
y.create.l HWIO_PMIC_ARB6_CHNL40_STATUS_ADDR A:0x2546008
y.create.l HWIO_PMIC_ARB6_CHNL41_STATUS_ADDR A:0x254e008
y.create.l HWIO_PMIC_ARB6_CHNL42_STATUS_ADDR A:0x2556008
y.create.l HWIO_PMIC_ARB6_CHNL43_STATUS_ADDR A:0x255e008
y.create.l HWIO_PMIC_ARB6_CHNL44_STATUS_ADDR A:0x2566008
y.create.l HWIO_PMIC_ARB6_CHNL45_STATUS_ADDR A:0x256e008
y.create.l HWIO_PMIC_ARB6_CHNL46_STATUS_ADDR A:0x2576008
y.create.l HWIO_PMIC_ARB6_CHNL47_STATUS_ADDR A:0x257e008
y.create.l HWIO_PMIC_ARB6_CHNL48_STATUS_ADDR A:0x2586008
y.create.l HWIO_PMIC_ARB6_CHNL49_STATUS_ADDR A:0x258e008
y.create.l HWIO_PMIC_ARB6_CHNL50_STATUS_ADDR A:0x2596008
y.create.l HWIO_PMIC_ARB6_CHNL51_STATUS_ADDR A:0x259e008
y.create.l HWIO_PMIC_ARB6_CHNL52_STATUS_ADDR A:0x25a6008
y.create.l HWIO_PMIC_ARB6_CHNL53_STATUS_ADDR A:0x25ae008
y.create.l HWIO_PMIC_ARB6_CHNL54_STATUS_ADDR A:0x25b6008
y.create.l HWIO_PMIC_ARB6_CHNL55_STATUS_ADDR A:0x25be008
y.create.l HWIO_PMIC_ARB6_CHNL56_STATUS_ADDR A:0x25c6008
y.create.l HWIO_PMIC_ARB6_CHNL57_STATUS_ADDR A:0x25ce008
y.create.l HWIO_PMIC_ARB6_CHNL58_STATUS_ADDR A:0x25d6008
y.create.l HWIO_PMIC_ARB6_CHNL59_STATUS_ADDR A:0x25de008
y.create.l HWIO_PMIC_ARB6_CHNL60_STATUS_ADDR A:0x25e6008
y.create.l HWIO_PMIC_ARB6_CHNL61_STATUS_ADDR A:0x25ee008
y.create.l HWIO_PMIC_ARB6_CHNL62_STATUS_ADDR A:0x25f6008
y.create.l HWIO_PMIC_ARB6_CHNL63_STATUS_ADDR A:0x25fe008
y.create.l HWIO_PMIC_ARB6_CHNL64_STATUS_ADDR A:0x2606008
y.create.l HWIO_PMIC_ARB6_CHNL65_STATUS_ADDR A:0x260e008
y.create.l HWIO_PMIC_ARB6_CHNL66_STATUS_ADDR A:0x2616008
y.create.l HWIO_PMIC_ARB6_CHNL67_STATUS_ADDR A:0x261e008
y.create.l HWIO_PMIC_ARB6_CHNL68_STATUS_ADDR A:0x2626008
y.create.l HWIO_PMIC_ARB6_CHNL69_STATUS_ADDR A:0x262e008
y.create.l HWIO_PMIC_ARB6_CHNL70_STATUS_ADDR A:0x2636008
y.create.l HWIO_PMIC_ARB6_CHNL71_STATUS_ADDR A:0x263e008
y.create.l HWIO_PMIC_ARB6_CHNL72_STATUS_ADDR A:0x2646008
y.create.l HWIO_PMIC_ARB6_CHNL73_STATUS_ADDR A:0x264e008
y.create.l HWIO_PMIC_ARB6_CHNL74_STATUS_ADDR A:0x2656008
y.create.l HWIO_PMIC_ARB6_CHNL75_STATUS_ADDR A:0x265e008
y.create.l HWIO_PMIC_ARB6_CHNL76_STATUS_ADDR A:0x2666008
y.create.l HWIO_PMIC_ARB6_CHNL77_STATUS_ADDR A:0x266e008
y.create.l HWIO_PMIC_ARB6_CHNL78_STATUS_ADDR A:0x2676008
y.create.l HWIO_PMIC_ARB6_CHNL79_STATUS_ADDR A:0x267e008
y.create.l HWIO_PMIC_ARB6_CHNL80_STATUS_ADDR A:0x2686008
y.create.l HWIO_PMIC_ARB6_CHNL81_STATUS_ADDR A:0x268e008
y.create.l HWIO_PMIC_ARB6_CHNL82_STATUS_ADDR A:0x2696008
y.create.l HWIO_PMIC_ARB6_CHNL83_STATUS_ADDR A:0x269e008
y.create.l HWIO_PMIC_ARB6_CHNL84_STATUS_ADDR A:0x26a6008
y.create.l HWIO_PMIC_ARB6_CHNL85_STATUS_ADDR A:0x26ae008
y.create.l HWIO_PMIC_ARB6_CHNL86_STATUS_ADDR A:0x26b6008
y.create.l HWIO_PMIC_ARB6_CHNL87_STATUS_ADDR A:0x26be008
y.create.l HWIO_PMIC_ARB6_CHNL88_STATUS_ADDR A:0x26c6008
y.create.l HWIO_PMIC_ARB6_CHNL89_STATUS_ADDR A:0x26ce008
y.create.l HWIO_PMIC_ARB6_CHNL90_STATUS_ADDR A:0x26d6008
y.create.l HWIO_PMIC_ARB6_CHNL91_STATUS_ADDR A:0x26de008
y.create.l HWIO_PMIC_ARB6_CHNL92_STATUS_ADDR A:0x26e6008
y.create.l HWIO_PMIC_ARB6_CHNL93_STATUS_ADDR A:0x26ee008
y.create.l HWIO_PMIC_ARB6_CHNL94_STATUS_ADDR A:0x26f6008
y.create.l HWIO_PMIC_ARB6_CHNL95_STATUS_ADDR A:0x26fe008
y.create.l HWIO_PMIC_ARB6_CHNL96_STATUS_ADDR A:0x2706008
y.create.l HWIO_PMIC_ARB6_CHNL97_STATUS_ADDR A:0x270e008
y.create.l HWIO_PMIC_ARB6_CHNL98_STATUS_ADDR A:0x2716008
y.create.l HWIO_PMIC_ARB6_CHNL99_STATUS_ADDR A:0x271e008
y.create.l HWIO_PMIC_ARB6_CHNL100_STATUS_ADDR A:0x2726008
y.create.l HWIO_PMIC_ARB6_CHNL101_STATUS_ADDR A:0x272e008
y.create.l HWIO_PMIC_ARB6_CHNL102_STATUS_ADDR A:0x2736008
y.create.l HWIO_PMIC_ARB6_CHNL103_STATUS_ADDR A:0x273e008
y.create.l HWIO_PMIC_ARB6_CHNL104_STATUS_ADDR A:0x2746008
y.create.l HWIO_PMIC_ARB6_CHNL105_STATUS_ADDR A:0x274e008
y.create.l HWIO_PMIC_ARB6_CHNL106_STATUS_ADDR A:0x2756008
y.create.l HWIO_PMIC_ARB6_CHNL107_STATUS_ADDR A:0x275e008
y.create.l HWIO_PMIC_ARB6_CHNL108_STATUS_ADDR A:0x2766008
y.create.l HWIO_PMIC_ARB6_CHNL109_STATUS_ADDR A:0x276e008
y.create.l HWIO_PMIC_ARB6_CHNL110_STATUS_ADDR A:0x2776008
y.create.l HWIO_PMIC_ARB6_CHNL111_STATUS_ADDR A:0x277e008
y.create.l HWIO_PMIC_ARB6_CHNL112_STATUS_ADDR A:0x2786008
y.create.l HWIO_PMIC_ARB6_CHNL113_STATUS_ADDR A:0x278e008
y.create.l HWIO_PMIC_ARB6_CHNL114_STATUS_ADDR A:0x2796008
y.create.l HWIO_PMIC_ARB6_CHNL115_STATUS_ADDR A:0x279e008
y.create.l HWIO_PMIC_ARB6_CHNL116_STATUS_ADDR A:0x27a6008
y.create.l HWIO_PMIC_ARB6_CHNL117_STATUS_ADDR A:0x27ae008
y.create.l HWIO_PMIC_ARB6_CHNL118_STATUS_ADDR A:0x27b6008
y.create.l HWIO_PMIC_ARB6_CHNL119_STATUS_ADDR A:0x27be008
y.create.l HWIO_PMIC_ARB6_CHNL120_STATUS_ADDR A:0x27c6008
y.create.l HWIO_PMIC_ARB6_CHNL121_STATUS_ADDR A:0x27ce008
y.create.l HWIO_PMIC_ARB6_CHNL122_STATUS_ADDR A:0x27d6008
y.create.l HWIO_PMIC_ARB6_CHNL123_STATUS_ADDR A:0x27de008
y.create.l HWIO_PMIC_ARB6_CHNL124_STATUS_ADDR A:0x27e6008
y.create.l HWIO_PMIC_ARB6_CHNL125_STATUS_ADDR A:0x27ee008
y.create.l HWIO_PMIC_ARB6_CHNL126_STATUS_ADDR A:0x27f6008
y.create.l HWIO_PMIC_ARB6_CHNL127_STATUS_ADDR A:0x27fe008
y.create.l HWIO_PMIC_ARB6_CHNL128_STATUS_ADDR A:0x2806008
y.create.l HWIO_PMIC_ARB6_CHNL129_STATUS_ADDR A:0x280e008
y.create.l HWIO_PMIC_ARB6_CHNL130_STATUS_ADDR A:0x2816008
y.create.l HWIO_PMIC_ARB6_CHNL131_STATUS_ADDR A:0x281e008
y.create.l HWIO_PMIC_ARB6_CHNL132_STATUS_ADDR A:0x2826008
y.create.l HWIO_PMIC_ARB6_CHNL133_STATUS_ADDR A:0x282e008
y.create.l HWIO_PMIC_ARB6_CHNL134_STATUS_ADDR A:0x2836008
y.create.l HWIO_PMIC_ARB6_CHNL135_STATUS_ADDR A:0x283e008
y.create.l HWIO_PMIC_ARB6_CHNL136_STATUS_ADDR A:0x2846008
y.create.l HWIO_PMIC_ARB6_CHNL137_STATUS_ADDR A:0x284e008
y.create.l HWIO_PMIC_ARB6_CHNL138_STATUS_ADDR A:0x2856008
y.create.l HWIO_PMIC_ARB6_CHNL139_STATUS_ADDR A:0x285e008
y.create.l HWIO_PMIC_ARB6_CHNL140_STATUS_ADDR A:0x2866008
y.create.l HWIO_PMIC_ARB6_CHNL141_STATUS_ADDR A:0x286e008
y.create.l HWIO_PMIC_ARB6_CHNL142_STATUS_ADDR A:0x2876008
y.create.l HWIO_PMIC_ARB6_CHNL143_STATUS_ADDR A:0x287e008
y.create.l HWIO_PMIC_ARB6_CHNL144_STATUS_ADDR A:0x2886008
y.create.l HWIO_PMIC_ARB6_CHNL145_STATUS_ADDR A:0x288e008
y.create.l HWIO_PMIC_ARB6_CHNL146_STATUS_ADDR A:0x2896008
y.create.l HWIO_PMIC_ARB6_CHNL147_STATUS_ADDR A:0x289e008
y.create.l HWIO_PMIC_ARB6_CHNL148_STATUS_ADDR A:0x28a6008
y.create.l HWIO_PMIC_ARB6_CHNL149_STATUS_ADDR A:0x28ae008
y.create.l HWIO_PMIC_ARB6_CHNL150_STATUS_ADDR A:0x28b6008
y.create.l HWIO_PMIC_ARB6_CHNL151_STATUS_ADDR A:0x28be008
y.create.l HWIO_PMIC_ARB6_CHNL152_STATUS_ADDR A:0x28c6008
y.create.l HWIO_PMIC_ARB6_CHNL153_STATUS_ADDR A:0x28ce008
y.create.l HWIO_PMIC_ARB6_CHNL154_STATUS_ADDR A:0x28d6008
y.create.l HWIO_PMIC_ARB6_CHNL155_STATUS_ADDR A:0x28de008
y.create.l HWIO_PMIC_ARB6_CHNL156_STATUS_ADDR A:0x28e6008
y.create.l HWIO_PMIC_ARB6_CHNL157_STATUS_ADDR A:0x28ee008
y.create.l HWIO_PMIC_ARB6_CHNL158_STATUS_ADDR A:0x28f6008
y.create.l HWIO_PMIC_ARB6_CHNL159_STATUS_ADDR A:0x28fe008
y.create.l HWIO_PMIC_ARB6_CHNL160_STATUS_ADDR A:0x2906008
y.create.l HWIO_PMIC_ARB6_CHNL161_STATUS_ADDR A:0x290e008
y.create.l HWIO_PMIC_ARB6_CHNL162_STATUS_ADDR A:0x2916008
y.create.l HWIO_PMIC_ARB6_CHNL163_STATUS_ADDR A:0x291e008
y.create.l HWIO_PMIC_ARB6_CHNL164_STATUS_ADDR A:0x2926008
y.create.l HWIO_PMIC_ARB6_CHNL165_STATUS_ADDR A:0x292e008
y.create.l HWIO_PMIC_ARB6_CHNL166_STATUS_ADDR A:0x2936008
y.create.l HWIO_PMIC_ARB6_CHNL167_STATUS_ADDR A:0x293e008
y.create.l HWIO_PMIC_ARB6_CHNL168_STATUS_ADDR A:0x2946008
y.create.l HWIO_PMIC_ARB6_CHNL169_STATUS_ADDR A:0x294e008
y.create.l HWIO_PMIC_ARB6_CHNL170_STATUS_ADDR A:0x2956008
y.create.l HWIO_PMIC_ARB6_CHNL171_STATUS_ADDR A:0x295e008
y.create.l HWIO_PMIC_ARB6_CHNL172_STATUS_ADDR A:0x2966008
y.create.l HWIO_PMIC_ARB6_CHNL173_STATUS_ADDR A:0x296e008
y.create.l HWIO_PMIC_ARB6_CHNL174_STATUS_ADDR A:0x2976008
y.create.l HWIO_PMIC_ARB6_CHNL175_STATUS_ADDR A:0x297e008
y.create.l HWIO_PMIC_ARB6_CHNL176_STATUS_ADDR A:0x2986008
y.create.l HWIO_PMIC_ARB6_CHNL177_STATUS_ADDR A:0x298e008
y.create.l HWIO_PMIC_ARB6_CHNL178_STATUS_ADDR A:0x2996008
y.create.l HWIO_PMIC_ARB6_CHNL179_STATUS_ADDR A:0x299e008
y.create.l HWIO_PMIC_ARB6_CHNL180_STATUS_ADDR A:0x29a6008
y.create.l HWIO_PMIC_ARB6_CHNL181_STATUS_ADDR A:0x29ae008
y.create.l HWIO_PMIC_ARB6_CHNL182_STATUS_ADDR A:0x29b6008
y.create.l HWIO_PMIC_ARB6_CHNL183_STATUS_ADDR A:0x29be008
y.create.l HWIO_PMIC_ARB6_CHNL184_STATUS_ADDR A:0x29c6008
y.create.l HWIO_PMIC_ARB6_CHNL185_STATUS_ADDR A:0x29ce008
y.create.l HWIO_PMIC_ARB6_CHNL186_STATUS_ADDR A:0x29d6008
y.create.l HWIO_PMIC_ARB6_CHNL187_STATUS_ADDR A:0x29de008
y.create.l HWIO_PMIC_ARB6_CHNL188_STATUS_ADDR A:0x29e6008
y.create.l HWIO_PMIC_ARB6_CHNL189_STATUS_ADDR A:0x29ee008
y.create.l HWIO_PMIC_ARB6_CHNL190_STATUS_ADDR A:0x29f6008
y.create.l HWIO_PMIC_ARB6_CHNL191_STATUS_ADDR A:0x29fe008
y.create.l HWIO_PMIC_ARB6_CHNL192_STATUS_ADDR A:0x2a06008
y.create.l HWIO_PMIC_ARB6_CHNL193_STATUS_ADDR A:0x2a0e008
y.create.l HWIO_PMIC_ARB6_CHNL194_STATUS_ADDR A:0x2a16008
y.create.l HWIO_PMIC_ARB6_CHNL195_STATUS_ADDR A:0x2a1e008
y.create.l HWIO_PMIC_ARB6_CHNL196_STATUS_ADDR A:0x2a26008
y.create.l HWIO_PMIC_ARB6_CHNL197_STATUS_ADDR A:0x2a2e008
y.create.l HWIO_PMIC_ARB6_CHNL198_STATUS_ADDR A:0x2a36008
y.create.l HWIO_PMIC_ARB6_CHNL199_STATUS_ADDR A:0x2a3e008
y.create.l HWIO_PMIC_ARB6_CHNL200_STATUS_ADDR A:0x2a46008
y.create.l HWIO_PMIC_ARB6_CHNL201_STATUS_ADDR A:0x2a4e008
y.create.l HWIO_PMIC_ARB6_CHNL202_STATUS_ADDR A:0x2a56008
y.create.l HWIO_PMIC_ARB6_CHNL203_STATUS_ADDR A:0x2a5e008
y.create.l HWIO_PMIC_ARB6_CHNL204_STATUS_ADDR A:0x2a66008
y.create.l HWIO_PMIC_ARB6_CHNL205_STATUS_ADDR A:0x2a6e008
y.create.l HWIO_PMIC_ARB6_CHNL206_STATUS_ADDR A:0x2a76008
y.create.l HWIO_PMIC_ARB6_CHNL207_STATUS_ADDR A:0x2a7e008
y.create.l HWIO_PMIC_ARB6_CHNL208_STATUS_ADDR A:0x2a86008
y.create.l HWIO_PMIC_ARB6_CHNL209_STATUS_ADDR A:0x2a8e008
y.create.l HWIO_PMIC_ARB6_CHNL210_STATUS_ADDR A:0x2a96008
y.create.l HWIO_PMIC_ARB6_CHNL211_STATUS_ADDR A:0x2a9e008
y.create.l HWIO_PMIC_ARB6_CHNL212_STATUS_ADDR A:0x2aa6008
y.create.l HWIO_PMIC_ARB6_CHNL213_STATUS_ADDR A:0x2aae008
y.create.l HWIO_PMIC_ARB6_CHNL214_STATUS_ADDR A:0x2ab6008
y.create.l HWIO_PMIC_ARB6_CHNL215_STATUS_ADDR A:0x2abe008
y.create.l HWIO_PMIC_ARB6_CHNL216_STATUS_ADDR A:0x2ac6008
y.create.l HWIO_PMIC_ARB6_CHNL217_STATUS_ADDR A:0x2ace008
y.create.l HWIO_PMIC_ARB6_CHNL218_STATUS_ADDR A:0x2ad6008
y.create.l HWIO_PMIC_ARB6_CHNL219_STATUS_ADDR A:0x2ade008
y.create.l HWIO_PMIC_ARB6_CHNL220_STATUS_ADDR A:0x2ae6008
y.create.l HWIO_PMIC_ARB6_CHNL221_STATUS_ADDR A:0x2aee008
y.create.l HWIO_PMIC_ARB6_CHNL222_STATUS_ADDR A:0x2af6008
y.create.l HWIO_PMIC_ARB6_CHNL223_STATUS_ADDR A:0x2afe008
y.create.l HWIO_PMIC_ARB6_CHNL224_STATUS_ADDR A:0x2b06008
y.create.l HWIO_PMIC_ARB6_CHNL225_STATUS_ADDR A:0x2b0e008
y.create.l HWIO_PMIC_ARB6_CHNL226_STATUS_ADDR A:0x2b16008
y.create.l HWIO_PMIC_ARB6_CHNL227_STATUS_ADDR A:0x2b1e008
y.create.l HWIO_PMIC_ARB6_CHNL228_STATUS_ADDR A:0x2b26008
y.create.l HWIO_PMIC_ARB6_CHNL229_STATUS_ADDR A:0x2b2e008
y.create.l HWIO_PMIC_ARB6_CHNL230_STATUS_ADDR A:0x2b36008
y.create.l HWIO_PMIC_ARB6_CHNL231_STATUS_ADDR A:0x2b3e008
y.create.l HWIO_PMIC_ARB6_CHNL232_STATUS_ADDR A:0x2b46008
y.create.l HWIO_PMIC_ARB6_CHNL233_STATUS_ADDR A:0x2b4e008
y.create.l HWIO_PMIC_ARB6_CHNL234_STATUS_ADDR A:0x2b56008
y.create.l HWIO_PMIC_ARB6_CHNL235_STATUS_ADDR A:0x2b5e008
y.create.l HWIO_PMIC_ARB6_CHNL236_STATUS_ADDR A:0x2b66008
y.create.l HWIO_PMIC_ARB6_CHNL237_STATUS_ADDR A:0x2b6e008
y.create.l HWIO_PMIC_ARB6_CHNL238_STATUS_ADDR A:0x2b76008
y.create.l HWIO_PMIC_ARB6_CHNL239_STATUS_ADDR A:0x2b7e008
y.create.l HWIO_PMIC_ARB6_CHNL240_STATUS_ADDR A:0x2b86008
y.create.l HWIO_PMIC_ARB6_CHNL241_STATUS_ADDR A:0x2b8e008
y.create.l HWIO_PMIC_ARB6_CHNL242_STATUS_ADDR A:0x2b96008
y.create.l HWIO_PMIC_ARB6_CHNL243_STATUS_ADDR A:0x2b9e008
y.create.l HWIO_PMIC_ARB6_CHNL244_STATUS_ADDR A:0x2ba6008
y.create.l HWIO_PMIC_ARB6_CHNL245_STATUS_ADDR A:0x2bae008
y.create.l HWIO_PMIC_ARB6_CHNL246_STATUS_ADDR A:0x2bb6008
y.create.l HWIO_PMIC_ARB6_CHNL247_STATUS_ADDR A:0x2bbe008
y.create.l HWIO_PMIC_ARB6_CHNL248_STATUS_ADDR A:0x2bc6008
y.create.l HWIO_PMIC_ARB6_CHNL249_STATUS_ADDR A:0x2bce008
y.create.l HWIO_PMIC_ARB6_CHNL250_STATUS_ADDR A:0x2bd6008
y.create.l HWIO_PMIC_ARB6_CHNL251_STATUS_ADDR A:0x2bde008
y.create.l HWIO_PMIC_ARB6_CHNL252_STATUS_ADDR A:0x2be6008
y.create.l HWIO_PMIC_ARB6_CHNL253_STATUS_ADDR A:0x2bee008
y.create.l HWIO_PMIC_ARB6_CHNL254_STATUS_ADDR A:0x2bf6008
y.create.l HWIO_PMIC_ARB6_CHNL255_STATUS_ADDR A:0x2bfe008
y.create.l HWIO_PMIC_ARB0_CHNL0_WDATA0_ADDR A:0x2400010
y.create.l HWIO_PMIC_ARB0_CHNL1_WDATA0_ADDR A:0x2408010
y.create.l HWIO_PMIC_ARB0_CHNL2_WDATA0_ADDR A:0x2410010
y.create.l HWIO_PMIC_ARB0_CHNL3_WDATA0_ADDR A:0x2418010
y.create.l HWIO_PMIC_ARB0_CHNL4_WDATA0_ADDR A:0x2420010
y.create.l HWIO_PMIC_ARB0_CHNL5_WDATA0_ADDR A:0x2428010
y.create.l HWIO_PMIC_ARB0_CHNL6_WDATA0_ADDR A:0x2430010
y.create.l HWIO_PMIC_ARB0_CHNL7_WDATA0_ADDR A:0x2438010
y.create.l HWIO_PMIC_ARB0_CHNL8_WDATA0_ADDR A:0x2440010
y.create.l HWIO_PMIC_ARB0_CHNL9_WDATA0_ADDR A:0x2448010
y.create.l HWIO_PMIC_ARB0_CHNL10_WDATA0_ADDR A:0x2450010
y.create.l HWIO_PMIC_ARB0_CHNL11_WDATA0_ADDR A:0x2458010
y.create.l HWIO_PMIC_ARB0_CHNL12_WDATA0_ADDR A:0x2460010
y.create.l HWIO_PMIC_ARB0_CHNL13_WDATA0_ADDR A:0x2468010
y.create.l HWIO_PMIC_ARB0_CHNL14_WDATA0_ADDR A:0x2470010
y.create.l HWIO_PMIC_ARB0_CHNL15_WDATA0_ADDR A:0x2478010
y.create.l HWIO_PMIC_ARB0_CHNL16_WDATA0_ADDR A:0x2480010
y.create.l HWIO_PMIC_ARB0_CHNL17_WDATA0_ADDR A:0x2488010
y.create.l HWIO_PMIC_ARB0_CHNL18_WDATA0_ADDR A:0x2490010
y.create.l HWIO_PMIC_ARB0_CHNL19_WDATA0_ADDR A:0x2498010
y.create.l HWIO_PMIC_ARB0_CHNL20_WDATA0_ADDR A:0x24a0010
y.create.l HWIO_PMIC_ARB0_CHNL21_WDATA0_ADDR A:0x24a8010
y.create.l HWIO_PMIC_ARB0_CHNL22_WDATA0_ADDR A:0x24b0010
y.create.l HWIO_PMIC_ARB0_CHNL23_WDATA0_ADDR A:0x24b8010
y.create.l HWIO_PMIC_ARB0_CHNL24_WDATA0_ADDR A:0x24c0010
y.create.l HWIO_PMIC_ARB0_CHNL25_WDATA0_ADDR A:0x24c8010
y.create.l HWIO_PMIC_ARB0_CHNL26_WDATA0_ADDR A:0x24d0010
y.create.l HWIO_PMIC_ARB0_CHNL27_WDATA0_ADDR A:0x24d8010
y.create.l HWIO_PMIC_ARB0_CHNL28_WDATA0_ADDR A:0x24e0010
y.create.l HWIO_PMIC_ARB0_CHNL29_WDATA0_ADDR A:0x24e8010
y.create.l HWIO_PMIC_ARB0_CHNL30_WDATA0_ADDR A:0x24f0010
y.create.l HWIO_PMIC_ARB0_CHNL31_WDATA0_ADDR A:0x24f8010
y.create.l HWIO_PMIC_ARB0_CHNL32_WDATA0_ADDR A:0x2500010
y.create.l HWIO_PMIC_ARB0_CHNL33_WDATA0_ADDR A:0x2508010
y.create.l HWIO_PMIC_ARB0_CHNL34_WDATA0_ADDR A:0x2510010
y.create.l HWIO_PMIC_ARB0_CHNL35_WDATA0_ADDR A:0x2518010
y.create.l HWIO_PMIC_ARB0_CHNL36_WDATA0_ADDR A:0x2520010
y.create.l HWIO_PMIC_ARB0_CHNL37_WDATA0_ADDR A:0x2528010
y.create.l HWIO_PMIC_ARB0_CHNL38_WDATA0_ADDR A:0x2530010
y.create.l HWIO_PMIC_ARB0_CHNL39_WDATA0_ADDR A:0x2538010
y.create.l HWIO_PMIC_ARB0_CHNL40_WDATA0_ADDR A:0x2540010
y.create.l HWIO_PMIC_ARB0_CHNL41_WDATA0_ADDR A:0x2548010
y.create.l HWIO_PMIC_ARB0_CHNL42_WDATA0_ADDR A:0x2550010
y.create.l HWIO_PMIC_ARB0_CHNL43_WDATA0_ADDR A:0x2558010
y.create.l HWIO_PMIC_ARB0_CHNL44_WDATA0_ADDR A:0x2560010
y.create.l HWIO_PMIC_ARB0_CHNL45_WDATA0_ADDR A:0x2568010
y.create.l HWIO_PMIC_ARB0_CHNL46_WDATA0_ADDR A:0x2570010
y.create.l HWIO_PMIC_ARB0_CHNL47_WDATA0_ADDR A:0x2578010
y.create.l HWIO_PMIC_ARB0_CHNL48_WDATA0_ADDR A:0x2580010
y.create.l HWIO_PMIC_ARB0_CHNL49_WDATA0_ADDR A:0x2588010
y.create.l HWIO_PMIC_ARB0_CHNL50_WDATA0_ADDR A:0x2590010
y.create.l HWIO_PMIC_ARB0_CHNL51_WDATA0_ADDR A:0x2598010
y.create.l HWIO_PMIC_ARB0_CHNL52_WDATA0_ADDR A:0x25a0010
y.create.l HWIO_PMIC_ARB0_CHNL53_WDATA0_ADDR A:0x25a8010
y.create.l HWIO_PMIC_ARB0_CHNL54_WDATA0_ADDR A:0x25b0010
y.create.l HWIO_PMIC_ARB0_CHNL55_WDATA0_ADDR A:0x25b8010
y.create.l HWIO_PMIC_ARB0_CHNL56_WDATA0_ADDR A:0x25c0010
y.create.l HWIO_PMIC_ARB0_CHNL57_WDATA0_ADDR A:0x25c8010
y.create.l HWIO_PMIC_ARB0_CHNL58_WDATA0_ADDR A:0x25d0010
y.create.l HWIO_PMIC_ARB0_CHNL59_WDATA0_ADDR A:0x25d8010
y.create.l HWIO_PMIC_ARB0_CHNL60_WDATA0_ADDR A:0x25e0010
y.create.l HWIO_PMIC_ARB0_CHNL61_WDATA0_ADDR A:0x25e8010
y.create.l HWIO_PMIC_ARB0_CHNL62_WDATA0_ADDR A:0x25f0010
y.create.l HWIO_PMIC_ARB0_CHNL63_WDATA0_ADDR A:0x25f8010
y.create.l HWIO_PMIC_ARB0_CHNL64_WDATA0_ADDR A:0x2600010
y.create.l HWIO_PMIC_ARB0_CHNL65_WDATA0_ADDR A:0x2608010
y.create.l HWIO_PMIC_ARB0_CHNL66_WDATA0_ADDR A:0x2610010
y.create.l HWIO_PMIC_ARB0_CHNL67_WDATA0_ADDR A:0x2618010
y.create.l HWIO_PMIC_ARB0_CHNL68_WDATA0_ADDR A:0x2620010
y.create.l HWIO_PMIC_ARB0_CHNL69_WDATA0_ADDR A:0x2628010
y.create.l HWIO_PMIC_ARB0_CHNL70_WDATA0_ADDR A:0x2630010
y.create.l HWIO_PMIC_ARB0_CHNL71_WDATA0_ADDR A:0x2638010
y.create.l HWIO_PMIC_ARB0_CHNL72_WDATA0_ADDR A:0x2640010
y.create.l HWIO_PMIC_ARB0_CHNL73_WDATA0_ADDR A:0x2648010
y.create.l HWIO_PMIC_ARB0_CHNL74_WDATA0_ADDR A:0x2650010
y.create.l HWIO_PMIC_ARB0_CHNL75_WDATA0_ADDR A:0x2658010
y.create.l HWIO_PMIC_ARB0_CHNL76_WDATA0_ADDR A:0x2660010
y.create.l HWIO_PMIC_ARB0_CHNL77_WDATA0_ADDR A:0x2668010
y.create.l HWIO_PMIC_ARB0_CHNL78_WDATA0_ADDR A:0x2670010
y.create.l HWIO_PMIC_ARB0_CHNL79_WDATA0_ADDR A:0x2678010
y.create.l HWIO_PMIC_ARB0_CHNL80_WDATA0_ADDR A:0x2680010
y.create.l HWIO_PMIC_ARB0_CHNL81_WDATA0_ADDR A:0x2688010
y.create.l HWIO_PMIC_ARB0_CHNL82_WDATA0_ADDR A:0x2690010
y.create.l HWIO_PMIC_ARB0_CHNL83_WDATA0_ADDR A:0x2698010
y.create.l HWIO_PMIC_ARB0_CHNL84_WDATA0_ADDR A:0x26a0010
y.create.l HWIO_PMIC_ARB0_CHNL85_WDATA0_ADDR A:0x26a8010
y.create.l HWIO_PMIC_ARB0_CHNL86_WDATA0_ADDR A:0x26b0010
y.create.l HWIO_PMIC_ARB0_CHNL87_WDATA0_ADDR A:0x26b8010
y.create.l HWIO_PMIC_ARB0_CHNL88_WDATA0_ADDR A:0x26c0010
y.create.l HWIO_PMIC_ARB0_CHNL89_WDATA0_ADDR A:0x26c8010
y.create.l HWIO_PMIC_ARB0_CHNL90_WDATA0_ADDR A:0x26d0010
y.create.l HWIO_PMIC_ARB0_CHNL91_WDATA0_ADDR A:0x26d8010
y.create.l HWIO_PMIC_ARB0_CHNL92_WDATA0_ADDR A:0x26e0010
y.create.l HWIO_PMIC_ARB0_CHNL93_WDATA0_ADDR A:0x26e8010
y.create.l HWIO_PMIC_ARB0_CHNL94_WDATA0_ADDR A:0x26f0010
y.create.l HWIO_PMIC_ARB0_CHNL95_WDATA0_ADDR A:0x26f8010
y.create.l HWIO_PMIC_ARB0_CHNL96_WDATA0_ADDR A:0x2700010
y.create.l HWIO_PMIC_ARB0_CHNL97_WDATA0_ADDR A:0x2708010
y.create.l HWIO_PMIC_ARB0_CHNL98_WDATA0_ADDR A:0x2710010
y.create.l HWIO_PMIC_ARB0_CHNL99_WDATA0_ADDR A:0x2718010
y.create.l HWIO_PMIC_ARB0_CHNL100_WDATA0_ADDR A:0x2720010
y.create.l HWIO_PMIC_ARB0_CHNL101_WDATA0_ADDR A:0x2728010
y.create.l HWIO_PMIC_ARB0_CHNL102_WDATA0_ADDR A:0x2730010
y.create.l HWIO_PMIC_ARB0_CHNL103_WDATA0_ADDR A:0x2738010
y.create.l HWIO_PMIC_ARB0_CHNL104_WDATA0_ADDR A:0x2740010
y.create.l HWIO_PMIC_ARB0_CHNL105_WDATA0_ADDR A:0x2748010
y.create.l HWIO_PMIC_ARB0_CHNL106_WDATA0_ADDR A:0x2750010
y.create.l HWIO_PMIC_ARB0_CHNL107_WDATA0_ADDR A:0x2758010
y.create.l HWIO_PMIC_ARB0_CHNL108_WDATA0_ADDR A:0x2760010
y.create.l HWIO_PMIC_ARB0_CHNL109_WDATA0_ADDR A:0x2768010
y.create.l HWIO_PMIC_ARB0_CHNL110_WDATA0_ADDR A:0x2770010
y.create.l HWIO_PMIC_ARB0_CHNL111_WDATA0_ADDR A:0x2778010
y.create.l HWIO_PMIC_ARB0_CHNL112_WDATA0_ADDR A:0x2780010
y.create.l HWIO_PMIC_ARB0_CHNL113_WDATA0_ADDR A:0x2788010
y.create.l HWIO_PMIC_ARB0_CHNL114_WDATA0_ADDR A:0x2790010
y.create.l HWIO_PMIC_ARB0_CHNL115_WDATA0_ADDR A:0x2798010
y.create.l HWIO_PMIC_ARB0_CHNL116_WDATA0_ADDR A:0x27a0010
y.create.l HWIO_PMIC_ARB0_CHNL117_WDATA0_ADDR A:0x27a8010
y.create.l HWIO_PMIC_ARB0_CHNL118_WDATA0_ADDR A:0x27b0010
y.create.l HWIO_PMIC_ARB0_CHNL119_WDATA0_ADDR A:0x27b8010
y.create.l HWIO_PMIC_ARB0_CHNL120_WDATA0_ADDR A:0x27c0010
y.create.l HWIO_PMIC_ARB0_CHNL121_WDATA0_ADDR A:0x27c8010
y.create.l HWIO_PMIC_ARB0_CHNL122_WDATA0_ADDR A:0x27d0010
y.create.l HWIO_PMIC_ARB0_CHNL123_WDATA0_ADDR A:0x27d8010
y.create.l HWIO_PMIC_ARB0_CHNL124_WDATA0_ADDR A:0x27e0010
y.create.l HWIO_PMIC_ARB0_CHNL125_WDATA0_ADDR A:0x27e8010
y.create.l HWIO_PMIC_ARB0_CHNL126_WDATA0_ADDR A:0x27f0010
y.create.l HWIO_PMIC_ARB0_CHNL127_WDATA0_ADDR A:0x27f8010
y.create.l HWIO_PMIC_ARB0_CHNL128_WDATA0_ADDR A:0x2800010
y.create.l HWIO_PMIC_ARB0_CHNL129_WDATA0_ADDR A:0x2808010
y.create.l HWIO_PMIC_ARB0_CHNL130_WDATA0_ADDR A:0x2810010
y.create.l HWIO_PMIC_ARB0_CHNL131_WDATA0_ADDR A:0x2818010
y.create.l HWIO_PMIC_ARB0_CHNL132_WDATA0_ADDR A:0x2820010
y.create.l HWIO_PMIC_ARB0_CHNL133_WDATA0_ADDR A:0x2828010
y.create.l HWIO_PMIC_ARB0_CHNL134_WDATA0_ADDR A:0x2830010
y.create.l HWIO_PMIC_ARB0_CHNL135_WDATA0_ADDR A:0x2838010
y.create.l HWIO_PMIC_ARB0_CHNL136_WDATA0_ADDR A:0x2840010
y.create.l HWIO_PMIC_ARB0_CHNL137_WDATA0_ADDR A:0x2848010
y.create.l HWIO_PMIC_ARB0_CHNL138_WDATA0_ADDR A:0x2850010
y.create.l HWIO_PMIC_ARB0_CHNL139_WDATA0_ADDR A:0x2858010
y.create.l HWIO_PMIC_ARB0_CHNL140_WDATA0_ADDR A:0x2860010
y.create.l HWIO_PMIC_ARB0_CHNL141_WDATA0_ADDR A:0x2868010
y.create.l HWIO_PMIC_ARB0_CHNL142_WDATA0_ADDR A:0x2870010
y.create.l HWIO_PMIC_ARB0_CHNL143_WDATA0_ADDR A:0x2878010
y.create.l HWIO_PMIC_ARB0_CHNL144_WDATA0_ADDR A:0x2880010
y.create.l HWIO_PMIC_ARB0_CHNL145_WDATA0_ADDR A:0x2888010
y.create.l HWIO_PMIC_ARB0_CHNL146_WDATA0_ADDR A:0x2890010
y.create.l HWIO_PMIC_ARB0_CHNL147_WDATA0_ADDR A:0x2898010
y.create.l HWIO_PMIC_ARB0_CHNL148_WDATA0_ADDR A:0x28a0010
y.create.l HWIO_PMIC_ARB0_CHNL149_WDATA0_ADDR A:0x28a8010
y.create.l HWIO_PMIC_ARB0_CHNL150_WDATA0_ADDR A:0x28b0010
y.create.l HWIO_PMIC_ARB0_CHNL151_WDATA0_ADDR A:0x28b8010
y.create.l HWIO_PMIC_ARB0_CHNL152_WDATA0_ADDR A:0x28c0010
y.create.l HWIO_PMIC_ARB0_CHNL153_WDATA0_ADDR A:0x28c8010
y.create.l HWIO_PMIC_ARB0_CHNL154_WDATA0_ADDR A:0x28d0010
y.create.l HWIO_PMIC_ARB0_CHNL155_WDATA0_ADDR A:0x28d8010
y.create.l HWIO_PMIC_ARB0_CHNL156_WDATA0_ADDR A:0x28e0010
y.create.l HWIO_PMIC_ARB0_CHNL157_WDATA0_ADDR A:0x28e8010
y.create.l HWIO_PMIC_ARB0_CHNL158_WDATA0_ADDR A:0x28f0010
y.create.l HWIO_PMIC_ARB0_CHNL159_WDATA0_ADDR A:0x28f8010
y.create.l HWIO_PMIC_ARB0_CHNL160_WDATA0_ADDR A:0x2900010
y.create.l HWIO_PMIC_ARB0_CHNL161_WDATA0_ADDR A:0x2908010
y.create.l HWIO_PMIC_ARB0_CHNL162_WDATA0_ADDR A:0x2910010
y.create.l HWIO_PMIC_ARB0_CHNL163_WDATA0_ADDR A:0x2918010
y.create.l HWIO_PMIC_ARB0_CHNL164_WDATA0_ADDR A:0x2920010
y.create.l HWIO_PMIC_ARB0_CHNL165_WDATA0_ADDR A:0x2928010
y.create.l HWIO_PMIC_ARB0_CHNL166_WDATA0_ADDR A:0x2930010
y.create.l HWIO_PMIC_ARB0_CHNL167_WDATA0_ADDR A:0x2938010
y.create.l HWIO_PMIC_ARB0_CHNL168_WDATA0_ADDR A:0x2940010
y.create.l HWIO_PMIC_ARB0_CHNL169_WDATA0_ADDR A:0x2948010
y.create.l HWIO_PMIC_ARB0_CHNL170_WDATA0_ADDR A:0x2950010
y.create.l HWIO_PMIC_ARB0_CHNL171_WDATA0_ADDR A:0x2958010
y.create.l HWIO_PMIC_ARB0_CHNL172_WDATA0_ADDR A:0x2960010
y.create.l HWIO_PMIC_ARB0_CHNL173_WDATA0_ADDR A:0x2968010
y.create.l HWIO_PMIC_ARB0_CHNL174_WDATA0_ADDR A:0x2970010
y.create.l HWIO_PMIC_ARB0_CHNL175_WDATA0_ADDR A:0x2978010
y.create.l HWIO_PMIC_ARB0_CHNL176_WDATA0_ADDR A:0x2980010
y.create.l HWIO_PMIC_ARB0_CHNL177_WDATA0_ADDR A:0x2988010
y.create.l HWIO_PMIC_ARB0_CHNL178_WDATA0_ADDR A:0x2990010
y.create.l HWIO_PMIC_ARB0_CHNL179_WDATA0_ADDR A:0x2998010
y.create.l HWIO_PMIC_ARB0_CHNL180_WDATA0_ADDR A:0x29a0010
y.create.l HWIO_PMIC_ARB0_CHNL181_WDATA0_ADDR A:0x29a8010
y.create.l HWIO_PMIC_ARB0_CHNL182_WDATA0_ADDR A:0x29b0010
y.create.l HWIO_PMIC_ARB0_CHNL183_WDATA0_ADDR A:0x29b8010
y.create.l HWIO_PMIC_ARB0_CHNL184_WDATA0_ADDR A:0x29c0010
y.create.l HWIO_PMIC_ARB0_CHNL185_WDATA0_ADDR A:0x29c8010
y.create.l HWIO_PMIC_ARB0_CHNL186_WDATA0_ADDR A:0x29d0010
y.create.l HWIO_PMIC_ARB0_CHNL187_WDATA0_ADDR A:0x29d8010
y.create.l HWIO_PMIC_ARB0_CHNL188_WDATA0_ADDR A:0x29e0010
y.create.l HWIO_PMIC_ARB0_CHNL189_WDATA0_ADDR A:0x29e8010
y.create.l HWIO_PMIC_ARB0_CHNL190_WDATA0_ADDR A:0x29f0010
y.create.l HWIO_PMIC_ARB0_CHNL191_WDATA0_ADDR A:0x29f8010
y.create.l HWIO_PMIC_ARB0_CHNL192_WDATA0_ADDR A:0x2a00010
y.create.l HWIO_PMIC_ARB0_CHNL193_WDATA0_ADDR A:0x2a08010
y.create.l HWIO_PMIC_ARB0_CHNL194_WDATA0_ADDR A:0x2a10010
y.create.l HWIO_PMIC_ARB0_CHNL195_WDATA0_ADDR A:0x2a18010
y.create.l HWIO_PMIC_ARB0_CHNL196_WDATA0_ADDR A:0x2a20010
y.create.l HWIO_PMIC_ARB0_CHNL197_WDATA0_ADDR A:0x2a28010
y.create.l HWIO_PMIC_ARB0_CHNL198_WDATA0_ADDR A:0x2a30010
y.create.l HWIO_PMIC_ARB0_CHNL199_WDATA0_ADDR A:0x2a38010
y.create.l HWIO_PMIC_ARB0_CHNL200_WDATA0_ADDR A:0x2a40010
y.create.l HWIO_PMIC_ARB0_CHNL201_WDATA0_ADDR A:0x2a48010
y.create.l HWIO_PMIC_ARB0_CHNL202_WDATA0_ADDR A:0x2a50010
y.create.l HWIO_PMIC_ARB0_CHNL203_WDATA0_ADDR A:0x2a58010
y.create.l HWIO_PMIC_ARB0_CHNL204_WDATA0_ADDR A:0x2a60010
y.create.l HWIO_PMIC_ARB0_CHNL205_WDATA0_ADDR A:0x2a68010
y.create.l HWIO_PMIC_ARB0_CHNL206_WDATA0_ADDR A:0x2a70010
y.create.l HWIO_PMIC_ARB0_CHNL207_WDATA0_ADDR A:0x2a78010
y.create.l HWIO_PMIC_ARB0_CHNL208_WDATA0_ADDR A:0x2a80010
y.create.l HWIO_PMIC_ARB0_CHNL209_WDATA0_ADDR A:0x2a88010
y.create.l HWIO_PMIC_ARB0_CHNL210_WDATA0_ADDR A:0x2a90010
y.create.l HWIO_PMIC_ARB0_CHNL211_WDATA0_ADDR A:0x2a98010
y.create.l HWIO_PMIC_ARB0_CHNL212_WDATA0_ADDR A:0x2aa0010
y.create.l HWIO_PMIC_ARB0_CHNL213_WDATA0_ADDR A:0x2aa8010
y.create.l HWIO_PMIC_ARB0_CHNL214_WDATA0_ADDR A:0x2ab0010
y.create.l HWIO_PMIC_ARB0_CHNL215_WDATA0_ADDR A:0x2ab8010
y.create.l HWIO_PMIC_ARB0_CHNL216_WDATA0_ADDR A:0x2ac0010
y.create.l HWIO_PMIC_ARB0_CHNL217_WDATA0_ADDR A:0x2ac8010
y.create.l HWIO_PMIC_ARB0_CHNL218_WDATA0_ADDR A:0x2ad0010
y.create.l HWIO_PMIC_ARB0_CHNL219_WDATA0_ADDR A:0x2ad8010
y.create.l HWIO_PMIC_ARB0_CHNL220_WDATA0_ADDR A:0x2ae0010
y.create.l HWIO_PMIC_ARB0_CHNL221_WDATA0_ADDR A:0x2ae8010
y.create.l HWIO_PMIC_ARB0_CHNL222_WDATA0_ADDR A:0x2af0010
y.create.l HWIO_PMIC_ARB0_CHNL223_WDATA0_ADDR A:0x2af8010
y.create.l HWIO_PMIC_ARB0_CHNL224_WDATA0_ADDR A:0x2b00010
y.create.l HWIO_PMIC_ARB0_CHNL225_WDATA0_ADDR A:0x2b08010
y.create.l HWIO_PMIC_ARB0_CHNL226_WDATA0_ADDR A:0x2b10010
y.create.l HWIO_PMIC_ARB0_CHNL227_WDATA0_ADDR A:0x2b18010
y.create.l HWIO_PMIC_ARB0_CHNL228_WDATA0_ADDR A:0x2b20010
y.create.l HWIO_PMIC_ARB0_CHNL229_WDATA0_ADDR A:0x2b28010
y.create.l HWIO_PMIC_ARB0_CHNL230_WDATA0_ADDR A:0x2b30010
y.create.l HWIO_PMIC_ARB0_CHNL231_WDATA0_ADDR A:0x2b38010
y.create.l HWIO_PMIC_ARB0_CHNL232_WDATA0_ADDR A:0x2b40010
y.create.l HWIO_PMIC_ARB0_CHNL233_WDATA0_ADDR A:0x2b48010
y.create.l HWIO_PMIC_ARB0_CHNL234_WDATA0_ADDR A:0x2b50010
y.create.l HWIO_PMIC_ARB0_CHNL235_WDATA0_ADDR A:0x2b58010
y.create.l HWIO_PMIC_ARB0_CHNL236_WDATA0_ADDR A:0x2b60010
y.create.l HWIO_PMIC_ARB0_CHNL237_WDATA0_ADDR A:0x2b68010
y.create.l HWIO_PMIC_ARB0_CHNL238_WDATA0_ADDR A:0x2b70010
y.create.l HWIO_PMIC_ARB0_CHNL239_WDATA0_ADDR A:0x2b78010
y.create.l HWIO_PMIC_ARB0_CHNL240_WDATA0_ADDR A:0x2b80010
y.create.l HWIO_PMIC_ARB0_CHNL241_WDATA0_ADDR A:0x2b88010
y.create.l HWIO_PMIC_ARB0_CHNL242_WDATA0_ADDR A:0x2b90010
y.create.l HWIO_PMIC_ARB0_CHNL243_WDATA0_ADDR A:0x2b98010
y.create.l HWIO_PMIC_ARB0_CHNL244_WDATA0_ADDR A:0x2ba0010
y.create.l HWIO_PMIC_ARB0_CHNL245_WDATA0_ADDR A:0x2ba8010
y.create.l HWIO_PMIC_ARB0_CHNL246_WDATA0_ADDR A:0x2bb0010
y.create.l HWIO_PMIC_ARB0_CHNL247_WDATA0_ADDR A:0x2bb8010
y.create.l HWIO_PMIC_ARB0_CHNL248_WDATA0_ADDR A:0x2bc0010
y.create.l HWIO_PMIC_ARB0_CHNL249_WDATA0_ADDR A:0x2bc8010
y.create.l HWIO_PMIC_ARB0_CHNL250_WDATA0_ADDR A:0x2bd0010
y.create.l HWIO_PMIC_ARB0_CHNL251_WDATA0_ADDR A:0x2bd8010
y.create.l HWIO_PMIC_ARB0_CHNL252_WDATA0_ADDR A:0x2be0010
y.create.l HWIO_PMIC_ARB0_CHNL253_WDATA0_ADDR A:0x2be8010
y.create.l HWIO_PMIC_ARB0_CHNL254_WDATA0_ADDR A:0x2bf0010
y.create.l HWIO_PMIC_ARB0_CHNL255_WDATA0_ADDR A:0x2bf8010
y.create.l HWIO_PMIC_ARB1_CHNL0_WDATA0_ADDR A:0x2401010
y.create.l HWIO_PMIC_ARB1_CHNL1_WDATA0_ADDR A:0x2409010
y.create.l HWIO_PMIC_ARB1_CHNL2_WDATA0_ADDR A:0x2411010
y.create.l HWIO_PMIC_ARB1_CHNL3_WDATA0_ADDR A:0x2419010
y.create.l HWIO_PMIC_ARB1_CHNL4_WDATA0_ADDR A:0x2421010
y.create.l HWIO_PMIC_ARB1_CHNL5_WDATA0_ADDR A:0x2429010
y.create.l HWIO_PMIC_ARB1_CHNL6_WDATA0_ADDR A:0x2431010
y.create.l HWIO_PMIC_ARB1_CHNL7_WDATA0_ADDR A:0x2439010
y.create.l HWIO_PMIC_ARB1_CHNL8_WDATA0_ADDR A:0x2441010
y.create.l HWIO_PMIC_ARB1_CHNL9_WDATA0_ADDR A:0x2449010
y.create.l HWIO_PMIC_ARB1_CHNL10_WDATA0_ADDR A:0x2451010
y.create.l HWIO_PMIC_ARB1_CHNL11_WDATA0_ADDR A:0x2459010
y.create.l HWIO_PMIC_ARB1_CHNL12_WDATA0_ADDR A:0x2461010
y.create.l HWIO_PMIC_ARB1_CHNL13_WDATA0_ADDR A:0x2469010
y.create.l HWIO_PMIC_ARB1_CHNL14_WDATA0_ADDR A:0x2471010
y.create.l HWIO_PMIC_ARB1_CHNL15_WDATA0_ADDR A:0x2479010
y.create.l HWIO_PMIC_ARB1_CHNL16_WDATA0_ADDR A:0x2481010
y.create.l HWIO_PMIC_ARB1_CHNL17_WDATA0_ADDR A:0x2489010
y.create.l HWIO_PMIC_ARB1_CHNL18_WDATA0_ADDR A:0x2491010
y.create.l HWIO_PMIC_ARB1_CHNL19_WDATA0_ADDR A:0x2499010
y.create.l HWIO_PMIC_ARB1_CHNL20_WDATA0_ADDR A:0x24a1010
y.create.l HWIO_PMIC_ARB1_CHNL21_WDATA0_ADDR A:0x24a9010
y.create.l HWIO_PMIC_ARB1_CHNL22_WDATA0_ADDR A:0x24b1010
y.create.l HWIO_PMIC_ARB1_CHNL23_WDATA0_ADDR A:0x24b9010
y.create.l HWIO_PMIC_ARB1_CHNL24_WDATA0_ADDR A:0x24c1010
y.create.l HWIO_PMIC_ARB1_CHNL25_WDATA0_ADDR A:0x24c9010
y.create.l HWIO_PMIC_ARB1_CHNL26_WDATA0_ADDR A:0x24d1010
y.create.l HWIO_PMIC_ARB1_CHNL27_WDATA0_ADDR A:0x24d9010
y.create.l HWIO_PMIC_ARB1_CHNL28_WDATA0_ADDR A:0x24e1010
y.create.l HWIO_PMIC_ARB1_CHNL29_WDATA0_ADDR A:0x24e9010
y.create.l HWIO_PMIC_ARB1_CHNL30_WDATA0_ADDR A:0x24f1010
y.create.l HWIO_PMIC_ARB1_CHNL31_WDATA0_ADDR A:0x24f9010
y.create.l HWIO_PMIC_ARB1_CHNL32_WDATA0_ADDR A:0x2501010
y.create.l HWIO_PMIC_ARB1_CHNL33_WDATA0_ADDR A:0x2509010
y.create.l HWIO_PMIC_ARB1_CHNL34_WDATA0_ADDR A:0x2511010
y.create.l HWIO_PMIC_ARB1_CHNL35_WDATA0_ADDR A:0x2519010
y.create.l HWIO_PMIC_ARB1_CHNL36_WDATA0_ADDR A:0x2521010
y.create.l HWIO_PMIC_ARB1_CHNL37_WDATA0_ADDR A:0x2529010
y.create.l HWIO_PMIC_ARB1_CHNL38_WDATA0_ADDR A:0x2531010
y.create.l HWIO_PMIC_ARB1_CHNL39_WDATA0_ADDR A:0x2539010
y.create.l HWIO_PMIC_ARB1_CHNL40_WDATA0_ADDR A:0x2541010
y.create.l HWIO_PMIC_ARB1_CHNL41_WDATA0_ADDR A:0x2549010
y.create.l HWIO_PMIC_ARB1_CHNL42_WDATA0_ADDR A:0x2551010
y.create.l HWIO_PMIC_ARB1_CHNL43_WDATA0_ADDR A:0x2559010
y.create.l HWIO_PMIC_ARB1_CHNL44_WDATA0_ADDR A:0x2561010
y.create.l HWIO_PMIC_ARB1_CHNL45_WDATA0_ADDR A:0x2569010
y.create.l HWIO_PMIC_ARB1_CHNL46_WDATA0_ADDR A:0x2571010
y.create.l HWIO_PMIC_ARB1_CHNL47_WDATA0_ADDR A:0x2579010
y.create.l HWIO_PMIC_ARB1_CHNL48_WDATA0_ADDR A:0x2581010
y.create.l HWIO_PMIC_ARB1_CHNL49_WDATA0_ADDR A:0x2589010
y.create.l HWIO_PMIC_ARB1_CHNL50_WDATA0_ADDR A:0x2591010
y.create.l HWIO_PMIC_ARB1_CHNL51_WDATA0_ADDR A:0x2599010
y.create.l HWIO_PMIC_ARB1_CHNL52_WDATA0_ADDR A:0x25a1010
y.create.l HWIO_PMIC_ARB1_CHNL53_WDATA0_ADDR A:0x25a9010
y.create.l HWIO_PMIC_ARB1_CHNL54_WDATA0_ADDR A:0x25b1010
y.create.l HWIO_PMIC_ARB1_CHNL55_WDATA0_ADDR A:0x25b9010
y.create.l HWIO_PMIC_ARB1_CHNL56_WDATA0_ADDR A:0x25c1010
y.create.l HWIO_PMIC_ARB1_CHNL57_WDATA0_ADDR A:0x25c9010
y.create.l HWIO_PMIC_ARB1_CHNL58_WDATA0_ADDR A:0x25d1010
y.create.l HWIO_PMIC_ARB1_CHNL59_WDATA0_ADDR A:0x25d9010
y.create.l HWIO_PMIC_ARB1_CHNL60_WDATA0_ADDR A:0x25e1010
y.create.l HWIO_PMIC_ARB1_CHNL61_WDATA0_ADDR A:0x25e9010
y.create.l HWIO_PMIC_ARB1_CHNL62_WDATA0_ADDR A:0x25f1010
y.create.l HWIO_PMIC_ARB1_CHNL63_WDATA0_ADDR A:0x25f9010
y.create.l HWIO_PMIC_ARB1_CHNL64_WDATA0_ADDR A:0x2601010
y.create.l HWIO_PMIC_ARB1_CHNL65_WDATA0_ADDR A:0x2609010
y.create.l HWIO_PMIC_ARB1_CHNL66_WDATA0_ADDR A:0x2611010
y.create.l HWIO_PMIC_ARB1_CHNL67_WDATA0_ADDR A:0x2619010
y.create.l HWIO_PMIC_ARB1_CHNL68_WDATA0_ADDR A:0x2621010
y.create.l HWIO_PMIC_ARB1_CHNL69_WDATA0_ADDR A:0x2629010
y.create.l HWIO_PMIC_ARB1_CHNL70_WDATA0_ADDR A:0x2631010
y.create.l HWIO_PMIC_ARB1_CHNL71_WDATA0_ADDR A:0x2639010
y.create.l HWIO_PMIC_ARB1_CHNL72_WDATA0_ADDR A:0x2641010
y.create.l HWIO_PMIC_ARB1_CHNL73_WDATA0_ADDR A:0x2649010
y.create.l HWIO_PMIC_ARB1_CHNL74_WDATA0_ADDR A:0x2651010
y.create.l HWIO_PMIC_ARB1_CHNL75_WDATA0_ADDR A:0x2659010
y.create.l HWIO_PMIC_ARB1_CHNL76_WDATA0_ADDR A:0x2661010
y.create.l HWIO_PMIC_ARB1_CHNL77_WDATA0_ADDR A:0x2669010
y.create.l HWIO_PMIC_ARB1_CHNL78_WDATA0_ADDR A:0x2671010
y.create.l HWIO_PMIC_ARB1_CHNL79_WDATA0_ADDR A:0x2679010
y.create.l HWIO_PMIC_ARB1_CHNL80_WDATA0_ADDR A:0x2681010
y.create.l HWIO_PMIC_ARB1_CHNL81_WDATA0_ADDR A:0x2689010
y.create.l HWIO_PMIC_ARB1_CHNL82_WDATA0_ADDR A:0x2691010
y.create.l HWIO_PMIC_ARB1_CHNL83_WDATA0_ADDR A:0x2699010
y.create.l HWIO_PMIC_ARB1_CHNL84_WDATA0_ADDR A:0x26a1010
y.create.l HWIO_PMIC_ARB1_CHNL85_WDATA0_ADDR A:0x26a9010
y.create.l HWIO_PMIC_ARB1_CHNL86_WDATA0_ADDR A:0x26b1010
y.create.l HWIO_PMIC_ARB1_CHNL87_WDATA0_ADDR A:0x26b9010
y.create.l HWIO_PMIC_ARB1_CHNL88_WDATA0_ADDR A:0x26c1010
y.create.l HWIO_PMIC_ARB1_CHNL89_WDATA0_ADDR A:0x26c9010
y.create.l HWIO_PMIC_ARB1_CHNL90_WDATA0_ADDR A:0x26d1010
y.create.l HWIO_PMIC_ARB1_CHNL91_WDATA0_ADDR A:0x26d9010
y.create.l HWIO_PMIC_ARB1_CHNL92_WDATA0_ADDR A:0x26e1010
y.create.l HWIO_PMIC_ARB1_CHNL93_WDATA0_ADDR A:0x26e9010
y.create.l HWIO_PMIC_ARB1_CHNL94_WDATA0_ADDR A:0x26f1010
y.create.l HWIO_PMIC_ARB1_CHNL95_WDATA0_ADDR A:0x26f9010
y.create.l HWIO_PMIC_ARB1_CHNL96_WDATA0_ADDR A:0x2701010
y.create.l HWIO_PMIC_ARB1_CHNL97_WDATA0_ADDR A:0x2709010
y.create.l HWIO_PMIC_ARB1_CHNL98_WDATA0_ADDR A:0x2711010
y.create.l HWIO_PMIC_ARB1_CHNL99_WDATA0_ADDR A:0x2719010
y.create.l HWIO_PMIC_ARB1_CHNL100_WDATA0_ADDR A:0x2721010
y.create.l HWIO_PMIC_ARB1_CHNL101_WDATA0_ADDR A:0x2729010
y.create.l HWIO_PMIC_ARB1_CHNL102_WDATA0_ADDR A:0x2731010
y.create.l HWIO_PMIC_ARB1_CHNL103_WDATA0_ADDR A:0x2739010
y.create.l HWIO_PMIC_ARB1_CHNL104_WDATA0_ADDR A:0x2741010
y.create.l HWIO_PMIC_ARB1_CHNL105_WDATA0_ADDR A:0x2749010
y.create.l HWIO_PMIC_ARB1_CHNL106_WDATA0_ADDR A:0x2751010
y.create.l HWIO_PMIC_ARB1_CHNL107_WDATA0_ADDR A:0x2759010
y.create.l HWIO_PMIC_ARB1_CHNL108_WDATA0_ADDR A:0x2761010
y.create.l HWIO_PMIC_ARB1_CHNL109_WDATA0_ADDR A:0x2769010
y.create.l HWIO_PMIC_ARB1_CHNL110_WDATA0_ADDR A:0x2771010
y.create.l HWIO_PMIC_ARB1_CHNL111_WDATA0_ADDR A:0x2779010
y.create.l HWIO_PMIC_ARB1_CHNL112_WDATA0_ADDR A:0x2781010
y.create.l HWIO_PMIC_ARB1_CHNL113_WDATA0_ADDR A:0x2789010
y.create.l HWIO_PMIC_ARB1_CHNL114_WDATA0_ADDR A:0x2791010
y.create.l HWIO_PMIC_ARB1_CHNL115_WDATA0_ADDR A:0x2799010
y.create.l HWIO_PMIC_ARB1_CHNL116_WDATA0_ADDR A:0x27a1010
y.create.l HWIO_PMIC_ARB1_CHNL117_WDATA0_ADDR A:0x27a9010
y.create.l HWIO_PMIC_ARB1_CHNL118_WDATA0_ADDR A:0x27b1010
y.create.l HWIO_PMIC_ARB1_CHNL119_WDATA0_ADDR A:0x27b9010
y.create.l HWIO_PMIC_ARB1_CHNL120_WDATA0_ADDR A:0x27c1010
y.create.l HWIO_PMIC_ARB1_CHNL121_WDATA0_ADDR A:0x27c9010
y.create.l HWIO_PMIC_ARB1_CHNL122_WDATA0_ADDR A:0x27d1010
y.create.l HWIO_PMIC_ARB1_CHNL123_WDATA0_ADDR A:0x27d9010
y.create.l HWIO_PMIC_ARB1_CHNL124_WDATA0_ADDR A:0x27e1010
y.create.l HWIO_PMIC_ARB1_CHNL125_WDATA0_ADDR A:0x27e9010
y.create.l HWIO_PMIC_ARB1_CHNL126_WDATA0_ADDR A:0x27f1010
y.create.l HWIO_PMIC_ARB1_CHNL127_WDATA0_ADDR A:0x27f9010
y.create.l HWIO_PMIC_ARB1_CHNL128_WDATA0_ADDR A:0x2801010
y.create.l HWIO_PMIC_ARB1_CHNL129_WDATA0_ADDR A:0x2809010
y.create.l HWIO_PMIC_ARB1_CHNL130_WDATA0_ADDR A:0x2811010
y.create.l HWIO_PMIC_ARB1_CHNL131_WDATA0_ADDR A:0x2819010
y.create.l HWIO_PMIC_ARB1_CHNL132_WDATA0_ADDR A:0x2821010
y.create.l HWIO_PMIC_ARB1_CHNL133_WDATA0_ADDR A:0x2829010
y.create.l HWIO_PMIC_ARB1_CHNL134_WDATA0_ADDR A:0x2831010
y.create.l HWIO_PMIC_ARB1_CHNL135_WDATA0_ADDR A:0x2839010
y.create.l HWIO_PMIC_ARB1_CHNL136_WDATA0_ADDR A:0x2841010
y.create.l HWIO_PMIC_ARB1_CHNL137_WDATA0_ADDR A:0x2849010
y.create.l HWIO_PMIC_ARB1_CHNL138_WDATA0_ADDR A:0x2851010
y.create.l HWIO_PMIC_ARB1_CHNL139_WDATA0_ADDR A:0x2859010
y.create.l HWIO_PMIC_ARB1_CHNL140_WDATA0_ADDR A:0x2861010
y.create.l HWIO_PMIC_ARB1_CHNL141_WDATA0_ADDR A:0x2869010
y.create.l HWIO_PMIC_ARB1_CHNL142_WDATA0_ADDR A:0x2871010
y.create.l HWIO_PMIC_ARB1_CHNL143_WDATA0_ADDR A:0x2879010
y.create.l HWIO_PMIC_ARB1_CHNL144_WDATA0_ADDR A:0x2881010
y.create.l HWIO_PMIC_ARB1_CHNL145_WDATA0_ADDR A:0x2889010
y.create.l HWIO_PMIC_ARB1_CHNL146_WDATA0_ADDR A:0x2891010
y.create.l HWIO_PMIC_ARB1_CHNL147_WDATA0_ADDR A:0x2899010
y.create.l HWIO_PMIC_ARB1_CHNL148_WDATA0_ADDR A:0x28a1010
y.create.l HWIO_PMIC_ARB1_CHNL149_WDATA0_ADDR A:0x28a9010
y.create.l HWIO_PMIC_ARB1_CHNL150_WDATA0_ADDR A:0x28b1010
y.create.l HWIO_PMIC_ARB1_CHNL151_WDATA0_ADDR A:0x28b9010
y.create.l HWIO_PMIC_ARB1_CHNL152_WDATA0_ADDR A:0x28c1010
y.create.l HWIO_PMIC_ARB1_CHNL153_WDATA0_ADDR A:0x28c9010
y.create.l HWIO_PMIC_ARB1_CHNL154_WDATA0_ADDR A:0x28d1010
y.create.l HWIO_PMIC_ARB1_CHNL155_WDATA0_ADDR A:0x28d9010
y.create.l HWIO_PMIC_ARB1_CHNL156_WDATA0_ADDR A:0x28e1010
y.create.l HWIO_PMIC_ARB1_CHNL157_WDATA0_ADDR A:0x28e9010
y.create.l HWIO_PMIC_ARB1_CHNL158_WDATA0_ADDR A:0x28f1010
y.create.l HWIO_PMIC_ARB1_CHNL159_WDATA0_ADDR A:0x28f9010
y.create.l HWIO_PMIC_ARB1_CHNL160_WDATA0_ADDR A:0x2901010
y.create.l HWIO_PMIC_ARB1_CHNL161_WDATA0_ADDR A:0x2909010
y.create.l HWIO_PMIC_ARB1_CHNL162_WDATA0_ADDR A:0x2911010
y.create.l HWIO_PMIC_ARB1_CHNL163_WDATA0_ADDR A:0x2919010
y.create.l HWIO_PMIC_ARB1_CHNL164_WDATA0_ADDR A:0x2921010
y.create.l HWIO_PMIC_ARB1_CHNL165_WDATA0_ADDR A:0x2929010
y.create.l HWIO_PMIC_ARB1_CHNL166_WDATA0_ADDR A:0x2931010
y.create.l HWIO_PMIC_ARB1_CHNL167_WDATA0_ADDR A:0x2939010
y.create.l HWIO_PMIC_ARB1_CHNL168_WDATA0_ADDR A:0x2941010
y.create.l HWIO_PMIC_ARB1_CHNL169_WDATA0_ADDR A:0x2949010
y.create.l HWIO_PMIC_ARB1_CHNL170_WDATA0_ADDR A:0x2951010
y.create.l HWIO_PMIC_ARB1_CHNL171_WDATA0_ADDR A:0x2959010
y.create.l HWIO_PMIC_ARB1_CHNL172_WDATA0_ADDR A:0x2961010
y.create.l HWIO_PMIC_ARB1_CHNL173_WDATA0_ADDR A:0x2969010
y.create.l HWIO_PMIC_ARB1_CHNL174_WDATA0_ADDR A:0x2971010
y.create.l HWIO_PMIC_ARB1_CHNL175_WDATA0_ADDR A:0x2979010
y.create.l HWIO_PMIC_ARB1_CHNL176_WDATA0_ADDR A:0x2981010
y.create.l HWIO_PMIC_ARB1_CHNL177_WDATA0_ADDR A:0x2989010
y.create.l HWIO_PMIC_ARB1_CHNL178_WDATA0_ADDR A:0x2991010
y.create.l HWIO_PMIC_ARB1_CHNL179_WDATA0_ADDR A:0x2999010
y.create.l HWIO_PMIC_ARB1_CHNL180_WDATA0_ADDR A:0x29a1010
y.create.l HWIO_PMIC_ARB1_CHNL181_WDATA0_ADDR A:0x29a9010
y.create.l HWIO_PMIC_ARB1_CHNL182_WDATA0_ADDR A:0x29b1010
y.create.l HWIO_PMIC_ARB1_CHNL183_WDATA0_ADDR A:0x29b9010
y.create.l HWIO_PMIC_ARB1_CHNL184_WDATA0_ADDR A:0x29c1010
y.create.l HWIO_PMIC_ARB1_CHNL185_WDATA0_ADDR A:0x29c9010
y.create.l HWIO_PMIC_ARB1_CHNL186_WDATA0_ADDR A:0x29d1010
y.create.l HWIO_PMIC_ARB1_CHNL187_WDATA0_ADDR A:0x29d9010
y.create.l HWIO_PMIC_ARB1_CHNL188_WDATA0_ADDR A:0x29e1010
y.create.l HWIO_PMIC_ARB1_CHNL189_WDATA0_ADDR A:0x29e9010
y.create.l HWIO_PMIC_ARB1_CHNL190_WDATA0_ADDR A:0x29f1010
y.create.l HWIO_PMIC_ARB1_CHNL191_WDATA0_ADDR A:0x29f9010
y.create.l HWIO_PMIC_ARB1_CHNL192_WDATA0_ADDR A:0x2a01010
y.create.l HWIO_PMIC_ARB1_CHNL193_WDATA0_ADDR A:0x2a09010
y.create.l HWIO_PMIC_ARB1_CHNL194_WDATA0_ADDR A:0x2a11010
y.create.l HWIO_PMIC_ARB1_CHNL195_WDATA0_ADDR A:0x2a19010
y.create.l HWIO_PMIC_ARB1_CHNL196_WDATA0_ADDR A:0x2a21010
y.create.l HWIO_PMIC_ARB1_CHNL197_WDATA0_ADDR A:0x2a29010
y.create.l HWIO_PMIC_ARB1_CHNL198_WDATA0_ADDR A:0x2a31010
y.create.l HWIO_PMIC_ARB1_CHNL199_WDATA0_ADDR A:0x2a39010
y.create.l HWIO_PMIC_ARB1_CHNL200_WDATA0_ADDR A:0x2a41010
y.create.l HWIO_PMIC_ARB1_CHNL201_WDATA0_ADDR A:0x2a49010
y.create.l HWIO_PMIC_ARB1_CHNL202_WDATA0_ADDR A:0x2a51010
y.create.l HWIO_PMIC_ARB1_CHNL203_WDATA0_ADDR A:0x2a59010
y.create.l HWIO_PMIC_ARB1_CHNL204_WDATA0_ADDR A:0x2a61010
y.create.l HWIO_PMIC_ARB1_CHNL205_WDATA0_ADDR A:0x2a69010
y.create.l HWIO_PMIC_ARB1_CHNL206_WDATA0_ADDR A:0x2a71010
y.create.l HWIO_PMIC_ARB1_CHNL207_WDATA0_ADDR A:0x2a79010
y.create.l HWIO_PMIC_ARB1_CHNL208_WDATA0_ADDR A:0x2a81010
y.create.l HWIO_PMIC_ARB1_CHNL209_WDATA0_ADDR A:0x2a89010
y.create.l HWIO_PMIC_ARB1_CHNL210_WDATA0_ADDR A:0x2a91010
y.create.l HWIO_PMIC_ARB1_CHNL211_WDATA0_ADDR A:0x2a99010
y.create.l HWIO_PMIC_ARB1_CHNL212_WDATA0_ADDR A:0x2aa1010
y.create.l HWIO_PMIC_ARB1_CHNL213_WDATA0_ADDR A:0x2aa9010
y.create.l HWIO_PMIC_ARB1_CHNL214_WDATA0_ADDR A:0x2ab1010
y.create.l HWIO_PMIC_ARB1_CHNL215_WDATA0_ADDR A:0x2ab9010
y.create.l HWIO_PMIC_ARB1_CHNL216_WDATA0_ADDR A:0x2ac1010
y.create.l HWIO_PMIC_ARB1_CHNL217_WDATA0_ADDR A:0x2ac9010
y.create.l HWIO_PMIC_ARB1_CHNL218_WDATA0_ADDR A:0x2ad1010
y.create.l HWIO_PMIC_ARB1_CHNL219_WDATA0_ADDR A:0x2ad9010
y.create.l HWIO_PMIC_ARB1_CHNL220_WDATA0_ADDR A:0x2ae1010
y.create.l HWIO_PMIC_ARB1_CHNL221_WDATA0_ADDR A:0x2ae9010
y.create.l HWIO_PMIC_ARB1_CHNL222_WDATA0_ADDR A:0x2af1010
y.create.l HWIO_PMIC_ARB1_CHNL223_WDATA0_ADDR A:0x2af9010
y.create.l HWIO_PMIC_ARB1_CHNL224_WDATA0_ADDR A:0x2b01010
y.create.l HWIO_PMIC_ARB1_CHNL225_WDATA0_ADDR A:0x2b09010
y.create.l HWIO_PMIC_ARB1_CHNL226_WDATA0_ADDR A:0x2b11010
y.create.l HWIO_PMIC_ARB1_CHNL227_WDATA0_ADDR A:0x2b19010
y.create.l HWIO_PMIC_ARB1_CHNL228_WDATA0_ADDR A:0x2b21010
y.create.l HWIO_PMIC_ARB1_CHNL229_WDATA0_ADDR A:0x2b29010
y.create.l HWIO_PMIC_ARB1_CHNL230_WDATA0_ADDR A:0x2b31010
y.create.l HWIO_PMIC_ARB1_CHNL231_WDATA0_ADDR A:0x2b39010
y.create.l HWIO_PMIC_ARB1_CHNL232_WDATA0_ADDR A:0x2b41010
y.create.l HWIO_PMIC_ARB1_CHNL233_WDATA0_ADDR A:0x2b49010
y.create.l HWIO_PMIC_ARB1_CHNL234_WDATA0_ADDR A:0x2b51010
y.create.l HWIO_PMIC_ARB1_CHNL235_WDATA0_ADDR A:0x2b59010
y.create.l HWIO_PMIC_ARB1_CHNL236_WDATA0_ADDR A:0x2b61010
y.create.l HWIO_PMIC_ARB1_CHNL237_WDATA0_ADDR A:0x2b69010
y.create.l HWIO_PMIC_ARB1_CHNL238_WDATA0_ADDR A:0x2b71010
y.create.l HWIO_PMIC_ARB1_CHNL239_WDATA0_ADDR A:0x2b79010
y.create.l HWIO_PMIC_ARB1_CHNL240_WDATA0_ADDR A:0x2b81010
y.create.l HWIO_PMIC_ARB1_CHNL241_WDATA0_ADDR A:0x2b89010
y.create.l HWIO_PMIC_ARB1_CHNL242_WDATA0_ADDR A:0x2b91010
y.create.l HWIO_PMIC_ARB1_CHNL243_WDATA0_ADDR A:0x2b99010
y.create.l HWIO_PMIC_ARB1_CHNL244_WDATA0_ADDR A:0x2ba1010
y.create.l HWIO_PMIC_ARB1_CHNL245_WDATA0_ADDR A:0x2ba9010
y.create.l HWIO_PMIC_ARB1_CHNL246_WDATA0_ADDR A:0x2bb1010
y.create.l HWIO_PMIC_ARB1_CHNL247_WDATA0_ADDR A:0x2bb9010
y.create.l HWIO_PMIC_ARB1_CHNL248_WDATA0_ADDR A:0x2bc1010
y.create.l HWIO_PMIC_ARB1_CHNL249_WDATA0_ADDR A:0x2bc9010
y.create.l HWIO_PMIC_ARB1_CHNL250_WDATA0_ADDR A:0x2bd1010
y.create.l HWIO_PMIC_ARB1_CHNL251_WDATA0_ADDR A:0x2bd9010
y.create.l HWIO_PMIC_ARB1_CHNL252_WDATA0_ADDR A:0x2be1010
y.create.l HWIO_PMIC_ARB1_CHNL253_WDATA0_ADDR A:0x2be9010
y.create.l HWIO_PMIC_ARB1_CHNL254_WDATA0_ADDR A:0x2bf1010
y.create.l HWIO_PMIC_ARB1_CHNL255_WDATA0_ADDR A:0x2bf9010
y.create.l HWIO_PMIC_ARB2_CHNL0_WDATA0_ADDR A:0x2402010
y.create.l HWIO_PMIC_ARB2_CHNL1_WDATA0_ADDR A:0x240a010
y.create.l HWIO_PMIC_ARB2_CHNL2_WDATA0_ADDR A:0x2412010
y.create.l HWIO_PMIC_ARB2_CHNL3_WDATA0_ADDR A:0x241a010
y.create.l HWIO_PMIC_ARB2_CHNL4_WDATA0_ADDR A:0x2422010
y.create.l HWIO_PMIC_ARB2_CHNL5_WDATA0_ADDR A:0x242a010
y.create.l HWIO_PMIC_ARB2_CHNL6_WDATA0_ADDR A:0x2432010
y.create.l HWIO_PMIC_ARB2_CHNL7_WDATA0_ADDR A:0x243a010
y.create.l HWIO_PMIC_ARB2_CHNL8_WDATA0_ADDR A:0x2442010
y.create.l HWIO_PMIC_ARB2_CHNL9_WDATA0_ADDR A:0x244a010
y.create.l HWIO_PMIC_ARB2_CHNL10_WDATA0_ADDR A:0x2452010
y.create.l HWIO_PMIC_ARB2_CHNL11_WDATA0_ADDR A:0x245a010
y.create.l HWIO_PMIC_ARB2_CHNL12_WDATA0_ADDR A:0x2462010
y.create.l HWIO_PMIC_ARB2_CHNL13_WDATA0_ADDR A:0x246a010
y.create.l HWIO_PMIC_ARB2_CHNL14_WDATA0_ADDR A:0x2472010
y.create.l HWIO_PMIC_ARB2_CHNL15_WDATA0_ADDR A:0x247a010
y.create.l HWIO_PMIC_ARB2_CHNL16_WDATA0_ADDR A:0x2482010
y.create.l HWIO_PMIC_ARB2_CHNL17_WDATA0_ADDR A:0x248a010
y.create.l HWIO_PMIC_ARB2_CHNL18_WDATA0_ADDR A:0x2492010
y.create.l HWIO_PMIC_ARB2_CHNL19_WDATA0_ADDR A:0x249a010
y.create.l HWIO_PMIC_ARB2_CHNL20_WDATA0_ADDR A:0x24a2010
y.create.l HWIO_PMIC_ARB2_CHNL21_WDATA0_ADDR A:0x24aa010
y.create.l HWIO_PMIC_ARB2_CHNL22_WDATA0_ADDR A:0x24b2010
y.create.l HWIO_PMIC_ARB2_CHNL23_WDATA0_ADDR A:0x24ba010
y.create.l HWIO_PMIC_ARB2_CHNL24_WDATA0_ADDR A:0x24c2010
y.create.l HWIO_PMIC_ARB2_CHNL25_WDATA0_ADDR A:0x24ca010
y.create.l HWIO_PMIC_ARB2_CHNL26_WDATA0_ADDR A:0x24d2010
y.create.l HWIO_PMIC_ARB2_CHNL27_WDATA0_ADDR A:0x24da010
y.create.l HWIO_PMIC_ARB2_CHNL28_WDATA0_ADDR A:0x24e2010
y.create.l HWIO_PMIC_ARB2_CHNL29_WDATA0_ADDR A:0x24ea010
y.create.l HWIO_PMIC_ARB2_CHNL30_WDATA0_ADDR A:0x24f2010
y.create.l HWIO_PMIC_ARB2_CHNL31_WDATA0_ADDR A:0x24fa010
y.create.l HWIO_PMIC_ARB2_CHNL32_WDATA0_ADDR A:0x2502010
y.create.l HWIO_PMIC_ARB2_CHNL33_WDATA0_ADDR A:0x250a010
y.create.l HWIO_PMIC_ARB2_CHNL34_WDATA0_ADDR A:0x2512010
y.create.l HWIO_PMIC_ARB2_CHNL35_WDATA0_ADDR A:0x251a010
y.create.l HWIO_PMIC_ARB2_CHNL36_WDATA0_ADDR A:0x2522010
y.create.l HWIO_PMIC_ARB2_CHNL37_WDATA0_ADDR A:0x252a010
y.create.l HWIO_PMIC_ARB2_CHNL38_WDATA0_ADDR A:0x2532010
y.create.l HWIO_PMIC_ARB2_CHNL39_WDATA0_ADDR A:0x253a010
y.create.l HWIO_PMIC_ARB2_CHNL40_WDATA0_ADDR A:0x2542010
y.create.l HWIO_PMIC_ARB2_CHNL41_WDATA0_ADDR A:0x254a010
y.create.l HWIO_PMIC_ARB2_CHNL42_WDATA0_ADDR A:0x2552010
y.create.l HWIO_PMIC_ARB2_CHNL43_WDATA0_ADDR A:0x255a010
y.create.l HWIO_PMIC_ARB2_CHNL44_WDATA0_ADDR A:0x2562010
y.create.l HWIO_PMIC_ARB2_CHNL45_WDATA0_ADDR A:0x256a010
y.create.l HWIO_PMIC_ARB2_CHNL46_WDATA0_ADDR A:0x2572010
y.create.l HWIO_PMIC_ARB2_CHNL47_WDATA0_ADDR A:0x257a010
y.create.l HWIO_PMIC_ARB2_CHNL48_WDATA0_ADDR A:0x2582010
y.create.l HWIO_PMIC_ARB2_CHNL49_WDATA0_ADDR A:0x258a010
y.create.l HWIO_PMIC_ARB2_CHNL50_WDATA0_ADDR A:0x2592010
y.create.l HWIO_PMIC_ARB2_CHNL51_WDATA0_ADDR A:0x259a010
y.create.l HWIO_PMIC_ARB2_CHNL52_WDATA0_ADDR A:0x25a2010
y.create.l HWIO_PMIC_ARB2_CHNL53_WDATA0_ADDR A:0x25aa010
y.create.l HWIO_PMIC_ARB2_CHNL54_WDATA0_ADDR A:0x25b2010
y.create.l HWIO_PMIC_ARB2_CHNL55_WDATA0_ADDR A:0x25ba010
y.create.l HWIO_PMIC_ARB2_CHNL56_WDATA0_ADDR A:0x25c2010
y.create.l HWIO_PMIC_ARB2_CHNL57_WDATA0_ADDR A:0x25ca010
y.create.l HWIO_PMIC_ARB2_CHNL58_WDATA0_ADDR A:0x25d2010
y.create.l HWIO_PMIC_ARB2_CHNL59_WDATA0_ADDR A:0x25da010
y.create.l HWIO_PMIC_ARB2_CHNL60_WDATA0_ADDR A:0x25e2010
y.create.l HWIO_PMIC_ARB2_CHNL61_WDATA0_ADDR A:0x25ea010
y.create.l HWIO_PMIC_ARB2_CHNL62_WDATA0_ADDR A:0x25f2010
y.create.l HWIO_PMIC_ARB2_CHNL63_WDATA0_ADDR A:0x25fa010
y.create.l HWIO_PMIC_ARB2_CHNL64_WDATA0_ADDR A:0x2602010
y.create.l HWIO_PMIC_ARB2_CHNL65_WDATA0_ADDR A:0x260a010
y.create.l HWIO_PMIC_ARB2_CHNL66_WDATA0_ADDR A:0x2612010
y.create.l HWIO_PMIC_ARB2_CHNL67_WDATA0_ADDR A:0x261a010
y.create.l HWIO_PMIC_ARB2_CHNL68_WDATA0_ADDR A:0x2622010
y.create.l HWIO_PMIC_ARB2_CHNL69_WDATA0_ADDR A:0x262a010
y.create.l HWIO_PMIC_ARB2_CHNL70_WDATA0_ADDR A:0x2632010
y.create.l HWIO_PMIC_ARB2_CHNL71_WDATA0_ADDR A:0x263a010
y.create.l HWIO_PMIC_ARB2_CHNL72_WDATA0_ADDR A:0x2642010
y.create.l HWIO_PMIC_ARB2_CHNL73_WDATA0_ADDR A:0x264a010
y.create.l HWIO_PMIC_ARB2_CHNL74_WDATA0_ADDR A:0x2652010
y.create.l HWIO_PMIC_ARB2_CHNL75_WDATA0_ADDR A:0x265a010
y.create.l HWIO_PMIC_ARB2_CHNL76_WDATA0_ADDR A:0x2662010
y.create.l HWIO_PMIC_ARB2_CHNL77_WDATA0_ADDR A:0x266a010
y.create.l HWIO_PMIC_ARB2_CHNL78_WDATA0_ADDR A:0x2672010
y.create.l HWIO_PMIC_ARB2_CHNL79_WDATA0_ADDR A:0x267a010
y.create.l HWIO_PMIC_ARB2_CHNL80_WDATA0_ADDR A:0x2682010
y.create.l HWIO_PMIC_ARB2_CHNL81_WDATA0_ADDR A:0x268a010
y.create.l HWIO_PMIC_ARB2_CHNL82_WDATA0_ADDR A:0x2692010
y.create.l HWIO_PMIC_ARB2_CHNL83_WDATA0_ADDR A:0x269a010
y.create.l HWIO_PMIC_ARB2_CHNL84_WDATA0_ADDR A:0x26a2010
y.create.l HWIO_PMIC_ARB2_CHNL85_WDATA0_ADDR A:0x26aa010
y.create.l HWIO_PMIC_ARB2_CHNL86_WDATA0_ADDR A:0x26b2010
y.create.l HWIO_PMIC_ARB2_CHNL87_WDATA0_ADDR A:0x26ba010
y.create.l HWIO_PMIC_ARB2_CHNL88_WDATA0_ADDR A:0x26c2010
y.create.l HWIO_PMIC_ARB2_CHNL89_WDATA0_ADDR A:0x26ca010
y.create.l HWIO_PMIC_ARB2_CHNL90_WDATA0_ADDR A:0x26d2010
y.create.l HWIO_PMIC_ARB2_CHNL91_WDATA0_ADDR A:0x26da010
y.create.l HWIO_PMIC_ARB2_CHNL92_WDATA0_ADDR A:0x26e2010
y.create.l HWIO_PMIC_ARB2_CHNL93_WDATA0_ADDR A:0x26ea010
y.create.l HWIO_PMIC_ARB2_CHNL94_WDATA0_ADDR A:0x26f2010
y.create.l HWIO_PMIC_ARB2_CHNL95_WDATA0_ADDR A:0x26fa010
y.create.l HWIO_PMIC_ARB2_CHNL96_WDATA0_ADDR A:0x2702010
y.create.l HWIO_PMIC_ARB2_CHNL97_WDATA0_ADDR A:0x270a010
y.create.l HWIO_PMIC_ARB2_CHNL98_WDATA0_ADDR A:0x2712010
y.create.l HWIO_PMIC_ARB2_CHNL99_WDATA0_ADDR A:0x271a010
y.create.l HWIO_PMIC_ARB2_CHNL100_WDATA0_ADDR A:0x2722010
y.create.l HWIO_PMIC_ARB2_CHNL101_WDATA0_ADDR A:0x272a010
y.create.l HWIO_PMIC_ARB2_CHNL102_WDATA0_ADDR A:0x2732010
y.create.l HWIO_PMIC_ARB2_CHNL103_WDATA0_ADDR A:0x273a010
y.create.l HWIO_PMIC_ARB2_CHNL104_WDATA0_ADDR A:0x2742010
y.create.l HWIO_PMIC_ARB2_CHNL105_WDATA0_ADDR A:0x274a010
y.create.l HWIO_PMIC_ARB2_CHNL106_WDATA0_ADDR A:0x2752010
y.create.l HWIO_PMIC_ARB2_CHNL107_WDATA0_ADDR A:0x275a010
y.create.l HWIO_PMIC_ARB2_CHNL108_WDATA0_ADDR A:0x2762010
y.create.l HWIO_PMIC_ARB2_CHNL109_WDATA0_ADDR A:0x276a010
y.create.l HWIO_PMIC_ARB2_CHNL110_WDATA0_ADDR A:0x2772010
y.create.l HWIO_PMIC_ARB2_CHNL111_WDATA0_ADDR A:0x277a010
y.create.l HWIO_PMIC_ARB2_CHNL112_WDATA0_ADDR A:0x2782010
y.create.l HWIO_PMIC_ARB2_CHNL113_WDATA0_ADDR A:0x278a010
y.create.l HWIO_PMIC_ARB2_CHNL114_WDATA0_ADDR A:0x2792010
y.create.l HWIO_PMIC_ARB2_CHNL115_WDATA0_ADDR A:0x279a010
y.create.l HWIO_PMIC_ARB2_CHNL116_WDATA0_ADDR A:0x27a2010
y.create.l HWIO_PMIC_ARB2_CHNL117_WDATA0_ADDR A:0x27aa010
y.create.l HWIO_PMIC_ARB2_CHNL118_WDATA0_ADDR A:0x27b2010
y.create.l HWIO_PMIC_ARB2_CHNL119_WDATA0_ADDR A:0x27ba010
y.create.l HWIO_PMIC_ARB2_CHNL120_WDATA0_ADDR A:0x27c2010
y.create.l HWIO_PMIC_ARB2_CHNL121_WDATA0_ADDR A:0x27ca010
y.create.l HWIO_PMIC_ARB2_CHNL122_WDATA0_ADDR A:0x27d2010
y.create.l HWIO_PMIC_ARB2_CHNL123_WDATA0_ADDR A:0x27da010
y.create.l HWIO_PMIC_ARB2_CHNL124_WDATA0_ADDR A:0x27e2010
y.create.l HWIO_PMIC_ARB2_CHNL125_WDATA0_ADDR A:0x27ea010
y.create.l HWIO_PMIC_ARB2_CHNL126_WDATA0_ADDR A:0x27f2010
y.create.l HWIO_PMIC_ARB2_CHNL127_WDATA0_ADDR A:0x27fa010
y.create.l HWIO_PMIC_ARB2_CHNL128_WDATA0_ADDR A:0x2802010
y.create.l HWIO_PMIC_ARB2_CHNL129_WDATA0_ADDR A:0x280a010
y.create.l HWIO_PMIC_ARB2_CHNL130_WDATA0_ADDR A:0x2812010
y.create.l HWIO_PMIC_ARB2_CHNL131_WDATA0_ADDR A:0x281a010
y.create.l HWIO_PMIC_ARB2_CHNL132_WDATA0_ADDR A:0x2822010
y.create.l HWIO_PMIC_ARB2_CHNL133_WDATA0_ADDR A:0x282a010
y.create.l HWIO_PMIC_ARB2_CHNL134_WDATA0_ADDR A:0x2832010
y.create.l HWIO_PMIC_ARB2_CHNL135_WDATA0_ADDR A:0x283a010
y.create.l HWIO_PMIC_ARB2_CHNL136_WDATA0_ADDR A:0x2842010
y.create.l HWIO_PMIC_ARB2_CHNL137_WDATA0_ADDR A:0x284a010
y.create.l HWIO_PMIC_ARB2_CHNL138_WDATA0_ADDR A:0x2852010
y.create.l HWIO_PMIC_ARB2_CHNL139_WDATA0_ADDR A:0x285a010
y.create.l HWIO_PMIC_ARB2_CHNL140_WDATA0_ADDR A:0x2862010
y.create.l HWIO_PMIC_ARB2_CHNL141_WDATA0_ADDR A:0x286a010
y.create.l HWIO_PMIC_ARB2_CHNL142_WDATA0_ADDR A:0x2872010
y.create.l HWIO_PMIC_ARB2_CHNL143_WDATA0_ADDR A:0x287a010
y.create.l HWIO_PMIC_ARB2_CHNL144_WDATA0_ADDR A:0x2882010
y.create.l HWIO_PMIC_ARB2_CHNL145_WDATA0_ADDR A:0x288a010
y.create.l HWIO_PMIC_ARB2_CHNL146_WDATA0_ADDR A:0x2892010
y.create.l HWIO_PMIC_ARB2_CHNL147_WDATA0_ADDR A:0x289a010
y.create.l HWIO_PMIC_ARB2_CHNL148_WDATA0_ADDR A:0x28a2010
y.create.l HWIO_PMIC_ARB2_CHNL149_WDATA0_ADDR A:0x28aa010
y.create.l HWIO_PMIC_ARB2_CHNL150_WDATA0_ADDR A:0x28b2010
y.create.l HWIO_PMIC_ARB2_CHNL151_WDATA0_ADDR A:0x28ba010
y.create.l HWIO_PMIC_ARB2_CHNL152_WDATA0_ADDR A:0x28c2010
y.create.l HWIO_PMIC_ARB2_CHNL153_WDATA0_ADDR A:0x28ca010
y.create.l HWIO_PMIC_ARB2_CHNL154_WDATA0_ADDR A:0x28d2010
y.create.l HWIO_PMIC_ARB2_CHNL155_WDATA0_ADDR A:0x28da010
y.create.l HWIO_PMIC_ARB2_CHNL156_WDATA0_ADDR A:0x28e2010
y.create.l HWIO_PMIC_ARB2_CHNL157_WDATA0_ADDR A:0x28ea010
y.create.l HWIO_PMIC_ARB2_CHNL158_WDATA0_ADDR A:0x28f2010
y.create.l HWIO_PMIC_ARB2_CHNL159_WDATA0_ADDR A:0x28fa010
y.create.l HWIO_PMIC_ARB2_CHNL160_WDATA0_ADDR A:0x2902010
y.create.l HWIO_PMIC_ARB2_CHNL161_WDATA0_ADDR A:0x290a010
y.create.l HWIO_PMIC_ARB2_CHNL162_WDATA0_ADDR A:0x2912010
y.create.l HWIO_PMIC_ARB2_CHNL163_WDATA0_ADDR A:0x291a010
y.create.l HWIO_PMIC_ARB2_CHNL164_WDATA0_ADDR A:0x2922010
y.create.l HWIO_PMIC_ARB2_CHNL165_WDATA0_ADDR A:0x292a010
y.create.l HWIO_PMIC_ARB2_CHNL166_WDATA0_ADDR A:0x2932010
y.create.l HWIO_PMIC_ARB2_CHNL167_WDATA0_ADDR A:0x293a010
y.create.l HWIO_PMIC_ARB2_CHNL168_WDATA0_ADDR A:0x2942010
y.create.l HWIO_PMIC_ARB2_CHNL169_WDATA0_ADDR A:0x294a010
y.create.l HWIO_PMIC_ARB2_CHNL170_WDATA0_ADDR A:0x2952010
y.create.l HWIO_PMIC_ARB2_CHNL171_WDATA0_ADDR A:0x295a010
y.create.l HWIO_PMIC_ARB2_CHNL172_WDATA0_ADDR A:0x2962010
y.create.l HWIO_PMIC_ARB2_CHNL173_WDATA0_ADDR A:0x296a010
y.create.l HWIO_PMIC_ARB2_CHNL174_WDATA0_ADDR A:0x2972010
y.create.l HWIO_PMIC_ARB2_CHNL175_WDATA0_ADDR A:0x297a010
y.create.l HWIO_PMIC_ARB2_CHNL176_WDATA0_ADDR A:0x2982010
y.create.l HWIO_PMIC_ARB2_CHNL177_WDATA0_ADDR A:0x298a010
y.create.l HWIO_PMIC_ARB2_CHNL178_WDATA0_ADDR A:0x2992010
y.create.l HWIO_PMIC_ARB2_CHNL179_WDATA0_ADDR A:0x299a010
y.create.l HWIO_PMIC_ARB2_CHNL180_WDATA0_ADDR A:0x29a2010
y.create.l HWIO_PMIC_ARB2_CHNL181_WDATA0_ADDR A:0x29aa010
y.create.l HWIO_PMIC_ARB2_CHNL182_WDATA0_ADDR A:0x29b2010
y.create.l HWIO_PMIC_ARB2_CHNL183_WDATA0_ADDR A:0x29ba010
y.create.l HWIO_PMIC_ARB2_CHNL184_WDATA0_ADDR A:0x29c2010
y.create.l HWIO_PMIC_ARB2_CHNL185_WDATA0_ADDR A:0x29ca010
y.create.l HWIO_PMIC_ARB2_CHNL186_WDATA0_ADDR A:0x29d2010
y.create.l HWIO_PMIC_ARB2_CHNL187_WDATA0_ADDR A:0x29da010
y.create.l HWIO_PMIC_ARB2_CHNL188_WDATA0_ADDR A:0x29e2010
y.create.l HWIO_PMIC_ARB2_CHNL189_WDATA0_ADDR A:0x29ea010
y.create.l HWIO_PMIC_ARB2_CHNL190_WDATA0_ADDR A:0x29f2010
y.create.l HWIO_PMIC_ARB2_CHNL191_WDATA0_ADDR A:0x29fa010
y.create.l HWIO_PMIC_ARB2_CHNL192_WDATA0_ADDR A:0x2a02010
y.create.l HWIO_PMIC_ARB2_CHNL193_WDATA0_ADDR A:0x2a0a010
y.create.l HWIO_PMIC_ARB2_CHNL194_WDATA0_ADDR A:0x2a12010
y.create.l HWIO_PMIC_ARB2_CHNL195_WDATA0_ADDR A:0x2a1a010
y.create.l HWIO_PMIC_ARB2_CHNL196_WDATA0_ADDR A:0x2a22010
y.create.l HWIO_PMIC_ARB2_CHNL197_WDATA0_ADDR A:0x2a2a010
y.create.l HWIO_PMIC_ARB2_CHNL198_WDATA0_ADDR A:0x2a32010
y.create.l HWIO_PMIC_ARB2_CHNL199_WDATA0_ADDR A:0x2a3a010
y.create.l HWIO_PMIC_ARB2_CHNL200_WDATA0_ADDR A:0x2a42010
y.create.l HWIO_PMIC_ARB2_CHNL201_WDATA0_ADDR A:0x2a4a010
y.create.l HWIO_PMIC_ARB2_CHNL202_WDATA0_ADDR A:0x2a52010
y.create.l HWIO_PMIC_ARB2_CHNL203_WDATA0_ADDR A:0x2a5a010
y.create.l HWIO_PMIC_ARB2_CHNL204_WDATA0_ADDR A:0x2a62010
y.create.l HWIO_PMIC_ARB2_CHNL205_WDATA0_ADDR A:0x2a6a010
y.create.l HWIO_PMIC_ARB2_CHNL206_WDATA0_ADDR A:0x2a72010
y.create.l HWIO_PMIC_ARB2_CHNL207_WDATA0_ADDR A:0x2a7a010
y.create.l HWIO_PMIC_ARB2_CHNL208_WDATA0_ADDR A:0x2a82010
y.create.l HWIO_PMIC_ARB2_CHNL209_WDATA0_ADDR A:0x2a8a010
y.create.l HWIO_PMIC_ARB2_CHNL210_WDATA0_ADDR A:0x2a92010
y.create.l HWIO_PMIC_ARB2_CHNL211_WDATA0_ADDR A:0x2a9a010
y.create.l HWIO_PMIC_ARB2_CHNL212_WDATA0_ADDR A:0x2aa2010
y.create.l HWIO_PMIC_ARB2_CHNL213_WDATA0_ADDR A:0x2aaa010
y.create.l HWIO_PMIC_ARB2_CHNL214_WDATA0_ADDR A:0x2ab2010
y.create.l HWIO_PMIC_ARB2_CHNL215_WDATA0_ADDR A:0x2aba010
y.create.l HWIO_PMIC_ARB2_CHNL216_WDATA0_ADDR A:0x2ac2010
y.create.l HWIO_PMIC_ARB2_CHNL217_WDATA0_ADDR A:0x2aca010
y.create.l HWIO_PMIC_ARB2_CHNL218_WDATA0_ADDR A:0x2ad2010
y.create.l HWIO_PMIC_ARB2_CHNL219_WDATA0_ADDR A:0x2ada010
y.create.l HWIO_PMIC_ARB2_CHNL220_WDATA0_ADDR A:0x2ae2010
y.create.l HWIO_PMIC_ARB2_CHNL221_WDATA0_ADDR A:0x2aea010
y.create.l HWIO_PMIC_ARB2_CHNL222_WDATA0_ADDR A:0x2af2010
y.create.l HWIO_PMIC_ARB2_CHNL223_WDATA0_ADDR A:0x2afa010
y.create.l HWIO_PMIC_ARB2_CHNL224_WDATA0_ADDR A:0x2b02010
y.create.l HWIO_PMIC_ARB2_CHNL225_WDATA0_ADDR A:0x2b0a010
y.create.l HWIO_PMIC_ARB2_CHNL226_WDATA0_ADDR A:0x2b12010
y.create.l HWIO_PMIC_ARB2_CHNL227_WDATA0_ADDR A:0x2b1a010
y.create.l HWIO_PMIC_ARB2_CHNL228_WDATA0_ADDR A:0x2b22010
y.create.l HWIO_PMIC_ARB2_CHNL229_WDATA0_ADDR A:0x2b2a010
y.create.l HWIO_PMIC_ARB2_CHNL230_WDATA0_ADDR A:0x2b32010
y.create.l HWIO_PMIC_ARB2_CHNL231_WDATA0_ADDR A:0x2b3a010
y.create.l HWIO_PMIC_ARB2_CHNL232_WDATA0_ADDR A:0x2b42010
y.create.l HWIO_PMIC_ARB2_CHNL233_WDATA0_ADDR A:0x2b4a010
y.create.l HWIO_PMIC_ARB2_CHNL234_WDATA0_ADDR A:0x2b52010
y.create.l HWIO_PMIC_ARB2_CHNL235_WDATA0_ADDR A:0x2b5a010
y.create.l HWIO_PMIC_ARB2_CHNL236_WDATA0_ADDR A:0x2b62010
y.create.l HWIO_PMIC_ARB2_CHNL237_WDATA0_ADDR A:0x2b6a010
y.create.l HWIO_PMIC_ARB2_CHNL238_WDATA0_ADDR A:0x2b72010
y.create.l HWIO_PMIC_ARB2_CHNL239_WDATA0_ADDR A:0x2b7a010
y.create.l HWIO_PMIC_ARB2_CHNL240_WDATA0_ADDR A:0x2b82010
y.create.l HWIO_PMIC_ARB2_CHNL241_WDATA0_ADDR A:0x2b8a010
y.create.l HWIO_PMIC_ARB2_CHNL242_WDATA0_ADDR A:0x2b92010
y.create.l HWIO_PMIC_ARB2_CHNL243_WDATA0_ADDR A:0x2b9a010
y.create.l HWIO_PMIC_ARB2_CHNL244_WDATA0_ADDR A:0x2ba2010
y.create.l HWIO_PMIC_ARB2_CHNL245_WDATA0_ADDR A:0x2baa010
y.create.l HWIO_PMIC_ARB2_CHNL246_WDATA0_ADDR A:0x2bb2010
y.create.l HWIO_PMIC_ARB2_CHNL247_WDATA0_ADDR A:0x2bba010
y.create.l HWIO_PMIC_ARB2_CHNL248_WDATA0_ADDR A:0x2bc2010
y.create.l HWIO_PMIC_ARB2_CHNL249_WDATA0_ADDR A:0x2bca010
y.create.l HWIO_PMIC_ARB2_CHNL250_WDATA0_ADDR A:0x2bd2010
y.create.l HWIO_PMIC_ARB2_CHNL251_WDATA0_ADDR A:0x2bda010
y.create.l HWIO_PMIC_ARB2_CHNL252_WDATA0_ADDR A:0x2be2010
y.create.l HWIO_PMIC_ARB2_CHNL253_WDATA0_ADDR A:0x2bea010
y.create.l HWIO_PMIC_ARB2_CHNL254_WDATA0_ADDR A:0x2bf2010
y.create.l HWIO_PMIC_ARB2_CHNL255_WDATA0_ADDR A:0x2bfa010
y.create.l HWIO_PMIC_ARB3_CHNL0_WDATA0_ADDR A:0x2403010
y.create.l HWIO_PMIC_ARB3_CHNL1_WDATA0_ADDR A:0x240b010
y.create.l HWIO_PMIC_ARB3_CHNL2_WDATA0_ADDR A:0x2413010
y.create.l HWIO_PMIC_ARB3_CHNL3_WDATA0_ADDR A:0x241b010
y.create.l HWIO_PMIC_ARB3_CHNL4_WDATA0_ADDR A:0x2423010
y.create.l HWIO_PMIC_ARB3_CHNL5_WDATA0_ADDR A:0x242b010
y.create.l HWIO_PMIC_ARB3_CHNL6_WDATA0_ADDR A:0x2433010
y.create.l HWIO_PMIC_ARB3_CHNL7_WDATA0_ADDR A:0x243b010
y.create.l HWIO_PMIC_ARB3_CHNL8_WDATA0_ADDR A:0x2443010
y.create.l HWIO_PMIC_ARB3_CHNL9_WDATA0_ADDR A:0x244b010
y.create.l HWIO_PMIC_ARB3_CHNL10_WDATA0_ADDR A:0x2453010
y.create.l HWIO_PMIC_ARB3_CHNL11_WDATA0_ADDR A:0x245b010
y.create.l HWIO_PMIC_ARB3_CHNL12_WDATA0_ADDR A:0x2463010
y.create.l HWIO_PMIC_ARB3_CHNL13_WDATA0_ADDR A:0x246b010
y.create.l HWIO_PMIC_ARB3_CHNL14_WDATA0_ADDR A:0x2473010
y.create.l HWIO_PMIC_ARB3_CHNL15_WDATA0_ADDR A:0x247b010
y.create.l HWIO_PMIC_ARB3_CHNL16_WDATA0_ADDR A:0x2483010
y.create.l HWIO_PMIC_ARB3_CHNL17_WDATA0_ADDR A:0x248b010
y.create.l HWIO_PMIC_ARB3_CHNL18_WDATA0_ADDR A:0x2493010
y.create.l HWIO_PMIC_ARB3_CHNL19_WDATA0_ADDR A:0x249b010
y.create.l HWIO_PMIC_ARB3_CHNL20_WDATA0_ADDR A:0x24a3010
y.create.l HWIO_PMIC_ARB3_CHNL21_WDATA0_ADDR A:0x24ab010
y.create.l HWIO_PMIC_ARB3_CHNL22_WDATA0_ADDR A:0x24b3010
y.create.l HWIO_PMIC_ARB3_CHNL23_WDATA0_ADDR A:0x24bb010
y.create.l HWIO_PMIC_ARB3_CHNL24_WDATA0_ADDR A:0x24c3010
y.create.l HWIO_PMIC_ARB3_CHNL25_WDATA0_ADDR A:0x24cb010
y.create.l HWIO_PMIC_ARB3_CHNL26_WDATA0_ADDR A:0x24d3010
y.create.l HWIO_PMIC_ARB3_CHNL27_WDATA0_ADDR A:0x24db010
y.create.l HWIO_PMIC_ARB3_CHNL28_WDATA0_ADDR A:0x24e3010
y.create.l HWIO_PMIC_ARB3_CHNL29_WDATA0_ADDR A:0x24eb010
y.create.l HWIO_PMIC_ARB3_CHNL30_WDATA0_ADDR A:0x24f3010
y.create.l HWIO_PMIC_ARB3_CHNL31_WDATA0_ADDR A:0x24fb010
y.create.l HWIO_PMIC_ARB3_CHNL32_WDATA0_ADDR A:0x2503010
y.create.l HWIO_PMIC_ARB3_CHNL33_WDATA0_ADDR A:0x250b010
y.create.l HWIO_PMIC_ARB3_CHNL34_WDATA0_ADDR A:0x2513010
y.create.l HWIO_PMIC_ARB3_CHNL35_WDATA0_ADDR A:0x251b010
y.create.l HWIO_PMIC_ARB3_CHNL36_WDATA0_ADDR A:0x2523010
y.create.l HWIO_PMIC_ARB3_CHNL37_WDATA0_ADDR A:0x252b010
y.create.l HWIO_PMIC_ARB3_CHNL38_WDATA0_ADDR A:0x2533010
y.create.l HWIO_PMIC_ARB3_CHNL39_WDATA0_ADDR A:0x253b010
y.create.l HWIO_PMIC_ARB3_CHNL40_WDATA0_ADDR A:0x2543010
y.create.l HWIO_PMIC_ARB3_CHNL41_WDATA0_ADDR A:0x254b010
y.create.l HWIO_PMIC_ARB3_CHNL42_WDATA0_ADDR A:0x2553010
y.create.l HWIO_PMIC_ARB3_CHNL43_WDATA0_ADDR A:0x255b010
y.create.l HWIO_PMIC_ARB3_CHNL44_WDATA0_ADDR A:0x2563010
y.create.l HWIO_PMIC_ARB3_CHNL45_WDATA0_ADDR A:0x256b010
y.create.l HWIO_PMIC_ARB3_CHNL46_WDATA0_ADDR A:0x2573010
y.create.l HWIO_PMIC_ARB3_CHNL47_WDATA0_ADDR A:0x257b010
y.create.l HWIO_PMIC_ARB3_CHNL48_WDATA0_ADDR A:0x2583010
y.create.l HWIO_PMIC_ARB3_CHNL49_WDATA0_ADDR A:0x258b010
y.create.l HWIO_PMIC_ARB3_CHNL50_WDATA0_ADDR A:0x2593010
y.create.l HWIO_PMIC_ARB3_CHNL51_WDATA0_ADDR A:0x259b010
y.create.l HWIO_PMIC_ARB3_CHNL52_WDATA0_ADDR A:0x25a3010
y.create.l HWIO_PMIC_ARB3_CHNL53_WDATA0_ADDR A:0x25ab010
y.create.l HWIO_PMIC_ARB3_CHNL54_WDATA0_ADDR A:0x25b3010
y.create.l HWIO_PMIC_ARB3_CHNL55_WDATA0_ADDR A:0x25bb010
y.create.l HWIO_PMIC_ARB3_CHNL56_WDATA0_ADDR A:0x25c3010
y.create.l HWIO_PMIC_ARB3_CHNL57_WDATA0_ADDR A:0x25cb010
y.create.l HWIO_PMIC_ARB3_CHNL58_WDATA0_ADDR A:0x25d3010
y.create.l HWIO_PMIC_ARB3_CHNL59_WDATA0_ADDR A:0x25db010
y.create.l HWIO_PMIC_ARB3_CHNL60_WDATA0_ADDR A:0x25e3010
y.create.l HWIO_PMIC_ARB3_CHNL61_WDATA0_ADDR A:0x25eb010
y.create.l HWIO_PMIC_ARB3_CHNL62_WDATA0_ADDR A:0x25f3010
y.create.l HWIO_PMIC_ARB3_CHNL63_WDATA0_ADDR A:0x25fb010
y.create.l HWIO_PMIC_ARB3_CHNL64_WDATA0_ADDR A:0x2603010
y.create.l HWIO_PMIC_ARB3_CHNL65_WDATA0_ADDR A:0x260b010
y.create.l HWIO_PMIC_ARB3_CHNL66_WDATA0_ADDR A:0x2613010
y.create.l HWIO_PMIC_ARB3_CHNL67_WDATA0_ADDR A:0x261b010
y.create.l HWIO_PMIC_ARB3_CHNL68_WDATA0_ADDR A:0x2623010
y.create.l HWIO_PMIC_ARB3_CHNL69_WDATA0_ADDR A:0x262b010
y.create.l HWIO_PMIC_ARB3_CHNL70_WDATA0_ADDR A:0x2633010
y.create.l HWIO_PMIC_ARB3_CHNL71_WDATA0_ADDR A:0x263b010
y.create.l HWIO_PMIC_ARB3_CHNL72_WDATA0_ADDR A:0x2643010
y.create.l HWIO_PMIC_ARB3_CHNL73_WDATA0_ADDR A:0x264b010
y.create.l HWIO_PMIC_ARB3_CHNL74_WDATA0_ADDR A:0x2653010
y.create.l HWIO_PMIC_ARB3_CHNL75_WDATA0_ADDR A:0x265b010
y.create.l HWIO_PMIC_ARB3_CHNL76_WDATA0_ADDR A:0x2663010
y.create.l HWIO_PMIC_ARB3_CHNL77_WDATA0_ADDR A:0x266b010
y.create.l HWIO_PMIC_ARB3_CHNL78_WDATA0_ADDR A:0x2673010
y.create.l HWIO_PMIC_ARB3_CHNL79_WDATA0_ADDR A:0x267b010
y.create.l HWIO_PMIC_ARB3_CHNL80_WDATA0_ADDR A:0x2683010
y.create.l HWIO_PMIC_ARB3_CHNL81_WDATA0_ADDR A:0x268b010
y.create.l HWIO_PMIC_ARB3_CHNL82_WDATA0_ADDR A:0x2693010
y.create.l HWIO_PMIC_ARB3_CHNL83_WDATA0_ADDR A:0x269b010
y.create.l HWIO_PMIC_ARB3_CHNL84_WDATA0_ADDR A:0x26a3010
y.create.l HWIO_PMIC_ARB3_CHNL85_WDATA0_ADDR A:0x26ab010
y.create.l HWIO_PMIC_ARB3_CHNL86_WDATA0_ADDR A:0x26b3010
y.create.l HWIO_PMIC_ARB3_CHNL87_WDATA0_ADDR A:0x26bb010
y.create.l HWIO_PMIC_ARB3_CHNL88_WDATA0_ADDR A:0x26c3010
y.create.l HWIO_PMIC_ARB3_CHNL89_WDATA0_ADDR A:0x26cb010
y.create.l HWIO_PMIC_ARB3_CHNL90_WDATA0_ADDR A:0x26d3010
y.create.l HWIO_PMIC_ARB3_CHNL91_WDATA0_ADDR A:0x26db010
y.create.l HWIO_PMIC_ARB3_CHNL92_WDATA0_ADDR A:0x26e3010
y.create.l HWIO_PMIC_ARB3_CHNL93_WDATA0_ADDR A:0x26eb010
y.create.l HWIO_PMIC_ARB3_CHNL94_WDATA0_ADDR A:0x26f3010
y.create.l HWIO_PMIC_ARB3_CHNL95_WDATA0_ADDR A:0x26fb010
y.create.l HWIO_PMIC_ARB3_CHNL96_WDATA0_ADDR A:0x2703010
y.create.l HWIO_PMIC_ARB3_CHNL97_WDATA0_ADDR A:0x270b010
y.create.l HWIO_PMIC_ARB3_CHNL98_WDATA0_ADDR A:0x2713010
y.create.l HWIO_PMIC_ARB3_CHNL99_WDATA0_ADDR A:0x271b010
y.create.l HWIO_PMIC_ARB3_CHNL100_WDATA0_ADDR A:0x2723010
y.create.l HWIO_PMIC_ARB3_CHNL101_WDATA0_ADDR A:0x272b010
y.create.l HWIO_PMIC_ARB3_CHNL102_WDATA0_ADDR A:0x2733010
y.create.l HWIO_PMIC_ARB3_CHNL103_WDATA0_ADDR A:0x273b010
y.create.l HWIO_PMIC_ARB3_CHNL104_WDATA0_ADDR A:0x2743010
y.create.l HWIO_PMIC_ARB3_CHNL105_WDATA0_ADDR A:0x274b010
y.create.l HWIO_PMIC_ARB3_CHNL106_WDATA0_ADDR A:0x2753010
y.create.l HWIO_PMIC_ARB3_CHNL107_WDATA0_ADDR A:0x275b010
y.create.l HWIO_PMIC_ARB3_CHNL108_WDATA0_ADDR A:0x2763010
y.create.l HWIO_PMIC_ARB3_CHNL109_WDATA0_ADDR A:0x276b010
y.create.l HWIO_PMIC_ARB3_CHNL110_WDATA0_ADDR A:0x2773010
y.create.l HWIO_PMIC_ARB3_CHNL111_WDATA0_ADDR A:0x277b010
y.create.l HWIO_PMIC_ARB3_CHNL112_WDATA0_ADDR A:0x2783010
y.create.l HWIO_PMIC_ARB3_CHNL113_WDATA0_ADDR A:0x278b010
y.create.l HWIO_PMIC_ARB3_CHNL114_WDATA0_ADDR A:0x2793010
y.create.l HWIO_PMIC_ARB3_CHNL115_WDATA0_ADDR A:0x279b010
y.create.l HWIO_PMIC_ARB3_CHNL116_WDATA0_ADDR A:0x27a3010
y.create.l HWIO_PMIC_ARB3_CHNL117_WDATA0_ADDR A:0x27ab010
y.create.l HWIO_PMIC_ARB3_CHNL118_WDATA0_ADDR A:0x27b3010
y.create.l HWIO_PMIC_ARB3_CHNL119_WDATA0_ADDR A:0x27bb010
y.create.l HWIO_PMIC_ARB3_CHNL120_WDATA0_ADDR A:0x27c3010
y.create.l HWIO_PMIC_ARB3_CHNL121_WDATA0_ADDR A:0x27cb010
y.create.l HWIO_PMIC_ARB3_CHNL122_WDATA0_ADDR A:0x27d3010
y.create.l HWIO_PMIC_ARB3_CHNL123_WDATA0_ADDR A:0x27db010
y.create.l HWIO_PMIC_ARB3_CHNL124_WDATA0_ADDR A:0x27e3010
y.create.l HWIO_PMIC_ARB3_CHNL125_WDATA0_ADDR A:0x27eb010
y.create.l HWIO_PMIC_ARB3_CHNL126_WDATA0_ADDR A:0x27f3010
y.create.l HWIO_PMIC_ARB3_CHNL127_WDATA0_ADDR A:0x27fb010
y.create.l HWIO_PMIC_ARB3_CHNL128_WDATA0_ADDR A:0x2803010
y.create.l HWIO_PMIC_ARB3_CHNL129_WDATA0_ADDR A:0x280b010
y.create.l HWIO_PMIC_ARB3_CHNL130_WDATA0_ADDR A:0x2813010
y.create.l HWIO_PMIC_ARB3_CHNL131_WDATA0_ADDR A:0x281b010
y.create.l HWIO_PMIC_ARB3_CHNL132_WDATA0_ADDR A:0x2823010
y.create.l HWIO_PMIC_ARB3_CHNL133_WDATA0_ADDR A:0x282b010
y.create.l HWIO_PMIC_ARB3_CHNL134_WDATA0_ADDR A:0x2833010
y.create.l HWIO_PMIC_ARB3_CHNL135_WDATA0_ADDR A:0x283b010
y.create.l HWIO_PMIC_ARB3_CHNL136_WDATA0_ADDR A:0x2843010
y.create.l HWIO_PMIC_ARB3_CHNL137_WDATA0_ADDR A:0x284b010
y.create.l HWIO_PMIC_ARB3_CHNL138_WDATA0_ADDR A:0x2853010
y.create.l HWIO_PMIC_ARB3_CHNL139_WDATA0_ADDR A:0x285b010
y.create.l HWIO_PMIC_ARB3_CHNL140_WDATA0_ADDR A:0x2863010
y.create.l HWIO_PMIC_ARB3_CHNL141_WDATA0_ADDR A:0x286b010
y.create.l HWIO_PMIC_ARB3_CHNL142_WDATA0_ADDR A:0x2873010
y.create.l HWIO_PMIC_ARB3_CHNL143_WDATA0_ADDR A:0x287b010
y.create.l HWIO_PMIC_ARB3_CHNL144_WDATA0_ADDR A:0x2883010
y.create.l HWIO_PMIC_ARB3_CHNL145_WDATA0_ADDR A:0x288b010
y.create.l HWIO_PMIC_ARB3_CHNL146_WDATA0_ADDR A:0x2893010
y.create.l HWIO_PMIC_ARB3_CHNL147_WDATA0_ADDR A:0x289b010
y.create.l HWIO_PMIC_ARB3_CHNL148_WDATA0_ADDR A:0x28a3010
y.create.l HWIO_PMIC_ARB3_CHNL149_WDATA0_ADDR A:0x28ab010
y.create.l HWIO_PMIC_ARB3_CHNL150_WDATA0_ADDR A:0x28b3010
y.create.l HWIO_PMIC_ARB3_CHNL151_WDATA0_ADDR A:0x28bb010
y.create.l HWIO_PMIC_ARB3_CHNL152_WDATA0_ADDR A:0x28c3010
y.create.l HWIO_PMIC_ARB3_CHNL153_WDATA0_ADDR A:0x28cb010
y.create.l HWIO_PMIC_ARB3_CHNL154_WDATA0_ADDR A:0x28d3010
y.create.l HWIO_PMIC_ARB3_CHNL155_WDATA0_ADDR A:0x28db010
y.create.l HWIO_PMIC_ARB3_CHNL156_WDATA0_ADDR A:0x28e3010
y.create.l HWIO_PMIC_ARB3_CHNL157_WDATA0_ADDR A:0x28eb010
y.create.l HWIO_PMIC_ARB3_CHNL158_WDATA0_ADDR A:0x28f3010
y.create.l HWIO_PMIC_ARB3_CHNL159_WDATA0_ADDR A:0x28fb010
y.create.l HWIO_PMIC_ARB3_CHNL160_WDATA0_ADDR A:0x2903010
y.create.l HWIO_PMIC_ARB3_CHNL161_WDATA0_ADDR A:0x290b010
y.create.l HWIO_PMIC_ARB3_CHNL162_WDATA0_ADDR A:0x2913010
y.create.l HWIO_PMIC_ARB3_CHNL163_WDATA0_ADDR A:0x291b010
y.create.l HWIO_PMIC_ARB3_CHNL164_WDATA0_ADDR A:0x2923010
y.create.l HWIO_PMIC_ARB3_CHNL165_WDATA0_ADDR A:0x292b010
y.create.l HWIO_PMIC_ARB3_CHNL166_WDATA0_ADDR A:0x2933010
y.create.l HWIO_PMIC_ARB3_CHNL167_WDATA0_ADDR A:0x293b010
y.create.l HWIO_PMIC_ARB3_CHNL168_WDATA0_ADDR A:0x2943010
y.create.l HWIO_PMIC_ARB3_CHNL169_WDATA0_ADDR A:0x294b010
y.create.l HWIO_PMIC_ARB3_CHNL170_WDATA0_ADDR A:0x2953010
y.create.l HWIO_PMIC_ARB3_CHNL171_WDATA0_ADDR A:0x295b010
y.create.l HWIO_PMIC_ARB3_CHNL172_WDATA0_ADDR A:0x2963010
y.create.l HWIO_PMIC_ARB3_CHNL173_WDATA0_ADDR A:0x296b010
y.create.l HWIO_PMIC_ARB3_CHNL174_WDATA0_ADDR A:0x2973010
y.create.l HWIO_PMIC_ARB3_CHNL175_WDATA0_ADDR A:0x297b010
y.create.l HWIO_PMIC_ARB3_CHNL176_WDATA0_ADDR A:0x2983010
y.create.l HWIO_PMIC_ARB3_CHNL177_WDATA0_ADDR A:0x298b010
y.create.l HWIO_PMIC_ARB3_CHNL178_WDATA0_ADDR A:0x2993010
y.create.l HWIO_PMIC_ARB3_CHNL179_WDATA0_ADDR A:0x299b010
y.create.l HWIO_PMIC_ARB3_CHNL180_WDATA0_ADDR A:0x29a3010
y.create.l HWIO_PMIC_ARB3_CHNL181_WDATA0_ADDR A:0x29ab010
y.create.l HWIO_PMIC_ARB3_CHNL182_WDATA0_ADDR A:0x29b3010
y.create.l HWIO_PMIC_ARB3_CHNL183_WDATA0_ADDR A:0x29bb010
y.create.l HWIO_PMIC_ARB3_CHNL184_WDATA0_ADDR A:0x29c3010
y.create.l HWIO_PMIC_ARB3_CHNL185_WDATA0_ADDR A:0x29cb010
y.create.l HWIO_PMIC_ARB3_CHNL186_WDATA0_ADDR A:0x29d3010
y.create.l HWIO_PMIC_ARB3_CHNL187_WDATA0_ADDR A:0x29db010
y.create.l HWIO_PMIC_ARB3_CHNL188_WDATA0_ADDR A:0x29e3010
y.create.l HWIO_PMIC_ARB3_CHNL189_WDATA0_ADDR A:0x29eb010
y.create.l HWIO_PMIC_ARB3_CHNL190_WDATA0_ADDR A:0x29f3010
y.create.l HWIO_PMIC_ARB3_CHNL191_WDATA0_ADDR A:0x29fb010
y.create.l HWIO_PMIC_ARB3_CHNL192_WDATA0_ADDR A:0x2a03010
y.create.l HWIO_PMIC_ARB3_CHNL193_WDATA0_ADDR A:0x2a0b010
y.create.l HWIO_PMIC_ARB3_CHNL194_WDATA0_ADDR A:0x2a13010
y.create.l HWIO_PMIC_ARB3_CHNL195_WDATA0_ADDR A:0x2a1b010
y.create.l HWIO_PMIC_ARB3_CHNL196_WDATA0_ADDR A:0x2a23010
y.create.l HWIO_PMIC_ARB3_CHNL197_WDATA0_ADDR A:0x2a2b010
y.create.l HWIO_PMIC_ARB3_CHNL198_WDATA0_ADDR A:0x2a33010
y.create.l HWIO_PMIC_ARB3_CHNL199_WDATA0_ADDR A:0x2a3b010
y.create.l HWIO_PMIC_ARB3_CHNL200_WDATA0_ADDR A:0x2a43010
y.create.l HWIO_PMIC_ARB3_CHNL201_WDATA0_ADDR A:0x2a4b010
y.create.l HWIO_PMIC_ARB3_CHNL202_WDATA0_ADDR A:0x2a53010
y.create.l HWIO_PMIC_ARB3_CHNL203_WDATA0_ADDR A:0x2a5b010
y.create.l HWIO_PMIC_ARB3_CHNL204_WDATA0_ADDR A:0x2a63010
y.create.l HWIO_PMIC_ARB3_CHNL205_WDATA0_ADDR A:0x2a6b010
y.create.l HWIO_PMIC_ARB3_CHNL206_WDATA0_ADDR A:0x2a73010
y.create.l HWIO_PMIC_ARB3_CHNL207_WDATA0_ADDR A:0x2a7b010
y.create.l HWIO_PMIC_ARB3_CHNL208_WDATA0_ADDR A:0x2a83010
y.create.l HWIO_PMIC_ARB3_CHNL209_WDATA0_ADDR A:0x2a8b010
y.create.l HWIO_PMIC_ARB3_CHNL210_WDATA0_ADDR A:0x2a93010
y.create.l HWIO_PMIC_ARB3_CHNL211_WDATA0_ADDR A:0x2a9b010
y.create.l HWIO_PMIC_ARB3_CHNL212_WDATA0_ADDR A:0x2aa3010
y.create.l HWIO_PMIC_ARB3_CHNL213_WDATA0_ADDR A:0x2aab010
y.create.l HWIO_PMIC_ARB3_CHNL214_WDATA0_ADDR A:0x2ab3010
y.create.l HWIO_PMIC_ARB3_CHNL215_WDATA0_ADDR A:0x2abb010
y.create.l HWIO_PMIC_ARB3_CHNL216_WDATA0_ADDR A:0x2ac3010
y.create.l HWIO_PMIC_ARB3_CHNL217_WDATA0_ADDR A:0x2acb010
y.create.l HWIO_PMIC_ARB3_CHNL218_WDATA0_ADDR A:0x2ad3010
y.create.l HWIO_PMIC_ARB3_CHNL219_WDATA0_ADDR A:0x2adb010
y.create.l HWIO_PMIC_ARB3_CHNL220_WDATA0_ADDR A:0x2ae3010
y.create.l HWIO_PMIC_ARB3_CHNL221_WDATA0_ADDR A:0x2aeb010
y.create.l HWIO_PMIC_ARB3_CHNL222_WDATA0_ADDR A:0x2af3010
y.create.l HWIO_PMIC_ARB3_CHNL223_WDATA0_ADDR A:0x2afb010
y.create.l HWIO_PMIC_ARB3_CHNL224_WDATA0_ADDR A:0x2b03010
y.create.l HWIO_PMIC_ARB3_CHNL225_WDATA0_ADDR A:0x2b0b010
y.create.l HWIO_PMIC_ARB3_CHNL226_WDATA0_ADDR A:0x2b13010
y.create.l HWIO_PMIC_ARB3_CHNL227_WDATA0_ADDR A:0x2b1b010
y.create.l HWIO_PMIC_ARB3_CHNL228_WDATA0_ADDR A:0x2b23010
y.create.l HWIO_PMIC_ARB3_CHNL229_WDATA0_ADDR A:0x2b2b010
y.create.l HWIO_PMIC_ARB3_CHNL230_WDATA0_ADDR A:0x2b33010
y.create.l HWIO_PMIC_ARB3_CHNL231_WDATA0_ADDR A:0x2b3b010
y.create.l HWIO_PMIC_ARB3_CHNL232_WDATA0_ADDR A:0x2b43010
y.create.l HWIO_PMIC_ARB3_CHNL233_WDATA0_ADDR A:0x2b4b010
y.create.l HWIO_PMIC_ARB3_CHNL234_WDATA0_ADDR A:0x2b53010
y.create.l HWIO_PMIC_ARB3_CHNL235_WDATA0_ADDR A:0x2b5b010
y.create.l HWIO_PMIC_ARB3_CHNL236_WDATA0_ADDR A:0x2b63010
y.create.l HWIO_PMIC_ARB3_CHNL237_WDATA0_ADDR A:0x2b6b010
y.create.l HWIO_PMIC_ARB3_CHNL238_WDATA0_ADDR A:0x2b73010
y.create.l HWIO_PMIC_ARB3_CHNL239_WDATA0_ADDR A:0x2b7b010
y.create.l HWIO_PMIC_ARB3_CHNL240_WDATA0_ADDR A:0x2b83010
y.create.l HWIO_PMIC_ARB3_CHNL241_WDATA0_ADDR A:0x2b8b010
y.create.l HWIO_PMIC_ARB3_CHNL242_WDATA0_ADDR A:0x2b93010
y.create.l HWIO_PMIC_ARB3_CHNL243_WDATA0_ADDR A:0x2b9b010
y.create.l HWIO_PMIC_ARB3_CHNL244_WDATA0_ADDR A:0x2ba3010
y.create.l HWIO_PMIC_ARB3_CHNL245_WDATA0_ADDR A:0x2bab010
y.create.l HWIO_PMIC_ARB3_CHNL246_WDATA0_ADDR A:0x2bb3010
y.create.l HWIO_PMIC_ARB3_CHNL247_WDATA0_ADDR A:0x2bbb010
y.create.l HWIO_PMIC_ARB3_CHNL248_WDATA0_ADDR A:0x2bc3010
y.create.l HWIO_PMIC_ARB3_CHNL249_WDATA0_ADDR A:0x2bcb010
y.create.l HWIO_PMIC_ARB3_CHNL250_WDATA0_ADDR A:0x2bd3010
y.create.l HWIO_PMIC_ARB3_CHNL251_WDATA0_ADDR A:0x2bdb010
y.create.l HWIO_PMIC_ARB3_CHNL252_WDATA0_ADDR A:0x2be3010
y.create.l HWIO_PMIC_ARB3_CHNL253_WDATA0_ADDR A:0x2beb010
y.create.l HWIO_PMIC_ARB3_CHNL254_WDATA0_ADDR A:0x2bf3010
y.create.l HWIO_PMIC_ARB3_CHNL255_WDATA0_ADDR A:0x2bfb010
y.create.l HWIO_PMIC_ARB4_CHNL0_WDATA0_ADDR A:0x2404010
y.create.l HWIO_PMIC_ARB4_CHNL1_WDATA0_ADDR A:0x240c010
y.create.l HWIO_PMIC_ARB4_CHNL2_WDATA0_ADDR A:0x2414010
y.create.l HWIO_PMIC_ARB4_CHNL3_WDATA0_ADDR A:0x241c010
y.create.l HWIO_PMIC_ARB4_CHNL4_WDATA0_ADDR A:0x2424010
y.create.l HWIO_PMIC_ARB4_CHNL5_WDATA0_ADDR A:0x242c010
y.create.l HWIO_PMIC_ARB4_CHNL6_WDATA0_ADDR A:0x2434010
y.create.l HWIO_PMIC_ARB4_CHNL7_WDATA0_ADDR A:0x243c010
y.create.l HWIO_PMIC_ARB4_CHNL8_WDATA0_ADDR A:0x2444010
y.create.l HWIO_PMIC_ARB4_CHNL9_WDATA0_ADDR A:0x244c010
y.create.l HWIO_PMIC_ARB4_CHNL10_WDATA0_ADDR A:0x2454010
y.create.l HWIO_PMIC_ARB4_CHNL11_WDATA0_ADDR A:0x245c010
y.create.l HWIO_PMIC_ARB4_CHNL12_WDATA0_ADDR A:0x2464010
y.create.l HWIO_PMIC_ARB4_CHNL13_WDATA0_ADDR A:0x246c010
y.create.l HWIO_PMIC_ARB4_CHNL14_WDATA0_ADDR A:0x2474010
y.create.l HWIO_PMIC_ARB4_CHNL15_WDATA0_ADDR A:0x247c010
y.create.l HWIO_PMIC_ARB4_CHNL16_WDATA0_ADDR A:0x2484010
y.create.l HWIO_PMIC_ARB4_CHNL17_WDATA0_ADDR A:0x248c010
y.create.l HWIO_PMIC_ARB4_CHNL18_WDATA0_ADDR A:0x2494010
y.create.l HWIO_PMIC_ARB4_CHNL19_WDATA0_ADDR A:0x249c010
y.create.l HWIO_PMIC_ARB4_CHNL20_WDATA0_ADDR A:0x24a4010
y.create.l HWIO_PMIC_ARB4_CHNL21_WDATA0_ADDR A:0x24ac010
y.create.l HWIO_PMIC_ARB4_CHNL22_WDATA0_ADDR A:0x24b4010
y.create.l HWIO_PMIC_ARB4_CHNL23_WDATA0_ADDR A:0x24bc010
y.create.l HWIO_PMIC_ARB4_CHNL24_WDATA0_ADDR A:0x24c4010
y.create.l HWIO_PMIC_ARB4_CHNL25_WDATA0_ADDR A:0x24cc010
y.create.l HWIO_PMIC_ARB4_CHNL26_WDATA0_ADDR A:0x24d4010
y.create.l HWIO_PMIC_ARB4_CHNL27_WDATA0_ADDR A:0x24dc010
y.create.l HWIO_PMIC_ARB4_CHNL28_WDATA0_ADDR A:0x24e4010
y.create.l HWIO_PMIC_ARB4_CHNL29_WDATA0_ADDR A:0x24ec010
y.create.l HWIO_PMIC_ARB4_CHNL30_WDATA0_ADDR A:0x24f4010
y.create.l HWIO_PMIC_ARB4_CHNL31_WDATA0_ADDR A:0x24fc010
y.create.l HWIO_PMIC_ARB4_CHNL32_WDATA0_ADDR A:0x2504010
y.create.l HWIO_PMIC_ARB4_CHNL33_WDATA0_ADDR A:0x250c010
y.create.l HWIO_PMIC_ARB4_CHNL34_WDATA0_ADDR A:0x2514010
y.create.l HWIO_PMIC_ARB4_CHNL35_WDATA0_ADDR A:0x251c010
y.create.l HWIO_PMIC_ARB4_CHNL36_WDATA0_ADDR A:0x2524010
y.create.l HWIO_PMIC_ARB4_CHNL37_WDATA0_ADDR A:0x252c010
y.create.l HWIO_PMIC_ARB4_CHNL38_WDATA0_ADDR A:0x2534010
y.create.l HWIO_PMIC_ARB4_CHNL39_WDATA0_ADDR A:0x253c010
y.create.l HWIO_PMIC_ARB4_CHNL40_WDATA0_ADDR A:0x2544010
y.create.l HWIO_PMIC_ARB4_CHNL41_WDATA0_ADDR A:0x254c010
y.create.l HWIO_PMIC_ARB4_CHNL42_WDATA0_ADDR A:0x2554010
y.create.l HWIO_PMIC_ARB4_CHNL43_WDATA0_ADDR A:0x255c010
y.create.l HWIO_PMIC_ARB4_CHNL44_WDATA0_ADDR A:0x2564010
y.create.l HWIO_PMIC_ARB4_CHNL45_WDATA0_ADDR A:0x256c010
y.create.l HWIO_PMIC_ARB4_CHNL46_WDATA0_ADDR A:0x2574010
y.create.l HWIO_PMIC_ARB4_CHNL47_WDATA0_ADDR A:0x257c010
y.create.l HWIO_PMIC_ARB4_CHNL48_WDATA0_ADDR A:0x2584010
y.create.l HWIO_PMIC_ARB4_CHNL49_WDATA0_ADDR A:0x258c010
y.create.l HWIO_PMIC_ARB4_CHNL50_WDATA0_ADDR A:0x2594010
y.create.l HWIO_PMIC_ARB4_CHNL51_WDATA0_ADDR A:0x259c010
y.create.l HWIO_PMIC_ARB4_CHNL52_WDATA0_ADDR A:0x25a4010
y.create.l HWIO_PMIC_ARB4_CHNL53_WDATA0_ADDR A:0x25ac010
y.create.l HWIO_PMIC_ARB4_CHNL54_WDATA0_ADDR A:0x25b4010
y.create.l HWIO_PMIC_ARB4_CHNL55_WDATA0_ADDR A:0x25bc010
y.create.l HWIO_PMIC_ARB4_CHNL56_WDATA0_ADDR A:0x25c4010
y.create.l HWIO_PMIC_ARB4_CHNL57_WDATA0_ADDR A:0x25cc010
y.create.l HWIO_PMIC_ARB4_CHNL58_WDATA0_ADDR A:0x25d4010
y.create.l HWIO_PMIC_ARB4_CHNL59_WDATA0_ADDR A:0x25dc010
y.create.l HWIO_PMIC_ARB4_CHNL60_WDATA0_ADDR A:0x25e4010
y.create.l HWIO_PMIC_ARB4_CHNL61_WDATA0_ADDR A:0x25ec010
y.create.l HWIO_PMIC_ARB4_CHNL62_WDATA0_ADDR A:0x25f4010
y.create.l HWIO_PMIC_ARB4_CHNL63_WDATA0_ADDR A:0x25fc010
y.create.l HWIO_PMIC_ARB4_CHNL64_WDATA0_ADDR A:0x2604010
y.create.l HWIO_PMIC_ARB4_CHNL65_WDATA0_ADDR A:0x260c010
y.create.l HWIO_PMIC_ARB4_CHNL66_WDATA0_ADDR A:0x2614010
y.create.l HWIO_PMIC_ARB4_CHNL67_WDATA0_ADDR A:0x261c010
y.create.l HWIO_PMIC_ARB4_CHNL68_WDATA0_ADDR A:0x2624010
y.create.l HWIO_PMIC_ARB4_CHNL69_WDATA0_ADDR A:0x262c010
y.create.l HWIO_PMIC_ARB4_CHNL70_WDATA0_ADDR A:0x2634010
y.create.l HWIO_PMIC_ARB4_CHNL71_WDATA0_ADDR A:0x263c010
y.create.l HWIO_PMIC_ARB4_CHNL72_WDATA0_ADDR A:0x2644010
y.create.l HWIO_PMIC_ARB4_CHNL73_WDATA0_ADDR A:0x264c010
y.create.l HWIO_PMIC_ARB4_CHNL74_WDATA0_ADDR A:0x2654010
y.create.l HWIO_PMIC_ARB4_CHNL75_WDATA0_ADDR A:0x265c010
y.create.l HWIO_PMIC_ARB4_CHNL76_WDATA0_ADDR A:0x2664010
y.create.l HWIO_PMIC_ARB4_CHNL77_WDATA0_ADDR A:0x266c010
y.create.l HWIO_PMIC_ARB4_CHNL78_WDATA0_ADDR A:0x2674010
y.create.l HWIO_PMIC_ARB4_CHNL79_WDATA0_ADDR A:0x267c010
y.create.l HWIO_PMIC_ARB4_CHNL80_WDATA0_ADDR A:0x2684010
y.create.l HWIO_PMIC_ARB4_CHNL81_WDATA0_ADDR A:0x268c010
y.create.l HWIO_PMIC_ARB4_CHNL82_WDATA0_ADDR A:0x2694010
y.create.l HWIO_PMIC_ARB4_CHNL83_WDATA0_ADDR A:0x269c010
y.create.l HWIO_PMIC_ARB4_CHNL84_WDATA0_ADDR A:0x26a4010
y.create.l HWIO_PMIC_ARB4_CHNL85_WDATA0_ADDR A:0x26ac010
y.create.l HWIO_PMIC_ARB4_CHNL86_WDATA0_ADDR A:0x26b4010
y.create.l HWIO_PMIC_ARB4_CHNL87_WDATA0_ADDR A:0x26bc010
y.create.l HWIO_PMIC_ARB4_CHNL88_WDATA0_ADDR A:0x26c4010
y.create.l HWIO_PMIC_ARB4_CHNL89_WDATA0_ADDR A:0x26cc010
y.create.l HWIO_PMIC_ARB4_CHNL90_WDATA0_ADDR A:0x26d4010
y.create.l HWIO_PMIC_ARB4_CHNL91_WDATA0_ADDR A:0x26dc010
y.create.l HWIO_PMIC_ARB4_CHNL92_WDATA0_ADDR A:0x26e4010
y.create.l HWIO_PMIC_ARB4_CHNL93_WDATA0_ADDR A:0x26ec010
y.create.l HWIO_PMIC_ARB4_CHNL94_WDATA0_ADDR A:0x26f4010
y.create.l HWIO_PMIC_ARB4_CHNL95_WDATA0_ADDR A:0x26fc010
y.create.l HWIO_PMIC_ARB4_CHNL96_WDATA0_ADDR A:0x2704010
y.create.l HWIO_PMIC_ARB4_CHNL97_WDATA0_ADDR A:0x270c010
y.create.l HWIO_PMIC_ARB4_CHNL98_WDATA0_ADDR A:0x2714010
y.create.l HWIO_PMIC_ARB4_CHNL99_WDATA0_ADDR A:0x271c010
y.create.l HWIO_PMIC_ARB4_CHNL100_WDATA0_ADDR A:0x2724010
y.create.l HWIO_PMIC_ARB4_CHNL101_WDATA0_ADDR A:0x272c010
y.create.l HWIO_PMIC_ARB4_CHNL102_WDATA0_ADDR A:0x2734010
y.create.l HWIO_PMIC_ARB4_CHNL103_WDATA0_ADDR A:0x273c010
y.create.l HWIO_PMIC_ARB4_CHNL104_WDATA0_ADDR A:0x2744010
y.create.l HWIO_PMIC_ARB4_CHNL105_WDATA0_ADDR A:0x274c010
y.create.l HWIO_PMIC_ARB4_CHNL106_WDATA0_ADDR A:0x2754010
y.create.l HWIO_PMIC_ARB4_CHNL107_WDATA0_ADDR A:0x275c010
y.create.l HWIO_PMIC_ARB4_CHNL108_WDATA0_ADDR A:0x2764010
y.create.l HWIO_PMIC_ARB4_CHNL109_WDATA0_ADDR A:0x276c010
y.create.l HWIO_PMIC_ARB4_CHNL110_WDATA0_ADDR A:0x2774010
y.create.l HWIO_PMIC_ARB4_CHNL111_WDATA0_ADDR A:0x277c010
y.create.l HWIO_PMIC_ARB4_CHNL112_WDATA0_ADDR A:0x2784010
y.create.l HWIO_PMIC_ARB4_CHNL113_WDATA0_ADDR A:0x278c010
y.create.l HWIO_PMIC_ARB4_CHNL114_WDATA0_ADDR A:0x2794010
y.create.l HWIO_PMIC_ARB4_CHNL115_WDATA0_ADDR A:0x279c010
y.create.l HWIO_PMIC_ARB4_CHNL116_WDATA0_ADDR A:0x27a4010
y.create.l HWIO_PMIC_ARB4_CHNL117_WDATA0_ADDR A:0x27ac010
y.create.l HWIO_PMIC_ARB4_CHNL118_WDATA0_ADDR A:0x27b4010
y.create.l HWIO_PMIC_ARB4_CHNL119_WDATA0_ADDR A:0x27bc010
y.create.l HWIO_PMIC_ARB4_CHNL120_WDATA0_ADDR A:0x27c4010
y.create.l HWIO_PMIC_ARB4_CHNL121_WDATA0_ADDR A:0x27cc010
y.create.l HWIO_PMIC_ARB4_CHNL122_WDATA0_ADDR A:0x27d4010
y.create.l HWIO_PMIC_ARB4_CHNL123_WDATA0_ADDR A:0x27dc010
y.create.l HWIO_PMIC_ARB4_CHNL124_WDATA0_ADDR A:0x27e4010
y.create.l HWIO_PMIC_ARB4_CHNL125_WDATA0_ADDR A:0x27ec010
y.create.l HWIO_PMIC_ARB4_CHNL126_WDATA0_ADDR A:0x27f4010
y.create.l HWIO_PMIC_ARB4_CHNL127_WDATA0_ADDR A:0x27fc010
y.create.l HWIO_PMIC_ARB4_CHNL128_WDATA0_ADDR A:0x2804010
y.create.l HWIO_PMIC_ARB4_CHNL129_WDATA0_ADDR A:0x280c010
y.create.l HWIO_PMIC_ARB4_CHNL130_WDATA0_ADDR A:0x2814010
y.create.l HWIO_PMIC_ARB4_CHNL131_WDATA0_ADDR A:0x281c010
y.create.l HWIO_PMIC_ARB4_CHNL132_WDATA0_ADDR A:0x2824010
y.create.l HWIO_PMIC_ARB4_CHNL133_WDATA0_ADDR A:0x282c010
y.create.l HWIO_PMIC_ARB4_CHNL134_WDATA0_ADDR A:0x2834010
y.create.l HWIO_PMIC_ARB4_CHNL135_WDATA0_ADDR A:0x283c010
y.create.l HWIO_PMIC_ARB4_CHNL136_WDATA0_ADDR A:0x2844010
y.create.l HWIO_PMIC_ARB4_CHNL137_WDATA0_ADDR A:0x284c010
y.create.l HWIO_PMIC_ARB4_CHNL138_WDATA0_ADDR A:0x2854010
y.create.l HWIO_PMIC_ARB4_CHNL139_WDATA0_ADDR A:0x285c010
y.create.l HWIO_PMIC_ARB4_CHNL140_WDATA0_ADDR A:0x2864010
y.create.l HWIO_PMIC_ARB4_CHNL141_WDATA0_ADDR A:0x286c010
y.create.l HWIO_PMIC_ARB4_CHNL142_WDATA0_ADDR A:0x2874010
y.create.l HWIO_PMIC_ARB4_CHNL143_WDATA0_ADDR A:0x287c010
y.create.l HWIO_PMIC_ARB4_CHNL144_WDATA0_ADDR A:0x2884010
y.create.l HWIO_PMIC_ARB4_CHNL145_WDATA0_ADDR A:0x288c010
y.create.l HWIO_PMIC_ARB4_CHNL146_WDATA0_ADDR A:0x2894010
y.create.l HWIO_PMIC_ARB4_CHNL147_WDATA0_ADDR A:0x289c010
y.create.l HWIO_PMIC_ARB4_CHNL148_WDATA0_ADDR A:0x28a4010
y.create.l HWIO_PMIC_ARB4_CHNL149_WDATA0_ADDR A:0x28ac010
y.create.l HWIO_PMIC_ARB4_CHNL150_WDATA0_ADDR A:0x28b4010
y.create.l HWIO_PMIC_ARB4_CHNL151_WDATA0_ADDR A:0x28bc010
y.create.l HWIO_PMIC_ARB4_CHNL152_WDATA0_ADDR A:0x28c4010
y.create.l HWIO_PMIC_ARB4_CHNL153_WDATA0_ADDR A:0x28cc010
y.create.l HWIO_PMIC_ARB4_CHNL154_WDATA0_ADDR A:0x28d4010
y.create.l HWIO_PMIC_ARB4_CHNL155_WDATA0_ADDR A:0x28dc010
y.create.l HWIO_PMIC_ARB4_CHNL156_WDATA0_ADDR A:0x28e4010
y.create.l HWIO_PMIC_ARB4_CHNL157_WDATA0_ADDR A:0x28ec010
y.create.l HWIO_PMIC_ARB4_CHNL158_WDATA0_ADDR A:0x28f4010
y.create.l HWIO_PMIC_ARB4_CHNL159_WDATA0_ADDR A:0x28fc010
y.create.l HWIO_PMIC_ARB4_CHNL160_WDATA0_ADDR A:0x2904010
y.create.l HWIO_PMIC_ARB4_CHNL161_WDATA0_ADDR A:0x290c010
y.create.l HWIO_PMIC_ARB4_CHNL162_WDATA0_ADDR A:0x2914010
y.create.l HWIO_PMIC_ARB4_CHNL163_WDATA0_ADDR A:0x291c010
y.create.l HWIO_PMIC_ARB4_CHNL164_WDATA0_ADDR A:0x2924010
y.create.l HWIO_PMIC_ARB4_CHNL165_WDATA0_ADDR A:0x292c010
y.create.l HWIO_PMIC_ARB4_CHNL166_WDATA0_ADDR A:0x2934010
y.create.l HWIO_PMIC_ARB4_CHNL167_WDATA0_ADDR A:0x293c010
y.create.l HWIO_PMIC_ARB4_CHNL168_WDATA0_ADDR A:0x2944010
y.create.l HWIO_PMIC_ARB4_CHNL169_WDATA0_ADDR A:0x294c010
y.create.l HWIO_PMIC_ARB4_CHNL170_WDATA0_ADDR A:0x2954010
y.create.l HWIO_PMIC_ARB4_CHNL171_WDATA0_ADDR A:0x295c010
y.create.l HWIO_PMIC_ARB4_CHNL172_WDATA0_ADDR A:0x2964010
y.create.l HWIO_PMIC_ARB4_CHNL173_WDATA0_ADDR A:0x296c010
y.create.l HWIO_PMIC_ARB4_CHNL174_WDATA0_ADDR A:0x2974010
y.create.l HWIO_PMIC_ARB4_CHNL175_WDATA0_ADDR A:0x297c010
y.create.l HWIO_PMIC_ARB4_CHNL176_WDATA0_ADDR A:0x2984010
y.create.l HWIO_PMIC_ARB4_CHNL177_WDATA0_ADDR A:0x298c010
y.create.l HWIO_PMIC_ARB4_CHNL178_WDATA0_ADDR A:0x2994010
y.create.l HWIO_PMIC_ARB4_CHNL179_WDATA0_ADDR A:0x299c010
y.create.l HWIO_PMIC_ARB4_CHNL180_WDATA0_ADDR A:0x29a4010
y.create.l HWIO_PMIC_ARB4_CHNL181_WDATA0_ADDR A:0x29ac010
y.create.l HWIO_PMIC_ARB4_CHNL182_WDATA0_ADDR A:0x29b4010
y.create.l HWIO_PMIC_ARB4_CHNL183_WDATA0_ADDR A:0x29bc010
y.create.l HWIO_PMIC_ARB4_CHNL184_WDATA0_ADDR A:0x29c4010
y.create.l HWIO_PMIC_ARB4_CHNL185_WDATA0_ADDR A:0x29cc010
y.create.l HWIO_PMIC_ARB4_CHNL186_WDATA0_ADDR A:0x29d4010
y.create.l HWIO_PMIC_ARB4_CHNL187_WDATA0_ADDR A:0x29dc010
y.create.l HWIO_PMIC_ARB4_CHNL188_WDATA0_ADDR A:0x29e4010
y.create.l HWIO_PMIC_ARB4_CHNL189_WDATA0_ADDR A:0x29ec010
y.create.l HWIO_PMIC_ARB4_CHNL190_WDATA0_ADDR A:0x29f4010
y.create.l HWIO_PMIC_ARB4_CHNL191_WDATA0_ADDR A:0x29fc010
y.create.l HWIO_PMIC_ARB4_CHNL192_WDATA0_ADDR A:0x2a04010
y.create.l HWIO_PMIC_ARB4_CHNL193_WDATA0_ADDR A:0x2a0c010
y.create.l HWIO_PMIC_ARB4_CHNL194_WDATA0_ADDR A:0x2a14010
y.create.l HWIO_PMIC_ARB4_CHNL195_WDATA0_ADDR A:0x2a1c010
y.create.l HWIO_PMIC_ARB4_CHNL196_WDATA0_ADDR A:0x2a24010
y.create.l HWIO_PMIC_ARB4_CHNL197_WDATA0_ADDR A:0x2a2c010
y.create.l HWIO_PMIC_ARB4_CHNL198_WDATA0_ADDR A:0x2a34010
y.create.l HWIO_PMIC_ARB4_CHNL199_WDATA0_ADDR A:0x2a3c010
y.create.l HWIO_PMIC_ARB4_CHNL200_WDATA0_ADDR A:0x2a44010
y.create.l HWIO_PMIC_ARB4_CHNL201_WDATA0_ADDR A:0x2a4c010
y.create.l HWIO_PMIC_ARB4_CHNL202_WDATA0_ADDR A:0x2a54010
y.create.l HWIO_PMIC_ARB4_CHNL203_WDATA0_ADDR A:0x2a5c010
y.create.l HWIO_PMIC_ARB4_CHNL204_WDATA0_ADDR A:0x2a64010
y.create.l HWIO_PMIC_ARB4_CHNL205_WDATA0_ADDR A:0x2a6c010
y.create.l HWIO_PMIC_ARB4_CHNL206_WDATA0_ADDR A:0x2a74010
y.create.l HWIO_PMIC_ARB4_CHNL207_WDATA0_ADDR A:0x2a7c010
y.create.l HWIO_PMIC_ARB4_CHNL208_WDATA0_ADDR A:0x2a84010
y.create.l HWIO_PMIC_ARB4_CHNL209_WDATA0_ADDR A:0x2a8c010
y.create.l HWIO_PMIC_ARB4_CHNL210_WDATA0_ADDR A:0x2a94010
y.create.l HWIO_PMIC_ARB4_CHNL211_WDATA0_ADDR A:0x2a9c010
y.create.l HWIO_PMIC_ARB4_CHNL212_WDATA0_ADDR A:0x2aa4010
y.create.l HWIO_PMIC_ARB4_CHNL213_WDATA0_ADDR A:0x2aac010
y.create.l HWIO_PMIC_ARB4_CHNL214_WDATA0_ADDR A:0x2ab4010
y.create.l HWIO_PMIC_ARB4_CHNL215_WDATA0_ADDR A:0x2abc010
y.create.l HWIO_PMIC_ARB4_CHNL216_WDATA0_ADDR A:0x2ac4010
y.create.l HWIO_PMIC_ARB4_CHNL217_WDATA0_ADDR A:0x2acc010
y.create.l HWIO_PMIC_ARB4_CHNL218_WDATA0_ADDR A:0x2ad4010
y.create.l HWIO_PMIC_ARB4_CHNL219_WDATA0_ADDR A:0x2adc010
y.create.l HWIO_PMIC_ARB4_CHNL220_WDATA0_ADDR A:0x2ae4010
y.create.l HWIO_PMIC_ARB4_CHNL221_WDATA0_ADDR A:0x2aec010
y.create.l HWIO_PMIC_ARB4_CHNL222_WDATA0_ADDR A:0x2af4010
y.create.l HWIO_PMIC_ARB4_CHNL223_WDATA0_ADDR A:0x2afc010
y.create.l HWIO_PMIC_ARB4_CHNL224_WDATA0_ADDR A:0x2b04010
y.create.l HWIO_PMIC_ARB4_CHNL225_WDATA0_ADDR A:0x2b0c010
y.create.l HWIO_PMIC_ARB4_CHNL226_WDATA0_ADDR A:0x2b14010
y.create.l HWIO_PMIC_ARB4_CHNL227_WDATA0_ADDR A:0x2b1c010
y.create.l HWIO_PMIC_ARB4_CHNL228_WDATA0_ADDR A:0x2b24010
y.create.l HWIO_PMIC_ARB4_CHNL229_WDATA0_ADDR A:0x2b2c010
y.create.l HWIO_PMIC_ARB4_CHNL230_WDATA0_ADDR A:0x2b34010
y.create.l HWIO_PMIC_ARB4_CHNL231_WDATA0_ADDR A:0x2b3c010
y.create.l HWIO_PMIC_ARB4_CHNL232_WDATA0_ADDR A:0x2b44010
y.create.l HWIO_PMIC_ARB4_CHNL233_WDATA0_ADDR A:0x2b4c010
y.create.l HWIO_PMIC_ARB4_CHNL234_WDATA0_ADDR A:0x2b54010
y.create.l HWIO_PMIC_ARB4_CHNL235_WDATA0_ADDR A:0x2b5c010
y.create.l HWIO_PMIC_ARB4_CHNL236_WDATA0_ADDR A:0x2b64010
y.create.l HWIO_PMIC_ARB4_CHNL237_WDATA0_ADDR A:0x2b6c010
y.create.l HWIO_PMIC_ARB4_CHNL238_WDATA0_ADDR A:0x2b74010
y.create.l HWIO_PMIC_ARB4_CHNL239_WDATA0_ADDR A:0x2b7c010
y.create.l HWIO_PMIC_ARB4_CHNL240_WDATA0_ADDR A:0x2b84010
y.create.l HWIO_PMIC_ARB4_CHNL241_WDATA0_ADDR A:0x2b8c010
y.create.l HWIO_PMIC_ARB4_CHNL242_WDATA0_ADDR A:0x2b94010
y.create.l HWIO_PMIC_ARB4_CHNL243_WDATA0_ADDR A:0x2b9c010
y.create.l HWIO_PMIC_ARB4_CHNL244_WDATA0_ADDR A:0x2ba4010
y.create.l HWIO_PMIC_ARB4_CHNL245_WDATA0_ADDR A:0x2bac010
y.create.l HWIO_PMIC_ARB4_CHNL246_WDATA0_ADDR A:0x2bb4010
y.create.l HWIO_PMIC_ARB4_CHNL247_WDATA0_ADDR A:0x2bbc010
y.create.l HWIO_PMIC_ARB4_CHNL248_WDATA0_ADDR A:0x2bc4010
y.create.l HWIO_PMIC_ARB4_CHNL249_WDATA0_ADDR A:0x2bcc010
y.create.l HWIO_PMIC_ARB4_CHNL250_WDATA0_ADDR A:0x2bd4010
y.create.l HWIO_PMIC_ARB4_CHNL251_WDATA0_ADDR A:0x2bdc010
y.create.l HWIO_PMIC_ARB4_CHNL252_WDATA0_ADDR A:0x2be4010
y.create.l HWIO_PMIC_ARB4_CHNL253_WDATA0_ADDR A:0x2bec010
y.create.l HWIO_PMIC_ARB4_CHNL254_WDATA0_ADDR A:0x2bf4010
y.create.l HWIO_PMIC_ARB4_CHNL255_WDATA0_ADDR A:0x2bfc010
y.create.l HWIO_PMIC_ARB5_CHNL0_WDATA0_ADDR A:0x2405010
y.create.l HWIO_PMIC_ARB5_CHNL1_WDATA0_ADDR A:0x240d010
y.create.l HWIO_PMIC_ARB5_CHNL2_WDATA0_ADDR A:0x2415010
y.create.l HWIO_PMIC_ARB5_CHNL3_WDATA0_ADDR A:0x241d010
y.create.l HWIO_PMIC_ARB5_CHNL4_WDATA0_ADDR A:0x2425010
y.create.l HWIO_PMIC_ARB5_CHNL5_WDATA0_ADDR A:0x242d010
y.create.l HWIO_PMIC_ARB5_CHNL6_WDATA0_ADDR A:0x2435010
y.create.l HWIO_PMIC_ARB5_CHNL7_WDATA0_ADDR A:0x243d010
y.create.l HWIO_PMIC_ARB5_CHNL8_WDATA0_ADDR A:0x2445010
y.create.l HWIO_PMIC_ARB5_CHNL9_WDATA0_ADDR A:0x244d010
y.create.l HWIO_PMIC_ARB5_CHNL10_WDATA0_ADDR A:0x2455010
y.create.l HWIO_PMIC_ARB5_CHNL11_WDATA0_ADDR A:0x245d010
y.create.l HWIO_PMIC_ARB5_CHNL12_WDATA0_ADDR A:0x2465010
y.create.l HWIO_PMIC_ARB5_CHNL13_WDATA0_ADDR A:0x246d010
y.create.l HWIO_PMIC_ARB5_CHNL14_WDATA0_ADDR A:0x2475010
y.create.l HWIO_PMIC_ARB5_CHNL15_WDATA0_ADDR A:0x247d010
y.create.l HWIO_PMIC_ARB5_CHNL16_WDATA0_ADDR A:0x2485010
y.create.l HWIO_PMIC_ARB5_CHNL17_WDATA0_ADDR A:0x248d010
y.create.l HWIO_PMIC_ARB5_CHNL18_WDATA0_ADDR A:0x2495010
y.create.l HWIO_PMIC_ARB5_CHNL19_WDATA0_ADDR A:0x249d010
y.create.l HWIO_PMIC_ARB5_CHNL20_WDATA0_ADDR A:0x24a5010
y.create.l HWIO_PMIC_ARB5_CHNL21_WDATA0_ADDR A:0x24ad010
y.create.l HWIO_PMIC_ARB5_CHNL22_WDATA0_ADDR A:0x24b5010
y.create.l HWIO_PMIC_ARB5_CHNL23_WDATA0_ADDR A:0x24bd010
y.create.l HWIO_PMIC_ARB5_CHNL24_WDATA0_ADDR A:0x24c5010
y.create.l HWIO_PMIC_ARB5_CHNL25_WDATA0_ADDR A:0x24cd010
y.create.l HWIO_PMIC_ARB5_CHNL26_WDATA0_ADDR A:0x24d5010
y.create.l HWIO_PMIC_ARB5_CHNL27_WDATA0_ADDR A:0x24dd010
y.create.l HWIO_PMIC_ARB5_CHNL28_WDATA0_ADDR A:0x24e5010
y.create.l HWIO_PMIC_ARB5_CHNL29_WDATA0_ADDR A:0x24ed010
y.create.l HWIO_PMIC_ARB5_CHNL30_WDATA0_ADDR A:0x24f5010
y.create.l HWIO_PMIC_ARB5_CHNL31_WDATA0_ADDR A:0x24fd010
y.create.l HWIO_PMIC_ARB5_CHNL32_WDATA0_ADDR A:0x2505010
y.create.l HWIO_PMIC_ARB5_CHNL33_WDATA0_ADDR A:0x250d010
y.create.l HWIO_PMIC_ARB5_CHNL34_WDATA0_ADDR A:0x2515010
y.create.l HWIO_PMIC_ARB5_CHNL35_WDATA0_ADDR A:0x251d010
y.create.l HWIO_PMIC_ARB5_CHNL36_WDATA0_ADDR A:0x2525010
y.create.l HWIO_PMIC_ARB5_CHNL37_WDATA0_ADDR A:0x252d010
y.create.l HWIO_PMIC_ARB5_CHNL38_WDATA0_ADDR A:0x2535010
y.create.l HWIO_PMIC_ARB5_CHNL39_WDATA0_ADDR A:0x253d010
y.create.l HWIO_PMIC_ARB5_CHNL40_WDATA0_ADDR A:0x2545010
y.create.l HWIO_PMIC_ARB5_CHNL41_WDATA0_ADDR A:0x254d010
y.create.l HWIO_PMIC_ARB5_CHNL42_WDATA0_ADDR A:0x2555010
y.create.l HWIO_PMIC_ARB5_CHNL43_WDATA0_ADDR A:0x255d010
y.create.l HWIO_PMIC_ARB5_CHNL44_WDATA0_ADDR A:0x2565010
y.create.l HWIO_PMIC_ARB5_CHNL45_WDATA0_ADDR A:0x256d010
y.create.l HWIO_PMIC_ARB5_CHNL46_WDATA0_ADDR A:0x2575010
y.create.l HWIO_PMIC_ARB5_CHNL47_WDATA0_ADDR A:0x257d010
y.create.l HWIO_PMIC_ARB5_CHNL48_WDATA0_ADDR A:0x2585010
y.create.l HWIO_PMIC_ARB5_CHNL49_WDATA0_ADDR A:0x258d010
y.create.l HWIO_PMIC_ARB5_CHNL50_WDATA0_ADDR A:0x2595010
y.create.l HWIO_PMIC_ARB5_CHNL51_WDATA0_ADDR A:0x259d010
y.create.l HWIO_PMIC_ARB5_CHNL52_WDATA0_ADDR A:0x25a5010
y.create.l HWIO_PMIC_ARB5_CHNL53_WDATA0_ADDR A:0x25ad010
y.create.l HWIO_PMIC_ARB5_CHNL54_WDATA0_ADDR A:0x25b5010
y.create.l HWIO_PMIC_ARB5_CHNL55_WDATA0_ADDR A:0x25bd010
y.create.l HWIO_PMIC_ARB5_CHNL56_WDATA0_ADDR A:0x25c5010
y.create.l HWIO_PMIC_ARB5_CHNL57_WDATA0_ADDR A:0x25cd010
y.create.l HWIO_PMIC_ARB5_CHNL58_WDATA0_ADDR A:0x25d5010
y.create.l HWIO_PMIC_ARB5_CHNL59_WDATA0_ADDR A:0x25dd010
y.create.l HWIO_PMIC_ARB5_CHNL60_WDATA0_ADDR A:0x25e5010
y.create.l HWIO_PMIC_ARB5_CHNL61_WDATA0_ADDR A:0x25ed010
y.create.l HWIO_PMIC_ARB5_CHNL62_WDATA0_ADDR A:0x25f5010
y.create.l HWIO_PMIC_ARB5_CHNL63_WDATA0_ADDR A:0x25fd010
y.create.l HWIO_PMIC_ARB5_CHNL64_WDATA0_ADDR A:0x2605010
y.create.l HWIO_PMIC_ARB5_CHNL65_WDATA0_ADDR A:0x260d010
y.create.l HWIO_PMIC_ARB5_CHNL66_WDATA0_ADDR A:0x2615010
y.create.l HWIO_PMIC_ARB5_CHNL67_WDATA0_ADDR A:0x261d010
y.create.l HWIO_PMIC_ARB5_CHNL68_WDATA0_ADDR A:0x2625010
y.create.l HWIO_PMIC_ARB5_CHNL69_WDATA0_ADDR A:0x262d010
y.create.l HWIO_PMIC_ARB5_CHNL70_WDATA0_ADDR A:0x2635010
y.create.l HWIO_PMIC_ARB5_CHNL71_WDATA0_ADDR A:0x263d010
y.create.l HWIO_PMIC_ARB5_CHNL72_WDATA0_ADDR A:0x2645010
y.create.l HWIO_PMIC_ARB5_CHNL73_WDATA0_ADDR A:0x264d010
y.create.l HWIO_PMIC_ARB5_CHNL74_WDATA0_ADDR A:0x2655010
y.create.l HWIO_PMIC_ARB5_CHNL75_WDATA0_ADDR A:0x265d010
y.create.l HWIO_PMIC_ARB5_CHNL76_WDATA0_ADDR A:0x2665010
y.create.l HWIO_PMIC_ARB5_CHNL77_WDATA0_ADDR A:0x266d010
y.create.l HWIO_PMIC_ARB5_CHNL78_WDATA0_ADDR A:0x2675010
y.create.l HWIO_PMIC_ARB5_CHNL79_WDATA0_ADDR A:0x267d010
y.create.l HWIO_PMIC_ARB5_CHNL80_WDATA0_ADDR A:0x2685010
y.create.l HWIO_PMIC_ARB5_CHNL81_WDATA0_ADDR A:0x268d010
y.create.l HWIO_PMIC_ARB5_CHNL82_WDATA0_ADDR A:0x2695010
y.create.l HWIO_PMIC_ARB5_CHNL83_WDATA0_ADDR A:0x269d010
y.create.l HWIO_PMIC_ARB5_CHNL84_WDATA0_ADDR A:0x26a5010
y.create.l HWIO_PMIC_ARB5_CHNL85_WDATA0_ADDR A:0x26ad010
y.create.l HWIO_PMIC_ARB5_CHNL86_WDATA0_ADDR A:0x26b5010
y.create.l HWIO_PMIC_ARB5_CHNL87_WDATA0_ADDR A:0x26bd010
y.create.l HWIO_PMIC_ARB5_CHNL88_WDATA0_ADDR A:0x26c5010
y.create.l HWIO_PMIC_ARB5_CHNL89_WDATA0_ADDR A:0x26cd010
y.create.l HWIO_PMIC_ARB5_CHNL90_WDATA0_ADDR A:0x26d5010
y.create.l HWIO_PMIC_ARB5_CHNL91_WDATA0_ADDR A:0x26dd010
y.create.l HWIO_PMIC_ARB5_CHNL92_WDATA0_ADDR A:0x26e5010
y.create.l HWIO_PMIC_ARB5_CHNL93_WDATA0_ADDR A:0x26ed010
y.create.l HWIO_PMIC_ARB5_CHNL94_WDATA0_ADDR A:0x26f5010
y.create.l HWIO_PMIC_ARB5_CHNL95_WDATA0_ADDR A:0x26fd010
y.create.l HWIO_PMIC_ARB5_CHNL96_WDATA0_ADDR A:0x2705010
y.create.l HWIO_PMIC_ARB5_CHNL97_WDATA0_ADDR A:0x270d010
y.create.l HWIO_PMIC_ARB5_CHNL98_WDATA0_ADDR A:0x2715010
y.create.l HWIO_PMIC_ARB5_CHNL99_WDATA0_ADDR A:0x271d010
y.create.l HWIO_PMIC_ARB5_CHNL100_WDATA0_ADDR A:0x2725010
y.create.l HWIO_PMIC_ARB5_CHNL101_WDATA0_ADDR A:0x272d010
y.create.l HWIO_PMIC_ARB5_CHNL102_WDATA0_ADDR A:0x2735010
y.create.l HWIO_PMIC_ARB5_CHNL103_WDATA0_ADDR A:0x273d010
y.create.l HWIO_PMIC_ARB5_CHNL104_WDATA0_ADDR A:0x2745010
y.create.l HWIO_PMIC_ARB5_CHNL105_WDATA0_ADDR A:0x274d010
y.create.l HWIO_PMIC_ARB5_CHNL106_WDATA0_ADDR A:0x2755010
y.create.l HWIO_PMIC_ARB5_CHNL107_WDATA0_ADDR A:0x275d010
y.create.l HWIO_PMIC_ARB5_CHNL108_WDATA0_ADDR A:0x2765010
y.create.l HWIO_PMIC_ARB5_CHNL109_WDATA0_ADDR A:0x276d010
y.create.l HWIO_PMIC_ARB5_CHNL110_WDATA0_ADDR A:0x2775010
y.create.l HWIO_PMIC_ARB5_CHNL111_WDATA0_ADDR A:0x277d010
y.create.l HWIO_PMIC_ARB5_CHNL112_WDATA0_ADDR A:0x2785010
y.create.l HWIO_PMIC_ARB5_CHNL113_WDATA0_ADDR A:0x278d010
y.create.l HWIO_PMIC_ARB5_CHNL114_WDATA0_ADDR A:0x2795010
y.create.l HWIO_PMIC_ARB5_CHNL115_WDATA0_ADDR A:0x279d010
y.create.l HWIO_PMIC_ARB5_CHNL116_WDATA0_ADDR A:0x27a5010
y.create.l HWIO_PMIC_ARB5_CHNL117_WDATA0_ADDR A:0x27ad010
y.create.l HWIO_PMIC_ARB5_CHNL118_WDATA0_ADDR A:0x27b5010
y.create.l HWIO_PMIC_ARB5_CHNL119_WDATA0_ADDR A:0x27bd010
y.create.l HWIO_PMIC_ARB5_CHNL120_WDATA0_ADDR A:0x27c5010
y.create.l HWIO_PMIC_ARB5_CHNL121_WDATA0_ADDR A:0x27cd010
y.create.l HWIO_PMIC_ARB5_CHNL122_WDATA0_ADDR A:0x27d5010
y.create.l HWIO_PMIC_ARB5_CHNL123_WDATA0_ADDR A:0x27dd010
y.create.l HWIO_PMIC_ARB5_CHNL124_WDATA0_ADDR A:0x27e5010
y.create.l HWIO_PMIC_ARB5_CHNL125_WDATA0_ADDR A:0x27ed010
y.create.l HWIO_PMIC_ARB5_CHNL126_WDATA0_ADDR A:0x27f5010
y.create.l HWIO_PMIC_ARB5_CHNL127_WDATA0_ADDR A:0x27fd010
y.create.l HWIO_PMIC_ARB5_CHNL128_WDATA0_ADDR A:0x2805010
y.create.l HWIO_PMIC_ARB5_CHNL129_WDATA0_ADDR A:0x280d010
y.create.l HWIO_PMIC_ARB5_CHNL130_WDATA0_ADDR A:0x2815010
y.create.l HWIO_PMIC_ARB5_CHNL131_WDATA0_ADDR A:0x281d010
y.create.l HWIO_PMIC_ARB5_CHNL132_WDATA0_ADDR A:0x2825010
y.create.l HWIO_PMIC_ARB5_CHNL133_WDATA0_ADDR A:0x282d010
y.create.l HWIO_PMIC_ARB5_CHNL134_WDATA0_ADDR A:0x2835010
y.create.l HWIO_PMIC_ARB5_CHNL135_WDATA0_ADDR A:0x283d010
y.create.l HWIO_PMIC_ARB5_CHNL136_WDATA0_ADDR A:0x2845010
y.create.l HWIO_PMIC_ARB5_CHNL137_WDATA0_ADDR A:0x284d010
y.create.l HWIO_PMIC_ARB5_CHNL138_WDATA0_ADDR A:0x2855010
y.create.l HWIO_PMIC_ARB5_CHNL139_WDATA0_ADDR A:0x285d010
y.create.l HWIO_PMIC_ARB5_CHNL140_WDATA0_ADDR A:0x2865010
y.create.l HWIO_PMIC_ARB5_CHNL141_WDATA0_ADDR A:0x286d010
y.create.l HWIO_PMIC_ARB5_CHNL142_WDATA0_ADDR A:0x2875010
y.create.l HWIO_PMIC_ARB5_CHNL143_WDATA0_ADDR A:0x287d010
y.create.l HWIO_PMIC_ARB5_CHNL144_WDATA0_ADDR A:0x2885010
y.create.l HWIO_PMIC_ARB5_CHNL145_WDATA0_ADDR A:0x288d010
y.create.l HWIO_PMIC_ARB5_CHNL146_WDATA0_ADDR A:0x2895010
y.create.l HWIO_PMIC_ARB5_CHNL147_WDATA0_ADDR A:0x289d010
y.create.l HWIO_PMIC_ARB5_CHNL148_WDATA0_ADDR A:0x28a5010
y.create.l HWIO_PMIC_ARB5_CHNL149_WDATA0_ADDR A:0x28ad010
y.create.l HWIO_PMIC_ARB5_CHNL150_WDATA0_ADDR A:0x28b5010
y.create.l HWIO_PMIC_ARB5_CHNL151_WDATA0_ADDR A:0x28bd010
y.create.l HWIO_PMIC_ARB5_CHNL152_WDATA0_ADDR A:0x28c5010
y.create.l HWIO_PMIC_ARB5_CHNL153_WDATA0_ADDR A:0x28cd010
y.create.l HWIO_PMIC_ARB5_CHNL154_WDATA0_ADDR A:0x28d5010
y.create.l HWIO_PMIC_ARB5_CHNL155_WDATA0_ADDR A:0x28dd010
y.create.l HWIO_PMIC_ARB5_CHNL156_WDATA0_ADDR A:0x28e5010
y.create.l HWIO_PMIC_ARB5_CHNL157_WDATA0_ADDR A:0x28ed010
y.create.l HWIO_PMIC_ARB5_CHNL158_WDATA0_ADDR A:0x28f5010
y.create.l HWIO_PMIC_ARB5_CHNL159_WDATA0_ADDR A:0x28fd010
y.create.l HWIO_PMIC_ARB5_CHNL160_WDATA0_ADDR A:0x2905010
y.create.l HWIO_PMIC_ARB5_CHNL161_WDATA0_ADDR A:0x290d010
y.create.l HWIO_PMIC_ARB5_CHNL162_WDATA0_ADDR A:0x2915010
y.create.l HWIO_PMIC_ARB5_CHNL163_WDATA0_ADDR A:0x291d010
y.create.l HWIO_PMIC_ARB5_CHNL164_WDATA0_ADDR A:0x2925010
y.create.l HWIO_PMIC_ARB5_CHNL165_WDATA0_ADDR A:0x292d010
y.create.l HWIO_PMIC_ARB5_CHNL166_WDATA0_ADDR A:0x2935010
y.create.l HWIO_PMIC_ARB5_CHNL167_WDATA0_ADDR A:0x293d010
y.create.l HWIO_PMIC_ARB5_CHNL168_WDATA0_ADDR A:0x2945010
y.create.l HWIO_PMIC_ARB5_CHNL169_WDATA0_ADDR A:0x294d010
y.create.l HWIO_PMIC_ARB5_CHNL170_WDATA0_ADDR A:0x2955010
y.create.l HWIO_PMIC_ARB5_CHNL171_WDATA0_ADDR A:0x295d010
y.create.l HWIO_PMIC_ARB5_CHNL172_WDATA0_ADDR A:0x2965010
y.create.l HWIO_PMIC_ARB5_CHNL173_WDATA0_ADDR A:0x296d010
y.create.l HWIO_PMIC_ARB5_CHNL174_WDATA0_ADDR A:0x2975010
y.create.l HWIO_PMIC_ARB5_CHNL175_WDATA0_ADDR A:0x297d010
y.create.l HWIO_PMIC_ARB5_CHNL176_WDATA0_ADDR A:0x2985010
y.create.l HWIO_PMIC_ARB5_CHNL177_WDATA0_ADDR A:0x298d010
y.create.l HWIO_PMIC_ARB5_CHNL178_WDATA0_ADDR A:0x2995010
y.create.l HWIO_PMIC_ARB5_CHNL179_WDATA0_ADDR A:0x299d010
y.create.l HWIO_PMIC_ARB5_CHNL180_WDATA0_ADDR A:0x29a5010
y.create.l HWIO_PMIC_ARB5_CHNL181_WDATA0_ADDR A:0x29ad010
y.create.l HWIO_PMIC_ARB5_CHNL182_WDATA0_ADDR A:0x29b5010
y.create.l HWIO_PMIC_ARB5_CHNL183_WDATA0_ADDR A:0x29bd010
y.create.l HWIO_PMIC_ARB5_CHNL184_WDATA0_ADDR A:0x29c5010
y.create.l HWIO_PMIC_ARB5_CHNL185_WDATA0_ADDR A:0x29cd010
y.create.l HWIO_PMIC_ARB5_CHNL186_WDATA0_ADDR A:0x29d5010
y.create.l HWIO_PMIC_ARB5_CHNL187_WDATA0_ADDR A:0x29dd010
y.create.l HWIO_PMIC_ARB5_CHNL188_WDATA0_ADDR A:0x29e5010
y.create.l HWIO_PMIC_ARB5_CHNL189_WDATA0_ADDR A:0x29ed010
y.create.l HWIO_PMIC_ARB5_CHNL190_WDATA0_ADDR A:0x29f5010
y.create.l HWIO_PMIC_ARB5_CHNL191_WDATA0_ADDR A:0x29fd010
y.create.l HWIO_PMIC_ARB5_CHNL192_WDATA0_ADDR A:0x2a05010
y.create.l HWIO_PMIC_ARB5_CHNL193_WDATA0_ADDR A:0x2a0d010
y.create.l HWIO_PMIC_ARB5_CHNL194_WDATA0_ADDR A:0x2a15010
y.create.l HWIO_PMIC_ARB5_CHNL195_WDATA0_ADDR A:0x2a1d010
y.create.l HWIO_PMIC_ARB5_CHNL196_WDATA0_ADDR A:0x2a25010
y.create.l HWIO_PMIC_ARB5_CHNL197_WDATA0_ADDR A:0x2a2d010
y.create.l HWIO_PMIC_ARB5_CHNL198_WDATA0_ADDR A:0x2a35010
y.create.l HWIO_PMIC_ARB5_CHNL199_WDATA0_ADDR A:0x2a3d010
y.create.l HWIO_PMIC_ARB5_CHNL200_WDATA0_ADDR A:0x2a45010
y.create.l HWIO_PMIC_ARB5_CHNL201_WDATA0_ADDR A:0x2a4d010
y.create.l HWIO_PMIC_ARB5_CHNL202_WDATA0_ADDR A:0x2a55010
y.create.l HWIO_PMIC_ARB5_CHNL203_WDATA0_ADDR A:0x2a5d010
y.create.l HWIO_PMIC_ARB5_CHNL204_WDATA0_ADDR A:0x2a65010
y.create.l HWIO_PMIC_ARB5_CHNL205_WDATA0_ADDR A:0x2a6d010
y.create.l HWIO_PMIC_ARB5_CHNL206_WDATA0_ADDR A:0x2a75010
y.create.l HWIO_PMIC_ARB5_CHNL207_WDATA0_ADDR A:0x2a7d010
y.create.l HWIO_PMIC_ARB5_CHNL208_WDATA0_ADDR A:0x2a85010
y.create.l HWIO_PMIC_ARB5_CHNL209_WDATA0_ADDR A:0x2a8d010
y.create.l HWIO_PMIC_ARB5_CHNL210_WDATA0_ADDR A:0x2a95010
y.create.l HWIO_PMIC_ARB5_CHNL211_WDATA0_ADDR A:0x2a9d010
y.create.l HWIO_PMIC_ARB5_CHNL212_WDATA0_ADDR A:0x2aa5010
y.create.l HWIO_PMIC_ARB5_CHNL213_WDATA0_ADDR A:0x2aad010
y.create.l HWIO_PMIC_ARB5_CHNL214_WDATA0_ADDR A:0x2ab5010
y.create.l HWIO_PMIC_ARB5_CHNL215_WDATA0_ADDR A:0x2abd010
y.create.l HWIO_PMIC_ARB5_CHNL216_WDATA0_ADDR A:0x2ac5010
y.create.l HWIO_PMIC_ARB5_CHNL217_WDATA0_ADDR A:0x2acd010
y.create.l HWIO_PMIC_ARB5_CHNL218_WDATA0_ADDR A:0x2ad5010
y.create.l HWIO_PMIC_ARB5_CHNL219_WDATA0_ADDR A:0x2add010
y.create.l HWIO_PMIC_ARB5_CHNL220_WDATA0_ADDR A:0x2ae5010
y.create.l HWIO_PMIC_ARB5_CHNL221_WDATA0_ADDR A:0x2aed010
y.create.l HWIO_PMIC_ARB5_CHNL222_WDATA0_ADDR A:0x2af5010
y.create.l HWIO_PMIC_ARB5_CHNL223_WDATA0_ADDR A:0x2afd010
y.create.l HWIO_PMIC_ARB5_CHNL224_WDATA0_ADDR A:0x2b05010
y.create.l HWIO_PMIC_ARB5_CHNL225_WDATA0_ADDR A:0x2b0d010
y.create.l HWIO_PMIC_ARB5_CHNL226_WDATA0_ADDR A:0x2b15010
y.create.l HWIO_PMIC_ARB5_CHNL227_WDATA0_ADDR A:0x2b1d010
y.create.l HWIO_PMIC_ARB5_CHNL228_WDATA0_ADDR A:0x2b25010
y.create.l HWIO_PMIC_ARB5_CHNL229_WDATA0_ADDR A:0x2b2d010
y.create.l HWIO_PMIC_ARB5_CHNL230_WDATA0_ADDR A:0x2b35010
y.create.l HWIO_PMIC_ARB5_CHNL231_WDATA0_ADDR A:0x2b3d010
y.create.l HWIO_PMIC_ARB5_CHNL232_WDATA0_ADDR A:0x2b45010
y.create.l HWIO_PMIC_ARB5_CHNL233_WDATA0_ADDR A:0x2b4d010
y.create.l HWIO_PMIC_ARB5_CHNL234_WDATA0_ADDR A:0x2b55010
y.create.l HWIO_PMIC_ARB5_CHNL235_WDATA0_ADDR A:0x2b5d010
y.create.l HWIO_PMIC_ARB5_CHNL236_WDATA0_ADDR A:0x2b65010
y.create.l HWIO_PMIC_ARB5_CHNL237_WDATA0_ADDR A:0x2b6d010
y.create.l HWIO_PMIC_ARB5_CHNL238_WDATA0_ADDR A:0x2b75010
y.create.l HWIO_PMIC_ARB5_CHNL239_WDATA0_ADDR A:0x2b7d010
y.create.l HWIO_PMIC_ARB5_CHNL240_WDATA0_ADDR A:0x2b85010
y.create.l HWIO_PMIC_ARB5_CHNL241_WDATA0_ADDR A:0x2b8d010
y.create.l HWIO_PMIC_ARB5_CHNL242_WDATA0_ADDR A:0x2b95010
y.create.l HWIO_PMIC_ARB5_CHNL243_WDATA0_ADDR A:0x2b9d010
y.create.l HWIO_PMIC_ARB5_CHNL244_WDATA0_ADDR A:0x2ba5010
y.create.l HWIO_PMIC_ARB5_CHNL245_WDATA0_ADDR A:0x2bad010
y.create.l HWIO_PMIC_ARB5_CHNL246_WDATA0_ADDR A:0x2bb5010
y.create.l HWIO_PMIC_ARB5_CHNL247_WDATA0_ADDR A:0x2bbd010
y.create.l HWIO_PMIC_ARB5_CHNL248_WDATA0_ADDR A:0x2bc5010
y.create.l HWIO_PMIC_ARB5_CHNL249_WDATA0_ADDR A:0x2bcd010
y.create.l HWIO_PMIC_ARB5_CHNL250_WDATA0_ADDR A:0x2bd5010
y.create.l HWIO_PMIC_ARB5_CHNL251_WDATA0_ADDR A:0x2bdd010
y.create.l HWIO_PMIC_ARB5_CHNL252_WDATA0_ADDR A:0x2be5010
y.create.l HWIO_PMIC_ARB5_CHNL253_WDATA0_ADDR A:0x2bed010
y.create.l HWIO_PMIC_ARB5_CHNL254_WDATA0_ADDR A:0x2bf5010
y.create.l HWIO_PMIC_ARB5_CHNL255_WDATA0_ADDR A:0x2bfd010
y.create.l HWIO_PMIC_ARB6_CHNL0_WDATA0_ADDR A:0x2406010
y.create.l HWIO_PMIC_ARB6_CHNL1_WDATA0_ADDR A:0x240e010
y.create.l HWIO_PMIC_ARB6_CHNL2_WDATA0_ADDR A:0x2416010
y.create.l HWIO_PMIC_ARB6_CHNL3_WDATA0_ADDR A:0x241e010
y.create.l HWIO_PMIC_ARB6_CHNL4_WDATA0_ADDR A:0x2426010
y.create.l HWIO_PMIC_ARB6_CHNL5_WDATA0_ADDR A:0x242e010
y.create.l HWIO_PMIC_ARB6_CHNL6_WDATA0_ADDR A:0x2436010
y.create.l HWIO_PMIC_ARB6_CHNL7_WDATA0_ADDR A:0x243e010
y.create.l HWIO_PMIC_ARB6_CHNL8_WDATA0_ADDR A:0x2446010
y.create.l HWIO_PMIC_ARB6_CHNL9_WDATA0_ADDR A:0x244e010
y.create.l HWIO_PMIC_ARB6_CHNL10_WDATA0_ADDR A:0x2456010
y.create.l HWIO_PMIC_ARB6_CHNL11_WDATA0_ADDR A:0x245e010
y.create.l HWIO_PMIC_ARB6_CHNL12_WDATA0_ADDR A:0x2466010
y.create.l HWIO_PMIC_ARB6_CHNL13_WDATA0_ADDR A:0x246e010
y.create.l HWIO_PMIC_ARB6_CHNL14_WDATA0_ADDR A:0x2476010
y.create.l HWIO_PMIC_ARB6_CHNL15_WDATA0_ADDR A:0x247e010
y.create.l HWIO_PMIC_ARB6_CHNL16_WDATA0_ADDR A:0x2486010
y.create.l HWIO_PMIC_ARB6_CHNL17_WDATA0_ADDR A:0x248e010
y.create.l HWIO_PMIC_ARB6_CHNL18_WDATA0_ADDR A:0x2496010
y.create.l HWIO_PMIC_ARB6_CHNL19_WDATA0_ADDR A:0x249e010
y.create.l HWIO_PMIC_ARB6_CHNL20_WDATA0_ADDR A:0x24a6010
y.create.l HWIO_PMIC_ARB6_CHNL21_WDATA0_ADDR A:0x24ae010
y.create.l HWIO_PMIC_ARB6_CHNL22_WDATA0_ADDR A:0x24b6010
y.create.l HWIO_PMIC_ARB6_CHNL23_WDATA0_ADDR A:0x24be010
y.create.l HWIO_PMIC_ARB6_CHNL24_WDATA0_ADDR A:0x24c6010
y.create.l HWIO_PMIC_ARB6_CHNL25_WDATA0_ADDR A:0x24ce010
y.create.l HWIO_PMIC_ARB6_CHNL26_WDATA0_ADDR A:0x24d6010
y.create.l HWIO_PMIC_ARB6_CHNL27_WDATA0_ADDR A:0x24de010
y.create.l HWIO_PMIC_ARB6_CHNL28_WDATA0_ADDR A:0x24e6010
y.create.l HWIO_PMIC_ARB6_CHNL29_WDATA0_ADDR A:0x24ee010
y.create.l HWIO_PMIC_ARB6_CHNL30_WDATA0_ADDR A:0x24f6010
y.create.l HWIO_PMIC_ARB6_CHNL31_WDATA0_ADDR A:0x24fe010
y.create.l HWIO_PMIC_ARB6_CHNL32_WDATA0_ADDR A:0x2506010
y.create.l HWIO_PMIC_ARB6_CHNL33_WDATA0_ADDR A:0x250e010
y.create.l HWIO_PMIC_ARB6_CHNL34_WDATA0_ADDR A:0x2516010
y.create.l HWIO_PMIC_ARB6_CHNL35_WDATA0_ADDR A:0x251e010
y.create.l HWIO_PMIC_ARB6_CHNL36_WDATA0_ADDR A:0x2526010
y.create.l HWIO_PMIC_ARB6_CHNL37_WDATA0_ADDR A:0x252e010
y.create.l HWIO_PMIC_ARB6_CHNL38_WDATA0_ADDR A:0x2536010
y.create.l HWIO_PMIC_ARB6_CHNL39_WDATA0_ADDR A:0x253e010
y.create.l HWIO_PMIC_ARB6_CHNL40_WDATA0_ADDR A:0x2546010
y.create.l HWIO_PMIC_ARB6_CHNL41_WDATA0_ADDR A:0x254e010
y.create.l HWIO_PMIC_ARB6_CHNL42_WDATA0_ADDR A:0x2556010
y.create.l HWIO_PMIC_ARB6_CHNL43_WDATA0_ADDR A:0x255e010
y.create.l HWIO_PMIC_ARB6_CHNL44_WDATA0_ADDR A:0x2566010
y.create.l HWIO_PMIC_ARB6_CHNL45_WDATA0_ADDR A:0x256e010
y.create.l HWIO_PMIC_ARB6_CHNL46_WDATA0_ADDR A:0x2576010
y.create.l HWIO_PMIC_ARB6_CHNL47_WDATA0_ADDR A:0x257e010
y.create.l HWIO_PMIC_ARB6_CHNL48_WDATA0_ADDR A:0x2586010
y.create.l HWIO_PMIC_ARB6_CHNL49_WDATA0_ADDR A:0x258e010
y.create.l HWIO_PMIC_ARB6_CHNL50_WDATA0_ADDR A:0x2596010
y.create.l HWIO_PMIC_ARB6_CHNL51_WDATA0_ADDR A:0x259e010
y.create.l HWIO_PMIC_ARB6_CHNL52_WDATA0_ADDR A:0x25a6010
y.create.l HWIO_PMIC_ARB6_CHNL53_WDATA0_ADDR A:0x25ae010
y.create.l HWIO_PMIC_ARB6_CHNL54_WDATA0_ADDR A:0x25b6010
y.create.l HWIO_PMIC_ARB6_CHNL55_WDATA0_ADDR A:0x25be010
y.create.l HWIO_PMIC_ARB6_CHNL56_WDATA0_ADDR A:0x25c6010
y.create.l HWIO_PMIC_ARB6_CHNL57_WDATA0_ADDR A:0x25ce010
y.create.l HWIO_PMIC_ARB6_CHNL58_WDATA0_ADDR A:0x25d6010
y.create.l HWIO_PMIC_ARB6_CHNL59_WDATA0_ADDR A:0x25de010
y.create.l HWIO_PMIC_ARB6_CHNL60_WDATA0_ADDR A:0x25e6010
y.create.l HWIO_PMIC_ARB6_CHNL61_WDATA0_ADDR A:0x25ee010
y.create.l HWIO_PMIC_ARB6_CHNL62_WDATA0_ADDR A:0x25f6010
y.create.l HWIO_PMIC_ARB6_CHNL63_WDATA0_ADDR A:0x25fe010
y.create.l HWIO_PMIC_ARB6_CHNL64_WDATA0_ADDR A:0x2606010
y.create.l HWIO_PMIC_ARB6_CHNL65_WDATA0_ADDR A:0x260e010
y.create.l HWIO_PMIC_ARB6_CHNL66_WDATA0_ADDR A:0x2616010
y.create.l HWIO_PMIC_ARB6_CHNL67_WDATA0_ADDR A:0x261e010
y.create.l HWIO_PMIC_ARB6_CHNL68_WDATA0_ADDR A:0x2626010
y.create.l HWIO_PMIC_ARB6_CHNL69_WDATA0_ADDR A:0x262e010
y.create.l HWIO_PMIC_ARB6_CHNL70_WDATA0_ADDR A:0x2636010
y.create.l HWIO_PMIC_ARB6_CHNL71_WDATA0_ADDR A:0x263e010
y.create.l HWIO_PMIC_ARB6_CHNL72_WDATA0_ADDR A:0x2646010
y.create.l HWIO_PMIC_ARB6_CHNL73_WDATA0_ADDR A:0x264e010
y.create.l HWIO_PMIC_ARB6_CHNL74_WDATA0_ADDR A:0x2656010
y.create.l HWIO_PMIC_ARB6_CHNL75_WDATA0_ADDR A:0x265e010
y.create.l HWIO_PMIC_ARB6_CHNL76_WDATA0_ADDR A:0x2666010
y.create.l HWIO_PMIC_ARB6_CHNL77_WDATA0_ADDR A:0x266e010
y.create.l HWIO_PMIC_ARB6_CHNL78_WDATA0_ADDR A:0x2676010
y.create.l HWIO_PMIC_ARB6_CHNL79_WDATA0_ADDR A:0x267e010
y.create.l HWIO_PMIC_ARB6_CHNL80_WDATA0_ADDR A:0x2686010
y.create.l HWIO_PMIC_ARB6_CHNL81_WDATA0_ADDR A:0x268e010
y.create.l HWIO_PMIC_ARB6_CHNL82_WDATA0_ADDR A:0x2696010
y.create.l HWIO_PMIC_ARB6_CHNL83_WDATA0_ADDR A:0x269e010
y.create.l HWIO_PMIC_ARB6_CHNL84_WDATA0_ADDR A:0x26a6010
y.create.l HWIO_PMIC_ARB6_CHNL85_WDATA0_ADDR A:0x26ae010
y.create.l HWIO_PMIC_ARB6_CHNL86_WDATA0_ADDR A:0x26b6010
y.create.l HWIO_PMIC_ARB6_CHNL87_WDATA0_ADDR A:0x26be010
y.create.l HWIO_PMIC_ARB6_CHNL88_WDATA0_ADDR A:0x26c6010
y.create.l HWIO_PMIC_ARB6_CHNL89_WDATA0_ADDR A:0x26ce010
y.create.l HWIO_PMIC_ARB6_CHNL90_WDATA0_ADDR A:0x26d6010
y.create.l HWIO_PMIC_ARB6_CHNL91_WDATA0_ADDR A:0x26de010
y.create.l HWIO_PMIC_ARB6_CHNL92_WDATA0_ADDR A:0x26e6010
y.create.l HWIO_PMIC_ARB6_CHNL93_WDATA0_ADDR A:0x26ee010
y.create.l HWIO_PMIC_ARB6_CHNL94_WDATA0_ADDR A:0x26f6010
y.create.l HWIO_PMIC_ARB6_CHNL95_WDATA0_ADDR A:0x26fe010
y.create.l HWIO_PMIC_ARB6_CHNL96_WDATA0_ADDR A:0x2706010
y.create.l HWIO_PMIC_ARB6_CHNL97_WDATA0_ADDR A:0x270e010
y.create.l HWIO_PMIC_ARB6_CHNL98_WDATA0_ADDR A:0x2716010
y.create.l HWIO_PMIC_ARB6_CHNL99_WDATA0_ADDR A:0x271e010
y.create.l HWIO_PMIC_ARB6_CHNL100_WDATA0_ADDR A:0x2726010
y.create.l HWIO_PMIC_ARB6_CHNL101_WDATA0_ADDR A:0x272e010
y.create.l HWIO_PMIC_ARB6_CHNL102_WDATA0_ADDR A:0x2736010
y.create.l HWIO_PMIC_ARB6_CHNL103_WDATA0_ADDR A:0x273e010
y.create.l HWIO_PMIC_ARB6_CHNL104_WDATA0_ADDR A:0x2746010
y.create.l HWIO_PMIC_ARB6_CHNL105_WDATA0_ADDR A:0x274e010
y.create.l HWIO_PMIC_ARB6_CHNL106_WDATA0_ADDR A:0x2756010
y.create.l HWIO_PMIC_ARB6_CHNL107_WDATA0_ADDR A:0x275e010
y.create.l HWIO_PMIC_ARB6_CHNL108_WDATA0_ADDR A:0x2766010
y.create.l HWIO_PMIC_ARB6_CHNL109_WDATA0_ADDR A:0x276e010
y.create.l HWIO_PMIC_ARB6_CHNL110_WDATA0_ADDR A:0x2776010
y.create.l HWIO_PMIC_ARB6_CHNL111_WDATA0_ADDR A:0x277e010
y.create.l HWIO_PMIC_ARB6_CHNL112_WDATA0_ADDR A:0x2786010
y.create.l HWIO_PMIC_ARB6_CHNL113_WDATA0_ADDR A:0x278e010
y.create.l HWIO_PMIC_ARB6_CHNL114_WDATA0_ADDR A:0x2796010
y.create.l HWIO_PMIC_ARB6_CHNL115_WDATA0_ADDR A:0x279e010
y.create.l HWIO_PMIC_ARB6_CHNL116_WDATA0_ADDR A:0x27a6010
y.create.l HWIO_PMIC_ARB6_CHNL117_WDATA0_ADDR A:0x27ae010
y.create.l HWIO_PMIC_ARB6_CHNL118_WDATA0_ADDR A:0x27b6010
y.create.l HWIO_PMIC_ARB6_CHNL119_WDATA0_ADDR A:0x27be010
y.create.l HWIO_PMIC_ARB6_CHNL120_WDATA0_ADDR A:0x27c6010
y.create.l HWIO_PMIC_ARB6_CHNL121_WDATA0_ADDR A:0x27ce010
y.create.l HWIO_PMIC_ARB6_CHNL122_WDATA0_ADDR A:0x27d6010
y.create.l HWIO_PMIC_ARB6_CHNL123_WDATA0_ADDR A:0x27de010
y.create.l HWIO_PMIC_ARB6_CHNL124_WDATA0_ADDR A:0x27e6010
y.create.l HWIO_PMIC_ARB6_CHNL125_WDATA0_ADDR A:0x27ee010
y.create.l HWIO_PMIC_ARB6_CHNL126_WDATA0_ADDR A:0x27f6010
y.create.l HWIO_PMIC_ARB6_CHNL127_WDATA0_ADDR A:0x27fe010
y.create.l HWIO_PMIC_ARB6_CHNL128_WDATA0_ADDR A:0x2806010
y.create.l HWIO_PMIC_ARB6_CHNL129_WDATA0_ADDR A:0x280e010
y.create.l HWIO_PMIC_ARB6_CHNL130_WDATA0_ADDR A:0x2816010
y.create.l HWIO_PMIC_ARB6_CHNL131_WDATA0_ADDR A:0x281e010
y.create.l HWIO_PMIC_ARB6_CHNL132_WDATA0_ADDR A:0x2826010
y.create.l HWIO_PMIC_ARB6_CHNL133_WDATA0_ADDR A:0x282e010
y.create.l HWIO_PMIC_ARB6_CHNL134_WDATA0_ADDR A:0x2836010
y.create.l HWIO_PMIC_ARB6_CHNL135_WDATA0_ADDR A:0x283e010
y.create.l HWIO_PMIC_ARB6_CHNL136_WDATA0_ADDR A:0x2846010
y.create.l HWIO_PMIC_ARB6_CHNL137_WDATA0_ADDR A:0x284e010
y.create.l HWIO_PMIC_ARB6_CHNL138_WDATA0_ADDR A:0x2856010
y.create.l HWIO_PMIC_ARB6_CHNL139_WDATA0_ADDR A:0x285e010
y.create.l HWIO_PMIC_ARB6_CHNL140_WDATA0_ADDR A:0x2866010
y.create.l HWIO_PMIC_ARB6_CHNL141_WDATA0_ADDR A:0x286e010
y.create.l HWIO_PMIC_ARB6_CHNL142_WDATA0_ADDR A:0x2876010
y.create.l HWIO_PMIC_ARB6_CHNL143_WDATA0_ADDR A:0x287e010
y.create.l HWIO_PMIC_ARB6_CHNL144_WDATA0_ADDR A:0x2886010
y.create.l HWIO_PMIC_ARB6_CHNL145_WDATA0_ADDR A:0x288e010
y.create.l HWIO_PMIC_ARB6_CHNL146_WDATA0_ADDR A:0x2896010
y.create.l HWIO_PMIC_ARB6_CHNL147_WDATA0_ADDR A:0x289e010
y.create.l HWIO_PMIC_ARB6_CHNL148_WDATA0_ADDR A:0x28a6010
y.create.l HWIO_PMIC_ARB6_CHNL149_WDATA0_ADDR A:0x28ae010
y.create.l HWIO_PMIC_ARB6_CHNL150_WDATA0_ADDR A:0x28b6010
y.create.l HWIO_PMIC_ARB6_CHNL151_WDATA0_ADDR A:0x28be010
y.create.l HWIO_PMIC_ARB6_CHNL152_WDATA0_ADDR A:0x28c6010
y.create.l HWIO_PMIC_ARB6_CHNL153_WDATA0_ADDR A:0x28ce010
y.create.l HWIO_PMIC_ARB6_CHNL154_WDATA0_ADDR A:0x28d6010
y.create.l HWIO_PMIC_ARB6_CHNL155_WDATA0_ADDR A:0x28de010
y.create.l HWIO_PMIC_ARB6_CHNL156_WDATA0_ADDR A:0x28e6010
y.create.l HWIO_PMIC_ARB6_CHNL157_WDATA0_ADDR A:0x28ee010
y.create.l HWIO_PMIC_ARB6_CHNL158_WDATA0_ADDR A:0x28f6010
y.create.l HWIO_PMIC_ARB6_CHNL159_WDATA0_ADDR A:0x28fe010
y.create.l HWIO_PMIC_ARB6_CHNL160_WDATA0_ADDR A:0x2906010
y.create.l HWIO_PMIC_ARB6_CHNL161_WDATA0_ADDR A:0x290e010
y.create.l HWIO_PMIC_ARB6_CHNL162_WDATA0_ADDR A:0x2916010
y.create.l HWIO_PMIC_ARB6_CHNL163_WDATA0_ADDR A:0x291e010
y.create.l HWIO_PMIC_ARB6_CHNL164_WDATA0_ADDR A:0x2926010
y.create.l HWIO_PMIC_ARB6_CHNL165_WDATA0_ADDR A:0x292e010
y.create.l HWIO_PMIC_ARB6_CHNL166_WDATA0_ADDR A:0x2936010
y.create.l HWIO_PMIC_ARB6_CHNL167_WDATA0_ADDR A:0x293e010
y.create.l HWIO_PMIC_ARB6_CHNL168_WDATA0_ADDR A:0x2946010
y.create.l HWIO_PMIC_ARB6_CHNL169_WDATA0_ADDR A:0x294e010
y.create.l HWIO_PMIC_ARB6_CHNL170_WDATA0_ADDR A:0x2956010
y.create.l HWIO_PMIC_ARB6_CHNL171_WDATA0_ADDR A:0x295e010
y.create.l HWIO_PMIC_ARB6_CHNL172_WDATA0_ADDR A:0x2966010
y.create.l HWIO_PMIC_ARB6_CHNL173_WDATA0_ADDR A:0x296e010
y.create.l HWIO_PMIC_ARB6_CHNL174_WDATA0_ADDR A:0x2976010
y.create.l HWIO_PMIC_ARB6_CHNL175_WDATA0_ADDR A:0x297e010
y.create.l HWIO_PMIC_ARB6_CHNL176_WDATA0_ADDR A:0x2986010
y.create.l HWIO_PMIC_ARB6_CHNL177_WDATA0_ADDR A:0x298e010
y.create.l HWIO_PMIC_ARB6_CHNL178_WDATA0_ADDR A:0x2996010
y.create.l HWIO_PMIC_ARB6_CHNL179_WDATA0_ADDR A:0x299e010
y.create.l HWIO_PMIC_ARB6_CHNL180_WDATA0_ADDR A:0x29a6010
y.create.l HWIO_PMIC_ARB6_CHNL181_WDATA0_ADDR A:0x29ae010
y.create.l HWIO_PMIC_ARB6_CHNL182_WDATA0_ADDR A:0x29b6010
y.create.l HWIO_PMIC_ARB6_CHNL183_WDATA0_ADDR A:0x29be010
y.create.l HWIO_PMIC_ARB6_CHNL184_WDATA0_ADDR A:0x29c6010
y.create.l HWIO_PMIC_ARB6_CHNL185_WDATA0_ADDR A:0x29ce010
y.create.l HWIO_PMIC_ARB6_CHNL186_WDATA0_ADDR A:0x29d6010
y.create.l HWIO_PMIC_ARB6_CHNL187_WDATA0_ADDR A:0x29de010
y.create.l HWIO_PMIC_ARB6_CHNL188_WDATA0_ADDR A:0x29e6010
y.create.l HWIO_PMIC_ARB6_CHNL189_WDATA0_ADDR A:0x29ee010
y.create.l HWIO_PMIC_ARB6_CHNL190_WDATA0_ADDR A:0x29f6010
y.create.l HWIO_PMIC_ARB6_CHNL191_WDATA0_ADDR A:0x29fe010
y.create.l HWIO_PMIC_ARB6_CHNL192_WDATA0_ADDR A:0x2a06010
y.create.l HWIO_PMIC_ARB6_CHNL193_WDATA0_ADDR A:0x2a0e010
y.create.l HWIO_PMIC_ARB6_CHNL194_WDATA0_ADDR A:0x2a16010
y.create.l HWIO_PMIC_ARB6_CHNL195_WDATA0_ADDR A:0x2a1e010
y.create.l HWIO_PMIC_ARB6_CHNL196_WDATA0_ADDR A:0x2a26010
y.create.l HWIO_PMIC_ARB6_CHNL197_WDATA0_ADDR A:0x2a2e010
y.create.l HWIO_PMIC_ARB6_CHNL198_WDATA0_ADDR A:0x2a36010
y.create.l HWIO_PMIC_ARB6_CHNL199_WDATA0_ADDR A:0x2a3e010
y.create.l HWIO_PMIC_ARB6_CHNL200_WDATA0_ADDR A:0x2a46010
y.create.l HWIO_PMIC_ARB6_CHNL201_WDATA0_ADDR A:0x2a4e010
y.create.l HWIO_PMIC_ARB6_CHNL202_WDATA0_ADDR A:0x2a56010
y.create.l HWIO_PMIC_ARB6_CHNL203_WDATA0_ADDR A:0x2a5e010
y.create.l HWIO_PMIC_ARB6_CHNL204_WDATA0_ADDR A:0x2a66010
y.create.l HWIO_PMIC_ARB6_CHNL205_WDATA0_ADDR A:0x2a6e010
y.create.l HWIO_PMIC_ARB6_CHNL206_WDATA0_ADDR A:0x2a76010
y.create.l HWIO_PMIC_ARB6_CHNL207_WDATA0_ADDR A:0x2a7e010
y.create.l HWIO_PMIC_ARB6_CHNL208_WDATA0_ADDR A:0x2a86010
y.create.l HWIO_PMIC_ARB6_CHNL209_WDATA0_ADDR A:0x2a8e010
y.create.l HWIO_PMIC_ARB6_CHNL210_WDATA0_ADDR A:0x2a96010
y.create.l HWIO_PMIC_ARB6_CHNL211_WDATA0_ADDR A:0x2a9e010
y.create.l HWIO_PMIC_ARB6_CHNL212_WDATA0_ADDR A:0x2aa6010
y.create.l HWIO_PMIC_ARB6_CHNL213_WDATA0_ADDR A:0x2aae010
y.create.l HWIO_PMIC_ARB6_CHNL214_WDATA0_ADDR A:0x2ab6010
y.create.l HWIO_PMIC_ARB6_CHNL215_WDATA0_ADDR A:0x2abe010
y.create.l HWIO_PMIC_ARB6_CHNL216_WDATA0_ADDR A:0x2ac6010
y.create.l HWIO_PMIC_ARB6_CHNL217_WDATA0_ADDR A:0x2ace010
y.create.l HWIO_PMIC_ARB6_CHNL218_WDATA0_ADDR A:0x2ad6010
y.create.l HWIO_PMIC_ARB6_CHNL219_WDATA0_ADDR A:0x2ade010
y.create.l HWIO_PMIC_ARB6_CHNL220_WDATA0_ADDR A:0x2ae6010
y.create.l HWIO_PMIC_ARB6_CHNL221_WDATA0_ADDR A:0x2aee010
y.create.l HWIO_PMIC_ARB6_CHNL222_WDATA0_ADDR A:0x2af6010
y.create.l HWIO_PMIC_ARB6_CHNL223_WDATA0_ADDR A:0x2afe010
y.create.l HWIO_PMIC_ARB6_CHNL224_WDATA0_ADDR A:0x2b06010
y.create.l HWIO_PMIC_ARB6_CHNL225_WDATA0_ADDR A:0x2b0e010
y.create.l HWIO_PMIC_ARB6_CHNL226_WDATA0_ADDR A:0x2b16010
y.create.l HWIO_PMIC_ARB6_CHNL227_WDATA0_ADDR A:0x2b1e010
y.create.l HWIO_PMIC_ARB6_CHNL228_WDATA0_ADDR A:0x2b26010
y.create.l HWIO_PMIC_ARB6_CHNL229_WDATA0_ADDR A:0x2b2e010
y.create.l HWIO_PMIC_ARB6_CHNL230_WDATA0_ADDR A:0x2b36010
y.create.l HWIO_PMIC_ARB6_CHNL231_WDATA0_ADDR A:0x2b3e010
y.create.l HWIO_PMIC_ARB6_CHNL232_WDATA0_ADDR A:0x2b46010
y.create.l HWIO_PMIC_ARB6_CHNL233_WDATA0_ADDR A:0x2b4e010
y.create.l HWIO_PMIC_ARB6_CHNL234_WDATA0_ADDR A:0x2b56010
y.create.l HWIO_PMIC_ARB6_CHNL235_WDATA0_ADDR A:0x2b5e010
y.create.l HWIO_PMIC_ARB6_CHNL236_WDATA0_ADDR A:0x2b66010
y.create.l HWIO_PMIC_ARB6_CHNL237_WDATA0_ADDR A:0x2b6e010
y.create.l HWIO_PMIC_ARB6_CHNL238_WDATA0_ADDR A:0x2b76010
y.create.l HWIO_PMIC_ARB6_CHNL239_WDATA0_ADDR A:0x2b7e010
y.create.l HWIO_PMIC_ARB6_CHNL240_WDATA0_ADDR A:0x2b86010
y.create.l HWIO_PMIC_ARB6_CHNL241_WDATA0_ADDR A:0x2b8e010
y.create.l HWIO_PMIC_ARB6_CHNL242_WDATA0_ADDR A:0x2b96010
y.create.l HWIO_PMIC_ARB6_CHNL243_WDATA0_ADDR A:0x2b9e010
y.create.l HWIO_PMIC_ARB6_CHNL244_WDATA0_ADDR A:0x2ba6010
y.create.l HWIO_PMIC_ARB6_CHNL245_WDATA0_ADDR A:0x2bae010
y.create.l HWIO_PMIC_ARB6_CHNL246_WDATA0_ADDR A:0x2bb6010
y.create.l HWIO_PMIC_ARB6_CHNL247_WDATA0_ADDR A:0x2bbe010
y.create.l HWIO_PMIC_ARB6_CHNL248_WDATA0_ADDR A:0x2bc6010
y.create.l HWIO_PMIC_ARB6_CHNL249_WDATA0_ADDR A:0x2bce010
y.create.l HWIO_PMIC_ARB6_CHNL250_WDATA0_ADDR A:0x2bd6010
y.create.l HWIO_PMIC_ARB6_CHNL251_WDATA0_ADDR A:0x2bde010
y.create.l HWIO_PMIC_ARB6_CHNL252_WDATA0_ADDR A:0x2be6010
y.create.l HWIO_PMIC_ARB6_CHNL253_WDATA0_ADDR A:0x2bee010
y.create.l HWIO_PMIC_ARB6_CHNL254_WDATA0_ADDR A:0x2bf6010
y.create.l HWIO_PMIC_ARB6_CHNL255_WDATA0_ADDR A:0x2bfe010
y.create.l HWIO_PMIC_ARB0_CHNL0_WDATA1_ADDR A:0x2400014
y.create.l HWIO_PMIC_ARB0_CHNL1_WDATA1_ADDR A:0x2408014
y.create.l HWIO_PMIC_ARB0_CHNL2_WDATA1_ADDR A:0x2410014
y.create.l HWIO_PMIC_ARB0_CHNL3_WDATA1_ADDR A:0x2418014
y.create.l HWIO_PMIC_ARB0_CHNL4_WDATA1_ADDR A:0x2420014
y.create.l HWIO_PMIC_ARB0_CHNL5_WDATA1_ADDR A:0x2428014
y.create.l HWIO_PMIC_ARB0_CHNL6_WDATA1_ADDR A:0x2430014
y.create.l HWIO_PMIC_ARB0_CHNL7_WDATA1_ADDR A:0x2438014
y.create.l HWIO_PMIC_ARB0_CHNL8_WDATA1_ADDR A:0x2440014
y.create.l HWIO_PMIC_ARB0_CHNL9_WDATA1_ADDR A:0x2448014
y.create.l HWIO_PMIC_ARB0_CHNL10_WDATA1_ADDR A:0x2450014
y.create.l HWIO_PMIC_ARB0_CHNL11_WDATA1_ADDR A:0x2458014
y.create.l HWIO_PMIC_ARB0_CHNL12_WDATA1_ADDR A:0x2460014
y.create.l HWIO_PMIC_ARB0_CHNL13_WDATA1_ADDR A:0x2468014
y.create.l HWIO_PMIC_ARB0_CHNL14_WDATA1_ADDR A:0x2470014
y.create.l HWIO_PMIC_ARB0_CHNL15_WDATA1_ADDR A:0x2478014
y.create.l HWIO_PMIC_ARB0_CHNL16_WDATA1_ADDR A:0x2480014
y.create.l HWIO_PMIC_ARB0_CHNL17_WDATA1_ADDR A:0x2488014
y.create.l HWIO_PMIC_ARB0_CHNL18_WDATA1_ADDR A:0x2490014
y.create.l HWIO_PMIC_ARB0_CHNL19_WDATA1_ADDR A:0x2498014
y.create.l HWIO_PMIC_ARB0_CHNL20_WDATA1_ADDR A:0x24a0014
y.create.l HWIO_PMIC_ARB0_CHNL21_WDATA1_ADDR A:0x24a8014
y.create.l HWIO_PMIC_ARB0_CHNL22_WDATA1_ADDR A:0x24b0014
y.create.l HWIO_PMIC_ARB0_CHNL23_WDATA1_ADDR A:0x24b8014
y.create.l HWIO_PMIC_ARB0_CHNL24_WDATA1_ADDR A:0x24c0014
y.create.l HWIO_PMIC_ARB0_CHNL25_WDATA1_ADDR A:0x24c8014
y.create.l HWIO_PMIC_ARB0_CHNL26_WDATA1_ADDR A:0x24d0014
y.create.l HWIO_PMIC_ARB0_CHNL27_WDATA1_ADDR A:0x24d8014
y.create.l HWIO_PMIC_ARB0_CHNL28_WDATA1_ADDR A:0x24e0014
y.create.l HWIO_PMIC_ARB0_CHNL29_WDATA1_ADDR A:0x24e8014
y.create.l HWIO_PMIC_ARB0_CHNL30_WDATA1_ADDR A:0x24f0014
y.create.l HWIO_PMIC_ARB0_CHNL31_WDATA1_ADDR A:0x24f8014
y.create.l HWIO_PMIC_ARB0_CHNL32_WDATA1_ADDR A:0x2500014
y.create.l HWIO_PMIC_ARB0_CHNL33_WDATA1_ADDR A:0x2508014
y.create.l HWIO_PMIC_ARB0_CHNL34_WDATA1_ADDR A:0x2510014
y.create.l HWIO_PMIC_ARB0_CHNL35_WDATA1_ADDR A:0x2518014
y.create.l HWIO_PMIC_ARB0_CHNL36_WDATA1_ADDR A:0x2520014
y.create.l HWIO_PMIC_ARB0_CHNL37_WDATA1_ADDR A:0x2528014
y.create.l HWIO_PMIC_ARB0_CHNL38_WDATA1_ADDR A:0x2530014
y.create.l HWIO_PMIC_ARB0_CHNL39_WDATA1_ADDR A:0x2538014
y.create.l HWIO_PMIC_ARB0_CHNL40_WDATA1_ADDR A:0x2540014
y.create.l HWIO_PMIC_ARB0_CHNL41_WDATA1_ADDR A:0x2548014
y.create.l HWIO_PMIC_ARB0_CHNL42_WDATA1_ADDR A:0x2550014
y.create.l HWIO_PMIC_ARB0_CHNL43_WDATA1_ADDR A:0x2558014
y.create.l HWIO_PMIC_ARB0_CHNL44_WDATA1_ADDR A:0x2560014
y.create.l HWIO_PMIC_ARB0_CHNL45_WDATA1_ADDR A:0x2568014
y.create.l HWIO_PMIC_ARB0_CHNL46_WDATA1_ADDR A:0x2570014
y.create.l HWIO_PMIC_ARB0_CHNL47_WDATA1_ADDR A:0x2578014
y.create.l HWIO_PMIC_ARB0_CHNL48_WDATA1_ADDR A:0x2580014
y.create.l HWIO_PMIC_ARB0_CHNL49_WDATA1_ADDR A:0x2588014
y.create.l HWIO_PMIC_ARB0_CHNL50_WDATA1_ADDR A:0x2590014
y.create.l HWIO_PMIC_ARB0_CHNL51_WDATA1_ADDR A:0x2598014
y.create.l HWIO_PMIC_ARB0_CHNL52_WDATA1_ADDR A:0x25a0014
y.create.l HWIO_PMIC_ARB0_CHNL53_WDATA1_ADDR A:0x25a8014
y.create.l HWIO_PMIC_ARB0_CHNL54_WDATA1_ADDR A:0x25b0014
y.create.l HWIO_PMIC_ARB0_CHNL55_WDATA1_ADDR A:0x25b8014
y.create.l HWIO_PMIC_ARB0_CHNL56_WDATA1_ADDR A:0x25c0014
y.create.l HWIO_PMIC_ARB0_CHNL57_WDATA1_ADDR A:0x25c8014
y.create.l HWIO_PMIC_ARB0_CHNL58_WDATA1_ADDR A:0x25d0014
y.create.l HWIO_PMIC_ARB0_CHNL59_WDATA1_ADDR A:0x25d8014
y.create.l HWIO_PMIC_ARB0_CHNL60_WDATA1_ADDR A:0x25e0014
y.create.l HWIO_PMIC_ARB0_CHNL61_WDATA1_ADDR A:0x25e8014
y.create.l HWIO_PMIC_ARB0_CHNL62_WDATA1_ADDR A:0x25f0014
y.create.l HWIO_PMIC_ARB0_CHNL63_WDATA1_ADDR A:0x25f8014
y.create.l HWIO_PMIC_ARB0_CHNL64_WDATA1_ADDR A:0x2600014
y.create.l HWIO_PMIC_ARB0_CHNL65_WDATA1_ADDR A:0x2608014
y.create.l HWIO_PMIC_ARB0_CHNL66_WDATA1_ADDR A:0x2610014
y.create.l HWIO_PMIC_ARB0_CHNL67_WDATA1_ADDR A:0x2618014
y.create.l HWIO_PMIC_ARB0_CHNL68_WDATA1_ADDR A:0x2620014
y.create.l HWIO_PMIC_ARB0_CHNL69_WDATA1_ADDR A:0x2628014
y.create.l HWIO_PMIC_ARB0_CHNL70_WDATA1_ADDR A:0x2630014
y.create.l HWIO_PMIC_ARB0_CHNL71_WDATA1_ADDR A:0x2638014
y.create.l HWIO_PMIC_ARB0_CHNL72_WDATA1_ADDR A:0x2640014
y.create.l HWIO_PMIC_ARB0_CHNL73_WDATA1_ADDR A:0x2648014
y.create.l HWIO_PMIC_ARB0_CHNL74_WDATA1_ADDR A:0x2650014
y.create.l HWIO_PMIC_ARB0_CHNL75_WDATA1_ADDR A:0x2658014
y.create.l HWIO_PMIC_ARB0_CHNL76_WDATA1_ADDR A:0x2660014
y.create.l HWIO_PMIC_ARB0_CHNL77_WDATA1_ADDR A:0x2668014
y.create.l HWIO_PMIC_ARB0_CHNL78_WDATA1_ADDR A:0x2670014
y.create.l HWIO_PMIC_ARB0_CHNL79_WDATA1_ADDR A:0x2678014
y.create.l HWIO_PMIC_ARB0_CHNL80_WDATA1_ADDR A:0x2680014
y.create.l HWIO_PMIC_ARB0_CHNL81_WDATA1_ADDR A:0x2688014
y.create.l HWIO_PMIC_ARB0_CHNL82_WDATA1_ADDR A:0x2690014
y.create.l HWIO_PMIC_ARB0_CHNL83_WDATA1_ADDR A:0x2698014
y.create.l HWIO_PMIC_ARB0_CHNL84_WDATA1_ADDR A:0x26a0014
y.create.l HWIO_PMIC_ARB0_CHNL85_WDATA1_ADDR A:0x26a8014
y.create.l HWIO_PMIC_ARB0_CHNL86_WDATA1_ADDR A:0x26b0014
y.create.l HWIO_PMIC_ARB0_CHNL87_WDATA1_ADDR A:0x26b8014
y.create.l HWIO_PMIC_ARB0_CHNL88_WDATA1_ADDR A:0x26c0014
y.create.l HWIO_PMIC_ARB0_CHNL89_WDATA1_ADDR A:0x26c8014
y.create.l HWIO_PMIC_ARB0_CHNL90_WDATA1_ADDR A:0x26d0014
y.create.l HWIO_PMIC_ARB0_CHNL91_WDATA1_ADDR A:0x26d8014
y.create.l HWIO_PMIC_ARB0_CHNL92_WDATA1_ADDR A:0x26e0014
y.create.l HWIO_PMIC_ARB0_CHNL93_WDATA1_ADDR A:0x26e8014
y.create.l HWIO_PMIC_ARB0_CHNL94_WDATA1_ADDR A:0x26f0014
y.create.l HWIO_PMIC_ARB0_CHNL95_WDATA1_ADDR A:0x26f8014
y.create.l HWIO_PMIC_ARB0_CHNL96_WDATA1_ADDR A:0x2700014
y.create.l HWIO_PMIC_ARB0_CHNL97_WDATA1_ADDR A:0x2708014
y.create.l HWIO_PMIC_ARB0_CHNL98_WDATA1_ADDR A:0x2710014
y.create.l HWIO_PMIC_ARB0_CHNL99_WDATA1_ADDR A:0x2718014
y.create.l HWIO_PMIC_ARB0_CHNL100_WDATA1_ADDR A:0x2720014
y.create.l HWIO_PMIC_ARB0_CHNL101_WDATA1_ADDR A:0x2728014
y.create.l HWIO_PMIC_ARB0_CHNL102_WDATA1_ADDR A:0x2730014
y.create.l HWIO_PMIC_ARB0_CHNL103_WDATA1_ADDR A:0x2738014
y.create.l HWIO_PMIC_ARB0_CHNL104_WDATA1_ADDR A:0x2740014
y.create.l HWIO_PMIC_ARB0_CHNL105_WDATA1_ADDR A:0x2748014
y.create.l HWIO_PMIC_ARB0_CHNL106_WDATA1_ADDR A:0x2750014
y.create.l HWIO_PMIC_ARB0_CHNL107_WDATA1_ADDR A:0x2758014
y.create.l HWIO_PMIC_ARB0_CHNL108_WDATA1_ADDR A:0x2760014
y.create.l HWIO_PMIC_ARB0_CHNL109_WDATA1_ADDR A:0x2768014
y.create.l HWIO_PMIC_ARB0_CHNL110_WDATA1_ADDR A:0x2770014
y.create.l HWIO_PMIC_ARB0_CHNL111_WDATA1_ADDR A:0x2778014
y.create.l HWIO_PMIC_ARB0_CHNL112_WDATA1_ADDR A:0x2780014
y.create.l HWIO_PMIC_ARB0_CHNL113_WDATA1_ADDR A:0x2788014
y.create.l HWIO_PMIC_ARB0_CHNL114_WDATA1_ADDR A:0x2790014
y.create.l HWIO_PMIC_ARB0_CHNL115_WDATA1_ADDR A:0x2798014
y.create.l HWIO_PMIC_ARB0_CHNL116_WDATA1_ADDR A:0x27a0014
y.create.l HWIO_PMIC_ARB0_CHNL117_WDATA1_ADDR A:0x27a8014
y.create.l HWIO_PMIC_ARB0_CHNL118_WDATA1_ADDR A:0x27b0014
y.create.l HWIO_PMIC_ARB0_CHNL119_WDATA1_ADDR A:0x27b8014
y.create.l HWIO_PMIC_ARB0_CHNL120_WDATA1_ADDR A:0x27c0014
y.create.l HWIO_PMIC_ARB0_CHNL121_WDATA1_ADDR A:0x27c8014
y.create.l HWIO_PMIC_ARB0_CHNL122_WDATA1_ADDR A:0x27d0014
y.create.l HWIO_PMIC_ARB0_CHNL123_WDATA1_ADDR A:0x27d8014
y.create.l HWIO_PMIC_ARB0_CHNL124_WDATA1_ADDR A:0x27e0014
y.create.l HWIO_PMIC_ARB0_CHNL125_WDATA1_ADDR A:0x27e8014
y.create.l HWIO_PMIC_ARB0_CHNL126_WDATA1_ADDR A:0x27f0014
y.create.l HWIO_PMIC_ARB0_CHNL127_WDATA1_ADDR A:0x27f8014
y.create.l HWIO_PMIC_ARB0_CHNL128_WDATA1_ADDR A:0x2800014
y.create.l HWIO_PMIC_ARB0_CHNL129_WDATA1_ADDR A:0x2808014
y.create.l HWIO_PMIC_ARB0_CHNL130_WDATA1_ADDR A:0x2810014
y.create.l HWIO_PMIC_ARB0_CHNL131_WDATA1_ADDR A:0x2818014
y.create.l HWIO_PMIC_ARB0_CHNL132_WDATA1_ADDR A:0x2820014
y.create.l HWIO_PMIC_ARB0_CHNL133_WDATA1_ADDR A:0x2828014
y.create.l HWIO_PMIC_ARB0_CHNL134_WDATA1_ADDR A:0x2830014
y.create.l HWIO_PMIC_ARB0_CHNL135_WDATA1_ADDR A:0x2838014
y.create.l HWIO_PMIC_ARB0_CHNL136_WDATA1_ADDR A:0x2840014
y.create.l HWIO_PMIC_ARB0_CHNL137_WDATA1_ADDR A:0x2848014
y.create.l HWIO_PMIC_ARB0_CHNL138_WDATA1_ADDR A:0x2850014
y.create.l HWIO_PMIC_ARB0_CHNL139_WDATA1_ADDR A:0x2858014
y.create.l HWIO_PMIC_ARB0_CHNL140_WDATA1_ADDR A:0x2860014
y.create.l HWIO_PMIC_ARB0_CHNL141_WDATA1_ADDR A:0x2868014
y.create.l HWIO_PMIC_ARB0_CHNL142_WDATA1_ADDR A:0x2870014
y.create.l HWIO_PMIC_ARB0_CHNL143_WDATA1_ADDR A:0x2878014
y.create.l HWIO_PMIC_ARB0_CHNL144_WDATA1_ADDR A:0x2880014
y.create.l HWIO_PMIC_ARB0_CHNL145_WDATA1_ADDR A:0x2888014
y.create.l HWIO_PMIC_ARB0_CHNL146_WDATA1_ADDR A:0x2890014
y.create.l HWIO_PMIC_ARB0_CHNL147_WDATA1_ADDR A:0x2898014
y.create.l HWIO_PMIC_ARB0_CHNL148_WDATA1_ADDR A:0x28a0014
y.create.l HWIO_PMIC_ARB0_CHNL149_WDATA1_ADDR A:0x28a8014
y.create.l HWIO_PMIC_ARB0_CHNL150_WDATA1_ADDR A:0x28b0014
y.create.l HWIO_PMIC_ARB0_CHNL151_WDATA1_ADDR A:0x28b8014
y.create.l HWIO_PMIC_ARB0_CHNL152_WDATA1_ADDR A:0x28c0014
y.create.l HWIO_PMIC_ARB0_CHNL153_WDATA1_ADDR A:0x28c8014
y.create.l HWIO_PMIC_ARB0_CHNL154_WDATA1_ADDR A:0x28d0014
y.create.l HWIO_PMIC_ARB0_CHNL155_WDATA1_ADDR A:0x28d8014
y.create.l HWIO_PMIC_ARB0_CHNL156_WDATA1_ADDR A:0x28e0014
y.create.l HWIO_PMIC_ARB0_CHNL157_WDATA1_ADDR A:0x28e8014
y.create.l HWIO_PMIC_ARB0_CHNL158_WDATA1_ADDR A:0x28f0014
y.create.l HWIO_PMIC_ARB0_CHNL159_WDATA1_ADDR A:0x28f8014
y.create.l HWIO_PMIC_ARB0_CHNL160_WDATA1_ADDR A:0x2900014
y.create.l HWIO_PMIC_ARB0_CHNL161_WDATA1_ADDR A:0x2908014
y.create.l HWIO_PMIC_ARB0_CHNL162_WDATA1_ADDR A:0x2910014
y.create.l HWIO_PMIC_ARB0_CHNL163_WDATA1_ADDR A:0x2918014
y.create.l HWIO_PMIC_ARB0_CHNL164_WDATA1_ADDR A:0x2920014
y.create.l HWIO_PMIC_ARB0_CHNL165_WDATA1_ADDR A:0x2928014
y.create.l HWIO_PMIC_ARB0_CHNL166_WDATA1_ADDR A:0x2930014
y.create.l HWIO_PMIC_ARB0_CHNL167_WDATA1_ADDR A:0x2938014
y.create.l HWIO_PMIC_ARB0_CHNL168_WDATA1_ADDR A:0x2940014
y.create.l HWIO_PMIC_ARB0_CHNL169_WDATA1_ADDR A:0x2948014
y.create.l HWIO_PMIC_ARB0_CHNL170_WDATA1_ADDR A:0x2950014
y.create.l HWIO_PMIC_ARB0_CHNL171_WDATA1_ADDR A:0x2958014
y.create.l HWIO_PMIC_ARB0_CHNL172_WDATA1_ADDR A:0x2960014
y.create.l HWIO_PMIC_ARB0_CHNL173_WDATA1_ADDR A:0x2968014
y.create.l HWIO_PMIC_ARB0_CHNL174_WDATA1_ADDR A:0x2970014
y.create.l HWIO_PMIC_ARB0_CHNL175_WDATA1_ADDR A:0x2978014
y.create.l HWIO_PMIC_ARB0_CHNL176_WDATA1_ADDR A:0x2980014
y.create.l HWIO_PMIC_ARB0_CHNL177_WDATA1_ADDR A:0x2988014
y.create.l HWIO_PMIC_ARB0_CHNL178_WDATA1_ADDR A:0x2990014
y.create.l HWIO_PMIC_ARB0_CHNL179_WDATA1_ADDR A:0x2998014
y.create.l HWIO_PMIC_ARB0_CHNL180_WDATA1_ADDR A:0x29a0014
y.create.l HWIO_PMIC_ARB0_CHNL181_WDATA1_ADDR A:0x29a8014
y.create.l HWIO_PMIC_ARB0_CHNL182_WDATA1_ADDR A:0x29b0014
y.create.l HWIO_PMIC_ARB0_CHNL183_WDATA1_ADDR A:0x29b8014
y.create.l HWIO_PMIC_ARB0_CHNL184_WDATA1_ADDR A:0x29c0014
y.create.l HWIO_PMIC_ARB0_CHNL185_WDATA1_ADDR A:0x29c8014
y.create.l HWIO_PMIC_ARB0_CHNL186_WDATA1_ADDR A:0x29d0014
y.create.l HWIO_PMIC_ARB0_CHNL187_WDATA1_ADDR A:0x29d8014
y.create.l HWIO_PMIC_ARB0_CHNL188_WDATA1_ADDR A:0x29e0014
y.create.l HWIO_PMIC_ARB0_CHNL189_WDATA1_ADDR A:0x29e8014
y.create.l HWIO_PMIC_ARB0_CHNL190_WDATA1_ADDR A:0x29f0014
y.create.l HWIO_PMIC_ARB0_CHNL191_WDATA1_ADDR A:0x29f8014
y.create.l HWIO_PMIC_ARB0_CHNL192_WDATA1_ADDR A:0x2a00014
y.create.l HWIO_PMIC_ARB0_CHNL193_WDATA1_ADDR A:0x2a08014
y.create.l HWIO_PMIC_ARB0_CHNL194_WDATA1_ADDR A:0x2a10014
y.create.l HWIO_PMIC_ARB0_CHNL195_WDATA1_ADDR A:0x2a18014
y.create.l HWIO_PMIC_ARB0_CHNL196_WDATA1_ADDR A:0x2a20014
y.create.l HWIO_PMIC_ARB0_CHNL197_WDATA1_ADDR A:0x2a28014
y.create.l HWIO_PMIC_ARB0_CHNL198_WDATA1_ADDR A:0x2a30014
y.create.l HWIO_PMIC_ARB0_CHNL199_WDATA1_ADDR A:0x2a38014
y.create.l HWIO_PMIC_ARB0_CHNL200_WDATA1_ADDR A:0x2a40014
y.create.l HWIO_PMIC_ARB0_CHNL201_WDATA1_ADDR A:0x2a48014
y.create.l HWIO_PMIC_ARB0_CHNL202_WDATA1_ADDR A:0x2a50014
y.create.l HWIO_PMIC_ARB0_CHNL203_WDATA1_ADDR A:0x2a58014
y.create.l HWIO_PMIC_ARB0_CHNL204_WDATA1_ADDR A:0x2a60014
y.create.l HWIO_PMIC_ARB0_CHNL205_WDATA1_ADDR A:0x2a68014
y.create.l HWIO_PMIC_ARB0_CHNL206_WDATA1_ADDR A:0x2a70014
y.create.l HWIO_PMIC_ARB0_CHNL207_WDATA1_ADDR A:0x2a78014
y.create.l HWIO_PMIC_ARB0_CHNL208_WDATA1_ADDR A:0x2a80014
y.create.l HWIO_PMIC_ARB0_CHNL209_WDATA1_ADDR A:0x2a88014
y.create.l HWIO_PMIC_ARB0_CHNL210_WDATA1_ADDR A:0x2a90014
y.create.l HWIO_PMIC_ARB0_CHNL211_WDATA1_ADDR A:0x2a98014
y.create.l HWIO_PMIC_ARB0_CHNL212_WDATA1_ADDR A:0x2aa0014
y.create.l HWIO_PMIC_ARB0_CHNL213_WDATA1_ADDR A:0x2aa8014
y.create.l HWIO_PMIC_ARB0_CHNL214_WDATA1_ADDR A:0x2ab0014
y.create.l HWIO_PMIC_ARB0_CHNL215_WDATA1_ADDR A:0x2ab8014
y.create.l HWIO_PMIC_ARB0_CHNL216_WDATA1_ADDR A:0x2ac0014
y.create.l HWIO_PMIC_ARB0_CHNL217_WDATA1_ADDR A:0x2ac8014
y.create.l HWIO_PMIC_ARB0_CHNL218_WDATA1_ADDR A:0x2ad0014
y.create.l HWIO_PMIC_ARB0_CHNL219_WDATA1_ADDR A:0x2ad8014
y.create.l HWIO_PMIC_ARB0_CHNL220_WDATA1_ADDR A:0x2ae0014
y.create.l HWIO_PMIC_ARB0_CHNL221_WDATA1_ADDR A:0x2ae8014
y.create.l HWIO_PMIC_ARB0_CHNL222_WDATA1_ADDR A:0x2af0014
y.create.l HWIO_PMIC_ARB0_CHNL223_WDATA1_ADDR A:0x2af8014
y.create.l HWIO_PMIC_ARB0_CHNL224_WDATA1_ADDR A:0x2b00014
y.create.l HWIO_PMIC_ARB0_CHNL225_WDATA1_ADDR A:0x2b08014
y.create.l HWIO_PMIC_ARB0_CHNL226_WDATA1_ADDR A:0x2b10014
y.create.l HWIO_PMIC_ARB0_CHNL227_WDATA1_ADDR A:0x2b18014
y.create.l HWIO_PMIC_ARB0_CHNL228_WDATA1_ADDR A:0x2b20014
y.create.l HWIO_PMIC_ARB0_CHNL229_WDATA1_ADDR A:0x2b28014
y.create.l HWIO_PMIC_ARB0_CHNL230_WDATA1_ADDR A:0x2b30014
y.create.l HWIO_PMIC_ARB0_CHNL231_WDATA1_ADDR A:0x2b38014
y.create.l HWIO_PMIC_ARB0_CHNL232_WDATA1_ADDR A:0x2b40014
y.create.l HWIO_PMIC_ARB0_CHNL233_WDATA1_ADDR A:0x2b48014
y.create.l HWIO_PMIC_ARB0_CHNL234_WDATA1_ADDR A:0x2b50014
y.create.l HWIO_PMIC_ARB0_CHNL235_WDATA1_ADDR A:0x2b58014
y.create.l HWIO_PMIC_ARB0_CHNL236_WDATA1_ADDR A:0x2b60014
y.create.l HWIO_PMIC_ARB0_CHNL237_WDATA1_ADDR A:0x2b68014
y.create.l HWIO_PMIC_ARB0_CHNL238_WDATA1_ADDR A:0x2b70014
y.create.l HWIO_PMIC_ARB0_CHNL239_WDATA1_ADDR A:0x2b78014
y.create.l HWIO_PMIC_ARB0_CHNL240_WDATA1_ADDR A:0x2b80014
y.create.l HWIO_PMIC_ARB0_CHNL241_WDATA1_ADDR A:0x2b88014
y.create.l HWIO_PMIC_ARB0_CHNL242_WDATA1_ADDR A:0x2b90014
y.create.l HWIO_PMIC_ARB0_CHNL243_WDATA1_ADDR A:0x2b98014
y.create.l HWIO_PMIC_ARB0_CHNL244_WDATA1_ADDR A:0x2ba0014
y.create.l HWIO_PMIC_ARB0_CHNL245_WDATA1_ADDR A:0x2ba8014
y.create.l HWIO_PMIC_ARB0_CHNL246_WDATA1_ADDR A:0x2bb0014
y.create.l HWIO_PMIC_ARB0_CHNL247_WDATA1_ADDR A:0x2bb8014
y.create.l HWIO_PMIC_ARB0_CHNL248_WDATA1_ADDR A:0x2bc0014
y.create.l HWIO_PMIC_ARB0_CHNL249_WDATA1_ADDR A:0x2bc8014
y.create.l HWIO_PMIC_ARB0_CHNL250_WDATA1_ADDR A:0x2bd0014
y.create.l HWIO_PMIC_ARB0_CHNL251_WDATA1_ADDR A:0x2bd8014
y.create.l HWIO_PMIC_ARB0_CHNL252_WDATA1_ADDR A:0x2be0014
y.create.l HWIO_PMIC_ARB0_CHNL253_WDATA1_ADDR A:0x2be8014
y.create.l HWIO_PMIC_ARB0_CHNL254_WDATA1_ADDR A:0x2bf0014
y.create.l HWIO_PMIC_ARB0_CHNL255_WDATA1_ADDR A:0x2bf8014
y.create.l HWIO_PMIC_ARB1_CHNL0_WDATA1_ADDR A:0x2401014
y.create.l HWIO_PMIC_ARB1_CHNL1_WDATA1_ADDR A:0x2409014
y.create.l HWIO_PMIC_ARB1_CHNL2_WDATA1_ADDR A:0x2411014
y.create.l HWIO_PMIC_ARB1_CHNL3_WDATA1_ADDR A:0x2419014
y.create.l HWIO_PMIC_ARB1_CHNL4_WDATA1_ADDR A:0x2421014
y.create.l HWIO_PMIC_ARB1_CHNL5_WDATA1_ADDR A:0x2429014
y.create.l HWIO_PMIC_ARB1_CHNL6_WDATA1_ADDR A:0x2431014
y.create.l HWIO_PMIC_ARB1_CHNL7_WDATA1_ADDR A:0x2439014
y.create.l HWIO_PMIC_ARB1_CHNL8_WDATA1_ADDR A:0x2441014
y.create.l HWIO_PMIC_ARB1_CHNL9_WDATA1_ADDR A:0x2449014
y.create.l HWIO_PMIC_ARB1_CHNL10_WDATA1_ADDR A:0x2451014
y.create.l HWIO_PMIC_ARB1_CHNL11_WDATA1_ADDR A:0x2459014
y.create.l HWIO_PMIC_ARB1_CHNL12_WDATA1_ADDR A:0x2461014
y.create.l HWIO_PMIC_ARB1_CHNL13_WDATA1_ADDR A:0x2469014
y.create.l HWIO_PMIC_ARB1_CHNL14_WDATA1_ADDR A:0x2471014
y.create.l HWIO_PMIC_ARB1_CHNL15_WDATA1_ADDR A:0x2479014
y.create.l HWIO_PMIC_ARB1_CHNL16_WDATA1_ADDR A:0x2481014
y.create.l HWIO_PMIC_ARB1_CHNL17_WDATA1_ADDR A:0x2489014
y.create.l HWIO_PMIC_ARB1_CHNL18_WDATA1_ADDR A:0x2491014
y.create.l HWIO_PMIC_ARB1_CHNL19_WDATA1_ADDR A:0x2499014
y.create.l HWIO_PMIC_ARB1_CHNL20_WDATA1_ADDR A:0x24a1014
y.create.l HWIO_PMIC_ARB1_CHNL21_WDATA1_ADDR A:0x24a9014
y.create.l HWIO_PMIC_ARB1_CHNL22_WDATA1_ADDR A:0x24b1014
y.create.l HWIO_PMIC_ARB1_CHNL23_WDATA1_ADDR A:0x24b9014
y.create.l HWIO_PMIC_ARB1_CHNL24_WDATA1_ADDR A:0x24c1014
y.create.l HWIO_PMIC_ARB1_CHNL25_WDATA1_ADDR A:0x24c9014
y.create.l HWIO_PMIC_ARB1_CHNL26_WDATA1_ADDR A:0x24d1014
y.create.l HWIO_PMIC_ARB1_CHNL27_WDATA1_ADDR A:0x24d9014
y.create.l HWIO_PMIC_ARB1_CHNL28_WDATA1_ADDR A:0x24e1014
y.create.l HWIO_PMIC_ARB1_CHNL29_WDATA1_ADDR A:0x24e9014
y.create.l HWIO_PMIC_ARB1_CHNL30_WDATA1_ADDR A:0x24f1014
y.create.l HWIO_PMIC_ARB1_CHNL31_WDATA1_ADDR A:0x24f9014
y.create.l HWIO_PMIC_ARB1_CHNL32_WDATA1_ADDR A:0x2501014
y.create.l HWIO_PMIC_ARB1_CHNL33_WDATA1_ADDR A:0x2509014
y.create.l HWIO_PMIC_ARB1_CHNL34_WDATA1_ADDR A:0x2511014
y.create.l HWIO_PMIC_ARB1_CHNL35_WDATA1_ADDR A:0x2519014
y.create.l HWIO_PMIC_ARB1_CHNL36_WDATA1_ADDR A:0x2521014
y.create.l HWIO_PMIC_ARB1_CHNL37_WDATA1_ADDR A:0x2529014
y.create.l HWIO_PMIC_ARB1_CHNL38_WDATA1_ADDR A:0x2531014
y.create.l HWIO_PMIC_ARB1_CHNL39_WDATA1_ADDR A:0x2539014
y.create.l HWIO_PMIC_ARB1_CHNL40_WDATA1_ADDR A:0x2541014
y.create.l HWIO_PMIC_ARB1_CHNL41_WDATA1_ADDR A:0x2549014
y.create.l HWIO_PMIC_ARB1_CHNL42_WDATA1_ADDR A:0x2551014
y.create.l HWIO_PMIC_ARB1_CHNL43_WDATA1_ADDR A:0x2559014
y.create.l HWIO_PMIC_ARB1_CHNL44_WDATA1_ADDR A:0x2561014
y.create.l HWIO_PMIC_ARB1_CHNL45_WDATA1_ADDR A:0x2569014
y.create.l HWIO_PMIC_ARB1_CHNL46_WDATA1_ADDR A:0x2571014
y.create.l HWIO_PMIC_ARB1_CHNL47_WDATA1_ADDR A:0x2579014
y.create.l HWIO_PMIC_ARB1_CHNL48_WDATA1_ADDR A:0x2581014
y.create.l HWIO_PMIC_ARB1_CHNL49_WDATA1_ADDR A:0x2589014
y.create.l HWIO_PMIC_ARB1_CHNL50_WDATA1_ADDR A:0x2591014
y.create.l HWIO_PMIC_ARB1_CHNL51_WDATA1_ADDR A:0x2599014
y.create.l HWIO_PMIC_ARB1_CHNL52_WDATA1_ADDR A:0x25a1014
y.create.l HWIO_PMIC_ARB1_CHNL53_WDATA1_ADDR A:0x25a9014
y.create.l HWIO_PMIC_ARB1_CHNL54_WDATA1_ADDR A:0x25b1014
y.create.l HWIO_PMIC_ARB1_CHNL55_WDATA1_ADDR A:0x25b9014
y.create.l HWIO_PMIC_ARB1_CHNL56_WDATA1_ADDR A:0x25c1014
y.create.l HWIO_PMIC_ARB1_CHNL57_WDATA1_ADDR A:0x25c9014
y.create.l HWIO_PMIC_ARB1_CHNL58_WDATA1_ADDR A:0x25d1014
y.create.l HWIO_PMIC_ARB1_CHNL59_WDATA1_ADDR A:0x25d9014
y.create.l HWIO_PMIC_ARB1_CHNL60_WDATA1_ADDR A:0x25e1014
y.create.l HWIO_PMIC_ARB1_CHNL61_WDATA1_ADDR A:0x25e9014
y.create.l HWIO_PMIC_ARB1_CHNL62_WDATA1_ADDR A:0x25f1014
y.create.l HWIO_PMIC_ARB1_CHNL63_WDATA1_ADDR A:0x25f9014
y.create.l HWIO_PMIC_ARB1_CHNL64_WDATA1_ADDR A:0x2601014
y.create.l HWIO_PMIC_ARB1_CHNL65_WDATA1_ADDR A:0x2609014
y.create.l HWIO_PMIC_ARB1_CHNL66_WDATA1_ADDR A:0x2611014
y.create.l HWIO_PMIC_ARB1_CHNL67_WDATA1_ADDR A:0x2619014
y.create.l HWIO_PMIC_ARB1_CHNL68_WDATA1_ADDR A:0x2621014
y.create.l HWIO_PMIC_ARB1_CHNL69_WDATA1_ADDR A:0x2629014
y.create.l HWIO_PMIC_ARB1_CHNL70_WDATA1_ADDR A:0x2631014
y.create.l HWIO_PMIC_ARB1_CHNL71_WDATA1_ADDR A:0x2639014
y.create.l HWIO_PMIC_ARB1_CHNL72_WDATA1_ADDR A:0x2641014
y.create.l HWIO_PMIC_ARB1_CHNL73_WDATA1_ADDR A:0x2649014
y.create.l HWIO_PMIC_ARB1_CHNL74_WDATA1_ADDR A:0x2651014
y.create.l HWIO_PMIC_ARB1_CHNL75_WDATA1_ADDR A:0x2659014
y.create.l HWIO_PMIC_ARB1_CHNL76_WDATA1_ADDR A:0x2661014
y.create.l HWIO_PMIC_ARB1_CHNL77_WDATA1_ADDR A:0x2669014
y.create.l HWIO_PMIC_ARB1_CHNL78_WDATA1_ADDR A:0x2671014
y.create.l HWIO_PMIC_ARB1_CHNL79_WDATA1_ADDR A:0x2679014
y.create.l HWIO_PMIC_ARB1_CHNL80_WDATA1_ADDR A:0x2681014
y.create.l HWIO_PMIC_ARB1_CHNL81_WDATA1_ADDR A:0x2689014
y.create.l HWIO_PMIC_ARB1_CHNL82_WDATA1_ADDR A:0x2691014
y.create.l HWIO_PMIC_ARB1_CHNL83_WDATA1_ADDR A:0x2699014
y.create.l HWIO_PMIC_ARB1_CHNL84_WDATA1_ADDR A:0x26a1014
y.create.l HWIO_PMIC_ARB1_CHNL85_WDATA1_ADDR A:0x26a9014
y.create.l HWIO_PMIC_ARB1_CHNL86_WDATA1_ADDR A:0x26b1014
y.create.l HWIO_PMIC_ARB1_CHNL87_WDATA1_ADDR A:0x26b9014
y.create.l HWIO_PMIC_ARB1_CHNL88_WDATA1_ADDR A:0x26c1014
y.create.l HWIO_PMIC_ARB1_CHNL89_WDATA1_ADDR A:0x26c9014
y.create.l HWIO_PMIC_ARB1_CHNL90_WDATA1_ADDR A:0x26d1014
y.create.l HWIO_PMIC_ARB1_CHNL91_WDATA1_ADDR A:0x26d9014
y.create.l HWIO_PMIC_ARB1_CHNL92_WDATA1_ADDR A:0x26e1014
y.create.l HWIO_PMIC_ARB1_CHNL93_WDATA1_ADDR A:0x26e9014
y.create.l HWIO_PMIC_ARB1_CHNL94_WDATA1_ADDR A:0x26f1014
y.create.l HWIO_PMIC_ARB1_CHNL95_WDATA1_ADDR A:0x26f9014
y.create.l HWIO_PMIC_ARB1_CHNL96_WDATA1_ADDR A:0x2701014
y.create.l HWIO_PMIC_ARB1_CHNL97_WDATA1_ADDR A:0x2709014
y.create.l HWIO_PMIC_ARB1_CHNL98_WDATA1_ADDR A:0x2711014
y.create.l HWIO_PMIC_ARB1_CHNL99_WDATA1_ADDR A:0x2719014
y.create.l HWIO_PMIC_ARB1_CHNL100_WDATA1_ADDR A:0x2721014
y.create.l HWIO_PMIC_ARB1_CHNL101_WDATA1_ADDR A:0x2729014
y.create.l HWIO_PMIC_ARB1_CHNL102_WDATA1_ADDR A:0x2731014
y.create.l HWIO_PMIC_ARB1_CHNL103_WDATA1_ADDR A:0x2739014
y.create.l HWIO_PMIC_ARB1_CHNL104_WDATA1_ADDR A:0x2741014
y.create.l HWIO_PMIC_ARB1_CHNL105_WDATA1_ADDR A:0x2749014
y.create.l HWIO_PMIC_ARB1_CHNL106_WDATA1_ADDR A:0x2751014
y.create.l HWIO_PMIC_ARB1_CHNL107_WDATA1_ADDR A:0x2759014
y.create.l HWIO_PMIC_ARB1_CHNL108_WDATA1_ADDR A:0x2761014
y.create.l HWIO_PMIC_ARB1_CHNL109_WDATA1_ADDR A:0x2769014
y.create.l HWIO_PMIC_ARB1_CHNL110_WDATA1_ADDR A:0x2771014
y.create.l HWIO_PMIC_ARB1_CHNL111_WDATA1_ADDR A:0x2779014
y.create.l HWIO_PMIC_ARB1_CHNL112_WDATA1_ADDR A:0x2781014
y.create.l HWIO_PMIC_ARB1_CHNL113_WDATA1_ADDR A:0x2789014
y.create.l HWIO_PMIC_ARB1_CHNL114_WDATA1_ADDR A:0x2791014
y.create.l HWIO_PMIC_ARB1_CHNL115_WDATA1_ADDR A:0x2799014
y.create.l HWIO_PMIC_ARB1_CHNL116_WDATA1_ADDR A:0x27a1014
y.create.l HWIO_PMIC_ARB1_CHNL117_WDATA1_ADDR A:0x27a9014
y.create.l HWIO_PMIC_ARB1_CHNL118_WDATA1_ADDR A:0x27b1014
y.create.l HWIO_PMIC_ARB1_CHNL119_WDATA1_ADDR A:0x27b9014
y.create.l HWIO_PMIC_ARB1_CHNL120_WDATA1_ADDR A:0x27c1014
y.create.l HWIO_PMIC_ARB1_CHNL121_WDATA1_ADDR A:0x27c9014
y.create.l HWIO_PMIC_ARB1_CHNL122_WDATA1_ADDR A:0x27d1014
y.create.l HWIO_PMIC_ARB1_CHNL123_WDATA1_ADDR A:0x27d9014
y.create.l HWIO_PMIC_ARB1_CHNL124_WDATA1_ADDR A:0x27e1014
y.create.l HWIO_PMIC_ARB1_CHNL125_WDATA1_ADDR A:0x27e9014
y.create.l HWIO_PMIC_ARB1_CHNL126_WDATA1_ADDR A:0x27f1014
y.create.l HWIO_PMIC_ARB1_CHNL127_WDATA1_ADDR A:0x27f9014
y.create.l HWIO_PMIC_ARB1_CHNL128_WDATA1_ADDR A:0x2801014
y.create.l HWIO_PMIC_ARB1_CHNL129_WDATA1_ADDR A:0x2809014
y.create.l HWIO_PMIC_ARB1_CHNL130_WDATA1_ADDR A:0x2811014
y.create.l HWIO_PMIC_ARB1_CHNL131_WDATA1_ADDR A:0x2819014
y.create.l HWIO_PMIC_ARB1_CHNL132_WDATA1_ADDR A:0x2821014
y.create.l HWIO_PMIC_ARB1_CHNL133_WDATA1_ADDR A:0x2829014
y.create.l HWIO_PMIC_ARB1_CHNL134_WDATA1_ADDR A:0x2831014
y.create.l HWIO_PMIC_ARB1_CHNL135_WDATA1_ADDR A:0x2839014
y.create.l HWIO_PMIC_ARB1_CHNL136_WDATA1_ADDR A:0x2841014
y.create.l HWIO_PMIC_ARB1_CHNL137_WDATA1_ADDR A:0x2849014
y.create.l HWIO_PMIC_ARB1_CHNL138_WDATA1_ADDR A:0x2851014
y.create.l HWIO_PMIC_ARB1_CHNL139_WDATA1_ADDR A:0x2859014
y.create.l HWIO_PMIC_ARB1_CHNL140_WDATA1_ADDR A:0x2861014
y.create.l HWIO_PMIC_ARB1_CHNL141_WDATA1_ADDR A:0x2869014
y.create.l HWIO_PMIC_ARB1_CHNL142_WDATA1_ADDR A:0x2871014
y.create.l HWIO_PMIC_ARB1_CHNL143_WDATA1_ADDR A:0x2879014
y.create.l HWIO_PMIC_ARB1_CHNL144_WDATA1_ADDR A:0x2881014
y.create.l HWIO_PMIC_ARB1_CHNL145_WDATA1_ADDR A:0x2889014
y.create.l HWIO_PMIC_ARB1_CHNL146_WDATA1_ADDR A:0x2891014
y.create.l HWIO_PMIC_ARB1_CHNL147_WDATA1_ADDR A:0x2899014
y.create.l HWIO_PMIC_ARB1_CHNL148_WDATA1_ADDR A:0x28a1014
y.create.l HWIO_PMIC_ARB1_CHNL149_WDATA1_ADDR A:0x28a9014
y.create.l HWIO_PMIC_ARB1_CHNL150_WDATA1_ADDR A:0x28b1014
y.create.l HWIO_PMIC_ARB1_CHNL151_WDATA1_ADDR A:0x28b9014
y.create.l HWIO_PMIC_ARB1_CHNL152_WDATA1_ADDR A:0x28c1014
y.create.l HWIO_PMIC_ARB1_CHNL153_WDATA1_ADDR A:0x28c9014
y.create.l HWIO_PMIC_ARB1_CHNL154_WDATA1_ADDR A:0x28d1014
y.create.l HWIO_PMIC_ARB1_CHNL155_WDATA1_ADDR A:0x28d9014
y.create.l HWIO_PMIC_ARB1_CHNL156_WDATA1_ADDR A:0x28e1014
y.create.l HWIO_PMIC_ARB1_CHNL157_WDATA1_ADDR A:0x28e9014
y.create.l HWIO_PMIC_ARB1_CHNL158_WDATA1_ADDR A:0x28f1014
y.create.l HWIO_PMIC_ARB1_CHNL159_WDATA1_ADDR A:0x28f9014
y.create.l HWIO_PMIC_ARB1_CHNL160_WDATA1_ADDR A:0x2901014
y.create.l HWIO_PMIC_ARB1_CHNL161_WDATA1_ADDR A:0x2909014
y.create.l HWIO_PMIC_ARB1_CHNL162_WDATA1_ADDR A:0x2911014
y.create.l HWIO_PMIC_ARB1_CHNL163_WDATA1_ADDR A:0x2919014
y.create.l HWIO_PMIC_ARB1_CHNL164_WDATA1_ADDR A:0x2921014
y.create.l HWIO_PMIC_ARB1_CHNL165_WDATA1_ADDR A:0x2929014
y.create.l HWIO_PMIC_ARB1_CHNL166_WDATA1_ADDR A:0x2931014
y.create.l HWIO_PMIC_ARB1_CHNL167_WDATA1_ADDR A:0x2939014
y.create.l HWIO_PMIC_ARB1_CHNL168_WDATA1_ADDR A:0x2941014
y.create.l HWIO_PMIC_ARB1_CHNL169_WDATA1_ADDR A:0x2949014
y.create.l HWIO_PMIC_ARB1_CHNL170_WDATA1_ADDR A:0x2951014
y.create.l HWIO_PMIC_ARB1_CHNL171_WDATA1_ADDR A:0x2959014
y.create.l HWIO_PMIC_ARB1_CHNL172_WDATA1_ADDR A:0x2961014
y.create.l HWIO_PMIC_ARB1_CHNL173_WDATA1_ADDR A:0x2969014
y.create.l HWIO_PMIC_ARB1_CHNL174_WDATA1_ADDR A:0x2971014
y.create.l HWIO_PMIC_ARB1_CHNL175_WDATA1_ADDR A:0x2979014
y.create.l HWIO_PMIC_ARB1_CHNL176_WDATA1_ADDR A:0x2981014
y.create.l HWIO_PMIC_ARB1_CHNL177_WDATA1_ADDR A:0x2989014
y.create.l HWIO_PMIC_ARB1_CHNL178_WDATA1_ADDR A:0x2991014
y.create.l HWIO_PMIC_ARB1_CHNL179_WDATA1_ADDR A:0x2999014
y.create.l HWIO_PMIC_ARB1_CHNL180_WDATA1_ADDR A:0x29a1014
y.create.l HWIO_PMIC_ARB1_CHNL181_WDATA1_ADDR A:0x29a9014
y.create.l HWIO_PMIC_ARB1_CHNL182_WDATA1_ADDR A:0x29b1014
y.create.l HWIO_PMIC_ARB1_CHNL183_WDATA1_ADDR A:0x29b9014
y.create.l HWIO_PMIC_ARB1_CHNL184_WDATA1_ADDR A:0x29c1014
y.create.l HWIO_PMIC_ARB1_CHNL185_WDATA1_ADDR A:0x29c9014
y.create.l HWIO_PMIC_ARB1_CHNL186_WDATA1_ADDR A:0x29d1014
y.create.l HWIO_PMIC_ARB1_CHNL187_WDATA1_ADDR A:0x29d9014
y.create.l HWIO_PMIC_ARB1_CHNL188_WDATA1_ADDR A:0x29e1014
y.create.l HWIO_PMIC_ARB1_CHNL189_WDATA1_ADDR A:0x29e9014
y.create.l HWIO_PMIC_ARB1_CHNL190_WDATA1_ADDR A:0x29f1014
y.create.l HWIO_PMIC_ARB1_CHNL191_WDATA1_ADDR A:0x29f9014
y.create.l HWIO_PMIC_ARB1_CHNL192_WDATA1_ADDR A:0x2a01014
y.create.l HWIO_PMIC_ARB1_CHNL193_WDATA1_ADDR A:0x2a09014
y.create.l HWIO_PMIC_ARB1_CHNL194_WDATA1_ADDR A:0x2a11014
y.create.l HWIO_PMIC_ARB1_CHNL195_WDATA1_ADDR A:0x2a19014
y.create.l HWIO_PMIC_ARB1_CHNL196_WDATA1_ADDR A:0x2a21014
y.create.l HWIO_PMIC_ARB1_CHNL197_WDATA1_ADDR A:0x2a29014
y.create.l HWIO_PMIC_ARB1_CHNL198_WDATA1_ADDR A:0x2a31014
y.create.l HWIO_PMIC_ARB1_CHNL199_WDATA1_ADDR A:0x2a39014
y.create.l HWIO_PMIC_ARB1_CHNL200_WDATA1_ADDR A:0x2a41014
y.create.l HWIO_PMIC_ARB1_CHNL201_WDATA1_ADDR A:0x2a49014
y.create.l HWIO_PMIC_ARB1_CHNL202_WDATA1_ADDR A:0x2a51014
y.create.l HWIO_PMIC_ARB1_CHNL203_WDATA1_ADDR A:0x2a59014
y.create.l HWIO_PMIC_ARB1_CHNL204_WDATA1_ADDR A:0x2a61014
y.create.l HWIO_PMIC_ARB1_CHNL205_WDATA1_ADDR A:0x2a69014
y.create.l HWIO_PMIC_ARB1_CHNL206_WDATA1_ADDR A:0x2a71014
y.create.l HWIO_PMIC_ARB1_CHNL207_WDATA1_ADDR A:0x2a79014
y.create.l HWIO_PMIC_ARB1_CHNL208_WDATA1_ADDR A:0x2a81014
y.create.l HWIO_PMIC_ARB1_CHNL209_WDATA1_ADDR A:0x2a89014
y.create.l HWIO_PMIC_ARB1_CHNL210_WDATA1_ADDR A:0x2a91014
y.create.l HWIO_PMIC_ARB1_CHNL211_WDATA1_ADDR A:0x2a99014
y.create.l HWIO_PMIC_ARB1_CHNL212_WDATA1_ADDR A:0x2aa1014
y.create.l HWIO_PMIC_ARB1_CHNL213_WDATA1_ADDR A:0x2aa9014
y.create.l HWIO_PMIC_ARB1_CHNL214_WDATA1_ADDR A:0x2ab1014
y.create.l HWIO_PMIC_ARB1_CHNL215_WDATA1_ADDR A:0x2ab9014
y.create.l HWIO_PMIC_ARB1_CHNL216_WDATA1_ADDR A:0x2ac1014
y.create.l HWIO_PMIC_ARB1_CHNL217_WDATA1_ADDR A:0x2ac9014
y.create.l HWIO_PMIC_ARB1_CHNL218_WDATA1_ADDR A:0x2ad1014
y.create.l HWIO_PMIC_ARB1_CHNL219_WDATA1_ADDR A:0x2ad9014
y.create.l HWIO_PMIC_ARB1_CHNL220_WDATA1_ADDR A:0x2ae1014
y.create.l HWIO_PMIC_ARB1_CHNL221_WDATA1_ADDR A:0x2ae9014
y.create.l HWIO_PMIC_ARB1_CHNL222_WDATA1_ADDR A:0x2af1014
y.create.l HWIO_PMIC_ARB1_CHNL223_WDATA1_ADDR A:0x2af9014
y.create.l HWIO_PMIC_ARB1_CHNL224_WDATA1_ADDR A:0x2b01014
y.create.l HWIO_PMIC_ARB1_CHNL225_WDATA1_ADDR A:0x2b09014
y.create.l HWIO_PMIC_ARB1_CHNL226_WDATA1_ADDR A:0x2b11014
y.create.l HWIO_PMIC_ARB1_CHNL227_WDATA1_ADDR A:0x2b19014
y.create.l HWIO_PMIC_ARB1_CHNL228_WDATA1_ADDR A:0x2b21014
y.create.l HWIO_PMIC_ARB1_CHNL229_WDATA1_ADDR A:0x2b29014
y.create.l HWIO_PMIC_ARB1_CHNL230_WDATA1_ADDR A:0x2b31014
y.create.l HWIO_PMIC_ARB1_CHNL231_WDATA1_ADDR A:0x2b39014
y.create.l HWIO_PMIC_ARB1_CHNL232_WDATA1_ADDR A:0x2b41014
y.create.l HWIO_PMIC_ARB1_CHNL233_WDATA1_ADDR A:0x2b49014
y.create.l HWIO_PMIC_ARB1_CHNL234_WDATA1_ADDR A:0x2b51014
y.create.l HWIO_PMIC_ARB1_CHNL235_WDATA1_ADDR A:0x2b59014
y.create.l HWIO_PMIC_ARB1_CHNL236_WDATA1_ADDR A:0x2b61014
y.create.l HWIO_PMIC_ARB1_CHNL237_WDATA1_ADDR A:0x2b69014
y.create.l HWIO_PMIC_ARB1_CHNL238_WDATA1_ADDR A:0x2b71014
y.create.l HWIO_PMIC_ARB1_CHNL239_WDATA1_ADDR A:0x2b79014
y.create.l HWIO_PMIC_ARB1_CHNL240_WDATA1_ADDR A:0x2b81014
y.create.l HWIO_PMIC_ARB1_CHNL241_WDATA1_ADDR A:0x2b89014
y.create.l HWIO_PMIC_ARB1_CHNL242_WDATA1_ADDR A:0x2b91014
y.create.l HWIO_PMIC_ARB1_CHNL243_WDATA1_ADDR A:0x2b99014
y.create.l HWIO_PMIC_ARB1_CHNL244_WDATA1_ADDR A:0x2ba1014
y.create.l HWIO_PMIC_ARB1_CHNL245_WDATA1_ADDR A:0x2ba9014
y.create.l HWIO_PMIC_ARB1_CHNL246_WDATA1_ADDR A:0x2bb1014
y.create.l HWIO_PMIC_ARB1_CHNL247_WDATA1_ADDR A:0x2bb9014
y.create.l HWIO_PMIC_ARB1_CHNL248_WDATA1_ADDR A:0x2bc1014
y.create.l HWIO_PMIC_ARB1_CHNL249_WDATA1_ADDR A:0x2bc9014
y.create.l HWIO_PMIC_ARB1_CHNL250_WDATA1_ADDR A:0x2bd1014
y.create.l HWIO_PMIC_ARB1_CHNL251_WDATA1_ADDR A:0x2bd9014
y.create.l HWIO_PMIC_ARB1_CHNL252_WDATA1_ADDR A:0x2be1014
y.create.l HWIO_PMIC_ARB1_CHNL253_WDATA1_ADDR A:0x2be9014
y.create.l HWIO_PMIC_ARB1_CHNL254_WDATA1_ADDR A:0x2bf1014
y.create.l HWIO_PMIC_ARB1_CHNL255_WDATA1_ADDR A:0x2bf9014
y.create.l HWIO_PMIC_ARB2_CHNL0_WDATA1_ADDR A:0x2402014
y.create.l HWIO_PMIC_ARB2_CHNL1_WDATA1_ADDR A:0x240a014
y.create.l HWIO_PMIC_ARB2_CHNL2_WDATA1_ADDR A:0x2412014
y.create.l HWIO_PMIC_ARB2_CHNL3_WDATA1_ADDR A:0x241a014
y.create.l HWIO_PMIC_ARB2_CHNL4_WDATA1_ADDR A:0x2422014
y.create.l HWIO_PMIC_ARB2_CHNL5_WDATA1_ADDR A:0x242a014
y.create.l HWIO_PMIC_ARB2_CHNL6_WDATA1_ADDR A:0x2432014
y.create.l HWIO_PMIC_ARB2_CHNL7_WDATA1_ADDR A:0x243a014
y.create.l HWIO_PMIC_ARB2_CHNL8_WDATA1_ADDR A:0x2442014
y.create.l HWIO_PMIC_ARB2_CHNL9_WDATA1_ADDR A:0x244a014
y.create.l HWIO_PMIC_ARB2_CHNL10_WDATA1_ADDR A:0x2452014
y.create.l HWIO_PMIC_ARB2_CHNL11_WDATA1_ADDR A:0x245a014
y.create.l HWIO_PMIC_ARB2_CHNL12_WDATA1_ADDR A:0x2462014
y.create.l HWIO_PMIC_ARB2_CHNL13_WDATA1_ADDR A:0x246a014
y.create.l HWIO_PMIC_ARB2_CHNL14_WDATA1_ADDR A:0x2472014
y.create.l HWIO_PMIC_ARB2_CHNL15_WDATA1_ADDR A:0x247a014
y.create.l HWIO_PMIC_ARB2_CHNL16_WDATA1_ADDR A:0x2482014
y.create.l HWIO_PMIC_ARB2_CHNL17_WDATA1_ADDR A:0x248a014
y.create.l HWIO_PMIC_ARB2_CHNL18_WDATA1_ADDR A:0x2492014
y.create.l HWIO_PMIC_ARB2_CHNL19_WDATA1_ADDR A:0x249a014
y.create.l HWIO_PMIC_ARB2_CHNL20_WDATA1_ADDR A:0x24a2014
y.create.l HWIO_PMIC_ARB2_CHNL21_WDATA1_ADDR A:0x24aa014
y.create.l HWIO_PMIC_ARB2_CHNL22_WDATA1_ADDR A:0x24b2014
y.create.l HWIO_PMIC_ARB2_CHNL23_WDATA1_ADDR A:0x24ba014
y.create.l HWIO_PMIC_ARB2_CHNL24_WDATA1_ADDR A:0x24c2014
y.create.l HWIO_PMIC_ARB2_CHNL25_WDATA1_ADDR A:0x24ca014
y.create.l HWIO_PMIC_ARB2_CHNL26_WDATA1_ADDR A:0x24d2014
y.create.l HWIO_PMIC_ARB2_CHNL27_WDATA1_ADDR A:0x24da014
y.create.l HWIO_PMIC_ARB2_CHNL28_WDATA1_ADDR A:0x24e2014
y.create.l HWIO_PMIC_ARB2_CHNL29_WDATA1_ADDR A:0x24ea014
y.create.l HWIO_PMIC_ARB2_CHNL30_WDATA1_ADDR A:0x24f2014
y.create.l HWIO_PMIC_ARB2_CHNL31_WDATA1_ADDR A:0x24fa014
y.create.l HWIO_PMIC_ARB2_CHNL32_WDATA1_ADDR A:0x2502014
y.create.l HWIO_PMIC_ARB2_CHNL33_WDATA1_ADDR A:0x250a014
y.create.l HWIO_PMIC_ARB2_CHNL34_WDATA1_ADDR A:0x2512014
y.create.l HWIO_PMIC_ARB2_CHNL35_WDATA1_ADDR A:0x251a014
y.create.l HWIO_PMIC_ARB2_CHNL36_WDATA1_ADDR A:0x2522014
y.create.l HWIO_PMIC_ARB2_CHNL37_WDATA1_ADDR A:0x252a014
y.create.l HWIO_PMIC_ARB2_CHNL38_WDATA1_ADDR A:0x2532014
y.create.l HWIO_PMIC_ARB2_CHNL39_WDATA1_ADDR A:0x253a014
y.create.l HWIO_PMIC_ARB2_CHNL40_WDATA1_ADDR A:0x2542014
y.create.l HWIO_PMIC_ARB2_CHNL41_WDATA1_ADDR A:0x254a014
y.create.l HWIO_PMIC_ARB2_CHNL42_WDATA1_ADDR A:0x2552014
y.create.l HWIO_PMIC_ARB2_CHNL43_WDATA1_ADDR A:0x255a014
y.create.l HWIO_PMIC_ARB2_CHNL44_WDATA1_ADDR A:0x2562014
y.create.l HWIO_PMIC_ARB2_CHNL45_WDATA1_ADDR A:0x256a014
y.create.l HWIO_PMIC_ARB2_CHNL46_WDATA1_ADDR A:0x2572014
y.create.l HWIO_PMIC_ARB2_CHNL47_WDATA1_ADDR A:0x257a014
y.create.l HWIO_PMIC_ARB2_CHNL48_WDATA1_ADDR A:0x2582014
y.create.l HWIO_PMIC_ARB2_CHNL49_WDATA1_ADDR A:0x258a014
y.create.l HWIO_PMIC_ARB2_CHNL50_WDATA1_ADDR A:0x2592014
y.create.l HWIO_PMIC_ARB2_CHNL51_WDATA1_ADDR A:0x259a014
y.create.l HWIO_PMIC_ARB2_CHNL52_WDATA1_ADDR A:0x25a2014
y.create.l HWIO_PMIC_ARB2_CHNL53_WDATA1_ADDR A:0x25aa014
y.create.l HWIO_PMIC_ARB2_CHNL54_WDATA1_ADDR A:0x25b2014
y.create.l HWIO_PMIC_ARB2_CHNL55_WDATA1_ADDR A:0x25ba014
y.create.l HWIO_PMIC_ARB2_CHNL56_WDATA1_ADDR A:0x25c2014
y.create.l HWIO_PMIC_ARB2_CHNL57_WDATA1_ADDR A:0x25ca014
y.create.l HWIO_PMIC_ARB2_CHNL58_WDATA1_ADDR A:0x25d2014
y.create.l HWIO_PMIC_ARB2_CHNL59_WDATA1_ADDR A:0x25da014
y.create.l HWIO_PMIC_ARB2_CHNL60_WDATA1_ADDR A:0x25e2014
y.create.l HWIO_PMIC_ARB2_CHNL61_WDATA1_ADDR A:0x25ea014
y.create.l HWIO_PMIC_ARB2_CHNL62_WDATA1_ADDR A:0x25f2014
y.create.l HWIO_PMIC_ARB2_CHNL63_WDATA1_ADDR A:0x25fa014
y.create.l HWIO_PMIC_ARB2_CHNL64_WDATA1_ADDR A:0x2602014
y.create.l HWIO_PMIC_ARB2_CHNL65_WDATA1_ADDR A:0x260a014
y.create.l HWIO_PMIC_ARB2_CHNL66_WDATA1_ADDR A:0x2612014
y.create.l HWIO_PMIC_ARB2_CHNL67_WDATA1_ADDR A:0x261a014
y.create.l HWIO_PMIC_ARB2_CHNL68_WDATA1_ADDR A:0x2622014
y.create.l HWIO_PMIC_ARB2_CHNL69_WDATA1_ADDR A:0x262a014
y.create.l HWIO_PMIC_ARB2_CHNL70_WDATA1_ADDR A:0x2632014
y.create.l HWIO_PMIC_ARB2_CHNL71_WDATA1_ADDR A:0x263a014
y.create.l HWIO_PMIC_ARB2_CHNL72_WDATA1_ADDR A:0x2642014
y.create.l HWIO_PMIC_ARB2_CHNL73_WDATA1_ADDR A:0x264a014
y.create.l HWIO_PMIC_ARB2_CHNL74_WDATA1_ADDR A:0x2652014
y.create.l HWIO_PMIC_ARB2_CHNL75_WDATA1_ADDR A:0x265a014
y.create.l HWIO_PMIC_ARB2_CHNL76_WDATA1_ADDR A:0x2662014
y.create.l HWIO_PMIC_ARB2_CHNL77_WDATA1_ADDR A:0x266a014
y.create.l HWIO_PMIC_ARB2_CHNL78_WDATA1_ADDR A:0x2672014
y.create.l HWIO_PMIC_ARB2_CHNL79_WDATA1_ADDR A:0x267a014
y.create.l HWIO_PMIC_ARB2_CHNL80_WDATA1_ADDR A:0x2682014
y.create.l HWIO_PMIC_ARB2_CHNL81_WDATA1_ADDR A:0x268a014
y.create.l HWIO_PMIC_ARB2_CHNL82_WDATA1_ADDR A:0x2692014
y.create.l HWIO_PMIC_ARB2_CHNL83_WDATA1_ADDR A:0x269a014
y.create.l HWIO_PMIC_ARB2_CHNL84_WDATA1_ADDR A:0x26a2014
y.create.l HWIO_PMIC_ARB2_CHNL85_WDATA1_ADDR A:0x26aa014
y.create.l HWIO_PMIC_ARB2_CHNL86_WDATA1_ADDR A:0x26b2014
y.create.l HWIO_PMIC_ARB2_CHNL87_WDATA1_ADDR A:0x26ba014
y.create.l HWIO_PMIC_ARB2_CHNL88_WDATA1_ADDR A:0x26c2014
y.create.l HWIO_PMIC_ARB2_CHNL89_WDATA1_ADDR A:0x26ca014
y.create.l HWIO_PMIC_ARB2_CHNL90_WDATA1_ADDR A:0x26d2014
y.create.l HWIO_PMIC_ARB2_CHNL91_WDATA1_ADDR A:0x26da014
y.create.l HWIO_PMIC_ARB2_CHNL92_WDATA1_ADDR A:0x26e2014
y.create.l HWIO_PMIC_ARB2_CHNL93_WDATA1_ADDR A:0x26ea014
y.create.l HWIO_PMIC_ARB2_CHNL94_WDATA1_ADDR A:0x26f2014
y.create.l HWIO_PMIC_ARB2_CHNL95_WDATA1_ADDR A:0x26fa014
y.create.l HWIO_PMIC_ARB2_CHNL96_WDATA1_ADDR A:0x2702014
y.create.l HWIO_PMIC_ARB2_CHNL97_WDATA1_ADDR A:0x270a014
y.create.l HWIO_PMIC_ARB2_CHNL98_WDATA1_ADDR A:0x2712014
y.create.l HWIO_PMIC_ARB2_CHNL99_WDATA1_ADDR A:0x271a014
y.create.l HWIO_PMIC_ARB2_CHNL100_WDATA1_ADDR A:0x2722014
y.create.l HWIO_PMIC_ARB2_CHNL101_WDATA1_ADDR A:0x272a014
y.create.l HWIO_PMIC_ARB2_CHNL102_WDATA1_ADDR A:0x2732014
y.create.l HWIO_PMIC_ARB2_CHNL103_WDATA1_ADDR A:0x273a014
y.create.l HWIO_PMIC_ARB2_CHNL104_WDATA1_ADDR A:0x2742014
y.create.l HWIO_PMIC_ARB2_CHNL105_WDATA1_ADDR A:0x274a014
y.create.l HWIO_PMIC_ARB2_CHNL106_WDATA1_ADDR A:0x2752014
y.create.l HWIO_PMIC_ARB2_CHNL107_WDATA1_ADDR A:0x275a014
y.create.l HWIO_PMIC_ARB2_CHNL108_WDATA1_ADDR A:0x2762014
y.create.l HWIO_PMIC_ARB2_CHNL109_WDATA1_ADDR A:0x276a014
y.create.l HWIO_PMIC_ARB2_CHNL110_WDATA1_ADDR A:0x2772014
y.create.l HWIO_PMIC_ARB2_CHNL111_WDATA1_ADDR A:0x277a014
y.create.l HWIO_PMIC_ARB2_CHNL112_WDATA1_ADDR A:0x2782014
y.create.l HWIO_PMIC_ARB2_CHNL113_WDATA1_ADDR A:0x278a014
y.create.l HWIO_PMIC_ARB2_CHNL114_WDATA1_ADDR A:0x2792014
y.create.l HWIO_PMIC_ARB2_CHNL115_WDATA1_ADDR A:0x279a014
y.create.l HWIO_PMIC_ARB2_CHNL116_WDATA1_ADDR A:0x27a2014
y.create.l HWIO_PMIC_ARB2_CHNL117_WDATA1_ADDR A:0x27aa014
y.create.l HWIO_PMIC_ARB2_CHNL118_WDATA1_ADDR A:0x27b2014
y.create.l HWIO_PMIC_ARB2_CHNL119_WDATA1_ADDR A:0x27ba014
y.create.l HWIO_PMIC_ARB2_CHNL120_WDATA1_ADDR A:0x27c2014
y.create.l HWIO_PMIC_ARB2_CHNL121_WDATA1_ADDR A:0x27ca014
y.create.l HWIO_PMIC_ARB2_CHNL122_WDATA1_ADDR A:0x27d2014
y.create.l HWIO_PMIC_ARB2_CHNL123_WDATA1_ADDR A:0x27da014
y.create.l HWIO_PMIC_ARB2_CHNL124_WDATA1_ADDR A:0x27e2014
y.create.l HWIO_PMIC_ARB2_CHNL125_WDATA1_ADDR A:0x27ea014
y.create.l HWIO_PMIC_ARB2_CHNL126_WDATA1_ADDR A:0x27f2014
y.create.l HWIO_PMIC_ARB2_CHNL127_WDATA1_ADDR A:0x27fa014
y.create.l HWIO_PMIC_ARB2_CHNL128_WDATA1_ADDR A:0x2802014
y.create.l HWIO_PMIC_ARB2_CHNL129_WDATA1_ADDR A:0x280a014
y.create.l HWIO_PMIC_ARB2_CHNL130_WDATA1_ADDR A:0x2812014
y.create.l HWIO_PMIC_ARB2_CHNL131_WDATA1_ADDR A:0x281a014
y.create.l HWIO_PMIC_ARB2_CHNL132_WDATA1_ADDR A:0x2822014
y.create.l HWIO_PMIC_ARB2_CHNL133_WDATA1_ADDR A:0x282a014
y.create.l HWIO_PMIC_ARB2_CHNL134_WDATA1_ADDR A:0x2832014
y.create.l HWIO_PMIC_ARB2_CHNL135_WDATA1_ADDR A:0x283a014
y.create.l HWIO_PMIC_ARB2_CHNL136_WDATA1_ADDR A:0x2842014
y.create.l HWIO_PMIC_ARB2_CHNL137_WDATA1_ADDR A:0x284a014
y.create.l HWIO_PMIC_ARB2_CHNL138_WDATA1_ADDR A:0x2852014
y.create.l HWIO_PMIC_ARB2_CHNL139_WDATA1_ADDR A:0x285a014
y.create.l HWIO_PMIC_ARB2_CHNL140_WDATA1_ADDR A:0x2862014
y.create.l HWIO_PMIC_ARB2_CHNL141_WDATA1_ADDR A:0x286a014
y.create.l HWIO_PMIC_ARB2_CHNL142_WDATA1_ADDR A:0x2872014
y.create.l HWIO_PMIC_ARB2_CHNL143_WDATA1_ADDR A:0x287a014
y.create.l HWIO_PMIC_ARB2_CHNL144_WDATA1_ADDR A:0x2882014
y.create.l HWIO_PMIC_ARB2_CHNL145_WDATA1_ADDR A:0x288a014
y.create.l HWIO_PMIC_ARB2_CHNL146_WDATA1_ADDR A:0x2892014
y.create.l HWIO_PMIC_ARB2_CHNL147_WDATA1_ADDR A:0x289a014
y.create.l HWIO_PMIC_ARB2_CHNL148_WDATA1_ADDR A:0x28a2014
y.create.l HWIO_PMIC_ARB2_CHNL149_WDATA1_ADDR A:0x28aa014
y.create.l HWIO_PMIC_ARB2_CHNL150_WDATA1_ADDR A:0x28b2014
y.create.l HWIO_PMIC_ARB2_CHNL151_WDATA1_ADDR A:0x28ba014
y.create.l HWIO_PMIC_ARB2_CHNL152_WDATA1_ADDR A:0x28c2014
y.create.l HWIO_PMIC_ARB2_CHNL153_WDATA1_ADDR A:0x28ca014
y.create.l HWIO_PMIC_ARB2_CHNL154_WDATA1_ADDR A:0x28d2014
y.create.l HWIO_PMIC_ARB2_CHNL155_WDATA1_ADDR A:0x28da014
y.create.l HWIO_PMIC_ARB2_CHNL156_WDATA1_ADDR A:0x28e2014
y.create.l HWIO_PMIC_ARB2_CHNL157_WDATA1_ADDR A:0x28ea014
y.create.l HWIO_PMIC_ARB2_CHNL158_WDATA1_ADDR A:0x28f2014
y.create.l HWIO_PMIC_ARB2_CHNL159_WDATA1_ADDR A:0x28fa014
y.create.l HWIO_PMIC_ARB2_CHNL160_WDATA1_ADDR A:0x2902014
y.create.l HWIO_PMIC_ARB2_CHNL161_WDATA1_ADDR A:0x290a014
y.create.l HWIO_PMIC_ARB2_CHNL162_WDATA1_ADDR A:0x2912014
y.create.l HWIO_PMIC_ARB2_CHNL163_WDATA1_ADDR A:0x291a014
y.create.l HWIO_PMIC_ARB2_CHNL164_WDATA1_ADDR A:0x2922014
y.create.l HWIO_PMIC_ARB2_CHNL165_WDATA1_ADDR A:0x292a014
y.create.l HWIO_PMIC_ARB2_CHNL166_WDATA1_ADDR A:0x2932014
y.create.l HWIO_PMIC_ARB2_CHNL167_WDATA1_ADDR A:0x293a014
y.create.l HWIO_PMIC_ARB2_CHNL168_WDATA1_ADDR A:0x2942014
y.create.l HWIO_PMIC_ARB2_CHNL169_WDATA1_ADDR A:0x294a014
y.create.l HWIO_PMIC_ARB2_CHNL170_WDATA1_ADDR A:0x2952014
y.create.l HWIO_PMIC_ARB2_CHNL171_WDATA1_ADDR A:0x295a014
y.create.l HWIO_PMIC_ARB2_CHNL172_WDATA1_ADDR A:0x2962014
y.create.l HWIO_PMIC_ARB2_CHNL173_WDATA1_ADDR A:0x296a014
y.create.l HWIO_PMIC_ARB2_CHNL174_WDATA1_ADDR A:0x2972014
y.create.l HWIO_PMIC_ARB2_CHNL175_WDATA1_ADDR A:0x297a014
y.create.l HWIO_PMIC_ARB2_CHNL176_WDATA1_ADDR A:0x2982014
y.create.l HWIO_PMIC_ARB2_CHNL177_WDATA1_ADDR A:0x298a014
y.create.l HWIO_PMIC_ARB2_CHNL178_WDATA1_ADDR A:0x2992014
y.create.l HWIO_PMIC_ARB2_CHNL179_WDATA1_ADDR A:0x299a014
y.create.l HWIO_PMIC_ARB2_CHNL180_WDATA1_ADDR A:0x29a2014
y.create.l HWIO_PMIC_ARB2_CHNL181_WDATA1_ADDR A:0x29aa014
y.create.l HWIO_PMIC_ARB2_CHNL182_WDATA1_ADDR A:0x29b2014
y.create.l HWIO_PMIC_ARB2_CHNL183_WDATA1_ADDR A:0x29ba014
y.create.l HWIO_PMIC_ARB2_CHNL184_WDATA1_ADDR A:0x29c2014
y.create.l HWIO_PMIC_ARB2_CHNL185_WDATA1_ADDR A:0x29ca014
y.create.l HWIO_PMIC_ARB2_CHNL186_WDATA1_ADDR A:0x29d2014
y.create.l HWIO_PMIC_ARB2_CHNL187_WDATA1_ADDR A:0x29da014
y.create.l HWIO_PMIC_ARB2_CHNL188_WDATA1_ADDR A:0x29e2014
y.create.l HWIO_PMIC_ARB2_CHNL189_WDATA1_ADDR A:0x29ea014
y.create.l HWIO_PMIC_ARB2_CHNL190_WDATA1_ADDR A:0x29f2014
y.create.l HWIO_PMIC_ARB2_CHNL191_WDATA1_ADDR A:0x29fa014
y.create.l HWIO_PMIC_ARB2_CHNL192_WDATA1_ADDR A:0x2a02014
y.create.l HWIO_PMIC_ARB2_CHNL193_WDATA1_ADDR A:0x2a0a014
y.create.l HWIO_PMIC_ARB2_CHNL194_WDATA1_ADDR A:0x2a12014
y.create.l HWIO_PMIC_ARB2_CHNL195_WDATA1_ADDR A:0x2a1a014
y.create.l HWIO_PMIC_ARB2_CHNL196_WDATA1_ADDR A:0x2a22014
y.create.l HWIO_PMIC_ARB2_CHNL197_WDATA1_ADDR A:0x2a2a014
y.create.l HWIO_PMIC_ARB2_CHNL198_WDATA1_ADDR A:0x2a32014
y.create.l HWIO_PMIC_ARB2_CHNL199_WDATA1_ADDR A:0x2a3a014
y.create.l HWIO_PMIC_ARB2_CHNL200_WDATA1_ADDR A:0x2a42014
y.create.l HWIO_PMIC_ARB2_CHNL201_WDATA1_ADDR A:0x2a4a014
y.create.l HWIO_PMIC_ARB2_CHNL202_WDATA1_ADDR A:0x2a52014
y.create.l HWIO_PMIC_ARB2_CHNL203_WDATA1_ADDR A:0x2a5a014
y.create.l HWIO_PMIC_ARB2_CHNL204_WDATA1_ADDR A:0x2a62014
y.create.l HWIO_PMIC_ARB2_CHNL205_WDATA1_ADDR A:0x2a6a014
y.create.l HWIO_PMIC_ARB2_CHNL206_WDATA1_ADDR A:0x2a72014
y.create.l HWIO_PMIC_ARB2_CHNL207_WDATA1_ADDR A:0x2a7a014
y.create.l HWIO_PMIC_ARB2_CHNL208_WDATA1_ADDR A:0x2a82014
y.create.l HWIO_PMIC_ARB2_CHNL209_WDATA1_ADDR A:0x2a8a014
y.create.l HWIO_PMIC_ARB2_CHNL210_WDATA1_ADDR A:0x2a92014
y.create.l HWIO_PMIC_ARB2_CHNL211_WDATA1_ADDR A:0x2a9a014
y.create.l HWIO_PMIC_ARB2_CHNL212_WDATA1_ADDR A:0x2aa2014
y.create.l HWIO_PMIC_ARB2_CHNL213_WDATA1_ADDR A:0x2aaa014
y.create.l HWIO_PMIC_ARB2_CHNL214_WDATA1_ADDR A:0x2ab2014
y.create.l HWIO_PMIC_ARB2_CHNL215_WDATA1_ADDR A:0x2aba014
y.create.l HWIO_PMIC_ARB2_CHNL216_WDATA1_ADDR A:0x2ac2014
y.create.l HWIO_PMIC_ARB2_CHNL217_WDATA1_ADDR A:0x2aca014
y.create.l HWIO_PMIC_ARB2_CHNL218_WDATA1_ADDR A:0x2ad2014
y.create.l HWIO_PMIC_ARB2_CHNL219_WDATA1_ADDR A:0x2ada014
y.create.l HWIO_PMIC_ARB2_CHNL220_WDATA1_ADDR A:0x2ae2014
y.create.l HWIO_PMIC_ARB2_CHNL221_WDATA1_ADDR A:0x2aea014
y.create.l HWIO_PMIC_ARB2_CHNL222_WDATA1_ADDR A:0x2af2014
y.create.l HWIO_PMIC_ARB2_CHNL223_WDATA1_ADDR A:0x2afa014
y.create.l HWIO_PMIC_ARB2_CHNL224_WDATA1_ADDR A:0x2b02014
y.create.l HWIO_PMIC_ARB2_CHNL225_WDATA1_ADDR A:0x2b0a014
y.create.l HWIO_PMIC_ARB2_CHNL226_WDATA1_ADDR A:0x2b12014
y.create.l HWIO_PMIC_ARB2_CHNL227_WDATA1_ADDR A:0x2b1a014
y.create.l HWIO_PMIC_ARB2_CHNL228_WDATA1_ADDR A:0x2b22014
y.create.l HWIO_PMIC_ARB2_CHNL229_WDATA1_ADDR A:0x2b2a014
y.create.l HWIO_PMIC_ARB2_CHNL230_WDATA1_ADDR A:0x2b32014
y.create.l HWIO_PMIC_ARB2_CHNL231_WDATA1_ADDR A:0x2b3a014
y.create.l HWIO_PMIC_ARB2_CHNL232_WDATA1_ADDR A:0x2b42014
y.create.l HWIO_PMIC_ARB2_CHNL233_WDATA1_ADDR A:0x2b4a014
y.create.l HWIO_PMIC_ARB2_CHNL234_WDATA1_ADDR A:0x2b52014
y.create.l HWIO_PMIC_ARB2_CHNL235_WDATA1_ADDR A:0x2b5a014
y.create.l HWIO_PMIC_ARB2_CHNL236_WDATA1_ADDR A:0x2b62014
y.create.l HWIO_PMIC_ARB2_CHNL237_WDATA1_ADDR A:0x2b6a014
y.create.l HWIO_PMIC_ARB2_CHNL238_WDATA1_ADDR A:0x2b72014
y.create.l HWIO_PMIC_ARB2_CHNL239_WDATA1_ADDR A:0x2b7a014
y.create.l HWIO_PMIC_ARB2_CHNL240_WDATA1_ADDR A:0x2b82014
y.create.l HWIO_PMIC_ARB2_CHNL241_WDATA1_ADDR A:0x2b8a014
y.create.l HWIO_PMIC_ARB2_CHNL242_WDATA1_ADDR A:0x2b92014
y.create.l HWIO_PMIC_ARB2_CHNL243_WDATA1_ADDR A:0x2b9a014
y.create.l HWIO_PMIC_ARB2_CHNL244_WDATA1_ADDR A:0x2ba2014
y.create.l HWIO_PMIC_ARB2_CHNL245_WDATA1_ADDR A:0x2baa014
y.create.l HWIO_PMIC_ARB2_CHNL246_WDATA1_ADDR A:0x2bb2014
y.create.l HWIO_PMIC_ARB2_CHNL247_WDATA1_ADDR A:0x2bba014
y.create.l HWIO_PMIC_ARB2_CHNL248_WDATA1_ADDR A:0x2bc2014
y.create.l HWIO_PMIC_ARB2_CHNL249_WDATA1_ADDR A:0x2bca014
y.create.l HWIO_PMIC_ARB2_CHNL250_WDATA1_ADDR A:0x2bd2014
y.create.l HWIO_PMIC_ARB2_CHNL251_WDATA1_ADDR A:0x2bda014
y.create.l HWIO_PMIC_ARB2_CHNL252_WDATA1_ADDR A:0x2be2014
y.create.l HWIO_PMIC_ARB2_CHNL253_WDATA1_ADDR A:0x2bea014
y.create.l HWIO_PMIC_ARB2_CHNL254_WDATA1_ADDR A:0x2bf2014
y.create.l HWIO_PMIC_ARB2_CHNL255_WDATA1_ADDR A:0x2bfa014
y.create.l HWIO_PMIC_ARB3_CHNL0_WDATA1_ADDR A:0x2403014
y.create.l HWIO_PMIC_ARB3_CHNL1_WDATA1_ADDR A:0x240b014
y.create.l HWIO_PMIC_ARB3_CHNL2_WDATA1_ADDR A:0x2413014
y.create.l HWIO_PMIC_ARB3_CHNL3_WDATA1_ADDR A:0x241b014
y.create.l HWIO_PMIC_ARB3_CHNL4_WDATA1_ADDR A:0x2423014
y.create.l HWIO_PMIC_ARB3_CHNL5_WDATA1_ADDR A:0x242b014
y.create.l HWIO_PMIC_ARB3_CHNL6_WDATA1_ADDR A:0x2433014
y.create.l HWIO_PMIC_ARB3_CHNL7_WDATA1_ADDR A:0x243b014
y.create.l HWIO_PMIC_ARB3_CHNL8_WDATA1_ADDR A:0x2443014
y.create.l HWIO_PMIC_ARB3_CHNL9_WDATA1_ADDR A:0x244b014
y.create.l HWIO_PMIC_ARB3_CHNL10_WDATA1_ADDR A:0x2453014
y.create.l HWIO_PMIC_ARB3_CHNL11_WDATA1_ADDR A:0x245b014
y.create.l HWIO_PMIC_ARB3_CHNL12_WDATA1_ADDR A:0x2463014
y.create.l HWIO_PMIC_ARB3_CHNL13_WDATA1_ADDR A:0x246b014
y.create.l HWIO_PMIC_ARB3_CHNL14_WDATA1_ADDR A:0x2473014
y.create.l HWIO_PMIC_ARB3_CHNL15_WDATA1_ADDR A:0x247b014
y.create.l HWIO_PMIC_ARB3_CHNL16_WDATA1_ADDR A:0x2483014
y.create.l HWIO_PMIC_ARB3_CHNL17_WDATA1_ADDR A:0x248b014
y.create.l HWIO_PMIC_ARB3_CHNL18_WDATA1_ADDR A:0x2493014
y.create.l HWIO_PMIC_ARB3_CHNL19_WDATA1_ADDR A:0x249b014
y.create.l HWIO_PMIC_ARB3_CHNL20_WDATA1_ADDR A:0x24a3014
y.create.l HWIO_PMIC_ARB3_CHNL21_WDATA1_ADDR A:0x24ab014
y.create.l HWIO_PMIC_ARB3_CHNL22_WDATA1_ADDR A:0x24b3014
y.create.l HWIO_PMIC_ARB3_CHNL23_WDATA1_ADDR A:0x24bb014
y.create.l HWIO_PMIC_ARB3_CHNL24_WDATA1_ADDR A:0x24c3014
y.create.l HWIO_PMIC_ARB3_CHNL25_WDATA1_ADDR A:0x24cb014
y.create.l HWIO_PMIC_ARB3_CHNL26_WDATA1_ADDR A:0x24d3014
y.create.l HWIO_PMIC_ARB3_CHNL27_WDATA1_ADDR A:0x24db014
y.create.l HWIO_PMIC_ARB3_CHNL28_WDATA1_ADDR A:0x24e3014
y.create.l HWIO_PMIC_ARB3_CHNL29_WDATA1_ADDR A:0x24eb014
y.create.l HWIO_PMIC_ARB3_CHNL30_WDATA1_ADDR A:0x24f3014
y.create.l HWIO_PMIC_ARB3_CHNL31_WDATA1_ADDR A:0x24fb014
y.create.l HWIO_PMIC_ARB3_CHNL32_WDATA1_ADDR A:0x2503014
y.create.l HWIO_PMIC_ARB3_CHNL33_WDATA1_ADDR A:0x250b014
y.create.l HWIO_PMIC_ARB3_CHNL34_WDATA1_ADDR A:0x2513014
y.create.l HWIO_PMIC_ARB3_CHNL35_WDATA1_ADDR A:0x251b014
y.create.l HWIO_PMIC_ARB3_CHNL36_WDATA1_ADDR A:0x2523014
y.create.l HWIO_PMIC_ARB3_CHNL37_WDATA1_ADDR A:0x252b014
y.create.l HWIO_PMIC_ARB3_CHNL38_WDATA1_ADDR A:0x2533014
y.create.l HWIO_PMIC_ARB3_CHNL39_WDATA1_ADDR A:0x253b014
y.create.l HWIO_PMIC_ARB3_CHNL40_WDATA1_ADDR A:0x2543014
y.create.l HWIO_PMIC_ARB3_CHNL41_WDATA1_ADDR A:0x254b014
y.create.l HWIO_PMIC_ARB3_CHNL42_WDATA1_ADDR A:0x2553014
y.create.l HWIO_PMIC_ARB3_CHNL43_WDATA1_ADDR A:0x255b014
y.create.l HWIO_PMIC_ARB3_CHNL44_WDATA1_ADDR A:0x2563014
y.create.l HWIO_PMIC_ARB3_CHNL45_WDATA1_ADDR A:0x256b014
y.create.l HWIO_PMIC_ARB3_CHNL46_WDATA1_ADDR A:0x2573014
y.create.l HWIO_PMIC_ARB3_CHNL47_WDATA1_ADDR A:0x257b014
y.create.l HWIO_PMIC_ARB3_CHNL48_WDATA1_ADDR A:0x2583014
y.create.l HWIO_PMIC_ARB3_CHNL49_WDATA1_ADDR A:0x258b014
y.create.l HWIO_PMIC_ARB3_CHNL50_WDATA1_ADDR A:0x2593014
y.create.l HWIO_PMIC_ARB3_CHNL51_WDATA1_ADDR A:0x259b014
y.create.l HWIO_PMIC_ARB3_CHNL52_WDATA1_ADDR A:0x25a3014
y.create.l HWIO_PMIC_ARB3_CHNL53_WDATA1_ADDR A:0x25ab014
y.create.l HWIO_PMIC_ARB3_CHNL54_WDATA1_ADDR A:0x25b3014
y.create.l HWIO_PMIC_ARB3_CHNL55_WDATA1_ADDR A:0x25bb014
y.create.l HWIO_PMIC_ARB3_CHNL56_WDATA1_ADDR A:0x25c3014
y.create.l HWIO_PMIC_ARB3_CHNL57_WDATA1_ADDR A:0x25cb014
y.create.l HWIO_PMIC_ARB3_CHNL58_WDATA1_ADDR A:0x25d3014
y.create.l HWIO_PMIC_ARB3_CHNL59_WDATA1_ADDR A:0x25db014
y.create.l HWIO_PMIC_ARB3_CHNL60_WDATA1_ADDR A:0x25e3014
y.create.l HWIO_PMIC_ARB3_CHNL61_WDATA1_ADDR A:0x25eb014
y.create.l HWIO_PMIC_ARB3_CHNL62_WDATA1_ADDR A:0x25f3014
y.create.l HWIO_PMIC_ARB3_CHNL63_WDATA1_ADDR A:0x25fb014
y.create.l HWIO_PMIC_ARB3_CHNL64_WDATA1_ADDR A:0x2603014
y.create.l HWIO_PMIC_ARB3_CHNL65_WDATA1_ADDR A:0x260b014
y.create.l HWIO_PMIC_ARB3_CHNL66_WDATA1_ADDR A:0x2613014
y.create.l HWIO_PMIC_ARB3_CHNL67_WDATA1_ADDR A:0x261b014
y.create.l HWIO_PMIC_ARB3_CHNL68_WDATA1_ADDR A:0x2623014
y.create.l HWIO_PMIC_ARB3_CHNL69_WDATA1_ADDR A:0x262b014
y.create.l HWIO_PMIC_ARB3_CHNL70_WDATA1_ADDR A:0x2633014
y.create.l HWIO_PMIC_ARB3_CHNL71_WDATA1_ADDR A:0x263b014
y.create.l HWIO_PMIC_ARB3_CHNL72_WDATA1_ADDR A:0x2643014
y.create.l HWIO_PMIC_ARB3_CHNL73_WDATA1_ADDR A:0x264b014
y.create.l HWIO_PMIC_ARB3_CHNL74_WDATA1_ADDR A:0x2653014
y.create.l HWIO_PMIC_ARB3_CHNL75_WDATA1_ADDR A:0x265b014
y.create.l HWIO_PMIC_ARB3_CHNL76_WDATA1_ADDR A:0x2663014
y.create.l HWIO_PMIC_ARB3_CHNL77_WDATA1_ADDR A:0x266b014
y.create.l HWIO_PMIC_ARB3_CHNL78_WDATA1_ADDR A:0x2673014
y.create.l HWIO_PMIC_ARB3_CHNL79_WDATA1_ADDR A:0x267b014
y.create.l HWIO_PMIC_ARB3_CHNL80_WDATA1_ADDR A:0x2683014
y.create.l HWIO_PMIC_ARB3_CHNL81_WDATA1_ADDR A:0x268b014
y.create.l HWIO_PMIC_ARB3_CHNL82_WDATA1_ADDR A:0x2693014
y.create.l HWIO_PMIC_ARB3_CHNL83_WDATA1_ADDR A:0x269b014
y.create.l HWIO_PMIC_ARB3_CHNL84_WDATA1_ADDR A:0x26a3014
y.create.l HWIO_PMIC_ARB3_CHNL85_WDATA1_ADDR A:0x26ab014
y.create.l HWIO_PMIC_ARB3_CHNL86_WDATA1_ADDR A:0x26b3014
y.create.l HWIO_PMIC_ARB3_CHNL87_WDATA1_ADDR A:0x26bb014
y.create.l HWIO_PMIC_ARB3_CHNL88_WDATA1_ADDR A:0x26c3014
y.create.l HWIO_PMIC_ARB3_CHNL89_WDATA1_ADDR A:0x26cb014
y.create.l HWIO_PMIC_ARB3_CHNL90_WDATA1_ADDR A:0x26d3014
y.create.l HWIO_PMIC_ARB3_CHNL91_WDATA1_ADDR A:0x26db014
y.create.l HWIO_PMIC_ARB3_CHNL92_WDATA1_ADDR A:0x26e3014
y.create.l HWIO_PMIC_ARB3_CHNL93_WDATA1_ADDR A:0x26eb014
y.create.l HWIO_PMIC_ARB3_CHNL94_WDATA1_ADDR A:0x26f3014
y.create.l HWIO_PMIC_ARB3_CHNL95_WDATA1_ADDR A:0x26fb014
y.create.l HWIO_PMIC_ARB3_CHNL96_WDATA1_ADDR A:0x2703014
y.create.l HWIO_PMIC_ARB3_CHNL97_WDATA1_ADDR A:0x270b014
y.create.l HWIO_PMIC_ARB3_CHNL98_WDATA1_ADDR A:0x2713014
y.create.l HWIO_PMIC_ARB3_CHNL99_WDATA1_ADDR A:0x271b014
y.create.l HWIO_PMIC_ARB3_CHNL100_WDATA1_ADDR A:0x2723014
y.create.l HWIO_PMIC_ARB3_CHNL101_WDATA1_ADDR A:0x272b014
y.create.l HWIO_PMIC_ARB3_CHNL102_WDATA1_ADDR A:0x2733014
y.create.l HWIO_PMIC_ARB3_CHNL103_WDATA1_ADDR A:0x273b014
y.create.l HWIO_PMIC_ARB3_CHNL104_WDATA1_ADDR A:0x2743014
y.create.l HWIO_PMIC_ARB3_CHNL105_WDATA1_ADDR A:0x274b014
y.create.l HWIO_PMIC_ARB3_CHNL106_WDATA1_ADDR A:0x2753014
y.create.l HWIO_PMIC_ARB3_CHNL107_WDATA1_ADDR A:0x275b014
y.create.l HWIO_PMIC_ARB3_CHNL108_WDATA1_ADDR A:0x2763014
y.create.l HWIO_PMIC_ARB3_CHNL109_WDATA1_ADDR A:0x276b014
y.create.l HWIO_PMIC_ARB3_CHNL110_WDATA1_ADDR A:0x2773014
y.create.l HWIO_PMIC_ARB3_CHNL111_WDATA1_ADDR A:0x277b014
y.create.l HWIO_PMIC_ARB3_CHNL112_WDATA1_ADDR A:0x2783014
y.create.l HWIO_PMIC_ARB3_CHNL113_WDATA1_ADDR A:0x278b014
y.create.l HWIO_PMIC_ARB3_CHNL114_WDATA1_ADDR A:0x2793014
y.create.l HWIO_PMIC_ARB3_CHNL115_WDATA1_ADDR A:0x279b014
y.create.l HWIO_PMIC_ARB3_CHNL116_WDATA1_ADDR A:0x27a3014
y.create.l HWIO_PMIC_ARB3_CHNL117_WDATA1_ADDR A:0x27ab014
y.create.l HWIO_PMIC_ARB3_CHNL118_WDATA1_ADDR A:0x27b3014
y.create.l HWIO_PMIC_ARB3_CHNL119_WDATA1_ADDR A:0x27bb014
y.create.l HWIO_PMIC_ARB3_CHNL120_WDATA1_ADDR A:0x27c3014
y.create.l HWIO_PMIC_ARB3_CHNL121_WDATA1_ADDR A:0x27cb014
y.create.l HWIO_PMIC_ARB3_CHNL122_WDATA1_ADDR A:0x27d3014
y.create.l HWIO_PMIC_ARB3_CHNL123_WDATA1_ADDR A:0x27db014
y.create.l HWIO_PMIC_ARB3_CHNL124_WDATA1_ADDR A:0x27e3014
y.create.l HWIO_PMIC_ARB3_CHNL125_WDATA1_ADDR A:0x27eb014
y.create.l HWIO_PMIC_ARB3_CHNL126_WDATA1_ADDR A:0x27f3014
y.create.l HWIO_PMIC_ARB3_CHNL127_WDATA1_ADDR A:0x27fb014
y.create.l HWIO_PMIC_ARB3_CHNL128_WDATA1_ADDR A:0x2803014
y.create.l HWIO_PMIC_ARB3_CHNL129_WDATA1_ADDR A:0x280b014
y.create.l HWIO_PMIC_ARB3_CHNL130_WDATA1_ADDR A:0x2813014
y.create.l HWIO_PMIC_ARB3_CHNL131_WDATA1_ADDR A:0x281b014
y.create.l HWIO_PMIC_ARB3_CHNL132_WDATA1_ADDR A:0x2823014
y.create.l HWIO_PMIC_ARB3_CHNL133_WDATA1_ADDR A:0x282b014
y.create.l HWIO_PMIC_ARB3_CHNL134_WDATA1_ADDR A:0x2833014
y.create.l HWIO_PMIC_ARB3_CHNL135_WDATA1_ADDR A:0x283b014
y.create.l HWIO_PMIC_ARB3_CHNL136_WDATA1_ADDR A:0x2843014
y.create.l HWIO_PMIC_ARB3_CHNL137_WDATA1_ADDR A:0x284b014
y.create.l HWIO_PMIC_ARB3_CHNL138_WDATA1_ADDR A:0x2853014
y.create.l HWIO_PMIC_ARB3_CHNL139_WDATA1_ADDR A:0x285b014
y.create.l HWIO_PMIC_ARB3_CHNL140_WDATA1_ADDR A:0x2863014
y.create.l HWIO_PMIC_ARB3_CHNL141_WDATA1_ADDR A:0x286b014
y.create.l HWIO_PMIC_ARB3_CHNL142_WDATA1_ADDR A:0x2873014
y.create.l HWIO_PMIC_ARB3_CHNL143_WDATA1_ADDR A:0x287b014
y.create.l HWIO_PMIC_ARB3_CHNL144_WDATA1_ADDR A:0x2883014
y.create.l HWIO_PMIC_ARB3_CHNL145_WDATA1_ADDR A:0x288b014
y.create.l HWIO_PMIC_ARB3_CHNL146_WDATA1_ADDR A:0x2893014
y.create.l HWIO_PMIC_ARB3_CHNL147_WDATA1_ADDR A:0x289b014
y.create.l HWIO_PMIC_ARB3_CHNL148_WDATA1_ADDR A:0x28a3014
y.create.l HWIO_PMIC_ARB3_CHNL149_WDATA1_ADDR A:0x28ab014
y.create.l HWIO_PMIC_ARB3_CHNL150_WDATA1_ADDR A:0x28b3014
y.create.l HWIO_PMIC_ARB3_CHNL151_WDATA1_ADDR A:0x28bb014
y.create.l HWIO_PMIC_ARB3_CHNL152_WDATA1_ADDR A:0x28c3014
y.create.l HWIO_PMIC_ARB3_CHNL153_WDATA1_ADDR A:0x28cb014
y.create.l HWIO_PMIC_ARB3_CHNL154_WDATA1_ADDR A:0x28d3014
y.create.l HWIO_PMIC_ARB3_CHNL155_WDATA1_ADDR A:0x28db014
y.create.l HWIO_PMIC_ARB3_CHNL156_WDATA1_ADDR A:0x28e3014
y.create.l HWIO_PMIC_ARB3_CHNL157_WDATA1_ADDR A:0x28eb014
y.create.l HWIO_PMIC_ARB3_CHNL158_WDATA1_ADDR A:0x28f3014
y.create.l HWIO_PMIC_ARB3_CHNL159_WDATA1_ADDR A:0x28fb014
y.create.l HWIO_PMIC_ARB3_CHNL160_WDATA1_ADDR A:0x2903014
y.create.l HWIO_PMIC_ARB3_CHNL161_WDATA1_ADDR A:0x290b014
y.create.l HWIO_PMIC_ARB3_CHNL162_WDATA1_ADDR A:0x2913014
y.create.l HWIO_PMIC_ARB3_CHNL163_WDATA1_ADDR A:0x291b014
y.create.l HWIO_PMIC_ARB3_CHNL164_WDATA1_ADDR A:0x2923014
y.create.l HWIO_PMIC_ARB3_CHNL165_WDATA1_ADDR A:0x292b014
y.create.l HWIO_PMIC_ARB3_CHNL166_WDATA1_ADDR A:0x2933014
y.create.l HWIO_PMIC_ARB3_CHNL167_WDATA1_ADDR A:0x293b014
y.create.l HWIO_PMIC_ARB3_CHNL168_WDATA1_ADDR A:0x2943014
y.create.l HWIO_PMIC_ARB3_CHNL169_WDATA1_ADDR A:0x294b014
y.create.l HWIO_PMIC_ARB3_CHNL170_WDATA1_ADDR A:0x2953014
y.create.l HWIO_PMIC_ARB3_CHNL171_WDATA1_ADDR A:0x295b014
y.create.l HWIO_PMIC_ARB3_CHNL172_WDATA1_ADDR A:0x2963014
y.create.l HWIO_PMIC_ARB3_CHNL173_WDATA1_ADDR A:0x296b014
y.create.l HWIO_PMIC_ARB3_CHNL174_WDATA1_ADDR A:0x2973014
y.create.l HWIO_PMIC_ARB3_CHNL175_WDATA1_ADDR A:0x297b014
y.create.l HWIO_PMIC_ARB3_CHNL176_WDATA1_ADDR A:0x2983014
y.create.l HWIO_PMIC_ARB3_CHNL177_WDATA1_ADDR A:0x298b014
y.create.l HWIO_PMIC_ARB3_CHNL178_WDATA1_ADDR A:0x2993014
y.create.l HWIO_PMIC_ARB3_CHNL179_WDATA1_ADDR A:0x299b014
y.create.l HWIO_PMIC_ARB3_CHNL180_WDATA1_ADDR A:0x29a3014
y.create.l HWIO_PMIC_ARB3_CHNL181_WDATA1_ADDR A:0x29ab014
y.create.l HWIO_PMIC_ARB3_CHNL182_WDATA1_ADDR A:0x29b3014
y.create.l HWIO_PMIC_ARB3_CHNL183_WDATA1_ADDR A:0x29bb014
y.create.l HWIO_PMIC_ARB3_CHNL184_WDATA1_ADDR A:0x29c3014
y.create.l HWIO_PMIC_ARB3_CHNL185_WDATA1_ADDR A:0x29cb014
y.create.l HWIO_PMIC_ARB3_CHNL186_WDATA1_ADDR A:0x29d3014
y.create.l HWIO_PMIC_ARB3_CHNL187_WDATA1_ADDR A:0x29db014
y.create.l HWIO_PMIC_ARB3_CHNL188_WDATA1_ADDR A:0x29e3014
y.create.l HWIO_PMIC_ARB3_CHNL189_WDATA1_ADDR A:0x29eb014
y.create.l HWIO_PMIC_ARB3_CHNL190_WDATA1_ADDR A:0x29f3014
y.create.l HWIO_PMIC_ARB3_CHNL191_WDATA1_ADDR A:0x29fb014
y.create.l HWIO_PMIC_ARB3_CHNL192_WDATA1_ADDR A:0x2a03014
y.create.l HWIO_PMIC_ARB3_CHNL193_WDATA1_ADDR A:0x2a0b014
y.create.l HWIO_PMIC_ARB3_CHNL194_WDATA1_ADDR A:0x2a13014
y.create.l HWIO_PMIC_ARB3_CHNL195_WDATA1_ADDR A:0x2a1b014
y.create.l HWIO_PMIC_ARB3_CHNL196_WDATA1_ADDR A:0x2a23014
y.create.l HWIO_PMIC_ARB3_CHNL197_WDATA1_ADDR A:0x2a2b014
y.create.l HWIO_PMIC_ARB3_CHNL198_WDATA1_ADDR A:0x2a33014
y.create.l HWIO_PMIC_ARB3_CHNL199_WDATA1_ADDR A:0x2a3b014
y.create.l HWIO_PMIC_ARB3_CHNL200_WDATA1_ADDR A:0x2a43014
y.create.l HWIO_PMIC_ARB3_CHNL201_WDATA1_ADDR A:0x2a4b014
y.create.l HWIO_PMIC_ARB3_CHNL202_WDATA1_ADDR A:0x2a53014
y.create.l HWIO_PMIC_ARB3_CHNL203_WDATA1_ADDR A:0x2a5b014
y.create.l HWIO_PMIC_ARB3_CHNL204_WDATA1_ADDR A:0x2a63014
y.create.l HWIO_PMIC_ARB3_CHNL205_WDATA1_ADDR A:0x2a6b014
y.create.l HWIO_PMIC_ARB3_CHNL206_WDATA1_ADDR A:0x2a73014
y.create.l HWIO_PMIC_ARB3_CHNL207_WDATA1_ADDR A:0x2a7b014
y.create.l HWIO_PMIC_ARB3_CHNL208_WDATA1_ADDR A:0x2a83014
y.create.l HWIO_PMIC_ARB3_CHNL209_WDATA1_ADDR A:0x2a8b014
y.create.l HWIO_PMIC_ARB3_CHNL210_WDATA1_ADDR A:0x2a93014
y.create.l HWIO_PMIC_ARB3_CHNL211_WDATA1_ADDR A:0x2a9b014
y.create.l HWIO_PMIC_ARB3_CHNL212_WDATA1_ADDR A:0x2aa3014
y.create.l HWIO_PMIC_ARB3_CHNL213_WDATA1_ADDR A:0x2aab014
y.create.l HWIO_PMIC_ARB3_CHNL214_WDATA1_ADDR A:0x2ab3014
y.create.l HWIO_PMIC_ARB3_CHNL215_WDATA1_ADDR A:0x2abb014
y.create.l HWIO_PMIC_ARB3_CHNL216_WDATA1_ADDR A:0x2ac3014
y.create.l HWIO_PMIC_ARB3_CHNL217_WDATA1_ADDR A:0x2acb014
y.create.l HWIO_PMIC_ARB3_CHNL218_WDATA1_ADDR A:0x2ad3014
y.create.l HWIO_PMIC_ARB3_CHNL219_WDATA1_ADDR A:0x2adb014
y.create.l HWIO_PMIC_ARB3_CHNL220_WDATA1_ADDR A:0x2ae3014
y.create.l HWIO_PMIC_ARB3_CHNL221_WDATA1_ADDR A:0x2aeb014
y.create.l HWIO_PMIC_ARB3_CHNL222_WDATA1_ADDR A:0x2af3014
y.create.l HWIO_PMIC_ARB3_CHNL223_WDATA1_ADDR A:0x2afb014
y.create.l HWIO_PMIC_ARB3_CHNL224_WDATA1_ADDR A:0x2b03014
y.create.l HWIO_PMIC_ARB3_CHNL225_WDATA1_ADDR A:0x2b0b014
y.create.l HWIO_PMIC_ARB3_CHNL226_WDATA1_ADDR A:0x2b13014
y.create.l HWIO_PMIC_ARB3_CHNL227_WDATA1_ADDR A:0x2b1b014
y.create.l HWIO_PMIC_ARB3_CHNL228_WDATA1_ADDR A:0x2b23014
y.create.l HWIO_PMIC_ARB3_CHNL229_WDATA1_ADDR A:0x2b2b014
y.create.l HWIO_PMIC_ARB3_CHNL230_WDATA1_ADDR A:0x2b33014
y.create.l HWIO_PMIC_ARB3_CHNL231_WDATA1_ADDR A:0x2b3b014
y.create.l HWIO_PMIC_ARB3_CHNL232_WDATA1_ADDR A:0x2b43014
y.create.l HWIO_PMIC_ARB3_CHNL233_WDATA1_ADDR A:0x2b4b014
y.create.l HWIO_PMIC_ARB3_CHNL234_WDATA1_ADDR A:0x2b53014
y.create.l HWIO_PMIC_ARB3_CHNL235_WDATA1_ADDR A:0x2b5b014
y.create.l HWIO_PMIC_ARB3_CHNL236_WDATA1_ADDR A:0x2b63014
y.create.l HWIO_PMIC_ARB3_CHNL237_WDATA1_ADDR A:0x2b6b014
y.create.l HWIO_PMIC_ARB3_CHNL238_WDATA1_ADDR A:0x2b73014
y.create.l HWIO_PMIC_ARB3_CHNL239_WDATA1_ADDR A:0x2b7b014
y.create.l HWIO_PMIC_ARB3_CHNL240_WDATA1_ADDR A:0x2b83014
y.create.l HWIO_PMIC_ARB3_CHNL241_WDATA1_ADDR A:0x2b8b014
y.create.l HWIO_PMIC_ARB3_CHNL242_WDATA1_ADDR A:0x2b93014
y.create.l HWIO_PMIC_ARB3_CHNL243_WDATA1_ADDR A:0x2b9b014
y.create.l HWIO_PMIC_ARB3_CHNL244_WDATA1_ADDR A:0x2ba3014
y.create.l HWIO_PMIC_ARB3_CHNL245_WDATA1_ADDR A:0x2bab014
y.create.l HWIO_PMIC_ARB3_CHNL246_WDATA1_ADDR A:0x2bb3014
y.create.l HWIO_PMIC_ARB3_CHNL247_WDATA1_ADDR A:0x2bbb014
y.create.l HWIO_PMIC_ARB3_CHNL248_WDATA1_ADDR A:0x2bc3014
y.create.l HWIO_PMIC_ARB3_CHNL249_WDATA1_ADDR A:0x2bcb014
y.create.l HWIO_PMIC_ARB3_CHNL250_WDATA1_ADDR A:0x2bd3014
y.create.l HWIO_PMIC_ARB3_CHNL251_WDATA1_ADDR A:0x2bdb014
y.create.l HWIO_PMIC_ARB3_CHNL252_WDATA1_ADDR A:0x2be3014
y.create.l HWIO_PMIC_ARB3_CHNL253_WDATA1_ADDR A:0x2beb014
y.create.l HWIO_PMIC_ARB3_CHNL254_WDATA1_ADDR A:0x2bf3014
y.create.l HWIO_PMIC_ARB3_CHNL255_WDATA1_ADDR A:0x2bfb014
y.create.l HWIO_PMIC_ARB4_CHNL0_WDATA1_ADDR A:0x2404014
y.create.l HWIO_PMIC_ARB4_CHNL1_WDATA1_ADDR A:0x240c014
y.create.l HWIO_PMIC_ARB4_CHNL2_WDATA1_ADDR A:0x2414014
y.create.l HWIO_PMIC_ARB4_CHNL3_WDATA1_ADDR A:0x241c014
y.create.l HWIO_PMIC_ARB4_CHNL4_WDATA1_ADDR A:0x2424014
y.create.l HWIO_PMIC_ARB4_CHNL5_WDATA1_ADDR A:0x242c014
y.create.l HWIO_PMIC_ARB4_CHNL6_WDATA1_ADDR A:0x2434014
y.create.l HWIO_PMIC_ARB4_CHNL7_WDATA1_ADDR A:0x243c014
y.create.l HWIO_PMIC_ARB4_CHNL8_WDATA1_ADDR A:0x2444014
y.create.l HWIO_PMIC_ARB4_CHNL9_WDATA1_ADDR A:0x244c014
y.create.l HWIO_PMIC_ARB4_CHNL10_WDATA1_ADDR A:0x2454014
y.create.l HWIO_PMIC_ARB4_CHNL11_WDATA1_ADDR A:0x245c014
y.create.l HWIO_PMIC_ARB4_CHNL12_WDATA1_ADDR A:0x2464014
y.create.l HWIO_PMIC_ARB4_CHNL13_WDATA1_ADDR A:0x246c014
y.create.l HWIO_PMIC_ARB4_CHNL14_WDATA1_ADDR A:0x2474014
y.create.l HWIO_PMIC_ARB4_CHNL15_WDATA1_ADDR A:0x247c014
y.create.l HWIO_PMIC_ARB4_CHNL16_WDATA1_ADDR A:0x2484014
y.create.l HWIO_PMIC_ARB4_CHNL17_WDATA1_ADDR A:0x248c014
y.create.l HWIO_PMIC_ARB4_CHNL18_WDATA1_ADDR A:0x2494014
y.create.l HWIO_PMIC_ARB4_CHNL19_WDATA1_ADDR A:0x249c014
y.create.l HWIO_PMIC_ARB4_CHNL20_WDATA1_ADDR A:0x24a4014
y.create.l HWIO_PMIC_ARB4_CHNL21_WDATA1_ADDR A:0x24ac014
y.create.l HWIO_PMIC_ARB4_CHNL22_WDATA1_ADDR A:0x24b4014
y.create.l HWIO_PMIC_ARB4_CHNL23_WDATA1_ADDR A:0x24bc014
y.create.l HWIO_PMIC_ARB4_CHNL24_WDATA1_ADDR A:0x24c4014
y.create.l HWIO_PMIC_ARB4_CHNL25_WDATA1_ADDR A:0x24cc014
y.create.l HWIO_PMIC_ARB4_CHNL26_WDATA1_ADDR A:0x24d4014
y.create.l HWIO_PMIC_ARB4_CHNL27_WDATA1_ADDR A:0x24dc014
y.create.l HWIO_PMIC_ARB4_CHNL28_WDATA1_ADDR A:0x24e4014
y.create.l HWIO_PMIC_ARB4_CHNL29_WDATA1_ADDR A:0x24ec014
y.create.l HWIO_PMIC_ARB4_CHNL30_WDATA1_ADDR A:0x24f4014
y.create.l HWIO_PMIC_ARB4_CHNL31_WDATA1_ADDR A:0x24fc014
y.create.l HWIO_PMIC_ARB4_CHNL32_WDATA1_ADDR A:0x2504014
y.create.l HWIO_PMIC_ARB4_CHNL33_WDATA1_ADDR A:0x250c014
y.create.l HWIO_PMIC_ARB4_CHNL34_WDATA1_ADDR A:0x2514014
y.create.l HWIO_PMIC_ARB4_CHNL35_WDATA1_ADDR A:0x251c014
y.create.l HWIO_PMIC_ARB4_CHNL36_WDATA1_ADDR A:0x2524014
y.create.l HWIO_PMIC_ARB4_CHNL37_WDATA1_ADDR A:0x252c014
y.create.l HWIO_PMIC_ARB4_CHNL38_WDATA1_ADDR A:0x2534014
y.create.l HWIO_PMIC_ARB4_CHNL39_WDATA1_ADDR A:0x253c014
y.create.l HWIO_PMIC_ARB4_CHNL40_WDATA1_ADDR A:0x2544014
y.create.l HWIO_PMIC_ARB4_CHNL41_WDATA1_ADDR A:0x254c014
y.create.l HWIO_PMIC_ARB4_CHNL42_WDATA1_ADDR A:0x2554014
y.create.l HWIO_PMIC_ARB4_CHNL43_WDATA1_ADDR A:0x255c014
y.create.l HWIO_PMIC_ARB4_CHNL44_WDATA1_ADDR A:0x2564014
y.create.l HWIO_PMIC_ARB4_CHNL45_WDATA1_ADDR A:0x256c014
y.create.l HWIO_PMIC_ARB4_CHNL46_WDATA1_ADDR A:0x2574014
y.create.l HWIO_PMIC_ARB4_CHNL47_WDATA1_ADDR A:0x257c014
y.create.l HWIO_PMIC_ARB4_CHNL48_WDATA1_ADDR A:0x2584014
y.create.l HWIO_PMIC_ARB4_CHNL49_WDATA1_ADDR A:0x258c014
y.create.l HWIO_PMIC_ARB4_CHNL50_WDATA1_ADDR A:0x2594014
y.create.l HWIO_PMIC_ARB4_CHNL51_WDATA1_ADDR A:0x259c014
y.create.l HWIO_PMIC_ARB4_CHNL52_WDATA1_ADDR A:0x25a4014
y.create.l HWIO_PMIC_ARB4_CHNL53_WDATA1_ADDR A:0x25ac014
y.create.l HWIO_PMIC_ARB4_CHNL54_WDATA1_ADDR A:0x25b4014
y.create.l HWIO_PMIC_ARB4_CHNL55_WDATA1_ADDR A:0x25bc014
y.create.l HWIO_PMIC_ARB4_CHNL56_WDATA1_ADDR A:0x25c4014
y.create.l HWIO_PMIC_ARB4_CHNL57_WDATA1_ADDR A:0x25cc014
y.create.l HWIO_PMIC_ARB4_CHNL58_WDATA1_ADDR A:0x25d4014
y.create.l HWIO_PMIC_ARB4_CHNL59_WDATA1_ADDR A:0x25dc014
y.create.l HWIO_PMIC_ARB4_CHNL60_WDATA1_ADDR A:0x25e4014
y.create.l HWIO_PMIC_ARB4_CHNL61_WDATA1_ADDR A:0x25ec014
y.create.l HWIO_PMIC_ARB4_CHNL62_WDATA1_ADDR A:0x25f4014
y.create.l HWIO_PMIC_ARB4_CHNL63_WDATA1_ADDR A:0x25fc014
y.create.l HWIO_PMIC_ARB4_CHNL64_WDATA1_ADDR A:0x2604014
y.create.l HWIO_PMIC_ARB4_CHNL65_WDATA1_ADDR A:0x260c014
y.create.l HWIO_PMIC_ARB4_CHNL66_WDATA1_ADDR A:0x2614014
y.create.l HWIO_PMIC_ARB4_CHNL67_WDATA1_ADDR A:0x261c014
y.create.l HWIO_PMIC_ARB4_CHNL68_WDATA1_ADDR A:0x2624014
y.create.l HWIO_PMIC_ARB4_CHNL69_WDATA1_ADDR A:0x262c014
y.create.l HWIO_PMIC_ARB4_CHNL70_WDATA1_ADDR A:0x2634014
y.create.l HWIO_PMIC_ARB4_CHNL71_WDATA1_ADDR A:0x263c014
y.create.l HWIO_PMIC_ARB4_CHNL72_WDATA1_ADDR A:0x2644014
y.create.l HWIO_PMIC_ARB4_CHNL73_WDATA1_ADDR A:0x264c014
y.create.l HWIO_PMIC_ARB4_CHNL74_WDATA1_ADDR A:0x2654014
y.create.l HWIO_PMIC_ARB4_CHNL75_WDATA1_ADDR A:0x265c014
y.create.l HWIO_PMIC_ARB4_CHNL76_WDATA1_ADDR A:0x2664014
y.create.l HWIO_PMIC_ARB4_CHNL77_WDATA1_ADDR A:0x266c014
y.create.l HWIO_PMIC_ARB4_CHNL78_WDATA1_ADDR A:0x2674014
y.create.l HWIO_PMIC_ARB4_CHNL79_WDATA1_ADDR A:0x267c014
y.create.l HWIO_PMIC_ARB4_CHNL80_WDATA1_ADDR A:0x2684014
y.create.l HWIO_PMIC_ARB4_CHNL81_WDATA1_ADDR A:0x268c014
y.create.l HWIO_PMIC_ARB4_CHNL82_WDATA1_ADDR A:0x2694014
y.create.l HWIO_PMIC_ARB4_CHNL83_WDATA1_ADDR A:0x269c014
y.create.l HWIO_PMIC_ARB4_CHNL84_WDATA1_ADDR A:0x26a4014
y.create.l HWIO_PMIC_ARB4_CHNL85_WDATA1_ADDR A:0x26ac014
y.create.l HWIO_PMIC_ARB4_CHNL86_WDATA1_ADDR A:0x26b4014
y.create.l HWIO_PMIC_ARB4_CHNL87_WDATA1_ADDR A:0x26bc014
y.create.l HWIO_PMIC_ARB4_CHNL88_WDATA1_ADDR A:0x26c4014
y.create.l HWIO_PMIC_ARB4_CHNL89_WDATA1_ADDR A:0x26cc014
y.create.l HWIO_PMIC_ARB4_CHNL90_WDATA1_ADDR A:0x26d4014
y.create.l HWIO_PMIC_ARB4_CHNL91_WDATA1_ADDR A:0x26dc014
y.create.l HWIO_PMIC_ARB4_CHNL92_WDATA1_ADDR A:0x26e4014
y.create.l HWIO_PMIC_ARB4_CHNL93_WDATA1_ADDR A:0x26ec014
y.create.l HWIO_PMIC_ARB4_CHNL94_WDATA1_ADDR A:0x26f4014
y.create.l HWIO_PMIC_ARB4_CHNL95_WDATA1_ADDR A:0x26fc014
y.create.l HWIO_PMIC_ARB4_CHNL96_WDATA1_ADDR A:0x2704014
y.create.l HWIO_PMIC_ARB4_CHNL97_WDATA1_ADDR A:0x270c014
y.create.l HWIO_PMIC_ARB4_CHNL98_WDATA1_ADDR A:0x2714014
y.create.l HWIO_PMIC_ARB4_CHNL99_WDATA1_ADDR A:0x271c014
y.create.l HWIO_PMIC_ARB4_CHNL100_WDATA1_ADDR A:0x2724014
y.create.l HWIO_PMIC_ARB4_CHNL101_WDATA1_ADDR A:0x272c014
y.create.l HWIO_PMIC_ARB4_CHNL102_WDATA1_ADDR A:0x2734014
y.create.l HWIO_PMIC_ARB4_CHNL103_WDATA1_ADDR A:0x273c014
y.create.l HWIO_PMIC_ARB4_CHNL104_WDATA1_ADDR A:0x2744014
y.create.l HWIO_PMIC_ARB4_CHNL105_WDATA1_ADDR A:0x274c014
y.create.l HWIO_PMIC_ARB4_CHNL106_WDATA1_ADDR A:0x2754014
y.create.l HWIO_PMIC_ARB4_CHNL107_WDATA1_ADDR A:0x275c014
y.create.l HWIO_PMIC_ARB4_CHNL108_WDATA1_ADDR A:0x2764014
y.create.l HWIO_PMIC_ARB4_CHNL109_WDATA1_ADDR A:0x276c014
y.create.l HWIO_PMIC_ARB4_CHNL110_WDATA1_ADDR A:0x2774014
y.create.l HWIO_PMIC_ARB4_CHNL111_WDATA1_ADDR A:0x277c014
y.create.l HWIO_PMIC_ARB4_CHNL112_WDATA1_ADDR A:0x2784014
y.create.l HWIO_PMIC_ARB4_CHNL113_WDATA1_ADDR A:0x278c014
y.create.l HWIO_PMIC_ARB4_CHNL114_WDATA1_ADDR A:0x2794014
y.create.l HWIO_PMIC_ARB4_CHNL115_WDATA1_ADDR A:0x279c014
y.create.l HWIO_PMIC_ARB4_CHNL116_WDATA1_ADDR A:0x27a4014
y.create.l HWIO_PMIC_ARB4_CHNL117_WDATA1_ADDR A:0x27ac014
y.create.l HWIO_PMIC_ARB4_CHNL118_WDATA1_ADDR A:0x27b4014
y.create.l HWIO_PMIC_ARB4_CHNL119_WDATA1_ADDR A:0x27bc014
y.create.l HWIO_PMIC_ARB4_CHNL120_WDATA1_ADDR A:0x27c4014
y.create.l HWIO_PMIC_ARB4_CHNL121_WDATA1_ADDR A:0x27cc014
y.create.l HWIO_PMIC_ARB4_CHNL122_WDATA1_ADDR A:0x27d4014
y.create.l HWIO_PMIC_ARB4_CHNL123_WDATA1_ADDR A:0x27dc014
y.create.l HWIO_PMIC_ARB4_CHNL124_WDATA1_ADDR A:0x27e4014
y.create.l HWIO_PMIC_ARB4_CHNL125_WDATA1_ADDR A:0x27ec014
y.create.l HWIO_PMIC_ARB4_CHNL126_WDATA1_ADDR A:0x27f4014
y.create.l HWIO_PMIC_ARB4_CHNL127_WDATA1_ADDR A:0x27fc014
y.create.l HWIO_PMIC_ARB4_CHNL128_WDATA1_ADDR A:0x2804014
y.create.l HWIO_PMIC_ARB4_CHNL129_WDATA1_ADDR A:0x280c014
y.create.l HWIO_PMIC_ARB4_CHNL130_WDATA1_ADDR A:0x2814014
y.create.l HWIO_PMIC_ARB4_CHNL131_WDATA1_ADDR A:0x281c014
y.create.l HWIO_PMIC_ARB4_CHNL132_WDATA1_ADDR A:0x2824014
y.create.l HWIO_PMIC_ARB4_CHNL133_WDATA1_ADDR A:0x282c014
y.create.l HWIO_PMIC_ARB4_CHNL134_WDATA1_ADDR A:0x2834014
y.create.l HWIO_PMIC_ARB4_CHNL135_WDATA1_ADDR A:0x283c014
y.create.l HWIO_PMIC_ARB4_CHNL136_WDATA1_ADDR A:0x2844014
y.create.l HWIO_PMIC_ARB4_CHNL137_WDATA1_ADDR A:0x284c014
y.create.l HWIO_PMIC_ARB4_CHNL138_WDATA1_ADDR A:0x2854014
y.create.l HWIO_PMIC_ARB4_CHNL139_WDATA1_ADDR A:0x285c014
y.create.l HWIO_PMIC_ARB4_CHNL140_WDATA1_ADDR A:0x2864014
y.create.l HWIO_PMIC_ARB4_CHNL141_WDATA1_ADDR A:0x286c014
y.create.l HWIO_PMIC_ARB4_CHNL142_WDATA1_ADDR A:0x2874014
y.create.l HWIO_PMIC_ARB4_CHNL143_WDATA1_ADDR A:0x287c014
y.create.l HWIO_PMIC_ARB4_CHNL144_WDATA1_ADDR A:0x2884014
y.create.l HWIO_PMIC_ARB4_CHNL145_WDATA1_ADDR A:0x288c014
y.create.l HWIO_PMIC_ARB4_CHNL146_WDATA1_ADDR A:0x2894014
y.create.l HWIO_PMIC_ARB4_CHNL147_WDATA1_ADDR A:0x289c014
y.create.l HWIO_PMIC_ARB4_CHNL148_WDATA1_ADDR A:0x28a4014
y.create.l HWIO_PMIC_ARB4_CHNL149_WDATA1_ADDR A:0x28ac014
y.create.l HWIO_PMIC_ARB4_CHNL150_WDATA1_ADDR A:0x28b4014
y.create.l HWIO_PMIC_ARB4_CHNL151_WDATA1_ADDR A:0x28bc014
y.create.l HWIO_PMIC_ARB4_CHNL152_WDATA1_ADDR A:0x28c4014
y.create.l HWIO_PMIC_ARB4_CHNL153_WDATA1_ADDR A:0x28cc014
y.create.l HWIO_PMIC_ARB4_CHNL154_WDATA1_ADDR A:0x28d4014
y.create.l HWIO_PMIC_ARB4_CHNL155_WDATA1_ADDR A:0x28dc014
y.create.l HWIO_PMIC_ARB4_CHNL156_WDATA1_ADDR A:0x28e4014
y.create.l HWIO_PMIC_ARB4_CHNL157_WDATA1_ADDR A:0x28ec014
y.create.l HWIO_PMIC_ARB4_CHNL158_WDATA1_ADDR A:0x28f4014
y.create.l HWIO_PMIC_ARB4_CHNL159_WDATA1_ADDR A:0x28fc014
y.create.l HWIO_PMIC_ARB4_CHNL160_WDATA1_ADDR A:0x2904014
y.create.l HWIO_PMIC_ARB4_CHNL161_WDATA1_ADDR A:0x290c014
y.create.l HWIO_PMIC_ARB4_CHNL162_WDATA1_ADDR A:0x2914014
y.create.l HWIO_PMIC_ARB4_CHNL163_WDATA1_ADDR A:0x291c014
y.create.l HWIO_PMIC_ARB4_CHNL164_WDATA1_ADDR A:0x2924014
y.create.l HWIO_PMIC_ARB4_CHNL165_WDATA1_ADDR A:0x292c014
y.create.l HWIO_PMIC_ARB4_CHNL166_WDATA1_ADDR A:0x2934014
y.create.l HWIO_PMIC_ARB4_CHNL167_WDATA1_ADDR A:0x293c014
y.create.l HWIO_PMIC_ARB4_CHNL168_WDATA1_ADDR A:0x2944014
y.create.l HWIO_PMIC_ARB4_CHNL169_WDATA1_ADDR A:0x294c014
y.create.l HWIO_PMIC_ARB4_CHNL170_WDATA1_ADDR A:0x2954014
y.create.l HWIO_PMIC_ARB4_CHNL171_WDATA1_ADDR A:0x295c014
y.create.l HWIO_PMIC_ARB4_CHNL172_WDATA1_ADDR A:0x2964014
y.create.l HWIO_PMIC_ARB4_CHNL173_WDATA1_ADDR A:0x296c014
y.create.l HWIO_PMIC_ARB4_CHNL174_WDATA1_ADDR A:0x2974014
y.create.l HWIO_PMIC_ARB4_CHNL175_WDATA1_ADDR A:0x297c014
y.create.l HWIO_PMIC_ARB4_CHNL176_WDATA1_ADDR A:0x2984014
y.create.l HWIO_PMIC_ARB4_CHNL177_WDATA1_ADDR A:0x298c014
y.create.l HWIO_PMIC_ARB4_CHNL178_WDATA1_ADDR A:0x2994014
y.create.l HWIO_PMIC_ARB4_CHNL179_WDATA1_ADDR A:0x299c014
y.create.l HWIO_PMIC_ARB4_CHNL180_WDATA1_ADDR A:0x29a4014
y.create.l HWIO_PMIC_ARB4_CHNL181_WDATA1_ADDR A:0x29ac014
y.create.l HWIO_PMIC_ARB4_CHNL182_WDATA1_ADDR A:0x29b4014
y.create.l HWIO_PMIC_ARB4_CHNL183_WDATA1_ADDR A:0x29bc014
y.create.l HWIO_PMIC_ARB4_CHNL184_WDATA1_ADDR A:0x29c4014
y.create.l HWIO_PMIC_ARB4_CHNL185_WDATA1_ADDR A:0x29cc014
y.create.l HWIO_PMIC_ARB4_CHNL186_WDATA1_ADDR A:0x29d4014
y.create.l HWIO_PMIC_ARB4_CHNL187_WDATA1_ADDR A:0x29dc014
y.create.l HWIO_PMIC_ARB4_CHNL188_WDATA1_ADDR A:0x29e4014
y.create.l HWIO_PMIC_ARB4_CHNL189_WDATA1_ADDR A:0x29ec014
y.create.l HWIO_PMIC_ARB4_CHNL190_WDATA1_ADDR A:0x29f4014
y.create.l HWIO_PMIC_ARB4_CHNL191_WDATA1_ADDR A:0x29fc014
y.create.l HWIO_PMIC_ARB4_CHNL192_WDATA1_ADDR A:0x2a04014
y.create.l HWIO_PMIC_ARB4_CHNL193_WDATA1_ADDR A:0x2a0c014
y.create.l HWIO_PMIC_ARB4_CHNL194_WDATA1_ADDR A:0x2a14014
y.create.l HWIO_PMIC_ARB4_CHNL195_WDATA1_ADDR A:0x2a1c014
y.create.l HWIO_PMIC_ARB4_CHNL196_WDATA1_ADDR A:0x2a24014
y.create.l HWIO_PMIC_ARB4_CHNL197_WDATA1_ADDR A:0x2a2c014
y.create.l HWIO_PMIC_ARB4_CHNL198_WDATA1_ADDR A:0x2a34014
y.create.l HWIO_PMIC_ARB4_CHNL199_WDATA1_ADDR A:0x2a3c014
y.create.l HWIO_PMIC_ARB4_CHNL200_WDATA1_ADDR A:0x2a44014
y.create.l HWIO_PMIC_ARB4_CHNL201_WDATA1_ADDR A:0x2a4c014
y.create.l HWIO_PMIC_ARB4_CHNL202_WDATA1_ADDR A:0x2a54014
y.create.l HWIO_PMIC_ARB4_CHNL203_WDATA1_ADDR A:0x2a5c014
y.create.l HWIO_PMIC_ARB4_CHNL204_WDATA1_ADDR A:0x2a64014
y.create.l HWIO_PMIC_ARB4_CHNL205_WDATA1_ADDR A:0x2a6c014
y.create.l HWIO_PMIC_ARB4_CHNL206_WDATA1_ADDR A:0x2a74014
y.create.l HWIO_PMIC_ARB4_CHNL207_WDATA1_ADDR A:0x2a7c014
y.create.l HWIO_PMIC_ARB4_CHNL208_WDATA1_ADDR A:0x2a84014
y.create.l HWIO_PMIC_ARB4_CHNL209_WDATA1_ADDR A:0x2a8c014
y.create.l HWIO_PMIC_ARB4_CHNL210_WDATA1_ADDR A:0x2a94014
y.create.l HWIO_PMIC_ARB4_CHNL211_WDATA1_ADDR A:0x2a9c014
y.create.l HWIO_PMIC_ARB4_CHNL212_WDATA1_ADDR A:0x2aa4014
y.create.l HWIO_PMIC_ARB4_CHNL213_WDATA1_ADDR A:0x2aac014
y.create.l HWIO_PMIC_ARB4_CHNL214_WDATA1_ADDR A:0x2ab4014
y.create.l HWIO_PMIC_ARB4_CHNL215_WDATA1_ADDR A:0x2abc014
y.create.l HWIO_PMIC_ARB4_CHNL216_WDATA1_ADDR A:0x2ac4014
y.create.l HWIO_PMIC_ARB4_CHNL217_WDATA1_ADDR A:0x2acc014
y.create.l HWIO_PMIC_ARB4_CHNL218_WDATA1_ADDR A:0x2ad4014
y.create.l HWIO_PMIC_ARB4_CHNL219_WDATA1_ADDR A:0x2adc014
y.create.l HWIO_PMIC_ARB4_CHNL220_WDATA1_ADDR A:0x2ae4014
y.create.l HWIO_PMIC_ARB4_CHNL221_WDATA1_ADDR A:0x2aec014
y.create.l HWIO_PMIC_ARB4_CHNL222_WDATA1_ADDR A:0x2af4014
y.create.l HWIO_PMIC_ARB4_CHNL223_WDATA1_ADDR A:0x2afc014
y.create.l HWIO_PMIC_ARB4_CHNL224_WDATA1_ADDR A:0x2b04014
y.create.l HWIO_PMIC_ARB4_CHNL225_WDATA1_ADDR A:0x2b0c014
y.create.l HWIO_PMIC_ARB4_CHNL226_WDATA1_ADDR A:0x2b14014
y.create.l HWIO_PMIC_ARB4_CHNL227_WDATA1_ADDR A:0x2b1c014
y.create.l HWIO_PMIC_ARB4_CHNL228_WDATA1_ADDR A:0x2b24014
y.create.l HWIO_PMIC_ARB4_CHNL229_WDATA1_ADDR A:0x2b2c014
y.create.l HWIO_PMIC_ARB4_CHNL230_WDATA1_ADDR A:0x2b34014
y.create.l HWIO_PMIC_ARB4_CHNL231_WDATA1_ADDR A:0x2b3c014
y.create.l HWIO_PMIC_ARB4_CHNL232_WDATA1_ADDR A:0x2b44014
y.create.l HWIO_PMIC_ARB4_CHNL233_WDATA1_ADDR A:0x2b4c014
y.create.l HWIO_PMIC_ARB4_CHNL234_WDATA1_ADDR A:0x2b54014
y.create.l HWIO_PMIC_ARB4_CHNL235_WDATA1_ADDR A:0x2b5c014
y.create.l HWIO_PMIC_ARB4_CHNL236_WDATA1_ADDR A:0x2b64014
y.create.l HWIO_PMIC_ARB4_CHNL237_WDATA1_ADDR A:0x2b6c014
y.create.l HWIO_PMIC_ARB4_CHNL238_WDATA1_ADDR A:0x2b74014
y.create.l HWIO_PMIC_ARB4_CHNL239_WDATA1_ADDR A:0x2b7c014
y.create.l HWIO_PMIC_ARB4_CHNL240_WDATA1_ADDR A:0x2b84014
y.create.l HWIO_PMIC_ARB4_CHNL241_WDATA1_ADDR A:0x2b8c014
y.create.l HWIO_PMIC_ARB4_CHNL242_WDATA1_ADDR A:0x2b94014
y.create.l HWIO_PMIC_ARB4_CHNL243_WDATA1_ADDR A:0x2b9c014
y.create.l HWIO_PMIC_ARB4_CHNL244_WDATA1_ADDR A:0x2ba4014
y.create.l HWIO_PMIC_ARB4_CHNL245_WDATA1_ADDR A:0x2bac014
y.create.l HWIO_PMIC_ARB4_CHNL246_WDATA1_ADDR A:0x2bb4014
y.create.l HWIO_PMIC_ARB4_CHNL247_WDATA1_ADDR A:0x2bbc014
y.create.l HWIO_PMIC_ARB4_CHNL248_WDATA1_ADDR A:0x2bc4014
y.create.l HWIO_PMIC_ARB4_CHNL249_WDATA1_ADDR A:0x2bcc014
y.create.l HWIO_PMIC_ARB4_CHNL250_WDATA1_ADDR A:0x2bd4014
y.create.l HWIO_PMIC_ARB4_CHNL251_WDATA1_ADDR A:0x2bdc014
y.create.l HWIO_PMIC_ARB4_CHNL252_WDATA1_ADDR A:0x2be4014
y.create.l HWIO_PMIC_ARB4_CHNL253_WDATA1_ADDR A:0x2bec014
y.create.l HWIO_PMIC_ARB4_CHNL254_WDATA1_ADDR A:0x2bf4014
y.create.l HWIO_PMIC_ARB4_CHNL255_WDATA1_ADDR A:0x2bfc014
y.create.l HWIO_PMIC_ARB5_CHNL0_WDATA1_ADDR A:0x2405014
y.create.l HWIO_PMIC_ARB5_CHNL1_WDATA1_ADDR A:0x240d014
y.create.l HWIO_PMIC_ARB5_CHNL2_WDATA1_ADDR A:0x2415014
y.create.l HWIO_PMIC_ARB5_CHNL3_WDATA1_ADDR A:0x241d014
y.create.l HWIO_PMIC_ARB5_CHNL4_WDATA1_ADDR A:0x2425014
y.create.l HWIO_PMIC_ARB5_CHNL5_WDATA1_ADDR A:0x242d014
y.create.l HWIO_PMIC_ARB5_CHNL6_WDATA1_ADDR A:0x2435014
y.create.l HWIO_PMIC_ARB5_CHNL7_WDATA1_ADDR A:0x243d014
y.create.l HWIO_PMIC_ARB5_CHNL8_WDATA1_ADDR A:0x2445014
y.create.l HWIO_PMIC_ARB5_CHNL9_WDATA1_ADDR A:0x244d014
y.create.l HWIO_PMIC_ARB5_CHNL10_WDATA1_ADDR A:0x2455014
y.create.l HWIO_PMIC_ARB5_CHNL11_WDATA1_ADDR A:0x245d014
y.create.l HWIO_PMIC_ARB5_CHNL12_WDATA1_ADDR A:0x2465014
y.create.l HWIO_PMIC_ARB5_CHNL13_WDATA1_ADDR A:0x246d014
y.create.l HWIO_PMIC_ARB5_CHNL14_WDATA1_ADDR A:0x2475014
y.create.l HWIO_PMIC_ARB5_CHNL15_WDATA1_ADDR A:0x247d014
y.create.l HWIO_PMIC_ARB5_CHNL16_WDATA1_ADDR A:0x2485014
y.create.l HWIO_PMIC_ARB5_CHNL17_WDATA1_ADDR A:0x248d014
y.create.l HWIO_PMIC_ARB5_CHNL18_WDATA1_ADDR A:0x2495014
y.create.l HWIO_PMIC_ARB5_CHNL19_WDATA1_ADDR A:0x249d014
y.create.l HWIO_PMIC_ARB5_CHNL20_WDATA1_ADDR A:0x24a5014
y.create.l HWIO_PMIC_ARB5_CHNL21_WDATA1_ADDR A:0x24ad014
y.create.l HWIO_PMIC_ARB5_CHNL22_WDATA1_ADDR A:0x24b5014
y.create.l HWIO_PMIC_ARB5_CHNL23_WDATA1_ADDR A:0x24bd014
y.create.l HWIO_PMIC_ARB5_CHNL24_WDATA1_ADDR A:0x24c5014
y.create.l HWIO_PMIC_ARB5_CHNL25_WDATA1_ADDR A:0x24cd014
y.create.l HWIO_PMIC_ARB5_CHNL26_WDATA1_ADDR A:0x24d5014
y.create.l HWIO_PMIC_ARB5_CHNL27_WDATA1_ADDR A:0x24dd014
y.create.l HWIO_PMIC_ARB5_CHNL28_WDATA1_ADDR A:0x24e5014
y.create.l HWIO_PMIC_ARB5_CHNL29_WDATA1_ADDR A:0x24ed014
y.create.l HWIO_PMIC_ARB5_CHNL30_WDATA1_ADDR A:0x24f5014
y.create.l HWIO_PMIC_ARB5_CHNL31_WDATA1_ADDR A:0x24fd014
y.create.l HWIO_PMIC_ARB5_CHNL32_WDATA1_ADDR A:0x2505014
y.create.l HWIO_PMIC_ARB5_CHNL33_WDATA1_ADDR A:0x250d014
y.create.l HWIO_PMIC_ARB5_CHNL34_WDATA1_ADDR A:0x2515014
y.create.l HWIO_PMIC_ARB5_CHNL35_WDATA1_ADDR A:0x251d014
y.create.l HWIO_PMIC_ARB5_CHNL36_WDATA1_ADDR A:0x2525014
y.create.l HWIO_PMIC_ARB5_CHNL37_WDATA1_ADDR A:0x252d014
y.create.l HWIO_PMIC_ARB5_CHNL38_WDATA1_ADDR A:0x2535014
y.create.l HWIO_PMIC_ARB5_CHNL39_WDATA1_ADDR A:0x253d014
y.create.l HWIO_PMIC_ARB5_CHNL40_WDATA1_ADDR A:0x2545014
y.create.l HWIO_PMIC_ARB5_CHNL41_WDATA1_ADDR A:0x254d014
y.create.l HWIO_PMIC_ARB5_CHNL42_WDATA1_ADDR A:0x2555014
y.create.l HWIO_PMIC_ARB5_CHNL43_WDATA1_ADDR A:0x255d014
y.create.l HWIO_PMIC_ARB5_CHNL44_WDATA1_ADDR A:0x2565014
y.create.l HWIO_PMIC_ARB5_CHNL45_WDATA1_ADDR A:0x256d014
y.create.l HWIO_PMIC_ARB5_CHNL46_WDATA1_ADDR A:0x2575014
y.create.l HWIO_PMIC_ARB5_CHNL47_WDATA1_ADDR A:0x257d014
y.create.l HWIO_PMIC_ARB5_CHNL48_WDATA1_ADDR A:0x2585014
y.create.l HWIO_PMIC_ARB5_CHNL49_WDATA1_ADDR A:0x258d014
y.create.l HWIO_PMIC_ARB5_CHNL50_WDATA1_ADDR A:0x2595014
y.create.l HWIO_PMIC_ARB5_CHNL51_WDATA1_ADDR A:0x259d014
y.create.l HWIO_PMIC_ARB5_CHNL52_WDATA1_ADDR A:0x25a5014
y.create.l HWIO_PMIC_ARB5_CHNL53_WDATA1_ADDR A:0x25ad014
y.create.l HWIO_PMIC_ARB5_CHNL54_WDATA1_ADDR A:0x25b5014
y.create.l HWIO_PMIC_ARB5_CHNL55_WDATA1_ADDR A:0x25bd014
y.create.l HWIO_PMIC_ARB5_CHNL56_WDATA1_ADDR A:0x25c5014
y.create.l HWIO_PMIC_ARB5_CHNL57_WDATA1_ADDR A:0x25cd014
y.create.l HWIO_PMIC_ARB5_CHNL58_WDATA1_ADDR A:0x25d5014
y.create.l HWIO_PMIC_ARB5_CHNL59_WDATA1_ADDR A:0x25dd014
y.create.l HWIO_PMIC_ARB5_CHNL60_WDATA1_ADDR A:0x25e5014
y.create.l HWIO_PMIC_ARB5_CHNL61_WDATA1_ADDR A:0x25ed014
y.create.l HWIO_PMIC_ARB5_CHNL62_WDATA1_ADDR A:0x25f5014
y.create.l HWIO_PMIC_ARB5_CHNL63_WDATA1_ADDR A:0x25fd014
y.create.l HWIO_PMIC_ARB5_CHNL64_WDATA1_ADDR A:0x2605014
y.create.l HWIO_PMIC_ARB5_CHNL65_WDATA1_ADDR A:0x260d014
y.create.l HWIO_PMIC_ARB5_CHNL66_WDATA1_ADDR A:0x2615014
y.create.l HWIO_PMIC_ARB5_CHNL67_WDATA1_ADDR A:0x261d014
y.create.l HWIO_PMIC_ARB5_CHNL68_WDATA1_ADDR A:0x2625014
y.create.l HWIO_PMIC_ARB5_CHNL69_WDATA1_ADDR A:0x262d014
y.create.l HWIO_PMIC_ARB5_CHNL70_WDATA1_ADDR A:0x2635014
y.create.l HWIO_PMIC_ARB5_CHNL71_WDATA1_ADDR A:0x263d014
y.create.l HWIO_PMIC_ARB5_CHNL72_WDATA1_ADDR A:0x2645014
y.create.l HWIO_PMIC_ARB5_CHNL73_WDATA1_ADDR A:0x264d014
y.create.l HWIO_PMIC_ARB5_CHNL74_WDATA1_ADDR A:0x2655014
y.create.l HWIO_PMIC_ARB5_CHNL75_WDATA1_ADDR A:0x265d014
y.create.l HWIO_PMIC_ARB5_CHNL76_WDATA1_ADDR A:0x2665014
y.create.l HWIO_PMIC_ARB5_CHNL77_WDATA1_ADDR A:0x266d014
y.create.l HWIO_PMIC_ARB5_CHNL78_WDATA1_ADDR A:0x2675014
y.create.l HWIO_PMIC_ARB5_CHNL79_WDATA1_ADDR A:0x267d014
y.create.l HWIO_PMIC_ARB5_CHNL80_WDATA1_ADDR A:0x2685014
y.create.l HWIO_PMIC_ARB5_CHNL81_WDATA1_ADDR A:0x268d014
y.create.l HWIO_PMIC_ARB5_CHNL82_WDATA1_ADDR A:0x2695014
y.create.l HWIO_PMIC_ARB5_CHNL83_WDATA1_ADDR A:0x269d014
y.create.l HWIO_PMIC_ARB5_CHNL84_WDATA1_ADDR A:0x26a5014
y.create.l HWIO_PMIC_ARB5_CHNL85_WDATA1_ADDR A:0x26ad014
y.create.l HWIO_PMIC_ARB5_CHNL86_WDATA1_ADDR A:0x26b5014
y.create.l HWIO_PMIC_ARB5_CHNL87_WDATA1_ADDR A:0x26bd014
y.create.l HWIO_PMIC_ARB5_CHNL88_WDATA1_ADDR A:0x26c5014
y.create.l HWIO_PMIC_ARB5_CHNL89_WDATA1_ADDR A:0x26cd014
y.create.l HWIO_PMIC_ARB5_CHNL90_WDATA1_ADDR A:0x26d5014
y.create.l HWIO_PMIC_ARB5_CHNL91_WDATA1_ADDR A:0x26dd014
y.create.l HWIO_PMIC_ARB5_CHNL92_WDATA1_ADDR A:0x26e5014
y.create.l HWIO_PMIC_ARB5_CHNL93_WDATA1_ADDR A:0x26ed014
y.create.l HWIO_PMIC_ARB5_CHNL94_WDATA1_ADDR A:0x26f5014
y.create.l HWIO_PMIC_ARB5_CHNL95_WDATA1_ADDR A:0x26fd014
y.create.l HWIO_PMIC_ARB5_CHNL96_WDATA1_ADDR A:0x2705014
y.create.l HWIO_PMIC_ARB5_CHNL97_WDATA1_ADDR A:0x270d014
y.create.l HWIO_PMIC_ARB5_CHNL98_WDATA1_ADDR A:0x2715014
y.create.l HWIO_PMIC_ARB5_CHNL99_WDATA1_ADDR A:0x271d014
y.create.l HWIO_PMIC_ARB5_CHNL100_WDATA1_ADDR A:0x2725014
y.create.l HWIO_PMIC_ARB5_CHNL101_WDATA1_ADDR A:0x272d014
y.create.l HWIO_PMIC_ARB5_CHNL102_WDATA1_ADDR A:0x2735014
y.create.l HWIO_PMIC_ARB5_CHNL103_WDATA1_ADDR A:0x273d014
y.create.l HWIO_PMIC_ARB5_CHNL104_WDATA1_ADDR A:0x2745014
y.create.l HWIO_PMIC_ARB5_CHNL105_WDATA1_ADDR A:0x274d014
y.create.l HWIO_PMIC_ARB5_CHNL106_WDATA1_ADDR A:0x2755014
y.create.l HWIO_PMIC_ARB5_CHNL107_WDATA1_ADDR A:0x275d014
y.create.l HWIO_PMIC_ARB5_CHNL108_WDATA1_ADDR A:0x2765014
y.create.l HWIO_PMIC_ARB5_CHNL109_WDATA1_ADDR A:0x276d014
y.create.l HWIO_PMIC_ARB5_CHNL110_WDATA1_ADDR A:0x2775014
y.create.l HWIO_PMIC_ARB5_CHNL111_WDATA1_ADDR A:0x277d014
y.create.l HWIO_PMIC_ARB5_CHNL112_WDATA1_ADDR A:0x2785014
y.create.l HWIO_PMIC_ARB5_CHNL113_WDATA1_ADDR A:0x278d014
y.create.l HWIO_PMIC_ARB5_CHNL114_WDATA1_ADDR A:0x2795014
y.create.l HWIO_PMIC_ARB5_CHNL115_WDATA1_ADDR A:0x279d014
y.create.l HWIO_PMIC_ARB5_CHNL116_WDATA1_ADDR A:0x27a5014
y.create.l HWIO_PMIC_ARB5_CHNL117_WDATA1_ADDR A:0x27ad014
y.create.l HWIO_PMIC_ARB5_CHNL118_WDATA1_ADDR A:0x27b5014
y.create.l HWIO_PMIC_ARB5_CHNL119_WDATA1_ADDR A:0x27bd014
y.create.l HWIO_PMIC_ARB5_CHNL120_WDATA1_ADDR A:0x27c5014
y.create.l HWIO_PMIC_ARB5_CHNL121_WDATA1_ADDR A:0x27cd014
y.create.l HWIO_PMIC_ARB5_CHNL122_WDATA1_ADDR A:0x27d5014
y.create.l HWIO_PMIC_ARB5_CHNL123_WDATA1_ADDR A:0x27dd014
y.create.l HWIO_PMIC_ARB5_CHNL124_WDATA1_ADDR A:0x27e5014
y.create.l HWIO_PMIC_ARB5_CHNL125_WDATA1_ADDR A:0x27ed014
y.create.l HWIO_PMIC_ARB5_CHNL126_WDATA1_ADDR A:0x27f5014
y.create.l HWIO_PMIC_ARB5_CHNL127_WDATA1_ADDR A:0x27fd014
y.create.l HWIO_PMIC_ARB5_CHNL128_WDATA1_ADDR A:0x2805014
y.create.l HWIO_PMIC_ARB5_CHNL129_WDATA1_ADDR A:0x280d014
y.create.l HWIO_PMIC_ARB5_CHNL130_WDATA1_ADDR A:0x2815014
y.create.l HWIO_PMIC_ARB5_CHNL131_WDATA1_ADDR A:0x281d014
y.create.l HWIO_PMIC_ARB5_CHNL132_WDATA1_ADDR A:0x2825014
y.create.l HWIO_PMIC_ARB5_CHNL133_WDATA1_ADDR A:0x282d014
y.create.l HWIO_PMIC_ARB5_CHNL134_WDATA1_ADDR A:0x2835014
y.create.l HWIO_PMIC_ARB5_CHNL135_WDATA1_ADDR A:0x283d014
y.create.l HWIO_PMIC_ARB5_CHNL136_WDATA1_ADDR A:0x2845014
y.create.l HWIO_PMIC_ARB5_CHNL137_WDATA1_ADDR A:0x284d014
y.create.l HWIO_PMIC_ARB5_CHNL138_WDATA1_ADDR A:0x2855014
y.create.l HWIO_PMIC_ARB5_CHNL139_WDATA1_ADDR A:0x285d014
y.create.l HWIO_PMIC_ARB5_CHNL140_WDATA1_ADDR A:0x2865014
y.create.l HWIO_PMIC_ARB5_CHNL141_WDATA1_ADDR A:0x286d014
y.create.l HWIO_PMIC_ARB5_CHNL142_WDATA1_ADDR A:0x2875014
y.create.l HWIO_PMIC_ARB5_CHNL143_WDATA1_ADDR A:0x287d014
y.create.l HWIO_PMIC_ARB5_CHNL144_WDATA1_ADDR A:0x2885014
y.create.l HWIO_PMIC_ARB5_CHNL145_WDATA1_ADDR A:0x288d014
y.create.l HWIO_PMIC_ARB5_CHNL146_WDATA1_ADDR A:0x2895014
y.create.l HWIO_PMIC_ARB5_CHNL147_WDATA1_ADDR A:0x289d014
y.create.l HWIO_PMIC_ARB5_CHNL148_WDATA1_ADDR A:0x28a5014
y.create.l HWIO_PMIC_ARB5_CHNL149_WDATA1_ADDR A:0x28ad014
y.create.l HWIO_PMIC_ARB5_CHNL150_WDATA1_ADDR A:0x28b5014
y.create.l HWIO_PMIC_ARB5_CHNL151_WDATA1_ADDR A:0x28bd014
y.create.l HWIO_PMIC_ARB5_CHNL152_WDATA1_ADDR A:0x28c5014
y.create.l HWIO_PMIC_ARB5_CHNL153_WDATA1_ADDR A:0x28cd014
y.create.l HWIO_PMIC_ARB5_CHNL154_WDATA1_ADDR A:0x28d5014
y.create.l HWIO_PMIC_ARB5_CHNL155_WDATA1_ADDR A:0x28dd014
y.create.l HWIO_PMIC_ARB5_CHNL156_WDATA1_ADDR A:0x28e5014
y.create.l HWIO_PMIC_ARB5_CHNL157_WDATA1_ADDR A:0x28ed014
y.create.l HWIO_PMIC_ARB5_CHNL158_WDATA1_ADDR A:0x28f5014
y.create.l HWIO_PMIC_ARB5_CHNL159_WDATA1_ADDR A:0x28fd014
y.create.l HWIO_PMIC_ARB5_CHNL160_WDATA1_ADDR A:0x2905014
y.create.l HWIO_PMIC_ARB5_CHNL161_WDATA1_ADDR A:0x290d014
y.create.l HWIO_PMIC_ARB5_CHNL162_WDATA1_ADDR A:0x2915014
y.create.l HWIO_PMIC_ARB5_CHNL163_WDATA1_ADDR A:0x291d014
y.create.l HWIO_PMIC_ARB5_CHNL164_WDATA1_ADDR A:0x2925014
y.create.l HWIO_PMIC_ARB5_CHNL165_WDATA1_ADDR A:0x292d014
y.create.l HWIO_PMIC_ARB5_CHNL166_WDATA1_ADDR A:0x2935014
y.create.l HWIO_PMIC_ARB5_CHNL167_WDATA1_ADDR A:0x293d014
y.create.l HWIO_PMIC_ARB5_CHNL168_WDATA1_ADDR A:0x2945014
y.create.l HWIO_PMIC_ARB5_CHNL169_WDATA1_ADDR A:0x294d014
y.create.l HWIO_PMIC_ARB5_CHNL170_WDATA1_ADDR A:0x2955014
y.create.l HWIO_PMIC_ARB5_CHNL171_WDATA1_ADDR A:0x295d014
y.create.l HWIO_PMIC_ARB5_CHNL172_WDATA1_ADDR A:0x2965014
y.create.l HWIO_PMIC_ARB5_CHNL173_WDATA1_ADDR A:0x296d014
y.create.l HWIO_PMIC_ARB5_CHNL174_WDATA1_ADDR A:0x2975014
y.create.l HWIO_PMIC_ARB5_CHNL175_WDATA1_ADDR A:0x297d014
y.create.l HWIO_PMIC_ARB5_CHNL176_WDATA1_ADDR A:0x2985014
y.create.l HWIO_PMIC_ARB5_CHNL177_WDATA1_ADDR A:0x298d014
y.create.l HWIO_PMIC_ARB5_CHNL178_WDATA1_ADDR A:0x2995014
y.create.l HWIO_PMIC_ARB5_CHNL179_WDATA1_ADDR A:0x299d014
y.create.l HWIO_PMIC_ARB5_CHNL180_WDATA1_ADDR A:0x29a5014
y.create.l HWIO_PMIC_ARB5_CHNL181_WDATA1_ADDR A:0x29ad014
y.create.l HWIO_PMIC_ARB5_CHNL182_WDATA1_ADDR A:0x29b5014
y.create.l HWIO_PMIC_ARB5_CHNL183_WDATA1_ADDR A:0x29bd014
y.create.l HWIO_PMIC_ARB5_CHNL184_WDATA1_ADDR A:0x29c5014
y.create.l HWIO_PMIC_ARB5_CHNL185_WDATA1_ADDR A:0x29cd014
y.create.l HWIO_PMIC_ARB5_CHNL186_WDATA1_ADDR A:0x29d5014
y.create.l HWIO_PMIC_ARB5_CHNL187_WDATA1_ADDR A:0x29dd014
y.create.l HWIO_PMIC_ARB5_CHNL188_WDATA1_ADDR A:0x29e5014
y.create.l HWIO_PMIC_ARB5_CHNL189_WDATA1_ADDR A:0x29ed014
y.create.l HWIO_PMIC_ARB5_CHNL190_WDATA1_ADDR A:0x29f5014
y.create.l HWIO_PMIC_ARB5_CHNL191_WDATA1_ADDR A:0x29fd014
y.create.l HWIO_PMIC_ARB5_CHNL192_WDATA1_ADDR A:0x2a05014
y.create.l HWIO_PMIC_ARB5_CHNL193_WDATA1_ADDR A:0x2a0d014
y.create.l HWIO_PMIC_ARB5_CHNL194_WDATA1_ADDR A:0x2a15014
y.create.l HWIO_PMIC_ARB5_CHNL195_WDATA1_ADDR A:0x2a1d014
y.create.l HWIO_PMIC_ARB5_CHNL196_WDATA1_ADDR A:0x2a25014
y.create.l HWIO_PMIC_ARB5_CHNL197_WDATA1_ADDR A:0x2a2d014
y.create.l HWIO_PMIC_ARB5_CHNL198_WDATA1_ADDR A:0x2a35014
y.create.l HWIO_PMIC_ARB5_CHNL199_WDATA1_ADDR A:0x2a3d014
y.create.l HWIO_PMIC_ARB5_CHNL200_WDATA1_ADDR A:0x2a45014
y.create.l HWIO_PMIC_ARB5_CHNL201_WDATA1_ADDR A:0x2a4d014
y.create.l HWIO_PMIC_ARB5_CHNL202_WDATA1_ADDR A:0x2a55014
y.create.l HWIO_PMIC_ARB5_CHNL203_WDATA1_ADDR A:0x2a5d014
y.create.l HWIO_PMIC_ARB5_CHNL204_WDATA1_ADDR A:0x2a65014
y.create.l HWIO_PMIC_ARB5_CHNL205_WDATA1_ADDR A:0x2a6d014
y.create.l HWIO_PMIC_ARB5_CHNL206_WDATA1_ADDR A:0x2a75014
y.create.l HWIO_PMIC_ARB5_CHNL207_WDATA1_ADDR A:0x2a7d014
y.create.l HWIO_PMIC_ARB5_CHNL208_WDATA1_ADDR A:0x2a85014
y.create.l HWIO_PMIC_ARB5_CHNL209_WDATA1_ADDR A:0x2a8d014
y.create.l HWIO_PMIC_ARB5_CHNL210_WDATA1_ADDR A:0x2a95014
y.create.l HWIO_PMIC_ARB5_CHNL211_WDATA1_ADDR A:0x2a9d014
y.create.l HWIO_PMIC_ARB5_CHNL212_WDATA1_ADDR A:0x2aa5014
y.create.l HWIO_PMIC_ARB5_CHNL213_WDATA1_ADDR A:0x2aad014
y.create.l HWIO_PMIC_ARB5_CHNL214_WDATA1_ADDR A:0x2ab5014
y.create.l HWIO_PMIC_ARB5_CHNL215_WDATA1_ADDR A:0x2abd014
y.create.l HWIO_PMIC_ARB5_CHNL216_WDATA1_ADDR A:0x2ac5014
y.create.l HWIO_PMIC_ARB5_CHNL217_WDATA1_ADDR A:0x2acd014
y.create.l HWIO_PMIC_ARB5_CHNL218_WDATA1_ADDR A:0x2ad5014
y.create.l HWIO_PMIC_ARB5_CHNL219_WDATA1_ADDR A:0x2add014
y.create.l HWIO_PMIC_ARB5_CHNL220_WDATA1_ADDR A:0x2ae5014
y.create.l HWIO_PMIC_ARB5_CHNL221_WDATA1_ADDR A:0x2aed014
y.create.l HWIO_PMIC_ARB5_CHNL222_WDATA1_ADDR A:0x2af5014
y.create.l HWIO_PMIC_ARB5_CHNL223_WDATA1_ADDR A:0x2afd014
y.create.l HWIO_PMIC_ARB5_CHNL224_WDATA1_ADDR A:0x2b05014
y.create.l HWIO_PMIC_ARB5_CHNL225_WDATA1_ADDR A:0x2b0d014
y.create.l HWIO_PMIC_ARB5_CHNL226_WDATA1_ADDR A:0x2b15014
y.create.l HWIO_PMIC_ARB5_CHNL227_WDATA1_ADDR A:0x2b1d014
y.create.l HWIO_PMIC_ARB5_CHNL228_WDATA1_ADDR A:0x2b25014
y.create.l HWIO_PMIC_ARB5_CHNL229_WDATA1_ADDR A:0x2b2d014
y.create.l HWIO_PMIC_ARB5_CHNL230_WDATA1_ADDR A:0x2b35014
y.create.l HWIO_PMIC_ARB5_CHNL231_WDATA1_ADDR A:0x2b3d014
y.create.l HWIO_PMIC_ARB5_CHNL232_WDATA1_ADDR A:0x2b45014
y.create.l HWIO_PMIC_ARB5_CHNL233_WDATA1_ADDR A:0x2b4d014
y.create.l HWIO_PMIC_ARB5_CHNL234_WDATA1_ADDR A:0x2b55014
y.create.l HWIO_PMIC_ARB5_CHNL235_WDATA1_ADDR A:0x2b5d014
y.create.l HWIO_PMIC_ARB5_CHNL236_WDATA1_ADDR A:0x2b65014
y.create.l HWIO_PMIC_ARB5_CHNL237_WDATA1_ADDR A:0x2b6d014
y.create.l HWIO_PMIC_ARB5_CHNL238_WDATA1_ADDR A:0x2b75014
y.create.l HWIO_PMIC_ARB5_CHNL239_WDATA1_ADDR A:0x2b7d014
y.create.l HWIO_PMIC_ARB5_CHNL240_WDATA1_ADDR A:0x2b85014
y.create.l HWIO_PMIC_ARB5_CHNL241_WDATA1_ADDR A:0x2b8d014
y.create.l HWIO_PMIC_ARB5_CHNL242_WDATA1_ADDR A:0x2b95014
y.create.l HWIO_PMIC_ARB5_CHNL243_WDATA1_ADDR A:0x2b9d014
y.create.l HWIO_PMIC_ARB5_CHNL244_WDATA1_ADDR A:0x2ba5014
y.create.l HWIO_PMIC_ARB5_CHNL245_WDATA1_ADDR A:0x2bad014
y.create.l HWIO_PMIC_ARB5_CHNL246_WDATA1_ADDR A:0x2bb5014
y.create.l HWIO_PMIC_ARB5_CHNL247_WDATA1_ADDR A:0x2bbd014
y.create.l HWIO_PMIC_ARB5_CHNL248_WDATA1_ADDR A:0x2bc5014
y.create.l HWIO_PMIC_ARB5_CHNL249_WDATA1_ADDR A:0x2bcd014
y.create.l HWIO_PMIC_ARB5_CHNL250_WDATA1_ADDR A:0x2bd5014
y.create.l HWIO_PMIC_ARB5_CHNL251_WDATA1_ADDR A:0x2bdd014
y.create.l HWIO_PMIC_ARB5_CHNL252_WDATA1_ADDR A:0x2be5014
y.create.l HWIO_PMIC_ARB5_CHNL253_WDATA1_ADDR A:0x2bed014
y.create.l HWIO_PMIC_ARB5_CHNL254_WDATA1_ADDR A:0x2bf5014
y.create.l HWIO_PMIC_ARB5_CHNL255_WDATA1_ADDR A:0x2bfd014
y.create.l HWIO_PMIC_ARB6_CHNL0_WDATA1_ADDR A:0x2406014
y.create.l HWIO_PMIC_ARB6_CHNL1_WDATA1_ADDR A:0x240e014
y.create.l HWIO_PMIC_ARB6_CHNL2_WDATA1_ADDR A:0x2416014
y.create.l HWIO_PMIC_ARB6_CHNL3_WDATA1_ADDR A:0x241e014
y.create.l HWIO_PMIC_ARB6_CHNL4_WDATA1_ADDR A:0x2426014
y.create.l HWIO_PMIC_ARB6_CHNL5_WDATA1_ADDR A:0x242e014
y.create.l HWIO_PMIC_ARB6_CHNL6_WDATA1_ADDR A:0x2436014
y.create.l HWIO_PMIC_ARB6_CHNL7_WDATA1_ADDR A:0x243e014
y.create.l HWIO_PMIC_ARB6_CHNL8_WDATA1_ADDR A:0x2446014
y.create.l HWIO_PMIC_ARB6_CHNL9_WDATA1_ADDR A:0x244e014
y.create.l HWIO_PMIC_ARB6_CHNL10_WDATA1_ADDR A:0x2456014
y.create.l HWIO_PMIC_ARB6_CHNL11_WDATA1_ADDR A:0x245e014
y.create.l HWIO_PMIC_ARB6_CHNL12_WDATA1_ADDR A:0x2466014
y.create.l HWIO_PMIC_ARB6_CHNL13_WDATA1_ADDR A:0x246e014
y.create.l HWIO_PMIC_ARB6_CHNL14_WDATA1_ADDR A:0x2476014
y.create.l HWIO_PMIC_ARB6_CHNL15_WDATA1_ADDR A:0x247e014
y.create.l HWIO_PMIC_ARB6_CHNL16_WDATA1_ADDR A:0x2486014
y.create.l HWIO_PMIC_ARB6_CHNL17_WDATA1_ADDR A:0x248e014
y.create.l HWIO_PMIC_ARB6_CHNL18_WDATA1_ADDR A:0x2496014
y.create.l HWIO_PMIC_ARB6_CHNL19_WDATA1_ADDR A:0x249e014
y.create.l HWIO_PMIC_ARB6_CHNL20_WDATA1_ADDR A:0x24a6014
y.create.l HWIO_PMIC_ARB6_CHNL21_WDATA1_ADDR A:0x24ae014
y.create.l HWIO_PMIC_ARB6_CHNL22_WDATA1_ADDR A:0x24b6014
y.create.l HWIO_PMIC_ARB6_CHNL23_WDATA1_ADDR A:0x24be014
y.create.l HWIO_PMIC_ARB6_CHNL24_WDATA1_ADDR A:0x24c6014
y.create.l HWIO_PMIC_ARB6_CHNL25_WDATA1_ADDR A:0x24ce014
y.create.l HWIO_PMIC_ARB6_CHNL26_WDATA1_ADDR A:0x24d6014
y.create.l HWIO_PMIC_ARB6_CHNL27_WDATA1_ADDR A:0x24de014
y.create.l HWIO_PMIC_ARB6_CHNL28_WDATA1_ADDR A:0x24e6014
y.create.l HWIO_PMIC_ARB6_CHNL29_WDATA1_ADDR A:0x24ee014
y.create.l HWIO_PMIC_ARB6_CHNL30_WDATA1_ADDR A:0x24f6014
y.create.l HWIO_PMIC_ARB6_CHNL31_WDATA1_ADDR A:0x24fe014
y.create.l HWIO_PMIC_ARB6_CHNL32_WDATA1_ADDR A:0x2506014
y.create.l HWIO_PMIC_ARB6_CHNL33_WDATA1_ADDR A:0x250e014
y.create.l HWIO_PMIC_ARB6_CHNL34_WDATA1_ADDR A:0x2516014
y.create.l HWIO_PMIC_ARB6_CHNL35_WDATA1_ADDR A:0x251e014
y.create.l HWIO_PMIC_ARB6_CHNL36_WDATA1_ADDR A:0x2526014
y.create.l HWIO_PMIC_ARB6_CHNL37_WDATA1_ADDR A:0x252e014
y.create.l HWIO_PMIC_ARB6_CHNL38_WDATA1_ADDR A:0x2536014
y.create.l HWIO_PMIC_ARB6_CHNL39_WDATA1_ADDR A:0x253e014
y.create.l HWIO_PMIC_ARB6_CHNL40_WDATA1_ADDR A:0x2546014
y.create.l HWIO_PMIC_ARB6_CHNL41_WDATA1_ADDR A:0x254e014
y.create.l HWIO_PMIC_ARB6_CHNL42_WDATA1_ADDR A:0x2556014
y.create.l HWIO_PMIC_ARB6_CHNL43_WDATA1_ADDR A:0x255e014
y.create.l HWIO_PMIC_ARB6_CHNL44_WDATA1_ADDR A:0x2566014
y.create.l HWIO_PMIC_ARB6_CHNL45_WDATA1_ADDR A:0x256e014
y.create.l HWIO_PMIC_ARB6_CHNL46_WDATA1_ADDR A:0x2576014
y.create.l HWIO_PMIC_ARB6_CHNL47_WDATA1_ADDR A:0x257e014
y.create.l HWIO_PMIC_ARB6_CHNL48_WDATA1_ADDR A:0x2586014
y.create.l HWIO_PMIC_ARB6_CHNL49_WDATA1_ADDR A:0x258e014
y.create.l HWIO_PMIC_ARB6_CHNL50_WDATA1_ADDR A:0x2596014
y.create.l HWIO_PMIC_ARB6_CHNL51_WDATA1_ADDR A:0x259e014
y.create.l HWIO_PMIC_ARB6_CHNL52_WDATA1_ADDR A:0x25a6014
y.create.l HWIO_PMIC_ARB6_CHNL53_WDATA1_ADDR A:0x25ae014
y.create.l HWIO_PMIC_ARB6_CHNL54_WDATA1_ADDR A:0x25b6014
y.create.l HWIO_PMIC_ARB6_CHNL55_WDATA1_ADDR A:0x25be014
y.create.l HWIO_PMIC_ARB6_CHNL56_WDATA1_ADDR A:0x25c6014
y.create.l HWIO_PMIC_ARB6_CHNL57_WDATA1_ADDR A:0x25ce014
y.create.l HWIO_PMIC_ARB6_CHNL58_WDATA1_ADDR A:0x25d6014
y.create.l HWIO_PMIC_ARB6_CHNL59_WDATA1_ADDR A:0x25de014
y.create.l HWIO_PMIC_ARB6_CHNL60_WDATA1_ADDR A:0x25e6014
y.create.l HWIO_PMIC_ARB6_CHNL61_WDATA1_ADDR A:0x25ee014
y.create.l HWIO_PMIC_ARB6_CHNL62_WDATA1_ADDR A:0x25f6014
y.create.l HWIO_PMIC_ARB6_CHNL63_WDATA1_ADDR A:0x25fe014
y.create.l HWIO_PMIC_ARB6_CHNL64_WDATA1_ADDR A:0x2606014
y.create.l HWIO_PMIC_ARB6_CHNL65_WDATA1_ADDR A:0x260e014
y.create.l HWIO_PMIC_ARB6_CHNL66_WDATA1_ADDR A:0x2616014
y.create.l HWIO_PMIC_ARB6_CHNL67_WDATA1_ADDR A:0x261e014
y.create.l HWIO_PMIC_ARB6_CHNL68_WDATA1_ADDR A:0x2626014
y.create.l HWIO_PMIC_ARB6_CHNL69_WDATA1_ADDR A:0x262e014
y.create.l HWIO_PMIC_ARB6_CHNL70_WDATA1_ADDR A:0x2636014
y.create.l HWIO_PMIC_ARB6_CHNL71_WDATA1_ADDR A:0x263e014
y.create.l HWIO_PMIC_ARB6_CHNL72_WDATA1_ADDR A:0x2646014
y.create.l HWIO_PMIC_ARB6_CHNL73_WDATA1_ADDR A:0x264e014
y.create.l HWIO_PMIC_ARB6_CHNL74_WDATA1_ADDR A:0x2656014
y.create.l HWIO_PMIC_ARB6_CHNL75_WDATA1_ADDR A:0x265e014
y.create.l HWIO_PMIC_ARB6_CHNL76_WDATA1_ADDR A:0x2666014
y.create.l HWIO_PMIC_ARB6_CHNL77_WDATA1_ADDR A:0x266e014
y.create.l HWIO_PMIC_ARB6_CHNL78_WDATA1_ADDR A:0x2676014
y.create.l HWIO_PMIC_ARB6_CHNL79_WDATA1_ADDR A:0x267e014
y.create.l HWIO_PMIC_ARB6_CHNL80_WDATA1_ADDR A:0x2686014
y.create.l HWIO_PMIC_ARB6_CHNL81_WDATA1_ADDR A:0x268e014
y.create.l HWIO_PMIC_ARB6_CHNL82_WDATA1_ADDR A:0x2696014
y.create.l HWIO_PMIC_ARB6_CHNL83_WDATA1_ADDR A:0x269e014
y.create.l HWIO_PMIC_ARB6_CHNL84_WDATA1_ADDR A:0x26a6014
y.create.l HWIO_PMIC_ARB6_CHNL85_WDATA1_ADDR A:0x26ae014
y.create.l HWIO_PMIC_ARB6_CHNL86_WDATA1_ADDR A:0x26b6014
y.create.l HWIO_PMIC_ARB6_CHNL87_WDATA1_ADDR A:0x26be014
y.create.l HWIO_PMIC_ARB6_CHNL88_WDATA1_ADDR A:0x26c6014
y.create.l HWIO_PMIC_ARB6_CHNL89_WDATA1_ADDR A:0x26ce014
y.create.l HWIO_PMIC_ARB6_CHNL90_WDATA1_ADDR A:0x26d6014
y.create.l HWIO_PMIC_ARB6_CHNL91_WDATA1_ADDR A:0x26de014
y.create.l HWIO_PMIC_ARB6_CHNL92_WDATA1_ADDR A:0x26e6014
y.create.l HWIO_PMIC_ARB6_CHNL93_WDATA1_ADDR A:0x26ee014
y.create.l HWIO_PMIC_ARB6_CHNL94_WDATA1_ADDR A:0x26f6014
y.create.l HWIO_PMIC_ARB6_CHNL95_WDATA1_ADDR A:0x26fe014
y.create.l HWIO_PMIC_ARB6_CHNL96_WDATA1_ADDR A:0x2706014
y.create.l HWIO_PMIC_ARB6_CHNL97_WDATA1_ADDR A:0x270e014
y.create.l HWIO_PMIC_ARB6_CHNL98_WDATA1_ADDR A:0x2716014
y.create.l HWIO_PMIC_ARB6_CHNL99_WDATA1_ADDR A:0x271e014
y.create.l HWIO_PMIC_ARB6_CHNL100_WDATA1_ADDR A:0x2726014
y.create.l HWIO_PMIC_ARB6_CHNL101_WDATA1_ADDR A:0x272e014
y.create.l HWIO_PMIC_ARB6_CHNL102_WDATA1_ADDR A:0x2736014
y.create.l HWIO_PMIC_ARB6_CHNL103_WDATA1_ADDR A:0x273e014
y.create.l HWIO_PMIC_ARB6_CHNL104_WDATA1_ADDR A:0x2746014
y.create.l HWIO_PMIC_ARB6_CHNL105_WDATA1_ADDR A:0x274e014
y.create.l HWIO_PMIC_ARB6_CHNL106_WDATA1_ADDR A:0x2756014
y.create.l HWIO_PMIC_ARB6_CHNL107_WDATA1_ADDR A:0x275e014
y.create.l HWIO_PMIC_ARB6_CHNL108_WDATA1_ADDR A:0x2766014
y.create.l HWIO_PMIC_ARB6_CHNL109_WDATA1_ADDR A:0x276e014
y.create.l HWIO_PMIC_ARB6_CHNL110_WDATA1_ADDR A:0x2776014
y.create.l HWIO_PMIC_ARB6_CHNL111_WDATA1_ADDR A:0x277e014
y.create.l HWIO_PMIC_ARB6_CHNL112_WDATA1_ADDR A:0x2786014
y.create.l HWIO_PMIC_ARB6_CHNL113_WDATA1_ADDR A:0x278e014
y.create.l HWIO_PMIC_ARB6_CHNL114_WDATA1_ADDR A:0x2796014
y.create.l HWIO_PMIC_ARB6_CHNL115_WDATA1_ADDR A:0x279e014
y.create.l HWIO_PMIC_ARB6_CHNL116_WDATA1_ADDR A:0x27a6014
y.create.l HWIO_PMIC_ARB6_CHNL117_WDATA1_ADDR A:0x27ae014
y.create.l HWIO_PMIC_ARB6_CHNL118_WDATA1_ADDR A:0x27b6014
y.create.l HWIO_PMIC_ARB6_CHNL119_WDATA1_ADDR A:0x27be014
y.create.l HWIO_PMIC_ARB6_CHNL120_WDATA1_ADDR A:0x27c6014
y.create.l HWIO_PMIC_ARB6_CHNL121_WDATA1_ADDR A:0x27ce014
y.create.l HWIO_PMIC_ARB6_CHNL122_WDATA1_ADDR A:0x27d6014
y.create.l HWIO_PMIC_ARB6_CHNL123_WDATA1_ADDR A:0x27de014
y.create.l HWIO_PMIC_ARB6_CHNL124_WDATA1_ADDR A:0x27e6014
y.create.l HWIO_PMIC_ARB6_CHNL125_WDATA1_ADDR A:0x27ee014
y.create.l HWIO_PMIC_ARB6_CHNL126_WDATA1_ADDR A:0x27f6014
y.create.l HWIO_PMIC_ARB6_CHNL127_WDATA1_ADDR A:0x27fe014
y.create.l HWIO_PMIC_ARB6_CHNL128_WDATA1_ADDR A:0x2806014
y.create.l HWIO_PMIC_ARB6_CHNL129_WDATA1_ADDR A:0x280e014
y.create.l HWIO_PMIC_ARB6_CHNL130_WDATA1_ADDR A:0x2816014
y.create.l HWIO_PMIC_ARB6_CHNL131_WDATA1_ADDR A:0x281e014
y.create.l HWIO_PMIC_ARB6_CHNL132_WDATA1_ADDR A:0x2826014
y.create.l HWIO_PMIC_ARB6_CHNL133_WDATA1_ADDR A:0x282e014
y.create.l HWIO_PMIC_ARB6_CHNL134_WDATA1_ADDR A:0x2836014
y.create.l HWIO_PMIC_ARB6_CHNL135_WDATA1_ADDR A:0x283e014
y.create.l HWIO_PMIC_ARB6_CHNL136_WDATA1_ADDR A:0x2846014
y.create.l HWIO_PMIC_ARB6_CHNL137_WDATA1_ADDR A:0x284e014
y.create.l HWIO_PMIC_ARB6_CHNL138_WDATA1_ADDR A:0x2856014
y.create.l HWIO_PMIC_ARB6_CHNL139_WDATA1_ADDR A:0x285e014
y.create.l HWIO_PMIC_ARB6_CHNL140_WDATA1_ADDR A:0x2866014
y.create.l HWIO_PMIC_ARB6_CHNL141_WDATA1_ADDR A:0x286e014
y.create.l HWIO_PMIC_ARB6_CHNL142_WDATA1_ADDR A:0x2876014
y.create.l HWIO_PMIC_ARB6_CHNL143_WDATA1_ADDR A:0x287e014
y.create.l HWIO_PMIC_ARB6_CHNL144_WDATA1_ADDR A:0x2886014
y.create.l HWIO_PMIC_ARB6_CHNL145_WDATA1_ADDR A:0x288e014
y.create.l HWIO_PMIC_ARB6_CHNL146_WDATA1_ADDR A:0x2896014
y.create.l HWIO_PMIC_ARB6_CHNL147_WDATA1_ADDR A:0x289e014
y.create.l HWIO_PMIC_ARB6_CHNL148_WDATA1_ADDR A:0x28a6014
y.create.l HWIO_PMIC_ARB6_CHNL149_WDATA1_ADDR A:0x28ae014
y.create.l HWIO_PMIC_ARB6_CHNL150_WDATA1_ADDR A:0x28b6014
y.create.l HWIO_PMIC_ARB6_CHNL151_WDATA1_ADDR A:0x28be014
y.create.l HWIO_PMIC_ARB6_CHNL152_WDATA1_ADDR A:0x28c6014
y.create.l HWIO_PMIC_ARB6_CHNL153_WDATA1_ADDR A:0x28ce014
y.create.l HWIO_PMIC_ARB6_CHNL154_WDATA1_ADDR A:0x28d6014
y.create.l HWIO_PMIC_ARB6_CHNL155_WDATA1_ADDR A:0x28de014
y.create.l HWIO_PMIC_ARB6_CHNL156_WDATA1_ADDR A:0x28e6014
y.create.l HWIO_PMIC_ARB6_CHNL157_WDATA1_ADDR A:0x28ee014
y.create.l HWIO_PMIC_ARB6_CHNL158_WDATA1_ADDR A:0x28f6014
y.create.l HWIO_PMIC_ARB6_CHNL159_WDATA1_ADDR A:0x28fe014
y.create.l HWIO_PMIC_ARB6_CHNL160_WDATA1_ADDR A:0x2906014
y.create.l HWIO_PMIC_ARB6_CHNL161_WDATA1_ADDR A:0x290e014
y.create.l HWIO_PMIC_ARB6_CHNL162_WDATA1_ADDR A:0x2916014
y.create.l HWIO_PMIC_ARB6_CHNL163_WDATA1_ADDR A:0x291e014
y.create.l HWIO_PMIC_ARB6_CHNL164_WDATA1_ADDR A:0x2926014
y.create.l HWIO_PMIC_ARB6_CHNL165_WDATA1_ADDR A:0x292e014
y.create.l HWIO_PMIC_ARB6_CHNL166_WDATA1_ADDR A:0x2936014
y.create.l HWIO_PMIC_ARB6_CHNL167_WDATA1_ADDR A:0x293e014
y.create.l HWIO_PMIC_ARB6_CHNL168_WDATA1_ADDR A:0x2946014
y.create.l HWIO_PMIC_ARB6_CHNL169_WDATA1_ADDR A:0x294e014
y.create.l HWIO_PMIC_ARB6_CHNL170_WDATA1_ADDR A:0x2956014
y.create.l HWIO_PMIC_ARB6_CHNL171_WDATA1_ADDR A:0x295e014
y.create.l HWIO_PMIC_ARB6_CHNL172_WDATA1_ADDR A:0x2966014
y.create.l HWIO_PMIC_ARB6_CHNL173_WDATA1_ADDR A:0x296e014
y.create.l HWIO_PMIC_ARB6_CHNL174_WDATA1_ADDR A:0x2976014
y.create.l HWIO_PMIC_ARB6_CHNL175_WDATA1_ADDR A:0x297e014
y.create.l HWIO_PMIC_ARB6_CHNL176_WDATA1_ADDR A:0x2986014
y.create.l HWIO_PMIC_ARB6_CHNL177_WDATA1_ADDR A:0x298e014
y.create.l HWIO_PMIC_ARB6_CHNL178_WDATA1_ADDR A:0x2996014
y.create.l HWIO_PMIC_ARB6_CHNL179_WDATA1_ADDR A:0x299e014
y.create.l HWIO_PMIC_ARB6_CHNL180_WDATA1_ADDR A:0x29a6014
y.create.l HWIO_PMIC_ARB6_CHNL181_WDATA1_ADDR A:0x29ae014
y.create.l HWIO_PMIC_ARB6_CHNL182_WDATA1_ADDR A:0x29b6014
y.create.l HWIO_PMIC_ARB6_CHNL183_WDATA1_ADDR A:0x29be014
y.create.l HWIO_PMIC_ARB6_CHNL184_WDATA1_ADDR A:0x29c6014
y.create.l HWIO_PMIC_ARB6_CHNL185_WDATA1_ADDR A:0x29ce014
y.create.l HWIO_PMIC_ARB6_CHNL186_WDATA1_ADDR A:0x29d6014
y.create.l HWIO_PMIC_ARB6_CHNL187_WDATA1_ADDR A:0x29de014
y.create.l HWIO_PMIC_ARB6_CHNL188_WDATA1_ADDR A:0x29e6014
y.create.l HWIO_PMIC_ARB6_CHNL189_WDATA1_ADDR A:0x29ee014
y.create.l HWIO_PMIC_ARB6_CHNL190_WDATA1_ADDR A:0x29f6014
y.create.l HWIO_PMIC_ARB6_CHNL191_WDATA1_ADDR A:0x29fe014
y.create.l HWIO_PMIC_ARB6_CHNL192_WDATA1_ADDR A:0x2a06014
y.create.l HWIO_PMIC_ARB6_CHNL193_WDATA1_ADDR A:0x2a0e014
y.create.l HWIO_PMIC_ARB6_CHNL194_WDATA1_ADDR A:0x2a16014
y.create.l HWIO_PMIC_ARB6_CHNL195_WDATA1_ADDR A:0x2a1e014
y.create.l HWIO_PMIC_ARB6_CHNL196_WDATA1_ADDR A:0x2a26014
y.create.l HWIO_PMIC_ARB6_CHNL197_WDATA1_ADDR A:0x2a2e014
y.create.l HWIO_PMIC_ARB6_CHNL198_WDATA1_ADDR A:0x2a36014
y.create.l HWIO_PMIC_ARB6_CHNL199_WDATA1_ADDR A:0x2a3e014
y.create.l HWIO_PMIC_ARB6_CHNL200_WDATA1_ADDR A:0x2a46014
y.create.l HWIO_PMIC_ARB6_CHNL201_WDATA1_ADDR A:0x2a4e014
y.create.l HWIO_PMIC_ARB6_CHNL202_WDATA1_ADDR A:0x2a56014
y.create.l HWIO_PMIC_ARB6_CHNL203_WDATA1_ADDR A:0x2a5e014
y.create.l HWIO_PMIC_ARB6_CHNL204_WDATA1_ADDR A:0x2a66014
y.create.l HWIO_PMIC_ARB6_CHNL205_WDATA1_ADDR A:0x2a6e014
y.create.l HWIO_PMIC_ARB6_CHNL206_WDATA1_ADDR A:0x2a76014
y.create.l HWIO_PMIC_ARB6_CHNL207_WDATA1_ADDR A:0x2a7e014
y.create.l HWIO_PMIC_ARB6_CHNL208_WDATA1_ADDR A:0x2a86014
y.create.l HWIO_PMIC_ARB6_CHNL209_WDATA1_ADDR A:0x2a8e014
y.create.l HWIO_PMIC_ARB6_CHNL210_WDATA1_ADDR A:0x2a96014
y.create.l HWIO_PMIC_ARB6_CHNL211_WDATA1_ADDR A:0x2a9e014
y.create.l HWIO_PMIC_ARB6_CHNL212_WDATA1_ADDR A:0x2aa6014
y.create.l HWIO_PMIC_ARB6_CHNL213_WDATA1_ADDR A:0x2aae014
y.create.l HWIO_PMIC_ARB6_CHNL214_WDATA1_ADDR A:0x2ab6014
y.create.l HWIO_PMIC_ARB6_CHNL215_WDATA1_ADDR A:0x2abe014
y.create.l HWIO_PMIC_ARB6_CHNL216_WDATA1_ADDR A:0x2ac6014
y.create.l HWIO_PMIC_ARB6_CHNL217_WDATA1_ADDR A:0x2ace014
y.create.l HWIO_PMIC_ARB6_CHNL218_WDATA1_ADDR A:0x2ad6014
y.create.l HWIO_PMIC_ARB6_CHNL219_WDATA1_ADDR A:0x2ade014
y.create.l HWIO_PMIC_ARB6_CHNL220_WDATA1_ADDR A:0x2ae6014
y.create.l HWIO_PMIC_ARB6_CHNL221_WDATA1_ADDR A:0x2aee014
y.create.l HWIO_PMIC_ARB6_CHNL222_WDATA1_ADDR A:0x2af6014
y.create.l HWIO_PMIC_ARB6_CHNL223_WDATA1_ADDR A:0x2afe014
y.create.l HWIO_PMIC_ARB6_CHNL224_WDATA1_ADDR A:0x2b06014
y.create.l HWIO_PMIC_ARB6_CHNL225_WDATA1_ADDR A:0x2b0e014
y.create.l HWIO_PMIC_ARB6_CHNL226_WDATA1_ADDR A:0x2b16014
y.create.l HWIO_PMIC_ARB6_CHNL227_WDATA1_ADDR A:0x2b1e014
y.create.l HWIO_PMIC_ARB6_CHNL228_WDATA1_ADDR A:0x2b26014
y.create.l HWIO_PMIC_ARB6_CHNL229_WDATA1_ADDR A:0x2b2e014
y.create.l HWIO_PMIC_ARB6_CHNL230_WDATA1_ADDR A:0x2b36014
y.create.l HWIO_PMIC_ARB6_CHNL231_WDATA1_ADDR A:0x2b3e014
y.create.l HWIO_PMIC_ARB6_CHNL232_WDATA1_ADDR A:0x2b46014
y.create.l HWIO_PMIC_ARB6_CHNL233_WDATA1_ADDR A:0x2b4e014
y.create.l HWIO_PMIC_ARB6_CHNL234_WDATA1_ADDR A:0x2b56014
y.create.l HWIO_PMIC_ARB6_CHNL235_WDATA1_ADDR A:0x2b5e014
y.create.l HWIO_PMIC_ARB6_CHNL236_WDATA1_ADDR A:0x2b66014
y.create.l HWIO_PMIC_ARB6_CHNL237_WDATA1_ADDR A:0x2b6e014
y.create.l HWIO_PMIC_ARB6_CHNL238_WDATA1_ADDR A:0x2b76014
y.create.l HWIO_PMIC_ARB6_CHNL239_WDATA1_ADDR A:0x2b7e014
y.create.l HWIO_PMIC_ARB6_CHNL240_WDATA1_ADDR A:0x2b86014
y.create.l HWIO_PMIC_ARB6_CHNL241_WDATA1_ADDR A:0x2b8e014
y.create.l HWIO_PMIC_ARB6_CHNL242_WDATA1_ADDR A:0x2b96014
y.create.l HWIO_PMIC_ARB6_CHNL243_WDATA1_ADDR A:0x2b9e014
y.create.l HWIO_PMIC_ARB6_CHNL244_WDATA1_ADDR A:0x2ba6014
y.create.l HWIO_PMIC_ARB6_CHNL245_WDATA1_ADDR A:0x2bae014
y.create.l HWIO_PMIC_ARB6_CHNL246_WDATA1_ADDR A:0x2bb6014
y.create.l HWIO_PMIC_ARB6_CHNL247_WDATA1_ADDR A:0x2bbe014
y.create.l HWIO_PMIC_ARB6_CHNL248_WDATA1_ADDR A:0x2bc6014
y.create.l HWIO_PMIC_ARB6_CHNL249_WDATA1_ADDR A:0x2bce014
y.create.l HWIO_PMIC_ARB6_CHNL250_WDATA1_ADDR A:0x2bd6014
y.create.l HWIO_PMIC_ARB6_CHNL251_WDATA1_ADDR A:0x2bde014
y.create.l HWIO_PMIC_ARB6_CHNL252_WDATA1_ADDR A:0x2be6014
y.create.l HWIO_PMIC_ARB6_CHNL253_WDATA1_ADDR A:0x2bee014
y.create.l HWIO_PMIC_ARB6_CHNL254_WDATA1_ADDR A:0x2bf6014
y.create.l HWIO_PMIC_ARB6_CHNL255_WDATA1_ADDR A:0x2bfe014
y.create.l HWIO_PMIC_ARB0_CHNL0_RDATA0_ADDR A:0x2400018
y.create.l HWIO_PMIC_ARB0_CHNL1_RDATA0_ADDR A:0x2408018
y.create.l HWIO_PMIC_ARB0_CHNL2_RDATA0_ADDR A:0x2410018
y.create.l HWIO_PMIC_ARB0_CHNL3_RDATA0_ADDR A:0x2418018
y.create.l HWIO_PMIC_ARB0_CHNL4_RDATA0_ADDR A:0x2420018
y.create.l HWIO_PMIC_ARB0_CHNL5_RDATA0_ADDR A:0x2428018
y.create.l HWIO_PMIC_ARB0_CHNL6_RDATA0_ADDR A:0x2430018
y.create.l HWIO_PMIC_ARB0_CHNL7_RDATA0_ADDR A:0x2438018
y.create.l HWIO_PMIC_ARB0_CHNL8_RDATA0_ADDR A:0x2440018
y.create.l HWIO_PMIC_ARB0_CHNL9_RDATA0_ADDR A:0x2448018
y.create.l HWIO_PMIC_ARB0_CHNL10_RDATA0_ADDR A:0x2450018
y.create.l HWIO_PMIC_ARB0_CHNL11_RDATA0_ADDR A:0x2458018
y.create.l HWIO_PMIC_ARB0_CHNL12_RDATA0_ADDR A:0x2460018
y.create.l HWIO_PMIC_ARB0_CHNL13_RDATA0_ADDR A:0x2468018
y.create.l HWIO_PMIC_ARB0_CHNL14_RDATA0_ADDR A:0x2470018
y.create.l HWIO_PMIC_ARB0_CHNL15_RDATA0_ADDR A:0x2478018
y.create.l HWIO_PMIC_ARB0_CHNL16_RDATA0_ADDR A:0x2480018
y.create.l HWIO_PMIC_ARB0_CHNL17_RDATA0_ADDR A:0x2488018
y.create.l HWIO_PMIC_ARB0_CHNL18_RDATA0_ADDR A:0x2490018
y.create.l HWIO_PMIC_ARB0_CHNL19_RDATA0_ADDR A:0x2498018
y.create.l HWIO_PMIC_ARB0_CHNL20_RDATA0_ADDR A:0x24a0018
y.create.l HWIO_PMIC_ARB0_CHNL21_RDATA0_ADDR A:0x24a8018
y.create.l HWIO_PMIC_ARB0_CHNL22_RDATA0_ADDR A:0x24b0018
y.create.l HWIO_PMIC_ARB0_CHNL23_RDATA0_ADDR A:0x24b8018
y.create.l HWIO_PMIC_ARB0_CHNL24_RDATA0_ADDR A:0x24c0018
y.create.l HWIO_PMIC_ARB0_CHNL25_RDATA0_ADDR A:0x24c8018
y.create.l HWIO_PMIC_ARB0_CHNL26_RDATA0_ADDR A:0x24d0018
y.create.l HWIO_PMIC_ARB0_CHNL27_RDATA0_ADDR A:0x24d8018
y.create.l HWIO_PMIC_ARB0_CHNL28_RDATA0_ADDR A:0x24e0018
y.create.l HWIO_PMIC_ARB0_CHNL29_RDATA0_ADDR A:0x24e8018
y.create.l HWIO_PMIC_ARB0_CHNL30_RDATA0_ADDR A:0x24f0018
y.create.l HWIO_PMIC_ARB0_CHNL31_RDATA0_ADDR A:0x24f8018
y.create.l HWIO_PMIC_ARB0_CHNL32_RDATA0_ADDR A:0x2500018
y.create.l HWIO_PMIC_ARB0_CHNL33_RDATA0_ADDR A:0x2508018
y.create.l HWIO_PMIC_ARB0_CHNL34_RDATA0_ADDR A:0x2510018
y.create.l HWIO_PMIC_ARB0_CHNL35_RDATA0_ADDR A:0x2518018
y.create.l HWIO_PMIC_ARB0_CHNL36_RDATA0_ADDR A:0x2520018
y.create.l HWIO_PMIC_ARB0_CHNL37_RDATA0_ADDR A:0x2528018
y.create.l HWIO_PMIC_ARB0_CHNL38_RDATA0_ADDR A:0x2530018
y.create.l HWIO_PMIC_ARB0_CHNL39_RDATA0_ADDR A:0x2538018
y.create.l HWIO_PMIC_ARB0_CHNL40_RDATA0_ADDR A:0x2540018
y.create.l HWIO_PMIC_ARB0_CHNL41_RDATA0_ADDR A:0x2548018
y.create.l HWIO_PMIC_ARB0_CHNL42_RDATA0_ADDR A:0x2550018
y.create.l HWIO_PMIC_ARB0_CHNL43_RDATA0_ADDR A:0x2558018
y.create.l HWIO_PMIC_ARB0_CHNL44_RDATA0_ADDR A:0x2560018
y.create.l HWIO_PMIC_ARB0_CHNL45_RDATA0_ADDR A:0x2568018
y.create.l HWIO_PMIC_ARB0_CHNL46_RDATA0_ADDR A:0x2570018
y.create.l HWIO_PMIC_ARB0_CHNL47_RDATA0_ADDR A:0x2578018
y.create.l HWIO_PMIC_ARB0_CHNL48_RDATA0_ADDR A:0x2580018
y.create.l HWIO_PMIC_ARB0_CHNL49_RDATA0_ADDR A:0x2588018
y.create.l HWIO_PMIC_ARB0_CHNL50_RDATA0_ADDR A:0x2590018
y.create.l HWIO_PMIC_ARB0_CHNL51_RDATA0_ADDR A:0x2598018
y.create.l HWIO_PMIC_ARB0_CHNL52_RDATA0_ADDR A:0x25a0018
y.create.l HWIO_PMIC_ARB0_CHNL53_RDATA0_ADDR A:0x25a8018
y.create.l HWIO_PMIC_ARB0_CHNL54_RDATA0_ADDR A:0x25b0018
y.create.l HWIO_PMIC_ARB0_CHNL55_RDATA0_ADDR A:0x25b8018
y.create.l HWIO_PMIC_ARB0_CHNL56_RDATA0_ADDR A:0x25c0018
y.create.l HWIO_PMIC_ARB0_CHNL57_RDATA0_ADDR A:0x25c8018
y.create.l HWIO_PMIC_ARB0_CHNL58_RDATA0_ADDR A:0x25d0018
y.create.l HWIO_PMIC_ARB0_CHNL59_RDATA0_ADDR A:0x25d8018
y.create.l HWIO_PMIC_ARB0_CHNL60_RDATA0_ADDR A:0x25e0018
y.create.l HWIO_PMIC_ARB0_CHNL61_RDATA0_ADDR A:0x25e8018
y.create.l HWIO_PMIC_ARB0_CHNL62_RDATA0_ADDR A:0x25f0018
y.create.l HWIO_PMIC_ARB0_CHNL63_RDATA0_ADDR A:0x25f8018
y.create.l HWIO_PMIC_ARB0_CHNL64_RDATA0_ADDR A:0x2600018
y.create.l HWIO_PMIC_ARB0_CHNL65_RDATA0_ADDR A:0x2608018
y.create.l HWIO_PMIC_ARB0_CHNL66_RDATA0_ADDR A:0x2610018
y.create.l HWIO_PMIC_ARB0_CHNL67_RDATA0_ADDR A:0x2618018
y.create.l HWIO_PMIC_ARB0_CHNL68_RDATA0_ADDR A:0x2620018
y.create.l HWIO_PMIC_ARB0_CHNL69_RDATA0_ADDR A:0x2628018
y.create.l HWIO_PMIC_ARB0_CHNL70_RDATA0_ADDR A:0x2630018
y.create.l HWIO_PMIC_ARB0_CHNL71_RDATA0_ADDR A:0x2638018
y.create.l HWIO_PMIC_ARB0_CHNL72_RDATA0_ADDR A:0x2640018
y.create.l HWIO_PMIC_ARB0_CHNL73_RDATA0_ADDR A:0x2648018
y.create.l HWIO_PMIC_ARB0_CHNL74_RDATA0_ADDR A:0x2650018
y.create.l HWIO_PMIC_ARB0_CHNL75_RDATA0_ADDR A:0x2658018
y.create.l HWIO_PMIC_ARB0_CHNL76_RDATA0_ADDR A:0x2660018
y.create.l HWIO_PMIC_ARB0_CHNL77_RDATA0_ADDR A:0x2668018
y.create.l HWIO_PMIC_ARB0_CHNL78_RDATA0_ADDR A:0x2670018
y.create.l HWIO_PMIC_ARB0_CHNL79_RDATA0_ADDR A:0x2678018
y.create.l HWIO_PMIC_ARB0_CHNL80_RDATA0_ADDR A:0x2680018
y.create.l HWIO_PMIC_ARB0_CHNL81_RDATA0_ADDR A:0x2688018
y.create.l HWIO_PMIC_ARB0_CHNL82_RDATA0_ADDR A:0x2690018
y.create.l HWIO_PMIC_ARB0_CHNL83_RDATA0_ADDR A:0x2698018
y.create.l HWIO_PMIC_ARB0_CHNL84_RDATA0_ADDR A:0x26a0018
y.create.l HWIO_PMIC_ARB0_CHNL85_RDATA0_ADDR A:0x26a8018
y.create.l HWIO_PMIC_ARB0_CHNL86_RDATA0_ADDR A:0x26b0018
y.create.l HWIO_PMIC_ARB0_CHNL87_RDATA0_ADDR A:0x26b8018
y.create.l HWIO_PMIC_ARB0_CHNL88_RDATA0_ADDR A:0x26c0018
y.create.l HWIO_PMIC_ARB0_CHNL89_RDATA0_ADDR A:0x26c8018
y.create.l HWIO_PMIC_ARB0_CHNL90_RDATA0_ADDR A:0x26d0018
y.create.l HWIO_PMIC_ARB0_CHNL91_RDATA0_ADDR A:0x26d8018
y.create.l HWIO_PMIC_ARB0_CHNL92_RDATA0_ADDR A:0x26e0018
y.create.l HWIO_PMIC_ARB0_CHNL93_RDATA0_ADDR A:0x26e8018
y.create.l HWIO_PMIC_ARB0_CHNL94_RDATA0_ADDR A:0x26f0018
y.create.l HWIO_PMIC_ARB0_CHNL95_RDATA0_ADDR A:0x26f8018
y.create.l HWIO_PMIC_ARB0_CHNL96_RDATA0_ADDR A:0x2700018
y.create.l HWIO_PMIC_ARB0_CHNL97_RDATA0_ADDR A:0x2708018
y.create.l HWIO_PMIC_ARB0_CHNL98_RDATA0_ADDR A:0x2710018
y.create.l HWIO_PMIC_ARB0_CHNL99_RDATA0_ADDR A:0x2718018
y.create.l HWIO_PMIC_ARB0_CHNL100_RDATA0_ADDR A:0x2720018
y.create.l HWIO_PMIC_ARB0_CHNL101_RDATA0_ADDR A:0x2728018
y.create.l HWIO_PMIC_ARB0_CHNL102_RDATA0_ADDR A:0x2730018
y.create.l HWIO_PMIC_ARB0_CHNL103_RDATA0_ADDR A:0x2738018
y.create.l HWIO_PMIC_ARB0_CHNL104_RDATA0_ADDR A:0x2740018
y.create.l HWIO_PMIC_ARB0_CHNL105_RDATA0_ADDR A:0x2748018
y.create.l HWIO_PMIC_ARB0_CHNL106_RDATA0_ADDR A:0x2750018
y.create.l HWIO_PMIC_ARB0_CHNL107_RDATA0_ADDR A:0x2758018
y.create.l HWIO_PMIC_ARB0_CHNL108_RDATA0_ADDR A:0x2760018
y.create.l HWIO_PMIC_ARB0_CHNL109_RDATA0_ADDR A:0x2768018
y.create.l HWIO_PMIC_ARB0_CHNL110_RDATA0_ADDR A:0x2770018
y.create.l HWIO_PMIC_ARB0_CHNL111_RDATA0_ADDR A:0x2778018
y.create.l HWIO_PMIC_ARB0_CHNL112_RDATA0_ADDR A:0x2780018
y.create.l HWIO_PMIC_ARB0_CHNL113_RDATA0_ADDR A:0x2788018
y.create.l HWIO_PMIC_ARB0_CHNL114_RDATA0_ADDR A:0x2790018
y.create.l HWIO_PMIC_ARB0_CHNL115_RDATA0_ADDR A:0x2798018
y.create.l HWIO_PMIC_ARB0_CHNL116_RDATA0_ADDR A:0x27a0018
y.create.l HWIO_PMIC_ARB0_CHNL117_RDATA0_ADDR A:0x27a8018
y.create.l HWIO_PMIC_ARB0_CHNL118_RDATA0_ADDR A:0x27b0018
y.create.l HWIO_PMIC_ARB0_CHNL119_RDATA0_ADDR A:0x27b8018
y.create.l HWIO_PMIC_ARB0_CHNL120_RDATA0_ADDR A:0x27c0018
y.create.l HWIO_PMIC_ARB0_CHNL121_RDATA0_ADDR A:0x27c8018
y.create.l HWIO_PMIC_ARB0_CHNL122_RDATA0_ADDR A:0x27d0018
y.create.l HWIO_PMIC_ARB0_CHNL123_RDATA0_ADDR A:0x27d8018
y.create.l HWIO_PMIC_ARB0_CHNL124_RDATA0_ADDR A:0x27e0018
y.create.l HWIO_PMIC_ARB0_CHNL125_RDATA0_ADDR A:0x27e8018
y.create.l HWIO_PMIC_ARB0_CHNL126_RDATA0_ADDR A:0x27f0018
y.create.l HWIO_PMIC_ARB0_CHNL127_RDATA0_ADDR A:0x27f8018
y.create.l HWIO_PMIC_ARB0_CHNL128_RDATA0_ADDR A:0x2800018
y.create.l HWIO_PMIC_ARB0_CHNL129_RDATA0_ADDR A:0x2808018
y.create.l HWIO_PMIC_ARB0_CHNL130_RDATA0_ADDR A:0x2810018
y.create.l HWIO_PMIC_ARB0_CHNL131_RDATA0_ADDR A:0x2818018
y.create.l HWIO_PMIC_ARB0_CHNL132_RDATA0_ADDR A:0x2820018
y.create.l HWIO_PMIC_ARB0_CHNL133_RDATA0_ADDR A:0x2828018
y.create.l HWIO_PMIC_ARB0_CHNL134_RDATA0_ADDR A:0x2830018
y.create.l HWIO_PMIC_ARB0_CHNL135_RDATA0_ADDR A:0x2838018
y.create.l HWIO_PMIC_ARB0_CHNL136_RDATA0_ADDR A:0x2840018
y.create.l HWIO_PMIC_ARB0_CHNL137_RDATA0_ADDR A:0x2848018
y.create.l HWIO_PMIC_ARB0_CHNL138_RDATA0_ADDR A:0x2850018
y.create.l HWIO_PMIC_ARB0_CHNL139_RDATA0_ADDR A:0x2858018
y.create.l HWIO_PMIC_ARB0_CHNL140_RDATA0_ADDR A:0x2860018
y.create.l HWIO_PMIC_ARB0_CHNL141_RDATA0_ADDR A:0x2868018
y.create.l HWIO_PMIC_ARB0_CHNL142_RDATA0_ADDR A:0x2870018
y.create.l HWIO_PMIC_ARB0_CHNL143_RDATA0_ADDR A:0x2878018
y.create.l HWIO_PMIC_ARB0_CHNL144_RDATA0_ADDR A:0x2880018
y.create.l HWIO_PMIC_ARB0_CHNL145_RDATA0_ADDR A:0x2888018
y.create.l HWIO_PMIC_ARB0_CHNL146_RDATA0_ADDR A:0x2890018
y.create.l HWIO_PMIC_ARB0_CHNL147_RDATA0_ADDR A:0x2898018
y.create.l HWIO_PMIC_ARB0_CHNL148_RDATA0_ADDR A:0x28a0018
y.create.l HWIO_PMIC_ARB0_CHNL149_RDATA0_ADDR A:0x28a8018
y.create.l HWIO_PMIC_ARB0_CHNL150_RDATA0_ADDR A:0x28b0018
y.create.l HWIO_PMIC_ARB0_CHNL151_RDATA0_ADDR A:0x28b8018
y.create.l HWIO_PMIC_ARB0_CHNL152_RDATA0_ADDR A:0x28c0018
y.create.l HWIO_PMIC_ARB0_CHNL153_RDATA0_ADDR A:0x28c8018
y.create.l HWIO_PMIC_ARB0_CHNL154_RDATA0_ADDR A:0x28d0018
y.create.l HWIO_PMIC_ARB0_CHNL155_RDATA0_ADDR A:0x28d8018
y.create.l HWIO_PMIC_ARB0_CHNL156_RDATA0_ADDR A:0x28e0018
y.create.l HWIO_PMIC_ARB0_CHNL157_RDATA0_ADDR A:0x28e8018
y.create.l HWIO_PMIC_ARB0_CHNL158_RDATA0_ADDR A:0x28f0018
y.create.l HWIO_PMIC_ARB0_CHNL159_RDATA0_ADDR A:0x28f8018
y.create.l HWIO_PMIC_ARB0_CHNL160_RDATA0_ADDR A:0x2900018
y.create.l HWIO_PMIC_ARB0_CHNL161_RDATA0_ADDR A:0x2908018
y.create.l HWIO_PMIC_ARB0_CHNL162_RDATA0_ADDR A:0x2910018
y.create.l HWIO_PMIC_ARB0_CHNL163_RDATA0_ADDR A:0x2918018
y.create.l HWIO_PMIC_ARB0_CHNL164_RDATA0_ADDR A:0x2920018
y.create.l HWIO_PMIC_ARB0_CHNL165_RDATA0_ADDR A:0x2928018
y.create.l HWIO_PMIC_ARB0_CHNL166_RDATA0_ADDR A:0x2930018
y.create.l HWIO_PMIC_ARB0_CHNL167_RDATA0_ADDR A:0x2938018
y.create.l HWIO_PMIC_ARB0_CHNL168_RDATA0_ADDR A:0x2940018
y.create.l HWIO_PMIC_ARB0_CHNL169_RDATA0_ADDR A:0x2948018
y.create.l HWIO_PMIC_ARB0_CHNL170_RDATA0_ADDR A:0x2950018
y.create.l HWIO_PMIC_ARB0_CHNL171_RDATA0_ADDR A:0x2958018
y.create.l HWIO_PMIC_ARB0_CHNL172_RDATA0_ADDR A:0x2960018
y.create.l HWIO_PMIC_ARB0_CHNL173_RDATA0_ADDR A:0x2968018
y.create.l HWIO_PMIC_ARB0_CHNL174_RDATA0_ADDR A:0x2970018
y.create.l HWIO_PMIC_ARB0_CHNL175_RDATA0_ADDR A:0x2978018
y.create.l HWIO_PMIC_ARB0_CHNL176_RDATA0_ADDR A:0x2980018
y.create.l HWIO_PMIC_ARB0_CHNL177_RDATA0_ADDR A:0x2988018
y.create.l HWIO_PMIC_ARB0_CHNL178_RDATA0_ADDR A:0x2990018
y.create.l HWIO_PMIC_ARB0_CHNL179_RDATA0_ADDR A:0x2998018
y.create.l HWIO_PMIC_ARB0_CHNL180_RDATA0_ADDR A:0x29a0018
y.create.l HWIO_PMIC_ARB0_CHNL181_RDATA0_ADDR A:0x29a8018
y.create.l HWIO_PMIC_ARB0_CHNL182_RDATA0_ADDR A:0x29b0018
y.create.l HWIO_PMIC_ARB0_CHNL183_RDATA0_ADDR A:0x29b8018
y.create.l HWIO_PMIC_ARB0_CHNL184_RDATA0_ADDR A:0x29c0018
y.create.l HWIO_PMIC_ARB0_CHNL185_RDATA0_ADDR A:0x29c8018
y.create.l HWIO_PMIC_ARB0_CHNL186_RDATA0_ADDR A:0x29d0018
y.create.l HWIO_PMIC_ARB0_CHNL187_RDATA0_ADDR A:0x29d8018
y.create.l HWIO_PMIC_ARB0_CHNL188_RDATA0_ADDR A:0x29e0018
y.create.l HWIO_PMIC_ARB0_CHNL189_RDATA0_ADDR A:0x29e8018
y.create.l HWIO_PMIC_ARB0_CHNL190_RDATA0_ADDR A:0x29f0018
y.create.l HWIO_PMIC_ARB0_CHNL191_RDATA0_ADDR A:0x29f8018
y.create.l HWIO_PMIC_ARB0_CHNL192_RDATA0_ADDR A:0x2a00018
y.create.l HWIO_PMIC_ARB0_CHNL193_RDATA0_ADDR A:0x2a08018
y.create.l HWIO_PMIC_ARB0_CHNL194_RDATA0_ADDR A:0x2a10018
y.create.l HWIO_PMIC_ARB0_CHNL195_RDATA0_ADDR A:0x2a18018
y.create.l HWIO_PMIC_ARB0_CHNL196_RDATA0_ADDR A:0x2a20018
y.create.l HWIO_PMIC_ARB0_CHNL197_RDATA0_ADDR A:0x2a28018
y.create.l HWIO_PMIC_ARB0_CHNL198_RDATA0_ADDR A:0x2a30018
y.create.l HWIO_PMIC_ARB0_CHNL199_RDATA0_ADDR A:0x2a38018
y.create.l HWIO_PMIC_ARB0_CHNL200_RDATA0_ADDR A:0x2a40018
y.create.l HWIO_PMIC_ARB0_CHNL201_RDATA0_ADDR A:0x2a48018
y.create.l HWIO_PMIC_ARB0_CHNL202_RDATA0_ADDR A:0x2a50018
y.create.l HWIO_PMIC_ARB0_CHNL203_RDATA0_ADDR A:0x2a58018
y.create.l HWIO_PMIC_ARB0_CHNL204_RDATA0_ADDR A:0x2a60018
y.create.l HWIO_PMIC_ARB0_CHNL205_RDATA0_ADDR A:0x2a68018
y.create.l HWIO_PMIC_ARB0_CHNL206_RDATA0_ADDR A:0x2a70018
y.create.l HWIO_PMIC_ARB0_CHNL207_RDATA0_ADDR A:0x2a78018
y.create.l HWIO_PMIC_ARB0_CHNL208_RDATA0_ADDR A:0x2a80018
y.create.l HWIO_PMIC_ARB0_CHNL209_RDATA0_ADDR A:0x2a88018
y.create.l HWIO_PMIC_ARB0_CHNL210_RDATA0_ADDR A:0x2a90018
y.create.l HWIO_PMIC_ARB0_CHNL211_RDATA0_ADDR A:0x2a98018
y.create.l HWIO_PMIC_ARB0_CHNL212_RDATA0_ADDR A:0x2aa0018
y.create.l HWIO_PMIC_ARB0_CHNL213_RDATA0_ADDR A:0x2aa8018
y.create.l HWIO_PMIC_ARB0_CHNL214_RDATA0_ADDR A:0x2ab0018
y.create.l HWIO_PMIC_ARB0_CHNL215_RDATA0_ADDR A:0x2ab8018
y.create.l HWIO_PMIC_ARB0_CHNL216_RDATA0_ADDR A:0x2ac0018
y.create.l HWIO_PMIC_ARB0_CHNL217_RDATA0_ADDR A:0x2ac8018
y.create.l HWIO_PMIC_ARB0_CHNL218_RDATA0_ADDR A:0x2ad0018
y.create.l HWIO_PMIC_ARB0_CHNL219_RDATA0_ADDR A:0x2ad8018
y.create.l HWIO_PMIC_ARB0_CHNL220_RDATA0_ADDR A:0x2ae0018
y.create.l HWIO_PMIC_ARB0_CHNL221_RDATA0_ADDR A:0x2ae8018
y.create.l HWIO_PMIC_ARB0_CHNL222_RDATA0_ADDR A:0x2af0018
y.create.l HWIO_PMIC_ARB0_CHNL223_RDATA0_ADDR A:0x2af8018
y.create.l HWIO_PMIC_ARB0_CHNL224_RDATA0_ADDR A:0x2b00018
y.create.l HWIO_PMIC_ARB0_CHNL225_RDATA0_ADDR A:0x2b08018
y.create.l HWIO_PMIC_ARB0_CHNL226_RDATA0_ADDR A:0x2b10018
y.create.l HWIO_PMIC_ARB0_CHNL227_RDATA0_ADDR A:0x2b18018
y.create.l HWIO_PMIC_ARB0_CHNL228_RDATA0_ADDR A:0x2b20018
y.create.l HWIO_PMIC_ARB0_CHNL229_RDATA0_ADDR A:0x2b28018
y.create.l HWIO_PMIC_ARB0_CHNL230_RDATA0_ADDR A:0x2b30018
y.create.l HWIO_PMIC_ARB0_CHNL231_RDATA0_ADDR A:0x2b38018
y.create.l HWIO_PMIC_ARB0_CHNL232_RDATA0_ADDR A:0x2b40018
y.create.l HWIO_PMIC_ARB0_CHNL233_RDATA0_ADDR A:0x2b48018
y.create.l HWIO_PMIC_ARB0_CHNL234_RDATA0_ADDR A:0x2b50018
y.create.l HWIO_PMIC_ARB0_CHNL235_RDATA0_ADDR A:0x2b58018
y.create.l HWIO_PMIC_ARB0_CHNL236_RDATA0_ADDR A:0x2b60018
y.create.l HWIO_PMIC_ARB0_CHNL237_RDATA0_ADDR A:0x2b68018
y.create.l HWIO_PMIC_ARB0_CHNL238_RDATA0_ADDR A:0x2b70018
y.create.l HWIO_PMIC_ARB0_CHNL239_RDATA0_ADDR A:0x2b78018
y.create.l HWIO_PMIC_ARB0_CHNL240_RDATA0_ADDR A:0x2b80018
y.create.l HWIO_PMIC_ARB0_CHNL241_RDATA0_ADDR A:0x2b88018
y.create.l HWIO_PMIC_ARB0_CHNL242_RDATA0_ADDR A:0x2b90018
y.create.l HWIO_PMIC_ARB0_CHNL243_RDATA0_ADDR A:0x2b98018
y.create.l HWIO_PMIC_ARB0_CHNL244_RDATA0_ADDR A:0x2ba0018
y.create.l HWIO_PMIC_ARB0_CHNL245_RDATA0_ADDR A:0x2ba8018
y.create.l HWIO_PMIC_ARB0_CHNL246_RDATA0_ADDR A:0x2bb0018
y.create.l HWIO_PMIC_ARB0_CHNL247_RDATA0_ADDR A:0x2bb8018
y.create.l HWIO_PMIC_ARB0_CHNL248_RDATA0_ADDR A:0x2bc0018
y.create.l HWIO_PMIC_ARB0_CHNL249_RDATA0_ADDR A:0x2bc8018
y.create.l HWIO_PMIC_ARB0_CHNL250_RDATA0_ADDR A:0x2bd0018
y.create.l HWIO_PMIC_ARB0_CHNL251_RDATA0_ADDR A:0x2bd8018
y.create.l HWIO_PMIC_ARB0_CHNL252_RDATA0_ADDR A:0x2be0018
y.create.l HWIO_PMIC_ARB0_CHNL253_RDATA0_ADDR A:0x2be8018
y.create.l HWIO_PMIC_ARB0_CHNL254_RDATA0_ADDR A:0x2bf0018
y.create.l HWIO_PMIC_ARB0_CHNL255_RDATA0_ADDR A:0x2bf8018
y.create.l HWIO_PMIC_ARB1_CHNL0_RDATA0_ADDR A:0x2401018
y.create.l HWIO_PMIC_ARB1_CHNL1_RDATA0_ADDR A:0x2409018
y.create.l HWIO_PMIC_ARB1_CHNL2_RDATA0_ADDR A:0x2411018
y.create.l HWIO_PMIC_ARB1_CHNL3_RDATA0_ADDR A:0x2419018
y.create.l HWIO_PMIC_ARB1_CHNL4_RDATA0_ADDR A:0x2421018
y.create.l HWIO_PMIC_ARB1_CHNL5_RDATA0_ADDR A:0x2429018
y.create.l HWIO_PMIC_ARB1_CHNL6_RDATA0_ADDR A:0x2431018
y.create.l HWIO_PMIC_ARB1_CHNL7_RDATA0_ADDR A:0x2439018
y.create.l HWIO_PMIC_ARB1_CHNL8_RDATA0_ADDR A:0x2441018
y.create.l HWIO_PMIC_ARB1_CHNL9_RDATA0_ADDR A:0x2449018
y.create.l HWIO_PMIC_ARB1_CHNL10_RDATA0_ADDR A:0x2451018
y.create.l HWIO_PMIC_ARB1_CHNL11_RDATA0_ADDR A:0x2459018
y.create.l HWIO_PMIC_ARB1_CHNL12_RDATA0_ADDR A:0x2461018
y.create.l HWIO_PMIC_ARB1_CHNL13_RDATA0_ADDR A:0x2469018
y.create.l HWIO_PMIC_ARB1_CHNL14_RDATA0_ADDR A:0x2471018
y.create.l HWIO_PMIC_ARB1_CHNL15_RDATA0_ADDR A:0x2479018
y.create.l HWIO_PMIC_ARB1_CHNL16_RDATA0_ADDR A:0x2481018
y.create.l HWIO_PMIC_ARB1_CHNL17_RDATA0_ADDR A:0x2489018
y.create.l HWIO_PMIC_ARB1_CHNL18_RDATA0_ADDR A:0x2491018
y.create.l HWIO_PMIC_ARB1_CHNL19_RDATA0_ADDR A:0x2499018
y.create.l HWIO_PMIC_ARB1_CHNL20_RDATA0_ADDR A:0x24a1018
y.create.l HWIO_PMIC_ARB1_CHNL21_RDATA0_ADDR A:0x24a9018
y.create.l HWIO_PMIC_ARB1_CHNL22_RDATA0_ADDR A:0x24b1018
y.create.l HWIO_PMIC_ARB1_CHNL23_RDATA0_ADDR A:0x24b9018
y.create.l HWIO_PMIC_ARB1_CHNL24_RDATA0_ADDR A:0x24c1018
y.create.l HWIO_PMIC_ARB1_CHNL25_RDATA0_ADDR A:0x24c9018
y.create.l HWIO_PMIC_ARB1_CHNL26_RDATA0_ADDR A:0x24d1018
y.create.l HWIO_PMIC_ARB1_CHNL27_RDATA0_ADDR A:0x24d9018
y.create.l HWIO_PMIC_ARB1_CHNL28_RDATA0_ADDR A:0x24e1018
y.create.l HWIO_PMIC_ARB1_CHNL29_RDATA0_ADDR A:0x24e9018
y.create.l HWIO_PMIC_ARB1_CHNL30_RDATA0_ADDR A:0x24f1018
y.create.l HWIO_PMIC_ARB1_CHNL31_RDATA0_ADDR A:0x24f9018
y.create.l HWIO_PMIC_ARB1_CHNL32_RDATA0_ADDR A:0x2501018
y.create.l HWIO_PMIC_ARB1_CHNL33_RDATA0_ADDR A:0x2509018
y.create.l HWIO_PMIC_ARB1_CHNL34_RDATA0_ADDR A:0x2511018
y.create.l HWIO_PMIC_ARB1_CHNL35_RDATA0_ADDR A:0x2519018
y.create.l HWIO_PMIC_ARB1_CHNL36_RDATA0_ADDR A:0x2521018
y.create.l HWIO_PMIC_ARB1_CHNL37_RDATA0_ADDR A:0x2529018
y.create.l HWIO_PMIC_ARB1_CHNL38_RDATA0_ADDR A:0x2531018
y.create.l HWIO_PMIC_ARB1_CHNL39_RDATA0_ADDR A:0x2539018
y.create.l HWIO_PMIC_ARB1_CHNL40_RDATA0_ADDR A:0x2541018
y.create.l HWIO_PMIC_ARB1_CHNL41_RDATA0_ADDR A:0x2549018
y.create.l HWIO_PMIC_ARB1_CHNL42_RDATA0_ADDR A:0x2551018
y.create.l HWIO_PMIC_ARB1_CHNL43_RDATA0_ADDR A:0x2559018
y.create.l HWIO_PMIC_ARB1_CHNL44_RDATA0_ADDR A:0x2561018
y.create.l HWIO_PMIC_ARB1_CHNL45_RDATA0_ADDR A:0x2569018
y.create.l HWIO_PMIC_ARB1_CHNL46_RDATA0_ADDR A:0x2571018
y.create.l HWIO_PMIC_ARB1_CHNL47_RDATA0_ADDR A:0x2579018
y.create.l HWIO_PMIC_ARB1_CHNL48_RDATA0_ADDR A:0x2581018
y.create.l HWIO_PMIC_ARB1_CHNL49_RDATA0_ADDR A:0x2589018
y.create.l HWIO_PMIC_ARB1_CHNL50_RDATA0_ADDR A:0x2591018
y.create.l HWIO_PMIC_ARB1_CHNL51_RDATA0_ADDR A:0x2599018
y.create.l HWIO_PMIC_ARB1_CHNL52_RDATA0_ADDR A:0x25a1018
y.create.l HWIO_PMIC_ARB1_CHNL53_RDATA0_ADDR A:0x25a9018
y.create.l HWIO_PMIC_ARB1_CHNL54_RDATA0_ADDR A:0x25b1018
y.create.l HWIO_PMIC_ARB1_CHNL55_RDATA0_ADDR A:0x25b9018
y.create.l HWIO_PMIC_ARB1_CHNL56_RDATA0_ADDR A:0x25c1018
y.create.l HWIO_PMIC_ARB1_CHNL57_RDATA0_ADDR A:0x25c9018
y.create.l HWIO_PMIC_ARB1_CHNL58_RDATA0_ADDR A:0x25d1018
y.create.l HWIO_PMIC_ARB1_CHNL59_RDATA0_ADDR A:0x25d9018
y.create.l HWIO_PMIC_ARB1_CHNL60_RDATA0_ADDR A:0x25e1018
y.create.l HWIO_PMIC_ARB1_CHNL61_RDATA0_ADDR A:0x25e9018
y.create.l HWIO_PMIC_ARB1_CHNL62_RDATA0_ADDR A:0x25f1018
y.create.l HWIO_PMIC_ARB1_CHNL63_RDATA0_ADDR A:0x25f9018
y.create.l HWIO_PMIC_ARB1_CHNL64_RDATA0_ADDR A:0x2601018
y.create.l HWIO_PMIC_ARB1_CHNL65_RDATA0_ADDR A:0x2609018
y.create.l HWIO_PMIC_ARB1_CHNL66_RDATA0_ADDR A:0x2611018
y.create.l HWIO_PMIC_ARB1_CHNL67_RDATA0_ADDR A:0x2619018
y.create.l HWIO_PMIC_ARB1_CHNL68_RDATA0_ADDR A:0x2621018
y.create.l HWIO_PMIC_ARB1_CHNL69_RDATA0_ADDR A:0x2629018
y.create.l HWIO_PMIC_ARB1_CHNL70_RDATA0_ADDR A:0x2631018
y.create.l HWIO_PMIC_ARB1_CHNL71_RDATA0_ADDR A:0x2639018
y.create.l HWIO_PMIC_ARB1_CHNL72_RDATA0_ADDR A:0x2641018
y.create.l HWIO_PMIC_ARB1_CHNL73_RDATA0_ADDR A:0x2649018
y.create.l HWIO_PMIC_ARB1_CHNL74_RDATA0_ADDR A:0x2651018
y.create.l HWIO_PMIC_ARB1_CHNL75_RDATA0_ADDR A:0x2659018
y.create.l HWIO_PMIC_ARB1_CHNL76_RDATA0_ADDR A:0x2661018
y.create.l HWIO_PMIC_ARB1_CHNL77_RDATA0_ADDR A:0x2669018
y.create.l HWIO_PMIC_ARB1_CHNL78_RDATA0_ADDR A:0x2671018
y.create.l HWIO_PMIC_ARB1_CHNL79_RDATA0_ADDR A:0x2679018
y.create.l HWIO_PMIC_ARB1_CHNL80_RDATA0_ADDR A:0x2681018
y.create.l HWIO_PMIC_ARB1_CHNL81_RDATA0_ADDR A:0x2689018
y.create.l HWIO_PMIC_ARB1_CHNL82_RDATA0_ADDR A:0x2691018
y.create.l HWIO_PMIC_ARB1_CHNL83_RDATA0_ADDR A:0x2699018
y.create.l HWIO_PMIC_ARB1_CHNL84_RDATA0_ADDR A:0x26a1018
y.create.l HWIO_PMIC_ARB1_CHNL85_RDATA0_ADDR A:0x26a9018
y.create.l HWIO_PMIC_ARB1_CHNL86_RDATA0_ADDR A:0x26b1018
y.create.l HWIO_PMIC_ARB1_CHNL87_RDATA0_ADDR A:0x26b9018
y.create.l HWIO_PMIC_ARB1_CHNL88_RDATA0_ADDR A:0x26c1018
y.create.l HWIO_PMIC_ARB1_CHNL89_RDATA0_ADDR A:0x26c9018
y.create.l HWIO_PMIC_ARB1_CHNL90_RDATA0_ADDR A:0x26d1018
y.create.l HWIO_PMIC_ARB1_CHNL91_RDATA0_ADDR A:0x26d9018
y.create.l HWIO_PMIC_ARB1_CHNL92_RDATA0_ADDR A:0x26e1018
y.create.l HWIO_PMIC_ARB1_CHNL93_RDATA0_ADDR A:0x26e9018
y.create.l HWIO_PMIC_ARB1_CHNL94_RDATA0_ADDR A:0x26f1018
y.create.l HWIO_PMIC_ARB1_CHNL95_RDATA0_ADDR A:0x26f9018
y.create.l HWIO_PMIC_ARB1_CHNL96_RDATA0_ADDR A:0x2701018
y.create.l HWIO_PMIC_ARB1_CHNL97_RDATA0_ADDR A:0x2709018
y.create.l HWIO_PMIC_ARB1_CHNL98_RDATA0_ADDR A:0x2711018
y.create.l HWIO_PMIC_ARB1_CHNL99_RDATA0_ADDR A:0x2719018
y.create.l HWIO_PMIC_ARB1_CHNL100_RDATA0_ADDR A:0x2721018
y.create.l HWIO_PMIC_ARB1_CHNL101_RDATA0_ADDR A:0x2729018
y.create.l HWIO_PMIC_ARB1_CHNL102_RDATA0_ADDR A:0x2731018
y.create.l HWIO_PMIC_ARB1_CHNL103_RDATA0_ADDR A:0x2739018
y.create.l HWIO_PMIC_ARB1_CHNL104_RDATA0_ADDR A:0x2741018
y.create.l HWIO_PMIC_ARB1_CHNL105_RDATA0_ADDR A:0x2749018
y.create.l HWIO_PMIC_ARB1_CHNL106_RDATA0_ADDR A:0x2751018
y.create.l HWIO_PMIC_ARB1_CHNL107_RDATA0_ADDR A:0x2759018
y.create.l HWIO_PMIC_ARB1_CHNL108_RDATA0_ADDR A:0x2761018
y.create.l HWIO_PMIC_ARB1_CHNL109_RDATA0_ADDR A:0x2769018
y.create.l HWIO_PMIC_ARB1_CHNL110_RDATA0_ADDR A:0x2771018
y.create.l HWIO_PMIC_ARB1_CHNL111_RDATA0_ADDR A:0x2779018
y.create.l HWIO_PMIC_ARB1_CHNL112_RDATA0_ADDR A:0x2781018
y.create.l HWIO_PMIC_ARB1_CHNL113_RDATA0_ADDR A:0x2789018
y.create.l HWIO_PMIC_ARB1_CHNL114_RDATA0_ADDR A:0x2791018
y.create.l HWIO_PMIC_ARB1_CHNL115_RDATA0_ADDR A:0x2799018
y.create.l HWIO_PMIC_ARB1_CHNL116_RDATA0_ADDR A:0x27a1018
y.create.l HWIO_PMIC_ARB1_CHNL117_RDATA0_ADDR A:0x27a9018
y.create.l HWIO_PMIC_ARB1_CHNL118_RDATA0_ADDR A:0x27b1018
y.create.l HWIO_PMIC_ARB1_CHNL119_RDATA0_ADDR A:0x27b9018
y.create.l HWIO_PMIC_ARB1_CHNL120_RDATA0_ADDR A:0x27c1018
y.create.l HWIO_PMIC_ARB1_CHNL121_RDATA0_ADDR A:0x27c9018
y.create.l HWIO_PMIC_ARB1_CHNL122_RDATA0_ADDR A:0x27d1018
y.create.l HWIO_PMIC_ARB1_CHNL123_RDATA0_ADDR A:0x27d9018
y.create.l HWIO_PMIC_ARB1_CHNL124_RDATA0_ADDR A:0x27e1018
y.create.l HWIO_PMIC_ARB1_CHNL125_RDATA0_ADDR A:0x27e9018
y.create.l HWIO_PMIC_ARB1_CHNL126_RDATA0_ADDR A:0x27f1018
y.create.l HWIO_PMIC_ARB1_CHNL127_RDATA0_ADDR A:0x27f9018
y.create.l HWIO_PMIC_ARB1_CHNL128_RDATA0_ADDR A:0x2801018
y.create.l HWIO_PMIC_ARB1_CHNL129_RDATA0_ADDR A:0x2809018
y.create.l HWIO_PMIC_ARB1_CHNL130_RDATA0_ADDR A:0x2811018
y.create.l HWIO_PMIC_ARB1_CHNL131_RDATA0_ADDR A:0x2819018
y.create.l HWIO_PMIC_ARB1_CHNL132_RDATA0_ADDR A:0x2821018
y.create.l HWIO_PMIC_ARB1_CHNL133_RDATA0_ADDR A:0x2829018
y.create.l HWIO_PMIC_ARB1_CHNL134_RDATA0_ADDR A:0x2831018
y.create.l HWIO_PMIC_ARB1_CHNL135_RDATA0_ADDR A:0x2839018
y.create.l HWIO_PMIC_ARB1_CHNL136_RDATA0_ADDR A:0x2841018
y.create.l HWIO_PMIC_ARB1_CHNL137_RDATA0_ADDR A:0x2849018
y.create.l HWIO_PMIC_ARB1_CHNL138_RDATA0_ADDR A:0x2851018
y.create.l HWIO_PMIC_ARB1_CHNL139_RDATA0_ADDR A:0x2859018
y.create.l HWIO_PMIC_ARB1_CHNL140_RDATA0_ADDR A:0x2861018
y.create.l HWIO_PMIC_ARB1_CHNL141_RDATA0_ADDR A:0x2869018
y.create.l HWIO_PMIC_ARB1_CHNL142_RDATA0_ADDR A:0x2871018
y.create.l HWIO_PMIC_ARB1_CHNL143_RDATA0_ADDR A:0x2879018
y.create.l HWIO_PMIC_ARB1_CHNL144_RDATA0_ADDR A:0x2881018
y.create.l HWIO_PMIC_ARB1_CHNL145_RDATA0_ADDR A:0x2889018
y.create.l HWIO_PMIC_ARB1_CHNL146_RDATA0_ADDR A:0x2891018
y.create.l HWIO_PMIC_ARB1_CHNL147_RDATA0_ADDR A:0x2899018
y.create.l HWIO_PMIC_ARB1_CHNL148_RDATA0_ADDR A:0x28a1018
y.create.l HWIO_PMIC_ARB1_CHNL149_RDATA0_ADDR A:0x28a9018
y.create.l HWIO_PMIC_ARB1_CHNL150_RDATA0_ADDR A:0x28b1018
y.create.l HWIO_PMIC_ARB1_CHNL151_RDATA0_ADDR A:0x28b9018
y.create.l HWIO_PMIC_ARB1_CHNL152_RDATA0_ADDR A:0x28c1018
y.create.l HWIO_PMIC_ARB1_CHNL153_RDATA0_ADDR A:0x28c9018
y.create.l HWIO_PMIC_ARB1_CHNL154_RDATA0_ADDR A:0x28d1018
y.create.l HWIO_PMIC_ARB1_CHNL155_RDATA0_ADDR A:0x28d9018
y.create.l HWIO_PMIC_ARB1_CHNL156_RDATA0_ADDR A:0x28e1018
y.create.l HWIO_PMIC_ARB1_CHNL157_RDATA0_ADDR A:0x28e9018
y.create.l HWIO_PMIC_ARB1_CHNL158_RDATA0_ADDR A:0x28f1018
y.create.l HWIO_PMIC_ARB1_CHNL159_RDATA0_ADDR A:0x28f9018
y.create.l HWIO_PMIC_ARB1_CHNL160_RDATA0_ADDR A:0x2901018
y.create.l HWIO_PMIC_ARB1_CHNL161_RDATA0_ADDR A:0x2909018
y.create.l HWIO_PMIC_ARB1_CHNL162_RDATA0_ADDR A:0x2911018
y.create.l HWIO_PMIC_ARB1_CHNL163_RDATA0_ADDR A:0x2919018
y.create.l HWIO_PMIC_ARB1_CHNL164_RDATA0_ADDR A:0x2921018
y.create.l HWIO_PMIC_ARB1_CHNL165_RDATA0_ADDR A:0x2929018
y.create.l HWIO_PMIC_ARB1_CHNL166_RDATA0_ADDR A:0x2931018
y.create.l HWIO_PMIC_ARB1_CHNL167_RDATA0_ADDR A:0x2939018
y.create.l HWIO_PMIC_ARB1_CHNL168_RDATA0_ADDR A:0x2941018
y.create.l HWIO_PMIC_ARB1_CHNL169_RDATA0_ADDR A:0x2949018
y.create.l HWIO_PMIC_ARB1_CHNL170_RDATA0_ADDR A:0x2951018
y.create.l HWIO_PMIC_ARB1_CHNL171_RDATA0_ADDR A:0x2959018
y.create.l HWIO_PMIC_ARB1_CHNL172_RDATA0_ADDR A:0x2961018
y.create.l HWIO_PMIC_ARB1_CHNL173_RDATA0_ADDR A:0x2969018
y.create.l HWIO_PMIC_ARB1_CHNL174_RDATA0_ADDR A:0x2971018
y.create.l HWIO_PMIC_ARB1_CHNL175_RDATA0_ADDR A:0x2979018
y.create.l HWIO_PMIC_ARB1_CHNL176_RDATA0_ADDR A:0x2981018
y.create.l HWIO_PMIC_ARB1_CHNL177_RDATA0_ADDR A:0x2989018
y.create.l HWIO_PMIC_ARB1_CHNL178_RDATA0_ADDR A:0x2991018
y.create.l HWIO_PMIC_ARB1_CHNL179_RDATA0_ADDR A:0x2999018
y.create.l HWIO_PMIC_ARB1_CHNL180_RDATA0_ADDR A:0x29a1018
y.create.l HWIO_PMIC_ARB1_CHNL181_RDATA0_ADDR A:0x29a9018
y.create.l HWIO_PMIC_ARB1_CHNL182_RDATA0_ADDR A:0x29b1018
y.create.l HWIO_PMIC_ARB1_CHNL183_RDATA0_ADDR A:0x29b9018
y.create.l HWIO_PMIC_ARB1_CHNL184_RDATA0_ADDR A:0x29c1018
y.create.l HWIO_PMIC_ARB1_CHNL185_RDATA0_ADDR A:0x29c9018
y.create.l HWIO_PMIC_ARB1_CHNL186_RDATA0_ADDR A:0x29d1018
y.create.l HWIO_PMIC_ARB1_CHNL187_RDATA0_ADDR A:0x29d9018
y.create.l HWIO_PMIC_ARB1_CHNL188_RDATA0_ADDR A:0x29e1018
y.create.l HWIO_PMIC_ARB1_CHNL189_RDATA0_ADDR A:0x29e9018
y.create.l HWIO_PMIC_ARB1_CHNL190_RDATA0_ADDR A:0x29f1018
y.create.l HWIO_PMIC_ARB1_CHNL191_RDATA0_ADDR A:0x29f9018
y.create.l HWIO_PMIC_ARB1_CHNL192_RDATA0_ADDR A:0x2a01018
y.create.l HWIO_PMIC_ARB1_CHNL193_RDATA0_ADDR A:0x2a09018
y.create.l HWIO_PMIC_ARB1_CHNL194_RDATA0_ADDR A:0x2a11018
y.create.l HWIO_PMIC_ARB1_CHNL195_RDATA0_ADDR A:0x2a19018
y.create.l HWIO_PMIC_ARB1_CHNL196_RDATA0_ADDR A:0x2a21018
y.create.l HWIO_PMIC_ARB1_CHNL197_RDATA0_ADDR A:0x2a29018
y.create.l HWIO_PMIC_ARB1_CHNL198_RDATA0_ADDR A:0x2a31018
y.create.l HWIO_PMIC_ARB1_CHNL199_RDATA0_ADDR A:0x2a39018
y.create.l HWIO_PMIC_ARB1_CHNL200_RDATA0_ADDR A:0x2a41018
y.create.l HWIO_PMIC_ARB1_CHNL201_RDATA0_ADDR A:0x2a49018
y.create.l HWIO_PMIC_ARB1_CHNL202_RDATA0_ADDR A:0x2a51018
y.create.l HWIO_PMIC_ARB1_CHNL203_RDATA0_ADDR A:0x2a59018
y.create.l HWIO_PMIC_ARB1_CHNL204_RDATA0_ADDR A:0x2a61018
y.create.l HWIO_PMIC_ARB1_CHNL205_RDATA0_ADDR A:0x2a69018
y.create.l HWIO_PMIC_ARB1_CHNL206_RDATA0_ADDR A:0x2a71018
y.create.l HWIO_PMIC_ARB1_CHNL207_RDATA0_ADDR A:0x2a79018
y.create.l HWIO_PMIC_ARB1_CHNL208_RDATA0_ADDR A:0x2a81018
y.create.l HWIO_PMIC_ARB1_CHNL209_RDATA0_ADDR A:0x2a89018
y.create.l HWIO_PMIC_ARB1_CHNL210_RDATA0_ADDR A:0x2a91018
y.create.l HWIO_PMIC_ARB1_CHNL211_RDATA0_ADDR A:0x2a99018
y.create.l HWIO_PMIC_ARB1_CHNL212_RDATA0_ADDR A:0x2aa1018
y.create.l HWIO_PMIC_ARB1_CHNL213_RDATA0_ADDR A:0x2aa9018
y.create.l HWIO_PMIC_ARB1_CHNL214_RDATA0_ADDR A:0x2ab1018
y.create.l HWIO_PMIC_ARB1_CHNL215_RDATA0_ADDR A:0x2ab9018
y.create.l HWIO_PMIC_ARB1_CHNL216_RDATA0_ADDR A:0x2ac1018
y.create.l HWIO_PMIC_ARB1_CHNL217_RDATA0_ADDR A:0x2ac9018
y.create.l HWIO_PMIC_ARB1_CHNL218_RDATA0_ADDR A:0x2ad1018
y.create.l HWIO_PMIC_ARB1_CHNL219_RDATA0_ADDR A:0x2ad9018
y.create.l HWIO_PMIC_ARB1_CHNL220_RDATA0_ADDR A:0x2ae1018
y.create.l HWIO_PMIC_ARB1_CHNL221_RDATA0_ADDR A:0x2ae9018
y.create.l HWIO_PMIC_ARB1_CHNL222_RDATA0_ADDR A:0x2af1018
y.create.l HWIO_PMIC_ARB1_CHNL223_RDATA0_ADDR A:0x2af9018
y.create.l HWIO_PMIC_ARB1_CHNL224_RDATA0_ADDR A:0x2b01018
y.create.l HWIO_PMIC_ARB1_CHNL225_RDATA0_ADDR A:0x2b09018
y.create.l HWIO_PMIC_ARB1_CHNL226_RDATA0_ADDR A:0x2b11018
y.create.l HWIO_PMIC_ARB1_CHNL227_RDATA0_ADDR A:0x2b19018
y.create.l HWIO_PMIC_ARB1_CHNL228_RDATA0_ADDR A:0x2b21018
y.create.l HWIO_PMIC_ARB1_CHNL229_RDATA0_ADDR A:0x2b29018
y.create.l HWIO_PMIC_ARB1_CHNL230_RDATA0_ADDR A:0x2b31018
y.create.l HWIO_PMIC_ARB1_CHNL231_RDATA0_ADDR A:0x2b39018
y.create.l HWIO_PMIC_ARB1_CHNL232_RDATA0_ADDR A:0x2b41018
y.create.l HWIO_PMIC_ARB1_CHNL233_RDATA0_ADDR A:0x2b49018
y.create.l HWIO_PMIC_ARB1_CHNL234_RDATA0_ADDR A:0x2b51018
y.create.l HWIO_PMIC_ARB1_CHNL235_RDATA0_ADDR A:0x2b59018
y.create.l HWIO_PMIC_ARB1_CHNL236_RDATA0_ADDR A:0x2b61018
y.create.l HWIO_PMIC_ARB1_CHNL237_RDATA0_ADDR A:0x2b69018
y.create.l HWIO_PMIC_ARB1_CHNL238_RDATA0_ADDR A:0x2b71018
y.create.l HWIO_PMIC_ARB1_CHNL239_RDATA0_ADDR A:0x2b79018
y.create.l HWIO_PMIC_ARB1_CHNL240_RDATA0_ADDR A:0x2b81018
y.create.l HWIO_PMIC_ARB1_CHNL241_RDATA0_ADDR A:0x2b89018
y.create.l HWIO_PMIC_ARB1_CHNL242_RDATA0_ADDR A:0x2b91018
y.create.l HWIO_PMIC_ARB1_CHNL243_RDATA0_ADDR A:0x2b99018
y.create.l HWIO_PMIC_ARB1_CHNL244_RDATA0_ADDR A:0x2ba1018
y.create.l HWIO_PMIC_ARB1_CHNL245_RDATA0_ADDR A:0x2ba9018
y.create.l HWIO_PMIC_ARB1_CHNL246_RDATA0_ADDR A:0x2bb1018
y.create.l HWIO_PMIC_ARB1_CHNL247_RDATA0_ADDR A:0x2bb9018
y.create.l HWIO_PMIC_ARB1_CHNL248_RDATA0_ADDR A:0x2bc1018
y.create.l HWIO_PMIC_ARB1_CHNL249_RDATA0_ADDR A:0x2bc9018
y.create.l HWIO_PMIC_ARB1_CHNL250_RDATA0_ADDR A:0x2bd1018
y.create.l HWIO_PMIC_ARB1_CHNL251_RDATA0_ADDR A:0x2bd9018
y.create.l HWIO_PMIC_ARB1_CHNL252_RDATA0_ADDR A:0x2be1018
y.create.l HWIO_PMIC_ARB1_CHNL253_RDATA0_ADDR A:0x2be9018
y.create.l HWIO_PMIC_ARB1_CHNL254_RDATA0_ADDR A:0x2bf1018
y.create.l HWIO_PMIC_ARB1_CHNL255_RDATA0_ADDR A:0x2bf9018
y.create.l HWIO_PMIC_ARB2_CHNL0_RDATA0_ADDR A:0x2402018
y.create.l HWIO_PMIC_ARB2_CHNL1_RDATA0_ADDR A:0x240a018
y.create.l HWIO_PMIC_ARB2_CHNL2_RDATA0_ADDR A:0x2412018
y.create.l HWIO_PMIC_ARB2_CHNL3_RDATA0_ADDR A:0x241a018
y.create.l HWIO_PMIC_ARB2_CHNL4_RDATA0_ADDR A:0x2422018
y.create.l HWIO_PMIC_ARB2_CHNL5_RDATA0_ADDR A:0x242a018
y.create.l HWIO_PMIC_ARB2_CHNL6_RDATA0_ADDR A:0x2432018
y.create.l HWIO_PMIC_ARB2_CHNL7_RDATA0_ADDR A:0x243a018
y.create.l HWIO_PMIC_ARB2_CHNL8_RDATA0_ADDR A:0x2442018
y.create.l HWIO_PMIC_ARB2_CHNL9_RDATA0_ADDR A:0x244a018
y.create.l HWIO_PMIC_ARB2_CHNL10_RDATA0_ADDR A:0x2452018
y.create.l HWIO_PMIC_ARB2_CHNL11_RDATA0_ADDR A:0x245a018
y.create.l HWIO_PMIC_ARB2_CHNL12_RDATA0_ADDR A:0x2462018
y.create.l HWIO_PMIC_ARB2_CHNL13_RDATA0_ADDR A:0x246a018
y.create.l HWIO_PMIC_ARB2_CHNL14_RDATA0_ADDR A:0x2472018
y.create.l HWIO_PMIC_ARB2_CHNL15_RDATA0_ADDR A:0x247a018
y.create.l HWIO_PMIC_ARB2_CHNL16_RDATA0_ADDR A:0x2482018
y.create.l HWIO_PMIC_ARB2_CHNL17_RDATA0_ADDR A:0x248a018
y.create.l HWIO_PMIC_ARB2_CHNL18_RDATA0_ADDR A:0x2492018
y.create.l HWIO_PMIC_ARB2_CHNL19_RDATA0_ADDR A:0x249a018
y.create.l HWIO_PMIC_ARB2_CHNL20_RDATA0_ADDR A:0x24a2018
y.create.l HWIO_PMIC_ARB2_CHNL21_RDATA0_ADDR A:0x24aa018
y.create.l HWIO_PMIC_ARB2_CHNL22_RDATA0_ADDR A:0x24b2018
y.create.l HWIO_PMIC_ARB2_CHNL23_RDATA0_ADDR A:0x24ba018
y.create.l HWIO_PMIC_ARB2_CHNL24_RDATA0_ADDR A:0x24c2018
y.create.l HWIO_PMIC_ARB2_CHNL25_RDATA0_ADDR A:0x24ca018
y.create.l HWIO_PMIC_ARB2_CHNL26_RDATA0_ADDR A:0x24d2018
y.create.l HWIO_PMIC_ARB2_CHNL27_RDATA0_ADDR A:0x24da018
y.create.l HWIO_PMIC_ARB2_CHNL28_RDATA0_ADDR A:0x24e2018
y.create.l HWIO_PMIC_ARB2_CHNL29_RDATA0_ADDR A:0x24ea018
y.create.l HWIO_PMIC_ARB2_CHNL30_RDATA0_ADDR A:0x24f2018
y.create.l HWIO_PMIC_ARB2_CHNL31_RDATA0_ADDR A:0x24fa018
y.create.l HWIO_PMIC_ARB2_CHNL32_RDATA0_ADDR A:0x2502018
y.create.l HWIO_PMIC_ARB2_CHNL33_RDATA0_ADDR A:0x250a018
y.create.l HWIO_PMIC_ARB2_CHNL34_RDATA0_ADDR A:0x2512018
y.create.l HWIO_PMIC_ARB2_CHNL35_RDATA0_ADDR A:0x251a018
y.create.l HWIO_PMIC_ARB2_CHNL36_RDATA0_ADDR A:0x2522018
y.create.l HWIO_PMIC_ARB2_CHNL37_RDATA0_ADDR A:0x252a018
y.create.l HWIO_PMIC_ARB2_CHNL38_RDATA0_ADDR A:0x2532018
y.create.l HWIO_PMIC_ARB2_CHNL39_RDATA0_ADDR A:0x253a018
y.create.l HWIO_PMIC_ARB2_CHNL40_RDATA0_ADDR A:0x2542018
y.create.l HWIO_PMIC_ARB2_CHNL41_RDATA0_ADDR A:0x254a018
y.create.l HWIO_PMIC_ARB2_CHNL42_RDATA0_ADDR A:0x2552018
y.create.l HWIO_PMIC_ARB2_CHNL43_RDATA0_ADDR A:0x255a018
y.create.l HWIO_PMIC_ARB2_CHNL44_RDATA0_ADDR A:0x2562018
y.create.l HWIO_PMIC_ARB2_CHNL45_RDATA0_ADDR A:0x256a018
y.create.l HWIO_PMIC_ARB2_CHNL46_RDATA0_ADDR A:0x2572018
y.create.l HWIO_PMIC_ARB2_CHNL47_RDATA0_ADDR A:0x257a018
y.create.l HWIO_PMIC_ARB2_CHNL48_RDATA0_ADDR A:0x2582018
y.create.l HWIO_PMIC_ARB2_CHNL49_RDATA0_ADDR A:0x258a018
y.create.l HWIO_PMIC_ARB2_CHNL50_RDATA0_ADDR A:0x2592018
y.create.l HWIO_PMIC_ARB2_CHNL51_RDATA0_ADDR A:0x259a018
y.create.l HWIO_PMIC_ARB2_CHNL52_RDATA0_ADDR A:0x25a2018
y.create.l HWIO_PMIC_ARB2_CHNL53_RDATA0_ADDR A:0x25aa018
y.create.l HWIO_PMIC_ARB2_CHNL54_RDATA0_ADDR A:0x25b2018
y.create.l HWIO_PMIC_ARB2_CHNL55_RDATA0_ADDR A:0x25ba018
y.create.l HWIO_PMIC_ARB2_CHNL56_RDATA0_ADDR A:0x25c2018
y.create.l HWIO_PMIC_ARB2_CHNL57_RDATA0_ADDR A:0x25ca018
y.create.l HWIO_PMIC_ARB2_CHNL58_RDATA0_ADDR A:0x25d2018
y.create.l HWIO_PMIC_ARB2_CHNL59_RDATA0_ADDR A:0x25da018
y.create.l HWIO_PMIC_ARB2_CHNL60_RDATA0_ADDR A:0x25e2018
y.create.l HWIO_PMIC_ARB2_CHNL61_RDATA0_ADDR A:0x25ea018
y.create.l HWIO_PMIC_ARB2_CHNL62_RDATA0_ADDR A:0x25f2018
y.create.l HWIO_PMIC_ARB2_CHNL63_RDATA0_ADDR A:0x25fa018
y.create.l HWIO_PMIC_ARB2_CHNL64_RDATA0_ADDR A:0x2602018
y.create.l HWIO_PMIC_ARB2_CHNL65_RDATA0_ADDR A:0x260a018
y.create.l HWIO_PMIC_ARB2_CHNL66_RDATA0_ADDR A:0x2612018
y.create.l HWIO_PMIC_ARB2_CHNL67_RDATA0_ADDR A:0x261a018
y.create.l HWIO_PMIC_ARB2_CHNL68_RDATA0_ADDR A:0x2622018
y.create.l HWIO_PMIC_ARB2_CHNL69_RDATA0_ADDR A:0x262a018
y.create.l HWIO_PMIC_ARB2_CHNL70_RDATA0_ADDR A:0x2632018
y.create.l HWIO_PMIC_ARB2_CHNL71_RDATA0_ADDR A:0x263a018
y.create.l HWIO_PMIC_ARB2_CHNL72_RDATA0_ADDR A:0x2642018
y.create.l HWIO_PMIC_ARB2_CHNL73_RDATA0_ADDR A:0x264a018
y.create.l HWIO_PMIC_ARB2_CHNL74_RDATA0_ADDR A:0x2652018
y.create.l HWIO_PMIC_ARB2_CHNL75_RDATA0_ADDR A:0x265a018
y.create.l HWIO_PMIC_ARB2_CHNL76_RDATA0_ADDR A:0x2662018
y.create.l HWIO_PMIC_ARB2_CHNL77_RDATA0_ADDR A:0x266a018
y.create.l HWIO_PMIC_ARB2_CHNL78_RDATA0_ADDR A:0x2672018
y.create.l HWIO_PMIC_ARB2_CHNL79_RDATA0_ADDR A:0x267a018
y.create.l HWIO_PMIC_ARB2_CHNL80_RDATA0_ADDR A:0x2682018
y.create.l HWIO_PMIC_ARB2_CHNL81_RDATA0_ADDR A:0x268a018
y.create.l HWIO_PMIC_ARB2_CHNL82_RDATA0_ADDR A:0x2692018
y.create.l HWIO_PMIC_ARB2_CHNL83_RDATA0_ADDR A:0x269a018
y.create.l HWIO_PMIC_ARB2_CHNL84_RDATA0_ADDR A:0x26a2018
y.create.l HWIO_PMIC_ARB2_CHNL85_RDATA0_ADDR A:0x26aa018
y.create.l HWIO_PMIC_ARB2_CHNL86_RDATA0_ADDR A:0x26b2018
y.create.l HWIO_PMIC_ARB2_CHNL87_RDATA0_ADDR A:0x26ba018
y.create.l HWIO_PMIC_ARB2_CHNL88_RDATA0_ADDR A:0x26c2018
y.create.l HWIO_PMIC_ARB2_CHNL89_RDATA0_ADDR A:0x26ca018
y.create.l HWIO_PMIC_ARB2_CHNL90_RDATA0_ADDR A:0x26d2018
y.create.l HWIO_PMIC_ARB2_CHNL91_RDATA0_ADDR A:0x26da018
y.create.l HWIO_PMIC_ARB2_CHNL92_RDATA0_ADDR A:0x26e2018
y.create.l HWIO_PMIC_ARB2_CHNL93_RDATA0_ADDR A:0x26ea018
y.create.l HWIO_PMIC_ARB2_CHNL94_RDATA0_ADDR A:0x26f2018
y.create.l HWIO_PMIC_ARB2_CHNL95_RDATA0_ADDR A:0x26fa018
y.create.l HWIO_PMIC_ARB2_CHNL96_RDATA0_ADDR A:0x2702018
y.create.l HWIO_PMIC_ARB2_CHNL97_RDATA0_ADDR A:0x270a018
y.create.l HWIO_PMIC_ARB2_CHNL98_RDATA0_ADDR A:0x2712018
y.create.l HWIO_PMIC_ARB2_CHNL99_RDATA0_ADDR A:0x271a018
y.create.l HWIO_PMIC_ARB2_CHNL100_RDATA0_ADDR A:0x2722018
y.create.l HWIO_PMIC_ARB2_CHNL101_RDATA0_ADDR A:0x272a018
y.create.l HWIO_PMIC_ARB2_CHNL102_RDATA0_ADDR A:0x2732018
y.create.l HWIO_PMIC_ARB2_CHNL103_RDATA0_ADDR A:0x273a018
y.create.l HWIO_PMIC_ARB2_CHNL104_RDATA0_ADDR A:0x2742018
y.create.l HWIO_PMIC_ARB2_CHNL105_RDATA0_ADDR A:0x274a018
y.create.l HWIO_PMIC_ARB2_CHNL106_RDATA0_ADDR A:0x2752018
y.create.l HWIO_PMIC_ARB2_CHNL107_RDATA0_ADDR A:0x275a018
y.create.l HWIO_PMIC_ARB2_CHNL108_RDATA0_ADDR A:0x2762018
y.create.l HWIO_PMIC_ARB2_CHNL109_RDATA0_ADDR A:0x276a018
y.create.l HWIO_PMIC_ARB2_CHNL110_RDATA0_ADDR A:0x2772018
y.create.l HWIO_PMIC_ARB2_CHNL111_RDATA0_ADDR A:0x277a018
y.create.l HWIO_PMIC_ARB2_CHNL112_RDATA0_ADDR A:0x2782018
y.create.l HWIO_PMIC_ARB2_CHNL113_RDATA0_ADDR A:0x278a018
y.create.l HWIO_PMIC_ARB2_CHNL114_RDATA0_ADDR A:0x2792018
y.create.l HWIO_PMIC_ARB2_CHNL115_RDATA0_ADDR A:0x279a018
y.create.l HWIO_PMIC_ARB2_CHNL116_RDATA0_ADDR A:0x27a2018
y.create.l HWIO_PMIC_ARB2_CHNL117_RDATA0_ADDR A:0x27aa018
y.create.l HWIO_PMIC_ARB2_CHNL118_RDATA0_ADDR A:0x27b2018
y.create.l HWIO_PMIC_ARB2_CHNL119_RDATA0_ADDR A:0x27ba018
y.create.l HWIO_PMIC_ARB2_CHNL120_RDATA0_ADDR A:0x27c2018
y.create.l HWIO_PMIC_ARB2_CHNL121_RDATA0_ADDR A:0x27ca018
y.create.l HWIO_PMIC_ARB2_CHNL122_RDATA0_ADDR A:0x27d2018
y.create.l HWIO_PMIC_ARB2_CHNL123_RDATA0_ADDR A:0x27da018
y.create.l HWIO_PMIC_ARB2_CHNL124_RDATA0_ADDR A:0x27e2018
y.create.l HWIO_PMIC_ARB2_CHNL125_RDATA0_ADDR A:0x27ea018
y.create.l HWIO_PMIC_ARB2_CHNL126_RDATA0_ADDR A:0x27f2018
y.create.l HWIO_PMIC_ARB2_CHNL127_RDATA0_ADDR A:0x27fa018
y.create.l HWIO_PMIC_ARB2_CHNL128_RDATA0_ADDR A:0x2802018
y.create.l HWIO_PMIC_ARB2_CHNL129_RDATA0_ADDR A:0x280a018
y.create.l HWIO_PMIC_ARB2_CHNL130_RDATA0_ADDR A:0x2812018
y.create.l HWIO_PMIC_ARB2_CHNL131_RDATA0_ADDR A:0x281a018
y.create.l HWIO_PMIC_ARB2_CHNL132_RDATA0_ADDR A:0x2822018
y.create.l HWIO_PMIC_ARB2_CHNL133_RDATA0_ADDR A:0x282a018
y.create.l HWIO_PMIC_ARB2_CHNL134_RDATA0_ADDR A:0x2832018
y.create.l HWIO_PMIC_ARB2_CHNL135_RDATA0_ADDR A:0x283a018
y.create.l HWIO_PMIC_ARB2_CHNL136_RDATA0_ADDR A:0x2842018
y.create.l HWIO_PMIC_ARB2_CHNL137_RDATA0_ADDR A:0x284a018
y.create.l HWIO_PMIC_ARB2_CHNL138_RDATA0_ADDR A:0x2852018
y.create.l HWIO_PMIC_ARB2_CHNL139_RDATA0_ADDR A:0x285a018
y.create.l HWIO_PMIC_ARB2_CHNL140_RDATA0_ADDR A:0x2862018
y.create.l HWIO_PMIC_ARB2_CHNL141_RDATA0_ADDR A:0x286a018
y.create.l HWIO_PMIC_ARB2_CHNL142_RDATA0_ADDR A:0x2872018
y.create.l HWIO_PMIC_ARB2_CHNL143_RDATA0_ADDR A:0x287a018
y.create.l HWIO_PMIC_ARB2_CHNL144_RDATA0_ADDR A:0x2882018
y.create.l HWIO_PMIC_ARB2_CHNL145_RDATA0_ADDR A:0x288a018
y.create.l HWIO_PMIC_ARB2_CHNL146_RDATA0_ADDR A:0x2892018
y.create.l HWIO_PMIC_ARB2_CHNL147_RDATA0_ADDR A:0x289a018
y.create.l HWIO_PMIC_ARB2_CHNL148_RDATA0_ADDR A:0x28a2018
y.create.l HWIO_PMIC_ARB2_CHNL149_RDATA0_ADDR A:0x28aa018
y.create.l HWIO_PMIC_ARB2_CHNL150_RDATA0_ADDR A:0x28b2018
y.create.l HWIO_PMIC_ARB2_CHNL151_RDATA0_ADDR A:0x28ba018
y.create.l HWIO_PMIC_ARB2_CHNL152_RDATA0_ADDR A:0x28c2018
y.create.l HWIO_PMIC_ARB2_CHNL153_RDATA0_ADDR A:0x28ca018
y.create.l HWIO_PMIC_ARB2_CHNL154_RDATA0_ADDR A:0x28d2018
y.create.l HWIO_PMIC_ARB2_CHNL155_RDATA0_ADDR A:0x28da018
y.create.l HWIO_PMIC_ARB2_CHNL156_RDATA0_ADDR A:0x28e2018
y.create.l HWIO_PMIC_ARB2_CHNL157_RDATA0_ADDR A:0x28ea018
y.create.l HWIO_PMIC_ARB2_CHNL158_RDATA0_ADDR A:0x28f2018
y.create.l HWIO_PMIC_ARB2_CHNL159_RDATA0_ADDR A:0x28fa018
y.create.l HWIO_PMIC_ARB2_CHNL160_RDATA0_ADDR A:0x2902018
y.create.l HWIO_PMIC_ARB2_CHNL161_RDATA0_ADDR A:0x290a018
y.create.l HWIO_PMIC_ARB2_CHNL162_RDATA0_ADDR A:0x2912018
y.create.l HWIO_PMIC_ARB2_CHNL163_RDATA0_ADDR A:0x291a018
y.create.l HWIO_PMIC_ARB2_CHNL164_RDATA0_ADDR A:0x2922018
y.create.l HWIO_PMIC_ARB2_CHNL165_RDATA0_ADDR A:0x292a018
y.create.l HWIO_PMIC_ARB2_CHNL166_RDATA0_ADDR A:0x2932018
y.create.l HWIO_PMIC_ARB2_CHNL167_RDATA0_ADDR A:0x293a018
y.create.l HWIO_PMIC_ARB2_CHNL168_RDATA0_ADDR A:0x2942018
y.create.l HWIO_PMIC_ARB2_CHNL169_RDATA0_ADDR A:0x294a018
y.create.l HWIO_PMIC_ARB2_CHNL170_RDATA0_ADDR A:0x2952018
y.create.l HWIO_PMIC_ARB2_CHNL171_RDATA0_ADDR A:0x295a018
y.create.l HWIO_PMIC_ARB2_CHNL172_RDATA0_ADDR A:0x2962018
y.create.l HWIO_PMIC_ARB2_CHNL173_RDATA0_ADDR A:0x296a018
y.create.l HWIO_PMIC_ARB2_CHNL174_RDATA0_ADDR A:0x2972018
y.create.l HWIO_PMIC_ARB2_CHNL175_RDATA0_ADDR A:0x297a018
y.create.l HWIO_PMIC_ARB2_CHNL176_RDATA0_ADDR A:0x2982018
y.create.l HWIO_PMIC_ARB2_CHNL177_RDATA0_ADDR A:0x298a018
y.create.l HWIO_PMIC_ARB2_CHNL178_RDATA0_ADDR A:0x2992018
y.create.l HWIO_PMIC_ARB2_CHNL179_RDATA0_ADDR A:0x299a018
y.create.l HWIO_PMIC_ARB2_CHNL180_RDATA0_ADDR A:0x29a2018
y.create.l HWIO_PMIC_ARB2_CHNL181_RDATA0_ADDR A:0x29aa018
y.create.l HWIO_PMIC_ARB2_CHNL182_RDATA0_ADDR A:0x29b2018
y.create.l HWIO_PMIC_ARB2_CHNL183_RDATA0_ADDR A:0x29ba018
y.create.l HWIO_PMIC_ARB2_CHNL184_RDATA0_ADDR A:0x29c2018
y.create.l HWIO_PMIC_ARB2_CHNL185_RDATA0_ADDR A:0x29ca018
y.create.l HWIO_PMIC_ARB2_CHNL186_RDATA0_ADDR A:0x29d2018
y.create.l HWIO_PMIC_ARB2_CHNL187_RDATA0_ADDR A:0x29da018
y.create.l HWIO_PMIC_ARB2_CHNL188_RDATA0_ADDR A:0x29e2018
y.create.l HWIO_PMIC_ARB2_CHNL189_RDATA0_ADDR A:0x29ea018
y.create.l HWIO_PMIC_ARB2_CHNL190_RDATA0_ADDR A:0x29f2018
y.create.l HWIO_PMIC_ARB2_CHNL191_RDATA0_ADDR A:0x29fa018
y.create.l HWIO_PMIC_ARB2_CHNL192_RDATA0_ADDR A:0x2a02018
y.create.l HWIO_PMIC_ARB2_CHNL193_RDATA0_ADDR A:0x2a0a018
y.create.l HWIO_PMIC_ARB2_CHNL194_RDATA0_ADDR A:0x2a12018
y.create.l HWIO_PMIC_ARB2_CHNL195_RDATA0_ADDR A:0x2a1a018
y.create.l HWIO_PMIC_ARB2_CHNL196_RDATA0_ADDR A:0x2a22018
y.create.l HWIO_PMIC_ARB2_CHNL197_RDATA0_ADDR A:0x2a2a018
y.create.l HWIO_PMIC_ARB2_CHNL198_RDATA0_ADDR A:0x2a32018
y.create.l HWIO_PMIC_ARB2_CHNL199_RDATA0_ADDR A:0x2a3a018
y.create.l HWIO_PMIC_ARB2_CHNL200_RDATA0_ADDR A:0x2a42018
y.create.l HWIO_PMIC_ARB2_CHNL201_RDATA0_ADDR A:0x2a4a018
y.create.l HWIO_PMIC_ARB2_CHNL202_RDATA0_ADDR A:0x2a52018
y.create.l HWIO_PMIC_ARB2_CHNL203_RDATA0_ADDR A:0x2a5a018
y.create.l HWIO_PMIC_ARB2_CHNL204_RDATA0_ADDR A:0x2a62018
y.create.l HWIO_PMIC_ARB2_CHNL205_RDATA0_ADDR A:0x2a6a018
y.create.l HWIO_PMIC_ARB2_CHNL206_RDATA0_ADDR A:0x2a72018
y.create.l HWIO_PMIC_ARB2_CHNL207_RDATA0_ADDR A:0x2a7a018
y.create.l HWIO_PMIC_ARB2_CHNL208_RDATA0_ADDR A:0x2a82018
y.create.l HWIO_PMIC_ARB2_CHNL209_RDATA0_ADDR A:0x2a8a018
y.create.l HWIO_PMIC_ARB2_CHNL210_RDATA0_ADDR A:0x2a92018
y.create.l HWIO_PMIC_ARB2_CHNL211_RDATA0_ADDR A:0x2a9a018
y.create.l HWIO_PMIC_ARB2_CHNL212_RDATA0_ADDR A:0x2aa2018
y.create.l HWIO_PMIC_ARB2_CHNL213_RDATA0_ADDR A:0x2aaa018
y.create.l HWIO_PMIC_ARB2_CHNL214_RDATA0_ADDR A:0x2ab2018
y.create.l HWIO_PMIC_ARB2_CHNL215_RDATA0_ADDR A:0x2aba018
y.create.l HWIO_PMIC_ARB2_CHNL216_RDATA0_ADDR A:0x2ac2018
y.create.l HWIO_PMIC_ARB2_CHNL217_RDATA0_ADDR A:0x2aca018
y.create.l HWIO_PMIC_ARB2_CHNL218_RDATA0_ADDR A:0x2ad2018
y.create.l HWIO_PMIC_ARB2_CHNL219_RDATA0_ADDR A:0x2ada018
y.create.l HWIO_PMIC_ARB2_CHNL220_RDATA0_ADDR A:0x2ae2018
y.create.l HWIO_PMIC_ARB2_CHNL221_RDATA0_ADDR A:0x2aea018
y.create.l HWIO_PMIC_ARB2_CHNL222_RDATA0_ADDR A:0x2af2018
y.create.l HWIO_PMIC_ARB2_CHNL223_RDATA0_ADDR A:0x2afa018
y.create.l HWIO_PMIC_ARB2_CHNL224_RDATA0_ADDR A:0x2b02018
y.create.l HWIO_PMIC_ARB2_CHNL225_RDATA0_ADDR A:0x2b0a018
y.create.l HWIO_PMIC_ARB2_CHNL226_RDATA0_ADDR A:0x2b12018
y.create.l HWIO_PMIC_ARB2_CHNL227_RDATA0_ADDR A:0x2b1a018
y.create.l HWIO_PMIC_ARB2_CHNL228_RDATA0_ADDR A:0x2b22018
y.create.l HWIO_PMIC_ARB2_CHNL229_RDATA0_ADDR A:0x2b2a018
y.create.l HWIO_PMIC_ARB2_CHNL230_RDATA0_ADDR A:0x2b32018
y.create.l HWIO_PMIC_ARB2_CHNL231_RDATA0_ADDR A:0x2b3a018
y.create.l HWIO_PMIC_ARB2_CHNL232_RDATA0_ADDR A:0x2b42018
y.create.l HWIO_PMIC_ARB2_CHNL233_RDATA0_ADDR A:0x2b4a018
y.create.l HWIO_PMIC_ARB2_CHNL234_RDATA0_ADDR A:0x2b52018
y.create.l HWIO_PMIC_ARB2_CHNL235_RDATA0_ADDR A:0x2b5a018
y.create.l HWIO_PMIC_ARB2_CHNL236_RDATA0_ADDR A:0x2b62018
y.create.l HWIO_PMIC_ARB2_CHNL237_RDATA0_ADDR A:0x2b6a018
y.create.l HWIO_PMIC_ARB2_CHNL238_RDATA0_ADDR A:0x2b72018
y.create.l HWIO_PMIC_ARB2_CHNL239_RDATA0_ADDR A:0x2b7a018
y.create.l HWIO_PMIC_ARB2_CHNL240_RDATA0_ADDR A:0x2b82018
y.create.l HWIO_PMIC_ARB2_CHNL241_RDATA0_ADDR A:0x2b8a018
y.create.l HWIO_PMIC_ARB2_CHNL242_RDATA0_ADDR A:0x2b92018
y.create.l HWIO_PMIC_ARB2_CHNL243_RDATA0_ADDR A:0x2b9a018
y.create.l HWIO_PMIC_ARB2_CHNL244_RDATA0_ADDR A:0x2ba2018
y.create.l HWIO_PMIC_ARB2_CHNL245_RDATA0_ADDR A:0x2baa018
y.create.l HWIO_PMIC_ARB2_CHNL246_RDATA0_ADDR A:0x2bb2018
y.create.l HWIO_PMIC_ARB2_CHNL247_RDATA0_ADDR A:0x2bba018
y.create.l HWIO_PMIC_ARB2_CHNL248_RDATA0_ADDR A:0x2bc2018
y.create.l HWIO_PMIC_ARB2_CHNL249_RDATA0_ADDR A:0x2bca018
y.create.l HWIO_PMIC_ARB2_CHNL250_RDATA0_ADDR A:0x2bd2018
y.create.l HWIO_PMIC_ARB2_CHNL251_RDATA0_ADDR A:0x2bda018
y.create.l HWIO_PMIC_ARB2_CHNL252_RDATA0_ADDR A:0x2be2018
y.create.l HWIO_PMIC_ARB2_CHNL253_RDATA0_ADDR A:0x2bea018
y.create.l HWIO_PMIC_ARB2_CHNL254_RDATA0_ADDR A:0x2bf2018
y.create.l HWIO_PMIC_ARB2_CHNL255_RDATA0_ADDR A:0x2bfa018
y.create.l HWIO_PMIC_ARB3_CHNL0_RDATA0_ADDR A:0x2403018
y.create.l HWIO_PMIC_ARB3_CHNL1_RDATA0_ADDR A:0x240b018
y.create.l HWIO_PMIC_ARB3_CHNL2_RDATA0_ADDR A:0x2413018
y.create.l HWIO_PMIC_ARB3_CHNL3_RDATA0_ADDR A:0x241b018
y.create.l HWIO_PMIC_ARB3_CHNL4_RDATA0_ADDR A:0x2423018
y.create.l HWIO_PMIC_ARB3_CHNL5_RDATA0_ADDR A:0x242b018
y.create.l HWIO_PMIC_ARB3_CHNL6_RDATA0_ADDR A:0x2433018
y.create.l HWIO_PMIC_ARB3_CHNL7_RDATA0_ADDR A:0x243b018
y.create.l HWIO_PMIC_ARB3_CHNL8_RDATA0_ADDR A:0x2443018
y.create.l HWIO_PMIC_ARB3_CHNL9_RDATA0_ADDR A:0x244b018
y.create.l HWIO_PMIC_ARB3_CHNL10_RDATA0_ADDR A:0x2453018
y.create.l HWIO_PMIC_ARB3_CHNL11_RDATA0_ADDR A:0x245b018
y.create.l HWIO_PMIC_ARB3_CHNL12_RDATA0_ADDR A:0x2463018
y.create.l HWIO_PMIC_ARB3_CHNL13_RDATA0_ADDR A:0x246b018
y.create.l HWIO_PMIC_ARB3_CHNL14_RDATA0_ADDR A:0x2473018
y.create.l HWIO_PMIC_ARB3_CHNL15_RDATA0_ADDR A:0x247b018
y.create.l HWIO_PMIC_ARB3_CHNL16_RDATA0_ADDR A:0x2483018
y.create.l HWIO_PMIC_ARB3_CHNL17_RDATA0_ADDR A:0x248b018
y.create.l HWIO_PMIC_ARB3_CHNL18_RDATA0_ADDR A:0x2493018
y.create.l HWIO_PMIC_ARB3_CHNL19_RDATA0_ADDR A:0x249b018
y.create.l HWIO_PMIC_ARB3_CHNL20_RDATA0_ADDR A:0x24a3018
y.create.l HWIO_PMIC_ARB3_CHNL21_RDATA0_ADDR A:0x24ab018
y.create.l HWIO_PMIC_ARB3_CHNL22_RDATA0_ADDR A:0x24b3018
y.create.l HWIO_PMIC_ARB3_CHNL23_RDATA0_ADDR A:0x24bb018
y.create.l HWIO_PMIC_ARB3_CHNL24_RDATA0_ADDR A:0x24c3018
y.create.l HWIO_PMIC_ARB3_CHNL25_RDATA0_ADDR A:0x24cb018
y.create.l HWIO_PMIC_ARB3_CHNL26_RDATA0_ADDR A:0x24d3018
y.create.l HWIO_PMIC_ARB3_CHNL27_RDATA0_ADDR A:0x24db018
y.create.l HWIO_PMIC_ARB3_CHNL28_RDATA0_ADDR A:0x24e3018
y.create.l HWIO_PMIC_ARB3_CHNL29_RDATA0_ADDR A:0x24eb018
y.create.l HWIO_PMIC_ARB3_CHNL30_RDATA0_ADDR A:0x24f3018
y.create.l HWIO_PMIC_ARB3_CHNL31_RDATA0_ADDR A:0x24fb018
y.create.l HWIO_PMIC_ARB3_CHNL32_RDATA0_ADDR A:0x2503018
y.create.l HWIO_PMIC_ARB3_CHNL33_RDATA0_ADDR A:0x250b018
y.create.l HWIO_PMIC_ARB3_CHNL34_RDATA0_ADDR A:0x2513018
y.create.l HWIO_PMIC_ARB3_CHNL35_RDATA0_ADDR A:0x251b018
y.create.l HWIO_PMIC_ARB3_CHNL36_RDATA0_ADDR A:0x2523018
y.create.l HWIO_PMIC_ARB3_CHNL37_RDATA0_ADDR A:0x252b018
y.create.l HWIO_PMIC_ARB3_CHNL38_RDATA0_ADDR A:0x2533018
y.create.l HWIO_PMIC_ARB3_CHNL39_RDATA0_ADDR A:0x253b018
y.create.l HWIO_PMIC_ARB3_CHNL40_RDATA0_ADDR A:0x2543018
y.create.l HWIO_PMIC_ARB3_CHNL41_RDATA0_ADDR A:0x254b018
y.create.l HWIO_PMIC_ARB3_CHNL42_RDATA0_ADDR A:0x2553018
y.create.l HWIO_PMIC_ARB3_CHNL43_RDATA0_ADDR A:0x255b018
y.create.l HWIO_PMIC_ARB3_CHNL44_RDATA0_ADDR A:0x2563018
y.create.l HWIO_PMIC_ARB3_CHNL45_RDATA0_ADDR A:0x256b018
y.create.l HWIO_PMIC_ARB3_CHNL46_RDATA0_ADDR A:0x2573018
y.create.l HWIO_PMIC_ARB3_CHNL47_RDATA0_ADDR A:0x257b018
y.create.l HWIO_PMIC_ARB3_CHNL48_RDATA0_ADDR A:0x2583018
y.create.l HWIO_PMIC_ARB3_CHNL49_RDATA0_ADDR A:0x258b018
y.create.l HWIO_PMIC_ARB3_CHNL50_RDATA0_ADDR A:0x2593018
y.create.l HWIO_PMIC_ARB3_CHNL51_RDATA0_ADDR A:0x259b018
y.create.l HWIO_PMIC_ARB3_CHNL52_RDATA0_ADDR A:0x25a3018
y.create.l HWIO_PMIC_ARB3_CHNL53_RDATA0_ADDR A:0x25ab018
y.create.l HWIO_PMIC_ARB3_CHNL54_RDATA0_ADDR A:0x25b3018
y.create.l HWIO_PMIC_ARB3_CHNL55_RDATA0_ADDR A:0x25bb018
y.create.l HWIO_PMIC_ARB3_CHNL56_RDATA0_ADDR A:0x25c3018
y.create.l HWIO_PMIC_ARB3_CHNL57_RDATA0_ADDR A:0x25cb018
y.create.l HWIO_PMIC_ARB3_CHNL58_RDATA0_ADDR A:0x25d3018
y.create.l HWIO_PMIC_ARB3_CHNL59_RDATA0_ADDR A:0x25db018
y.create.l HWIO_PMIC_ARB3_CHNL60_RDATA0_ADDR A:0x25e3018
y.create.l HWIO_PMIC_ARB3_CHNL61_RDATA0_ADDR A:0x25eb018
y.create.l HWIO_PMIC_ARB3_CHNL62_RDATA0_ADDR A:0x25f3018
y.create.l HWIO_PMIC_ARB3_CHNL63_RDATA0_ADDR A:0x25fb018
y.create.l HWIO_PMIC_ARB3_CHNL64_RDATA0_ADDR A:0x2603018
y.create.l HWIO_PMIC_ARB3_CHNL65_RDATA0_ADDR A:0x260b018
y.create.l HWIO_PMIC_ARB3_CHNL66_RDATA0_ADDR A:0x2613018
y.create.l HWIO_PMIC_ARB3_CHNL67_RDATA0_ADDR A:0x261b018
y.create.l HWIO_PMIC_ARB3_CHNL68_RDATA0_ADDR A:0x2623018
y.create.l HWIO_PMIC_ARB3_CHNL69_RDATA0_ADDR A:0x262b018
y.create.l HWIO_PMIC_ARB3_CHNL70_RDATA0_ADDR A:0x2633018
y.create.l HWIO_PMIC_ARB3_CHNL71_RDATA0_ADDR A:0x263b018
y.create.l HWIO_PMIC_ARB3_CHNL72_RDATA0_ADDR A:0x2643018
y.create.l HWIO_PMIC_ARB3_CHNL73_RDATA0_ADDR A:0x264b018
y.create.l HWIO_PMIC_ARB3_CHNL74_RDATA0_ADDR A:0x2653018
y.create.l HWIO_PMIC_ARB3_CHNL75_RDATA0_ADDR A:0x265b018
y.create.l HWIO_PMIC_ARB3_CHNL76_RDATA0_ADDR A:0x2663018
y.create.l HWIO_PMIC_ARB3_CHNL77_RDATA0_ADDR A:0x266b018
y.create.l HWIO_PMIC_ARB3_CHNL78_RDATA0_ADDR A:0x2673018
y.create.l HWIO_PMIC_ARB3_CHNL79_RDATA0_ADDR A:0x267b018
y.create.l HWIO_PMIC_ARB3_CHNL80_RDATA0_ADDR A:0x2683018
y.create.l HWIO_PMIC_ARB3_CHNL81_RDATA0_ADDR A:0x268b018
y.create.l HWIO_PMIC_ARB3_CHNL82_RDATA0_ADDR A:0x2693018
y.create.l HWIO_PMIC_ARB3_CHNL83_RDATA0_ADDR A:0x269b018
y.create.l HWIO_PMIC_ARB3_CHNL84_RDATA0_ADDR A:0x26a3018
y.create.l HWIO_PMIC_ARB3_CHNL85_RDATA0_ADDR A:0x26ab018
y.create.l HWIO_PMIC_ARB3_CHNL86_RDATA0_ADDR A:0x26b3018
y.create.l HWIO_PMIC_ARB3_CHNL87_RDATA0_ADDR A:0x26bb018
y.create.l HWIO_PMIC_ARB3_CHNL88_RDATA0_ADDR A:0x26c3018
y.create.l HWIO_PMIC_ARB3_CHNL89_RDATA0_ADDR A:0x26cb018
y.create.l HWIO_PMIC_ARB3_CHNL90_RDATA0_ADDR A:0x26d3018
y.create.l HWIO_PMIC_ARB3_CHNL91_RDATA0_ADDR A:0x26db018
y.create.l HWIO_PMIC_ARB3_CHNL92_RDATA0_ADDR A:0x26e3018
y.create.l HWIO_PMIC_ARB3_CHNL93_RDATA0_ADDR A:0x26eb018
y.create.l HWIO_PMIC_ARB3_CHNL94_RDATA0_ADDR A:0x26f3018
y.create.l HWIO_PMIC_ARB3_CHNL95_RDATA0_ADDR A:0x26fb018
y.create.l HWIO_PMIC_ARB3_CHNL96_RDATA0_ADDR A:0x2703018
y.create.l HWIO_PMIC_ARB3_CHNL97_RDATA0_ADDR A:0x270b018
y.create.l HWIO_PMIC_ARB3_CHNL98_RDATA0_ADDR A:0x2713018
y.create.l HWIO_PMIC_ARB3_CHNL99_RDATA0_ADDR A:0x271b018
y.create.l HWIO_PMIC_ARB3_CHNL100_RDATA0_ADDR A:0x2723018
y.create.l HWIO_PMIC_ARB3_CHNL101_RDATA0_ADDR A:0x272b018
y.create.l HWIO_PMIC_ARB3_CHNL102_RDATA0_ADDR A:0x2733018
y.create.l HWIO_PMIC_ARB3_CHNL103_RDATA0_ADDR A:0x273b018
y.create.l HWIO_PMIC_ARB3_CHNL104_RDATA0_ADDR A:0x2743018
y.create.l HWIO_PMIC_ARB3_CHNL105_RDATA0_ADDR A:0x274b018
y.create.l HWIO_PMIC_ARB3_CHNL106_RDATA0_ADDR A:0x2753018
y.create.l HWIO_PMIC_ARB3_CHNL107_RDATA0_ADDR A:0x275b018
y.create.l HWIO_PMIC_ARB3_CHNL108_RDATA0_ADDR A:0x2763018
y.create.l HWIO_PMIC_ARB3_CHNL109_RDATA0_ADDR A:0x276b018
y.create.l HWIO_PMIC_ARB3_CHNL110_RDATA0_ADDR A:0x2773018
y.create.l HWIO_PMIC_ARB3_CHNL111_RDATA0_ADDR A:0x277b018
y.create.l HWIO_PMIC_ARB3_CHNL112_RDATA0_ADDR A:0x2783018
y.create.l HWIO_PMIC_ARB3_CHNL113_RDATA0_ADDR A:0x278b018
y.create.l HWIO_PMIC_ARB3_CHNL114_RDATA0_ADDR A:0x2793018
y.create.l HWIO_PMIC_ARB3_CHNL115_RDATA0_ADDR A:0x279b018
y.create.l HWIO_PMIC_ARB3_CHNL116_RDATA0_ADDR A:0x27a3018
y.create.l HWIO_PMIC_ARB3_CHNL117_RDATA0_ADDR A:0x27ab018
y.create.l HWIO_PMIC_ARB3_CHNL118_RDATA0_ADDR A:0x27b3018
y.create.l HWIO_PMIC_ARB3_CHNL119_RDATA0_ADDR A:0x27bb018
y.create.l HWIO_PMIC_ARB3_CHNL120_RDATA0_ADDR A:0x27c3018
y.create.l HWIO_PMIC_ARB3_CHNL121_RDATA0_ADDR A:0x27cb018
y.create.l HWIO_PMIC_ARB3_CHNL122_RDATA0_ADDR A:0x27d3018
y.create.l HWIO_PMIC_ARB3_CHNL123_RDATA0_ADDR A:0x27db018
y.create.l HWIO_PMIC_ARB3_CHNL124_RDATA0_ADDR A:0x27e3018
y.create.l HWIO_PMIC_ARB3_CHNL125_RDATA0_ADDR A:0x27eb018
y.create.l HWIO_PMIC_ARB3_CHNL126_RDATA0_ADDR A:0x27f3018
y.create.l HWIO_PMIC_ARB3_CHNL127_RDATA0_ADDR A:0x27fb018
y.create.l HWIO_PMIC_ARB3_CHNL128_RDATA0_ADDR A:0x2803018
y.create.l HWIO_PMIC_ARB3_CHNL129_RDATA0_ADDR A:0x280b018
y.create.l HWIO_PMIC_ARB3_CHNL130_RDATA0_ADDR A:0x2813018
y.create.l HWIO_PMIC_ARB3_CHNL131_RDATA0_ADDR A:0x281b018
y.create.l HWIO_PMIC_ARB3_CHNL132_RDATA0_ADDR A:0x2823018
y.create.l HWIO_PMIC_ARB3_CHNL133_RDATA0_ADDR A:0x282b018
y.create.l HWIO_PMIC_ARB3_CHNL134_RDATA0_ADDR A:0x2833018
y.create.l HWIO_PMIC_ARB3_CHNL135_RDATA0_ADDR A:0x283b018
y.create.l HWIO_PMIC_ARB3_CHNL136_RDATA0_ADDR A:0x2843018
y.create.l HWIO_PMIC_ARB3_CHNL137_RDATA0_ADDR A:0x284b018
y.create.l HWIO_PMIC_ARB3_CHNL138_RDATA0_ADDR A:0x2853018
y.create.l HWIO_PMIC_ARB3_CHNL139_RDATA0_ADDR A:0x285b018
y.create.l HWIO_PMIC_ARB3_CHNL140_RDATA0_ADDR A:0x2863018
y.create.l HWIO_PMIC_ARB3_CHNL141_RDATA0_ADDR A:0x286b018
y.create.l HWIO_PMIC_ARB3_CHNL142_RDATA0_ADDR A:0x2873018
y.create.l HWIO_PMIC_ARB3_CHNL143_RDATA0_ADDR A:0x287b018
y.create.l HWIO_PMIC_ARB3_CHNL144_RDATA0_ADDR A:0x2883018
y.create.l HWIO_PMIC_ARB3_CHNL145_RDATA0_ADDR A:0x288b018
y.create.l HWIO_PMIC_ARB3_CHNL146_RDATA0_ADDR A:0x2893018
y.create.l HWIO_PMIC_ARB3_CHNL147_RDATA0_ADDR A:0x289b018
y.create.l HWIO_PMIC_ARB3_CHNL148_RDATA0_ADDR A:0x28a3018
y.create.l HWIO_PMIC_ARB3_CHNL149_RDATA0_ADDR A:0x28ab018
y.create.l HWIO_PMIC_ARB3_CHNL150_RDATA0_ADDR A:0x28b3018
y.create.l HWIO_PMIC_ARB3_CHNL151_RDATA0_ADDR A:0x28bb018
y.create.l HWIO_PMIC_ARB3_CHNL152_RDATA0_ADDR A:0x28c3018
y.create.l HWIO_PMIC_ARB3_CHNL153_RDATA0_ADDR A:0x28cb018
y.create.l HWIO_PMIC_ARB3_CHNL154_RDATA0_ADDR A:0x28d3018
y.create.l HWIO_PMIC_ARB3_CHNL155_RDATA0_ADDR A:0x28db018
y.create.l HWIO_PMIC_ARB3_CHNL156_RDATA0_ADDR A:0x28e3018
y.create.l HWIO_PMIC_ARB3_CHNL157_RDATA0_ADDR A:0x28eb018
y.create.l HWIO_PMIC_ARB3_CHNL158_RDATA0_ADDR A:0x28f3018
y.create.l HWIO_PMIC_ARB3_CHNL159_RDATA0_ADDR A:0x28fb018
y.create.l HWIO_PMIC_ARB3_CHNL160_RDATA0_ADDR A:0x2903018
y.create.l HWIO_PMIC_ARB3_CHNL161_RDATA0_ADDR A:0x290b018
y.create.l HWIO_PMIC_ARB3_CHNL162_RDATA0_ADDR A:0x2913018
y.create.l HWIO_PMIC_ARB3_CHNL163_RDATA0_ADDR A:0x291b018
y.create.l HWIO_PMIC_ARB3_CHNL164_RDATA0_ADDR A:0x2923018
y.create.l HWIO_PMIC_ARB3_CHNL165_RDATA0_ADDR A:0x292b018
y.create.l HWIO_PMIC_ARB3_CHNL166_RDATA0_ADDR A:0x2933018
y.create.l HWIO_PMIC_ARB3_CHNL167_RDATA0_ADDR A:0x293b018
y.create.l HWIO_PMIC_ARB3_CHNL168_RDATA0_ADDR A:0x2943018
y.create.l HWIO_PMIC_ARB3_CHNL169_RDATA0_ADDR A:0x294b018
y.create.l HWIO_PMIC_ARB3_CHNL170_RDATA0_ADDR A:0x2953018
y.create.l HWIO_PMIC_ARB3_CHNL171_RDATA0_ADDR A:0x295b018
y.create.l HWIO_PMIC_ARB3_CHNL172_RDATA0_ADDR A:0x2963018
y.create.l HWIO_PMIC_ARB3_CHNL173_RDATA0_ADDR A:0x296b018
y.create.l HWIO_PMIC_ARB3_CHNL174_RDATA0_ADDR A:0x2973018
y.create.l HWIO_PMIC_ARB3_CHNL175_RDATA0_ADDR A:0x297b018
y.create.l HWIO_PMIC_ARB3_CHNL176_RDATA0_ADDR A:0x2983018
y.create.l HWIO_PMIC_ARB3_CHNL177_RDATA0_ADDR A:0x298b018
y.create.l HWIO_PMIC_ARB3_CHNL178_RDATA0_ADDR A:0x2993018
y.create.l HWIO_PMIC_ARB3_CHNL179_RDATA0_ADDR A:0x299b018
y.create.l HWIO_PMIC_ARB3_CHNL180_RDATA0_ADDR A:0x29a3018
y.create.l HWIO_PMIC_ARB3_CHNL181_RDATA0_ADDR A:0x29ab018
y.create.l HWIO_PMIC_ARB3_CHNL182_RDATA0_ADDR A:0x29b3018
y.create.l HWIO_PMIC_ARB3_CHNL183_RDATA0_ADDR A:0x29bb018
y.create.l HWIO_PMIC_ARB3_CHNL184_RDATA0_ADDR A:0x29c3018
y.create.l HWIO_PMIC_ARB3_CHNL185_RDATA0_ADDR A:0x29cb018
y.create.l HWIO_PMIC_ARB3_CHNL186_RDATA0_ADDR A:0x29d3018
y.create.l HWIO_PMIC_ARB3_CHNL187_RDATA0_ADDR A:0x29db018
y.create.l HWIO_PMIC_ARB3_CHNL188_RDATA0_ADDR A:0x29e3018
y.create.l HWIO_PMIC_ARB3_CHNL189_RDATA0_ADDR A:0x29eb018
y.create.l HWIO_PMIC_ARB3_CHNL190_RDATA0_ADDR A:0x29f3018
y.create.l HWIO_PMIC_ARB3_CHNL191_RDATA0_ADDR A:0x29fb018
y.create.l HWIO_PMIC_ARB3_CHNL192_RDATA0_ADDR A:0x2a03018
y.create.l HWIO_PMIC_ARB3_CHNL193_RDATA0_ADDR A:0x2a0b018
y.create.l HWIO_PMIC_ARB3_CHNL194_RDATA0_ADDR A:0x2a13018
y.create.l HWIO_PMIC_ARB3_CHNL195_RDATA0_ADDR A:0x2a1b018
y.create.l HWIO_PMIC_ARB3_CHNL196_RDATA0_ADDR A:0x2a23018
y.create.l HWIO_PMIC_ARB3_CHNL197_RDATA0_ADDR A:0x2a2b018
y.create.l HWIO_PMIC_ARB3_CHNL198_RDATA0_ADDR A:0x2a33018
y.create.l HWIO_PMIC_ARB3_CHNL199_RDATA0_ADDR A:0x2a3b018
y.create.l HWIO_PMIC_ARB3_CHNL200_RDATA0_ADDR A:0x2a43018
y.create.l HWIO_PMIC_ARB3_CHNL201_RDATA0_ADDR A:0x2a4b018
y.create.l HWIO_PMIC_ARB3_CHNL202_RDATA0_ADDR A:0x2a53018
y.create.l HWIO_PMIC_ARB3_CHNL203_RDATA0_ADDR A:0x2a5b018
y.create.l HWIO_PMIC_ARB3_CHNL204_RDATA0_ADDR A:0x2a63018
y.create.l HWIO_PMIC_ARB3_CHNL205_RDATA0_ADDR A:0x2a6b018
y.create.l HWIO_PMIC_ARB3_CHNL206_RDATA0_ADDR A:0x2a73018
y.create.l HWIO_PMIC_ARB3_CHNL207_RDATA0_ADDR A:0x2a7b018
y.create.l HWIO_PMIC_ARB3_CHNL208_RDATA0_ADDR A:0x2a83018
y.create.l HWIO_PMIC_ARB3_CHNL209_RDATA0_ADDR A:0x2a8b018
y.create.l HWIO_PMIC_ARB3_CHNL210_RDATA0_ADDR A:0x2a93018
y.create.l HWIO_PMIC_ARB3_CHNL211_RDATA0_ADDR A:0x2a9b018
y.create.l HWIO_PMIC_ARB3_CHNL212_RDATA0_ADDR A:0x2aa3018
y.create.l HWIO_PMIC_ARB3_CHNL213_RDATA0_ADDR A:0x2aab018
y.create.l HWIO_PMIC_ARB3_CHNL214_RDATA0_ADDR A:0x2ab3018
y.create.l HWIO_PMIC_ARB3_CHNL215_RDATA0_ADDR A:0x2abb018
y.create.l HWIO_PMIC_ARB3_CHNL216_RDATA0_ADDR A:0x2ac3018
y.create.l HWIO_PMIC_ARB3_CHNL217_RDATA0_ADDR A:0x2acb018
y.create.l HWIO_PMIC_ARB3_CHNL218_RDATA0_ADDR A:0x2ad3018
y.create.l HWIO_PMIC_ARB3_CHNL219_RDATA0_ADDR A:0x2adb018
y.create.l HWIO_PMIC_ARB3_CHNL220_RDATA0_ADDR A:0x2ae3018
y.create.l HWIO_PMIC_ARB3_CHNL221_RDATA0_ADDR A:0x2aeb018
y.create.l HWIO_PMIC_ARB3_CHNL222_RDATA0_ADDR A:0x2af3018
y.create.l HWIO_PMIC_ARB3_CHNL223_RDATA0_ADDR A:0x2afb018
y.create.l HWIO_PMIC_ARB3_CHNL224_RDATA0_ADDR A:0x2b03018
y.create.l HWIO_PMIC_ARB3_CHNL225_RDATA0_ADDR A:0x2b0b018
y.create.l HWIO_PMIC_ARB3_CHNL226_RDATA0_ADDR A:0x2b13018
y.create.l HWIO_PMIC_ARB3_CHNL227_RDATA0_ADDR A:0x2b1b018
y.create.l HWIO_PMIC_ARB3_CHNL228_RDATA0_ADDR A:0x2b23018
y.create.l HWIO_PMIC_ARB3_CHNL229_RDATA0_ADDR A:0x2b2b018
y.create.l HWIO_PMIC_ARB3_CHNL230_RDATA0_ADDR A:0x2b33018
y.create.l HWIO_PMIC_ARB3_CHNL231_RDATA0_ADDR A:0x2b3b018
y.create.l HWIO_PMIC_ARB3_CHNL232_RDATA0_ADDR A:0x2b43018
y.create.l HWIO_PMIC_ARB3_CHNL233_RDATA0_ADDR A:0x2b4b018
y.create.l HWIO_PMIC_ARB3_CHNL234_RDATA0_ADDR A:0x2b53018
y.create.l HWIO_PMIC_ARB3_CHNL235_RDATA0_ADDR A:0x2b5b018
y.create.l HWIO_PMIC_ARB3_CHNL236_RDATA0_ADDR A:0x2b63018
y.create.l HWIO_PMIC_ARB3_CHNL237_RDATA0_ADDR A:0x2b6b018
y.create.l HWIO_PMIC_ARB3_CHNL238_RDATA0_ADDR A:0x2b73018
y.create.l HWIO_PMIC_ARB3_CHNL239_RDATA0_ADDR A:0x2b7b018
y.create.l HWIO_PMIC_ARB3_CHNL240_RDATA0_ADDR A:0x2b83018
y.create.l HWIO_PMIC_ARB3_CHNL241_RDATA0_ADDR A:0x2b8b018
y.create.l HWIO_PMIC_ARB3_CHNL242_RDATA0_ADDR A:0x2b93018
y.create.l HWIO_PMIC_ARB3_CHNL243_RDATA0_ADDR A:0x2b9b018
y.create.l HWIO_PMIC_ARB3_CHNL244_RDATA0_ADDR A:0x2ba3018
y.create.l HWIO_PMIC_ARB3_CHNL245_RDATA0_ADDR A:0x2bab018
y.create.l HWIO_PMIC_ARB3_CHNL246_RDATA0_ADDR A:0x2bb3018
y.create.l HWIO_PMIC_ARB3_CHNL247_RDATA0_ADDR A:0x2bbb018
y.create.l HWIO_PMIC_ARB3_CHNL248_RDATA0_ADDR A:0x2bc3018
y.create.l HWIO_PMIC_ARB3_CHNL249_RDATA0_ADDR A:0x2bcb018
y.create.l HWIO_PMIC_ARB3_CHNL250_RDATA0_ADDR A:0x2bd3018
y.create.l HWIO_PMIC_ARB3_CHNL251_RDATA0_ADDR A:0x2bdb018
y.create.l HWIO_PMIC_ARB3_CHNL252_RDATA0_ADDR A:0x2be3018
y.create.l HWIO_PMIC_ARB3_CHNL253_RDATA0_ADDR A:0x2beb018
y.create.l HWIO_PMIC_ARB3_CHNL254_RDATA0_ADDR A:0x2bf3018
y.create.l HWIO_PMIC_ARB3_CHNL255_RDATA0_ADDR A:0x2bfb018
y.create.l HWIO_PMIC_ARB4_CHNL0_RDATA0_ADDR A:0x2404018
y.create.l HWIO_PMIC_ARB4_CHNL1_RDATA0_ADDR A:0x240c018
y.create.l HWIO_PMIC_ARB4_CHNL2_RDATA0_ADDR A:0x2414018
y.create.l HWIO_PMIC_ARB4_CHNL3_RDATA0_ADDR A:0x241c018
y.create.l HWIO_PMIC_ARB4_CHNL4_RDATA0_ADDR A:0x2424018
y.create.l HWIO_PMIC_ARB4_CHNL5_RDATA0_ADDR A:0x242c018
y.create.l HWIO_PMIC_ARB4_CHNL6_RDATA0_ADDR A:0x2434018
y.create.l HWIO_PMIC_ARB4_CHNL7_RDATA0_ADDR A:0x243c018
y.create.l HWIO_PMIC_ARB4_CHNL8_RDATA0_ADDR A:0x2444018
y.create.l HWIO_PMIC_ARB4_CHNL9_RDATA0_ADDR A:0x244c018
y.create.l HWIO_PMIC_ARB4_CHNL10_RDATA0_ADDR A:0x2454018
y.create.l HWIO_PMIC_ARB4_CHNL11_RDATA0_ADDR A:0x245c018
y.create.l HWIO_PMIC_ARB4_CHNL12_RDATA0_ADDR A:0x2464018
y.create.l HWIO_PMIC_ARB4_CHNL13_RDATA0_ADDR A:0x246c018
y.create.l HWIO_PMIC_ARB4_CHNL14_RDATA0_ADDR A:0x2474018
y.create.l HWIO_PMIC_ARB4_CHNL15_RDATA0_ADDR A:0x247c018
y.create.l HWIO_PMIC_ARB4_CHNL16_RDATA0_ADDR A:0x2484018
y.create.l HWIO_PMIC_ARB4_CHNL17_RDATA0_ADDR A:0x248c018
y.create.l HWIO_PMIC_ARB4_CHNL18_RDATA0_ADDR A:0x2494018
y.create.l HWIO_PMIC_ARB4_CHNL19_RDATA0_ADDR A:0x249c018
y.create.l HWIO_PMIC_ARB4_CHNL20_RDATA0_ADDR A:0x24a4018
y.create.l HWIO_PMIC_ARB4_CHNL21_RDATA0_ADDR A:0x24ac018
y.create.l HWIO_PMIC_ARB4_CHNL22_RDATA0_ADDR A:0x24b4018
y.create.l HWIO_PMIC_ARB4_CHNL23_RDATA0_ADDR A:0x24bc018
y.create.l HWIO_PMIC_ARB4_CHNL24_RDATA0_ADDR A:0x24c4018
y.create.l HWIO_PMIC_ARB4_CHNL25_RDATA0_ADDR A:0x24cc018
y.create.l HWIO_PMIC_ARB4_CHNL26_RDATA0_ADDR A:0x24d4018
y.create.l HWIO_PMIC_ARB4_CHNL27_RDATA0_ADDR A:0x24dc018
y.create.l HWIO_PMIC_ARB4_CHNL28_RDATA0_ADDR A:0x24e4018
y.create.l HWIO_PMIC_ARB4_CHNL29_RDATA0_ADDR A:0x24ec018
y.create.l HWIO_PMIC_ARB4_CHNL30_RDATA0_ADDR A:0x24f4018
y.create.l HWIO_PMIC_ARB4_CHNL31_RDATA0_ADDR A:0x24fc018
y.create.l HWIO_PMIC_ARB4_CHNL32_RDATA0_ADDR A:0x2504018
y.create.l HWIO_PMIC_ARB4_CHNL33_RDATA0_ADDR A:0x250c018
y.create.l HWIO_PMIC_ARB4_CHNL34_RDATA0_ADDR A:0x2514018
y.create.l HWIO_PMIC_ARB4_CHNL35_RDATA0_ADDR A:0x251c018
y.create.l HWIO_PMIC_ARB4_CHNL36_RDATA0_ADDR A:0x2524018
y.create.l HWIO_PMIC_ARB4_CHNL37_RDATA0_ADDR A:0x252c018
y.create.l HWIO_PMIC_ARB4_CHNL38_RDATA0_ADDR A:0x2534018
y.create.l HWIO_PMIC_ARB4_CHNL39_RDATA0_ADDR A:0x253c018
y.create.l HWIO_PMIC_ARB4_CHNL40_RDATA0_ADDR A:0x2544018
y.create.l HWIO_PMIC_ARB4_CHNL41_RDATA0_ADDR A:0x254c018
y.create.l HWIO_PMIC_ARB4_CHNL42_RDATA0_ADDR A:0x2554018
y.create.l HWIO_PMIC_ARB4_CHNL43_RDATA0_ADDR A:0x255c018
y.create.l HWIO_PMIC_ARB4_CHNL44_RDATA0_ADDR A:0x2564018
y.create.l HWIO_PMIC_ARB4_CHNL45_RDATA0_ADDR A:0x256c018
y.create.l HWIO_PMIC_ARB4_CHNL46_RDATA0_ADDR A:0x2574018
y.create.l HWIO_PMIC_ARB4_CHNL47_RDATA0_ADDR A:0x257c018
y.create.l HWIO_PMIC_ARB4_CHNL48_RDATA0_ADDR A:0x2584018
y.create.l HWIO_PMIC_ARB4_CHNL49_RDATA0_ADDR A:0x258c018
y.create.l HWIO_PMIC_ARB4_CHNL50_RDATA0_ADDR A:0x2594018
y.create.l HWIO_PMIC_ARB4_CHNL51_RDATA0_ADDR A:0x259c018
y.create.l HWIO_PMIC_ARB4_CHNL52_RDATA0_ADDR A:0x25a4018
y.create.l HWIO_PMIC_ARB4_CHNL53_RDATA0_ADDR A:0x25ac018
y.create.l HWIO_PMIC_ARB4_CHNL54_RDATA0_ADDR A:0x25b4018
y.create.l HWIO_PMIC_ARB4_CHNL55_RDATA0_ADDR A:0x25bc018
y.create.l HWIO_PMIC_ARB4_CHNL56_RDATA0_ADDR A:0x25c4018
y.create.l HWIO_PMIC_ARB4_CHNL57_RDATA0_ADDR A:0x25cc018
y.create.l HWIO_PMIC_ARB4_CHNL58_RDATA0_ADDR A:0x25d4018
y.create.l HWIO_PMIC_ARB4_CHNL59_RDATA0_ADDR A:0x25dc018
y.create.l HWIO_PMIC_ARB4_CHNL60_RDATA0_ADDR A:0x25e4018
y.create.l HWIO_PMIC_ARB4_CHNL61_RDATA0_ADDR A:0x25ec018
y.create.l HWIO_PMIC_ARB4_CHNL62_RDATA0_ADDR A:0x25f4018
y.create.l HWIO_PMIC_ARB4_CHNL63_RDATA0_ADDR A:0x25fc018
y.create.l HWIO_PMIC_ARB4_CHNL64_RDATA0_ADDR A:0x2604018
y.create.l HWIO_PMIC_ARB4_CHNL65_RDATA0_ADDR A:0x260c018
y.create.l HWIO_PMIC_ARB4_CHNL66_RDATA0_ADDR A:0x2614018
y.create.l HWIO_PMIC_ARB4_CHNL67_RDATA0_ADDR A:0x261c018
y.create.l HWIO_PMIC_ARB4_CHNL68_RDATA0_ADDR A:0x2624018
y.create.l HWIO_PMIC_ARB4_CHNL69_RDATA0_ADDR A:0x262c018
y.create.l HWIO_PMIC_ARB4_CHNL70_RDATA0_ADDR A:0x2634018
y.create.l HWIO_PMIC_ARB4_CHNL71_RDATA0_ADDR A:0x263c018
y.create.l HWIO_PMIC_ARB4_CHNL72_RDATA0_ADDR A:0x2644018
y.create.l HWIO_PMIC_ARB4_CHNL73_RDATA0_ADDR A:0x264c018
y.create.l HWIO_PMIC_ARB4_CHNL74_RDATA0_ADDR A:0x2654018
y.create.l HWIO_PMIC_ARB4_CHNL75_RDATA0_ADDR A:0x265c018
y.create.l HWIO_PMIC_ARB4_CHNL76_RDATA0_ADDR A:0x2664018
y.create.l HWIO_PMIC_ARB4_CHNL77_RDATA0_ADDR A:0x266c018
y.create.l HWIO_PMIC_ARB4_CHNL78_RDATA0_ADDR A:0x2674018
y.create.l HWIO_PMIC_ARB4_CHNL79_RDATA0_ADDR A:0x267c018
y.create.l HWIO_PMIC_ARB4_CHNL80_RDATA0_ADDR A:0x2684018
y.create.l HWIO_PMIC_ARB4_CHNL81_RDATA0_ADDR A:0x268c018
y.create.l HWIO_PMIC_ARB4_CHNL82_RDATA0_ADDR A:0x2694018
y.create.l HWIO_PMIC_ARB4_CHNL83_RDATA0_ADDR A:0x269c018
y.create.l HWIO_PMIC_ARB4_CHNL84_RDATA0_ADDR A:0x26a4018
y.create.l HWIO_PMIC_ARB4_CHNL85_RDATA0_ADDR A:0x26ac018
y.create.l HWIO_PMIC_ARB4_CHNL86_RDATA0_ADDR A:0x26b4018
y.create.l HWIO_PMIC_ARB4_CHNL87_RDATA0_ADDR A:0x26bc018
y.create.l HWIO_PMIC_ARB4_CHNL88_RDATA0_ADDR A:0x26c4018
y.create.l HWIO_PMIC_ARB4_CHNL89_RDATA0_ADDR A:0x26cc018
y.create.l HWIO_PMIC_ARB4_CHNL90_RDATA0_ADDR A:0x26d4018
y.create.l HWIO_PMIC_ARB4_CHNL91_RDATA0_ADDR A:0x26dc018
y.create.l HWIO_PMIC_ARB4_CHNL92_RDATA0_ADDR A:0x26e4018
y.create.l HWIO_PMIC_ARB4_CHNL93_RDATA0_ADDR A:0x26ec018
y.create.l HWIO_PMIC_ARB4_CHNL94_RDATA0_ADDR A:0x26f4018
y.create.l HWIO_PMIC_ARB4_CHNL95_RDATA0_ADDR A:0x26fc018
y.create.l HWIO_PMIC_ARB4_CHNL96_RDATA0_ADDR A:0x2704018
y.create.l HWIO_PMIC_ARB4_CHNL97_RDATA0_ADDR A:0x270c018
y.create.l HWIO_PMIC_ARB4_CHNL98_RDATA0_ADDR A:0x2714018
y.create.l HWIO_PMIC_ARB4_CHNL99_RDATA0_ADDR A:0x271c018
y.create.l HWIO_PMIC_ARB4_CHNL100_RDATA0_ADDR A:0x2724018
y.create.l HWIO_PMIC_ARB4_CHNL101_RDATA0_ADDR A:0x272c018
y.create.l HWIO_PMIC_ARB4_CHNL102_RDATA0_ADDR A:0x2734018
y.create.l HWIO_PMIC_ARB4_CHNL103_RDATA0_ADDR A:0x273c018
y.create.l HWIO_PMIC_ARB4_CHNL104_RDATA0_ADDR A:0x2744018
y.create.l HWIO_PMIC_ARB4_CHNL105_RDATA0_ADDR A:0x274c018
y.create.l HWIO_PMIC_ARB4_CHNL106_RDATA0_ADDR A:0x2754018
y.create.l HWIO_PMIC_ARB4_CHNL107_RDATA0_ADDR A:0x275c018
y.create.l HWIO_PMIC_ARB4_CHNL108_RDATA0_ADDR A:0x2764018
y.create.l HWIO_PMIC_ARB4_CHNL109_RDATA0_ADDR A:0x276c018
y.create.l HWIO_PMIC_ARB4_CHNL110_RDATA0_ADDR A:0x2774018
y.create.l HWIO_PMIC_ARB4_CHNL111_RDATA0_ADDR A:0x277c018
y.create.l HWIO_PMIC_ARB4_CHNL112_RDATA0_ADDR A:0x2784018
y.create.l HWIO_PMIC_ARB4_CHNL113_RDATA0_ADDR A:0x278c018
y.create.l HWIO_PMIC_ARB4_CHNL114_RDATA0_ADDR A:0x2794018
y.create.l HWIO_PMIC_ARB4_CHNL115_RDATA0_ADDR A:0x279c018
y.create.l HWIO_PMIC_ARB4_CHNL116_RDATA0_ADDR A:0x27a4018
y.create.l HWIO_PMIC_ARB4_CHNL117_RDATA0_ADDR A:0x27ac018
y.create.l HWIO_PMIC_ARB4_CHNL118_RDATA0_ADDR A:0x27b4018
y.create.l HWIO_PMIC_ARB4_CHNL119_RDATA0_ADDR A:0x27bc018
y.create.l HWIO_PMIC_ARB4_CHNL120_RDATA0_ADDR A:0x27c4018
y.create.l HWIO_PMIC_ARB4_CHNL121_RDATA0_ADDR A:0x27cc018
y.create.l HWIO_PMIC_ARB4_CHNL122_RDATA0_ADDR A:0x27d4018
y.create.l HWIO_PMIC_ARB4_CHNL123_RDATA0_ADDR A:0x27dc018
y.create.l HWIO_PMIC_ARB4_CHNL124_RDATA0_ADDR A:0x27e4018
y.create.l HWIO_PMIC_ARB4_CHNL125_RDATA0_ADDR A:0x27ec018
y.create.l HWIO_PMIC_ARB4_CHNL126_RDATA0_ADDR A:0x27f4018
y.create.l HWIO_PMIC_ARB4_CHNL127_RDATA0_ADDR A:0x27fc018
y.create.l HWIO_PMIC_ARB4_CHNL128_RDATA0_ADDR A:0x2804018
y.create.l HWIO_PMIC_ARB4_CHNL129_RDATA0_ADDR A:0x280c018
y.create.l HWIO_PMIC_ARB4_CHNL130_RDATA0_ADDR A:0x2814018
y.create.l HWIO_PMIC_ARB4_CHNL131_RDATA0_ADDR A:0x281c018
y.create.l HWIO_PMIC_ARB4_CHNL132_RDATA0_ADDR A:0x2824018
y.create.l HWIO_PMIC_ARB4_CHNL133_RDATA0_ADDR A:0x282c018
y.create.l HWIO_PMIC_ARB4_CHNL134_RDATA0_ADDR A:0x2834018
y.create.l HWIO_PMIC_ARB4_CHNL135_RDATA0_ADDR A:0x283c018
y.create.l HWIO_PMIC_ARB4_CHNL136_RDATA0_ADDR A:0x2844018
y.create.l HWIO_PMIC_ARB4_CHNL137_RDATA0_ADDR A:0x284c018
y.create.l HWIO_PMIC_ARB4_CHNL138_RDATA0_ADDR A:0x2854018
y.create.l HWIO_PMIC_ARB4_CHNL139_RDATA0_ADDR A:0x285c018
y.create.l HWIO_PMIC_ARB4_CHNL140_RDATA0_ADDR A:0x2864018
y.create.l HWIO_PMIC_ARB4_CHNL141_RDATA0_ADDR A:0x286c018
y.create.l HWIO_PMIC_ARB4_CHNL142_RDATA0_ADDR A:0x2874018
y.create.l HWIO_PMIC_ARB4_CHNL143_RDATA0_ADDR A:0x287c018
y.create.l HWIO_PMIC_ARB4_CHNL144_RDATA0_ADDR A:0x2884018
y.create.l HWIO_PMIC_ARB4_CHNL145_RDATA0_ADDR A:0x288c018
y.create.l HWIO_PMIC_ARB4_CHNL146_RDATA0_ADDR A:0x2894018
y.create.l HWIO_PMIC_ARB4_CHNL147_RDATA0_ADDR A:0x289c018
y.create.l HWIO_PMIC_ARB4_CHNL148_RDATA0_ADDR A:0x28a4018
y.create.l HWIO_PMIC_ARB4_CHNL149_RDATA0_ADDR A:0x28ac018
y.create.l HWIO_PMIC_ARB4_CHNL150_RDATA0_ADDR A:0x28b4018
y.create.l HWIO_PMIC_ARB4_CHNL151_RDATA0_ADDR A:0x28bc018
y.create.l HWIO_PMIC_ARB4_CHNL152_RDATA0_ADDR A:0x28c4018
y.create.l HWIO_PMIC_ARB4_CHNL153_RDATA0_ADDR A:0x28cc018
y.create.l HWIO_PMIC_ARB4_CHNL154_RDATA0_ADDR A:0x28d4018
y.create.l HWIO_PMIC_ARB4_CHNL155_RDATA0_ADDR A:0x28dc018
y.create.l HWIO_PMIC_ARB4_CHNL156_RDATA0_ADDR A:0x28e4018
y.create.l HWIO_PMIC_ARB4_CHNL157_RDATA0_ADDR A:0x28ec018
y.create.l HWIO_PMIC_ARB4_CHNL158_RDATA0_ADDR A:0x28f4018
y.create.l HWIO_PMIC_ARB4_CHNL159_RDATA0_ADDR A:0x28fc018
y.create.l HWIO_PMIC_ARB4_CHNL160_RDATA0_ADDR A:0x2904018
y.create.l HWIO_PMIC_ARB4_CHNL161_RDATA0_ADDR A:0x290c018
y.create.l HWIO_PMIC_ARB4_CHNL162_RDATA0_ADDR A:0x2914018
y.create.l HWIO_PMIC_ARB4_CHNL163_RDATA0_ADDR A:0x291c018
y.create.l HWIO_PMIC_ARB4_CHNL164_RDATA0_ADDR A:0x2924018
y.create.l HWIO_PMIC_ARB4_CHNL165_RDATA0_ADDR A:0x292c018
y.create.l HWIO_PMIC_ARB4_CHNL166_RDATA0_ADDR A:0x2934018
y.create.l HWIO_PMIC_ARB4_CHNL167_RDATA0_ADDR A:0x293c018
y.create.l HWIO_PMIC_ARB4_CHNL168_RDATA0_ADDR A:0x2944018
y.create.l HWIO_PMIC_ARB4_CHNL169_RDATA0_ADDR A:0x294c018
y.create.l HWIO_PMIC_ARB4_CHNL170_RDATA0_ADDR A:0x2954018
y.create.l HWIO_PMIC_ARB4_CHNL171_RDATA0_ADDR A:0x295c018
y.create.l HWIO_PMIC_ARB4_CHNL172_RDATA0_ADDR A:0x2964018
y.create.l HWIO_PMIC_ARB4_CHNL173_RDATA0_ADDR A:0x296c018
y.create.l HWIO_PMIC_ARB4_CHNL174_RDATA0_ADDR A:0x2974018
y.create.l HWIO_PMIC_ARB4_CHNL175_RDATA0_ADDR A:0x297c018
y.create.l HWIO_PMIC_ARB4_CHNL176_RDATA0_ADDR A:0x2984018
y.create.l HWIO_PMIC_ARB4_CHNL177_RDATA0_ADDR A:0x298c018
y.create.l HWIO_PMIC_ARB4_CHNL178_RDATA0_ADDR A:0x2994018
y.create.l HWIO_PMIC_ARB4_CHNL179_RDATA0_ADDR A:0x299c018
y.create.l HWIO_PMIC_ARB4_CHNL180_RDATA0_ADDR A:0x29a4018
y.create.l HWIO_PMIC_ARB4_CHNL181_RDATA0_ADDR A:0x29ac018
y.create.l HWIO_PMIC_ARB4_CHNL182_RDATA0_ADDR A:0x29b4018
y.create.l HWIO_PMIC_ARB4_CHNL183_RDATA0_ADDR A:0x29bc018
y.create.l HWIO_PMIC_ARB4_CHNL184_RDATA0_ADDR A:0x29c4018
y.create.l HWIO_PMIC_ARB4_CHNL185_RDATA0_ADDR A:0x29cc018
y.create.l HWIO_PMIC_ARB4_CHNL186_RDATA0_ADDR A:0x29d4018
y.create.l HWIO_PMIC_ARB4_CHNL187_RDATA0_ADDR A:0x29dc018
y.create.l HWIO_PMIC_ARB4_CHNL188_RDATA0_ADDR A:0x29e4018
y.create.l HWIO_PMIC_ARB4_CHNL189_RDATA0_ADDR A:0x29ec018
y.create.l HWIO_PMIC_ARB4_CHNL190_RDATA0_ADDR A:0x29f4018
y.create.l HWIO_PMIC_ARB4_CHNL191_RDATA0_ADDR A:0x29fc018
y.create.l HWIO_PMIC_ARB4_CHNL192_RDATA0_ADDR A:0x2a04018
y.create.l HWIO_PMIC_ARB4_CHNL193_RDATA0_ADDR A:0x2a0c018
y.create.l HWIO_PMIC_ARB4_CHNL194_RDATA0_ADDR A:0x2a14018
y.create.l HWIO_PMIC_ARB4_CHNL195_RDATA0_ADDR A:0x2a1c018
y.create.l HWIO_PMIC_ARB4_CHNL196_RDATA0_ADDR A:0x2a24018
y.create.l HWIO_PMIC_ARB4_CHNL197_RDATA0_ADDR A:0x2a2c018
y.create.l HWIO_PMIC_ARB4_CHNL198_RDATA0_ADDR A:0x2a34018
y.create.l HWIO_PMIC_ARB4_CHNL199_RDATA0_ADDR A:0x2a3c018
y.create.l HWIO_PMIC_ARB4_CHNL200_RDATA0_ADDR A:0x2a44018
y.create.l HWIO_PMIC_ARB4_CHNL201_RDATA0_ADDR A:0x2a4c018
y.create.l HWIO_PMIC_ARB4_CHNL202_RDATA0_ADDR A:0x2a54018
y.create.l HWIO_PMIC_ARB4_CHNL203_RDATA0_ADDR A:0x2a5c018
y.create.l HWIO_PMIC_ARB4_CHNL204_RDATA0_ADDR A:0x2a64018
y.create.l HWIO_PMIC_ARB4_CHNL205_RDATA0_ADDR A:0x2a6c018
y.create.l HWIO_PMIC_ARB4_CHNL206_RDATA0_ADDR A:0x2a74018
y.create.l HWIO_PMIC_ARB4_CHNL207_RDATA0_ADDR A:0x2a7c018
y.create.l HWIO_PMIC_ARB4_CHNL208_RDATA0_ADDR A:0x2a84018
y.create.l HWIO_PMIC_ARB4_CHNL209_RDATA0_ADDR A:0x2a8c018
y.create.l HWIO_PMIC_ARB4_CHNL210_RDATA0_ADDR A:0x2a94018
y.create.l HWIO_PMIC_ARB4_CHNL211_RDATA0_ADDR A:0x2a9c018
y.create.l HWIO_PMIC_ARB4_CHNL212_RDATA0_ADDR A:0x2aa4018
y.create.l HWIO_PMIC_ARB4_CHNL213_RDATA0_ADDR A:0x2aac018
y.create.l HWIO_PMIC_ARB4_CHNL214_RDATA0_ADDR A:0x2ab4018
y.create.l HWIO_PMIC_ARB4_CHNL215_RDATA0_ADDR A:0x2abc018
y.create.l HWIO_PMIC_ARB4_CHNL216_RDATA0_ADDR A:0x2ac4018
y.create.l HWIO_PMIC_ARB4_CHNL217_RDATA0_ADDR A:0x2acc018
y.create.l HWIO_PMIC_ARB4_CHNL218_RDATA0_ADDR A:0x2ad4018
y.create.l HWIO_PMIC_ARB4_CHNL219_RDATA0_ADDR A:0x2adc018
y.create.l HWIO_PMIC_ARB4_CHNL220_RDATA0_ADDR A:0x2ae4018
y.create.l HWIO_PMIC_ARB4_CHNL221_RDATA0_ADDR A:0x2aec018
y.create.l HWIO_PMIC_ARB4_CHNL222_RDATA0_ADDR A:0x2af4018
y.create.l HWIO_PMIC_ARB4_CHNL223_RDATA0_ADDR A:0x2afc018
y.create.l HWIO_PMIC_ARB4_CHNL224_RDATA0_ADDR A:0x2b04018
y.create.l HWIO_PMIC_ARB4_CHNL225_RDATA0_ADDR A:0x2b0c018
y.create.l HWIO_PMIC_ARB4_CHNL226_RDATA0_ADDR A:0x2b14018
y.create.l HWIO_PMIC_ARB4_CHNL227_RDATA0_ADDR A:0x2b1c018
y.create.l HWIO_PMIC_ARB4_CHNL228_RDATA0_ADDR A:0x2b24018
y.create.l HWIO_PMIC_ARB4_CHNL229_RDATA0_ADDR A:0x2b2c018
y.create.l HWIO_PMIC_ARB4_CHNL230_RDATA0_ADDR A:0x2b34018
y.create.l HWIO_PMIC_ARB4_CHNL231_RDATA0_ADDR A:0x2b3c018
y.create.l HWIO_PMIC_ARB4_CHNL232_RDATA0_ADDR A:0x2b44018
y.create.l HWIO_PMIC_ARB4_CHNL233_RDATA0_ADDR A:0x2b4c018
y.create.l HWIO_PMIC_ARB4_CHNL234_RDATA0_ADDR A:0x2b54018
y.create.l HWIO_PMIC_ARB4_CHNL235_RDATA0_ADDR A:0x2b5c018
y.create.l HWIO_PMIC_ARB4_CHNL236_RDATA0_ADDR A:0x2b64018
y.create.l HWIO_PMIC_ARB4_CHNL237_RDATA0_ADDR A:0x2b6c018
y.create.l HWIO_PMIC_ARB4_CHNL238_RDATA0_ADDR A:0x2b74018
y.create.l HWIO_PMIC_ARB4_CHNL239_RDATA0_ADDR A:0x2b7c018
y.create.l HWIO_PMIC_ARB4_CHNL240_RDATA0_ADDR A:0x2b84018
y.create.l HWIO_PMIC_ARB4_CHNL241_RDATA0_ADDR A:0x2b8c018
y.create.l HWIO_PMIC_ARB4_CHNL242_RDATA0_ADDR A:0x2b94018
y.create.l HWIO_PMIC_ARB4_CHNL243_RDATA0_ADDR A:0x2b9c018
y.create.l HWIO_PMIC_ARB4_CHNL244_RDATA0_ADDR A:0x2ba4018
y.create.l HWIO_PMIC_ARB4_CHNL245_RDATA0_ADDR A:0x2bac018
y.create.l HWIO_PMIC_ARB4_CHNL246_RDATA0_ADDR A:0x2bb4018
y.create.l HWIO_PMIC_ARB4_CHNL247_RDATA0_ADDR A:0x2bbc018
y.create.l HWIO_PMIC_ARB4_CHNL248_RDATA0_ADDR A:0x2bc4018
y.create.l HWIO_PMIC_ARB4_CHNL249_RDATA0_ADDR A:0x2bcc018
y.create.l HWIO_PMIC_ARB4_CHNL250_RDATA0_ADDR A:0x2bd4018
y.create.l HWIO_PMIC_ARB4_CHNL251_RDATA0_ADDR A:0x2bdc018
y.create.l HWIO_PMIC_ARB4_CHNL252_RDATA0_ADDR A:0x2be4018
y.create.l HWIO_PMIC_ARB4_CHNL253_RDATA0_ADDR A:0x2bec018
y.create.l HWIO_PMIC_ARB4_CHNL254_RDATA0_ADDR A:0x2bf4018
y.create.l HWIO_PMIC_ARB4_CHNL255_RDATA0_ADDR A:0x2bfc018
y.create.l HWIO_PMIC_ARB5_CHNL0_RDATA0_ADDR A:0x2405018
y.create.l HWIO_PMIC_ARB5_CHNL1_RDATA0_ADDR A:0x240d018
y.create.l HWIO_PMIC_ARB5_CHNL2_RDATA0_ADDR A:0x2415018
y.create.l HWIO_PMIC_ARB5_CHNL3_RDATA0_ADDR A:0x241d018
y.create.l HWIO_PMIC_ARB5_CHNL4_RDATA0_ADDR A:0x2425018
y.create.l HWIO_PMIC_ARB5_CHNL5_RDATA0_ADDR A:0x242d018
y.create.l HWIO_PMIC_ARB5_CHNL6_RDATA0_ADDR A:0x2435018
y.create.l HWIO_PMIC_ARB5_CHNL7_RDATA0_ADDR A:0x243d018
y.create.l HWIO_PMIC_ARB5_CHNL8_RDATA0_ADDR A:0x2445018
y.create.l HWIO_PMIC_ARB5_CHNL9_RDATA0_ADDR A:0x244d018
y.create.l HWIO_PMIC_ARB5_CHNL10_RDATA0_ADDR A:0x2455018
y.create.l HWIO_PMIC_ARB5_CHNL11_RDATA0_ADDR A:0x245d018
y.create.l HWIO_PMIC_ARB5_CHNL12_RDATA0_ADDR A:0x2465018
y.create.l HWIO_PMIC_ARB5_CHNL13_RDATA0_ADDR A:0x246d018
y.create.l HWIO_PMIC_ARB5_CHNL14_RDATA0_ADDR A:0x2475018
y.create.l HWIO_PMIC_ARB5_CHNL15_RDATA0_ADDR A:0x247d018
y.create.l HWIO_PMIC_ARB5_CHNL16_RDATA0_ADDR A:0x2485018
y.create.l HWIO_PMIC_ARB5_CHNL17_RDATA0_ADDR A:0x248d018
y.create.l HWIO_PMIC_ARB5_CHNL18_RDATA0_ADDR A:0x2495018
y.create.l HWIO_PMIC_ARB5_CHNL19_RDATA0_ADDR A:0x249d018
y.create.l HWIO_PMIC_ARB5_CHNL20_RDATA0_ADDR A:0x24a5018
y.create.l HWIO_PMIC_ARB5_CHNL21_RDATA0_ADDR A:0x24ad018
y.create.l HWIO_PMIC_ARB5_CHNL22_RDATA0_ADDR A:0x24b5018
y.create.l HWIO_PMIC_ARB5_CHNL23_RDATA0_ADDR A:0x24bd018
y.create.l HWIO_PMIC_ARB5_CHNL24_RDATA0_ADDR A:0x24c5018
y.create.l HWIO_PMIC_ARB5_CHNL25_RDATA0_ADDR A:0x24cd018
y.create.l HWIO_PMIC_ARB5_CHNL26_RDATA0_ADDR A:0x24d5018
y.create.l HWIO_PMIC_ARB5_CHNL27_RDATA0_ADDR A:0x24dd018
y.create.l HWIO_PMIC_ARB5_CHNL28_RDATA0_ADDR A:0x24e5018
y.create.l HWIO_PMIC_ARB5_CHNL29_RDATA0_ADDR A:0x24ed018
y.create.l HWIO_PMIC_ARB5_CHNL30_RDATA0_ADDR A:0x24f5018
y.create.l HWIO_PMIC_ARB5_CHNL31_RDATA0_ADDR A:0x24fd018
y.create.l HWIO_PMIC_ARB5_CHNL32_RDATA0_ADDR A:0x2505018
y.create.l HWIO_PMIC_ARB5_CHNL33_RDATA0_ADDR A:0x250d018
y.create.l HWIO_PMIC_ARB5_CHNL34_RDATA0_ADDR A:0x2515018
y.create.l HWIO_PMIC_ARB5_CHNL35_RDATA0_ADDR A:0x251d018
y.create.l HWIO_PMIC_ARB5_CHNL36_RDATA0_ADDR A:0x2525018
y.create.l HWIO_PMIC_ARB5_CHNL37_RDATA0_ADDR A:0x252d018
y.create.l HWIO_PMIC_ARB5_CHNL38_RDATA0_ADDR A:0x2535018
y.create.l HWIO_PMIC_ARB5_CHNL39_RDATA0_ADDR A:0x253d018
y.create.l HWIO_PMIC_ARB5_CHNL40_RDATA0_ADDR A:0x2545018
y.create.l HWIO_PMIC_ARB5_CHNL41_RDATA0_ADDR A:0x254d018
y.create.l HWIO_PMIC_ARB5_CHNL42_RDATA0_ADDR A:0x2555018
y.create.l HWIO_PMIC_ARB5_CHNL43_RDATA0_ADDR A:0x255d018
y.create.l HWIO_PMIC_ARB5_CHNL44_RDATA0_ADDR A:0x2565018
y.create.l HWIO_PMIC_ARB5_CHNL45_RDATA0_ADDR A:0x256d018
y.create.l HWIO_PMIC_ARB5_CHNL46_RDATA0_ADDR A:0x2575018
y.create.l HWIO_PMIC_ARB5_CHNL47_RDATA0_ADDR A:0x257d018
y.create.l HWIO_PMIC_ARB5_CHNL48_RDATA0_ADDR A:0x2585018
y.create.l HWIO_PMIC_ARB5_CHNL49_RDATA0_ADDR A:0x258d018
y.create.l HWIO_PMIC_ARB5_CHNL50_RDATA0_ADDR A:0x2595018
y.create.l HWIO_PMIC_ARB5_CHNL51_RDATA0_ADDR A:0x259d018
y.create.l HWIO_PMIC_ARB5_CHNL52_RDATA0_ADDR A:0x25a5018
y.create.l HWIO_PMIC_ARB5_CHNL53_RDATA0_ADDR A:0x25ad018
y.create.l HWIO_PMIC_ARB5_CHNL54_RDATA0_ADDR A:0x25b5018
y.create.l HWIO_PMIC_ARB5_CHNL55_RDATA0_ADDR A:0x25bd018
y.create.l HWIO_PMIC_ARB5_CHNL56_RDATA0_ADDR A:0x25c5018
y.create.l HWIO_PMIC_ARB5_CHNL57_RDATA0_ADDR A:0x25cd018
y.create.l HWIO_PMIC_ARB5_CHNL58_RDATA0_ADDR A:0x25d5018
y.create.l HWIO_PMIC_ARB5_CHNL59_RDATA0_ADDR A:0x25dd018
y.create.l HWIO_PMIC_ARB5_CHNL60_RDATA0_ADDR A:0x25e5018
y.create.l HWIO_PMIC_ARB5_CHNL61_RDATA0_ADDR A:0x25ed018
y.create.l HWIO_PMIC_ARB5_CHNL62_RDATA0_ADDR A:0x25f5018
y.create.l HWIO_PMIC_ARB5_CHNL63_RDATA0_ADDR A:0x25fd018
y.create.l HWIO_PMIC_ARB5_CHNL64_RDATA0_ADDR A:0x2605018
y.create.l HWIO_PMIC_ARB5_CHNL65_RDATA0_ADDR A:0x260d018
y.create.l HWIO_PMIC_ARB5_CHNL66_RDATA0_ADDR A:0x2615018
y.create.l HWIO_PMIC_ARB5_CHNL67_RDATA0_ADDR A:0x261d018
y.create.l HWIO_PMIC_ARB5_CHNL68_RDATA0_ADDR A:0x2625018
y.create.l HWIO_PMIC_ARB5_CHNL69_RDATA0_ADDR A:0x262d018
y.create.l HWIO_PMIC_ARB5_CHNL70_RDATA0_ADDR A:0x2635018
y.create.l HWIO_PMIC_ARB5_CHNL71_RDATA0_ADDR A:0x263d018
y.create.l HWIO_PMIC_ARB5_CHNL72_RDATA0_ADDR A:0x2645018
y.create.l HWIO_PMIC_ARB5_CHNL73_RDATA0_ADDR A:0x264d018
y.create.l HWIO_PMIC_ARB5_CHNL74_RDATA0_ADDR A:0x2655018
y.create.l HWIO_PMIC_ARB5_CHNL75_RDATA0_ADDR A:0x265d018
y.create.l HWIO_PMIC_ARB5_CHNL76_RDATA0_ADDR A:0x2665018
y.create.l HWIO_PMIC_ARB5_CHNL77_RDATA0_ADDR A:0x266d018
y.create.l HWIO_PMIC_ARB5_CHNL78_RDATA0_ADDR A:0x2675018
y.create.l HWIO_PMIC_ARB5_CHNL79_RDATA0_ADDR A:0x267d018
y.create.l HWIO_PMIC_ARB5_CHNL80_RDATA0_ADDR A:0x2685018
y.create.l HWIO_PMIC_ARB5_CHNL81_RDATA0_ADDR A:0x268d018
y.create.l HWIO_PMIC_ARB5_CHNL82_RDATA0_ADDR A:0x2695018
y.create.l HWIO_PMIC_ARB5_CHNL83_RDATA0_ADDR A:0x269d018
y.create.l HWIO_PMIC_ARB5_CHNL84_RDATA0_ADDR A:0x26a5018
y.create.l HWIO_PMIC_ARB5_CHNL85_RDATA0_ADDR A:0x26ad018
y.create.l HWIO_PMIC_ARB5_CHNL86_RDATA0_ADDR A:0x26b5018
y.create.l HWIO_PMIC_ARB5_CHNL87_RDATA0_ADDR A:0x26bd018
y.create.l HWIO_PMIC_ARB5_CHNL88_RDATA0_ADDR A:0x26c5018
y.create.l HWIO_PMIC_ARB5_CHNL89_RDATA0_ADDR A:0x26cd018
y.create.l HWIO_PMIC_ARB5_CHNL90_RDATA0_ADDR A:0x26d5018
y.create.l HWIO_PMIC_ARB5_CHNL91_RDATA0_ADDR A:0x26dd018
y.create.l HWIO_PMIC_ARB5_CHNL92_RDATA0_ADDR A:0x26e5018
y.create.l HWIO_PMIC_ARB5_CHNL93_RDATA0_ADDR A:0x26ed018
y.create.l HWIO_PMIC_ARB5_CHNL94_RDATA0_ADDR A:0x26f5018
y.create.l HWIO_PMIC_ARB5_CHNL95_RDATA0_ADDR A:0x26fd018
y.create.l HWIO_PMIC_ARB5_CHNL96_RDATA0_ADDR A:0x2705018
y.create.l HWIO_PMIC_ARB5_CHNL97_RDATA0_ADDR A:0x270d018
y.create.l HWIO_PMIC_ARB5_CHNL98_RDATA0_ADDR A:0x2715018
y.create.l HWIO_PMIC_ARB5_CHNL99_RDATA0_ADDR A:0x271d018
y.create.l HWIO_PMIC_ARB5_CHNL100_RDATA0_ADDR A:0x2725018
y.create.l HWIO_PMIC_ARB5_CHNL101_RDATA0_ADDR A:0x272d018
y.create.l HWIO_PMIC_ARB5_CHNL102_RDATA0_ADDR A:0x2735018
y.create.l HWIO_PMIC_ARB5_CHNL103_RDATA0_ADDR A:0x273d018
y.create.l HWIO_PMIC_ARB5_CHNL104_RDATA0_ADDR A:0x2745018
y.create.l HWIO_PMIC_ARB5_CHNL105_RDATA0_ADDR A:0x274d018
y.create.l HWIO_PMIC_ARB5_CHNL106_RDATA0_ADDR A:0x2755018
y.create.l HWIO_PMIC_ARB5_CHNL107_RDATA0_ADDR A:0x275d018
y.create.l HWIO_PMIC_ARB5_CHNL108_RDATA0_ADDR A:0x2765018
y.create.l HWIO_PMIC_ARB5_CHNL109_RDATA0_ADDR A:0x276d018
y.create.l HWIO_PMIC_ARB5_CHNL110_RDATA0_ADDR A:0x2775018
y.create.l HWIO_PMIC_ARB5_CHNL111_RDATA0_ADDR A:0x277d018
y.create.l HWIO_PMIC_ARB5_CHNL112_RDATA0_ADDR A:0x2785018
y.create.l HWIO_PMIC_ARB5_CHNL113_RDATA0_ADDR A:0x278d018
y.create.l HWIO_PMIC_ARB5_CHNL114_RDATA0_ADDR A:0x2795018
y.create.l HWIO_PMIC_ARB5_CHNL115_RDATA0_ADDR A:0x279d018
y.create.l HWIO_PMIC_ARB5_CHNL116_RDATA0_ADDR A:0x27a5018
y.create.l HWIO_PMIC_ARB5_CHNL117_RDATA0_ADDR A:0x27ad018
y.create.l HWIO_PMIC_ARB5_CHNL118_RDATA0_ADDR A:0x27b5018
y.create.l HWIO_PMIC_ARB5_CHNL119_RDATA0_ADDR A:0x27bd018
y.create.l HWIO_PMIC_ARB5_CHNL120_RDATA0_ADDR A:0x27c5018
y.create.l HWIO_PMIC_ARB5_CHNL121_RDATA0_ADDR A:0x27cd018
y.create.l HWIO_PMIC_ARB5_CHNL122_RDATA0_ADDR A:0x27d5018
y.create.l HWIO_PMIC_ARB5_CHNL123_RDATA0_ADDR A:0x27dd018
y.create.l HWIO_PMIC_ARB5_CHNL124_RDATA0_ADDR A:0x27e5018
y.create.l HWIO_PMIC_ARB5_CHNL125_RDATA0_ADDR A:0x27ed018
y.create.l HWIO_PMIC_ARB5_CHNL126_RDATA0_ADDR A:0x27f5018
y.create.l HWIO_PMIC_ARB5_CHNL127_RDATA0_ADDR A:0x27fd018
y.create.l HWIO_PMIC_ARB5_CHNL128_RDATA0_ADDR A:0x2805018
y.create.l HWIO_PMIC_ARB5_CHNL129_RDATA0_ADDR A:0x280d018
y.create.l HWIO_PMIC_ARB5_CHNL130_RDATA0_ADDR A:0x2815018
y.create.l HWIO_PMIC_ARB5_CHNL131_RDATA0_ADDR A:0x281d018
y.create.l HWIO_PMIC_ARB5_CHNL132_RDATA0_ADDR A:0x2825018
y.create.l HWIO_PMIC_ARB5_CHNL133_RDATA0_ADDR A:0x282d018
y.create.l HWIO_PMIC_ARB5_CHNL134_RDATA0_ADDR A:0x2835018
y.create.l HWIO_PMIC_ARB5_CHNL135_RDATA0_ADDR A:0x283d018
y.create.l HWIO_PMIC_ARB5_CHNL136_RDATA0_ADDR A:0x2845018
y.create.l HWIO_PMIC_ARB5_CHNL137_RDATA0_ADDR A:0x284d018
y.create.l HWIO_PMIC_ARB5_CHNL138_RDATA0_ADDR A:0x2855018
y.create.l HWIO_PMIC_ARB5_CHNL139_RDATA0_ADDR A:0x285d018
y.create.l HWIO_PMIC_ARB5_CHNL140_RDATA0_ADDR A:0x2865018
y.create.l HWIO_PMIC_ARB5_CHNL141_RDATA0_ADDR A:0x286d018
y.create.l HWIO_PMIC_ARB5_CHNL142_RDATA0_ADDR A:0x2875018
y.create.l HWIO_PMIC_ARB5_CHNL143_RDATA0_ADDR A:0x287d018
y.create.l HWIO_PMIC_ARB5_CHNL144_RDATA0_ADDR A:0x2885018
y.create.l HWIO_PMIC_ARB5_CHNL145_RDATA0_ADDR A:0x288d018
y.create.l HWIO_PMIC_ARB5_CHNL146_RDATA0_ADDR A:0x2895018
y.create.l HWIO_PMIC_ARB5_CHNL147_RDATA0_ADDR A:0x289d018
y.create.l HWIO_PMIC_ARB5_CHNL148_RDATA0_ADDR A:0x28a5018
y.create.l HWIO_PMIC_ARB5_CHNL149_RDATA0_ADDR A:0x28ad018
y.create.l HWIO_PMIC_ARB5_CHNL150_RDATA0_ADDR A:0x28b5018
y.create.l HWIO_PMIC_ARB5_CHNL151_RDATA0_ADDR A:0x28bd018
y.create.l HWIO_PMIC_ARB5_CHNL152_RDATA0_ADDR A:0x28c5018
y.create.l HWIO_PMIC_ARB5_CHNL153_RDATA0_ADDR A:0x28cd018
y.create.l HWIO_PMIC_ARB5_CHNL154_RDATA0_ADDR A:0x28d5018
y.create.l HWIO_PMIC_ARB5_CHNL155_RDATA0_ADDR A:0x28dd018
y.create.l HWIO_PMIC_ARB5_CHNL156_RDATA0_ADDR A:0x28e5018
y.create.l HWIO_PMIC_ARB5_CHNL157_RDATA0_ADDR A:0x28ed018
y.create.l HWIO_PMIC_ARB5_CHNL158_RDATA0_ADDR A:0x28f5018
y.create.l HWIO_PMIC_ARB5_CHNL159_RDATA0_ADDR A:0x28fd018
y.create.l HWIO_PMIC_ARB5_CHNL160_RDATA0_ADDR A:0x2905018
y.create.l HWIO_PMIC_ARB5_CHNL161_RDATA0_ADDR A:0x290d018
y.create.l HWIO_PMIC_ARB5_CHNL162_RDATA0_ADDR A:0x2915018
y.create.l HWIO_PMIC_ARB5_CHNL163_RDATA0_ADDR A:0x291d018
y.create.l HWIO_PMIC_ARB5_CHNL164_RDATA0_ADDR A:0x2925018
y.create.l HWIO_PMIC_ARB5_CHNL165_RDATA0_ADDR A:0x292d018
y.create.l HWIO_PMIC_ARB5_CHNL166_RDATA0_ADDR A:0x2935018
y.create.l HWIO_PMIC_ARB5_CHNL167_RDATA0_ADDR A:0x293d018
y.create.l HWIO_PMIC_ARB5_CHNL168_RDATA0_ADDR A:0x2945018
y.create.l HWIO_PMIC_ARB5_CHNL169_RDATA0_ADDR A:0x294d018
y.create.l HWIO_PMIC_ARB5_CHNL170_RDATA0_ADDR A:0x2955018
y.create.l HWIO_PMIC_ARB5_CHNL171_RDATA0_ADDR A:0x295d018
y.create.l HWIO_PMIC_ARB5_CHNL172_RDATA0_ADDR A:0x2965018
y.create.l HWIO_PMIC_ARB5_CHNL173_RDATA0_ADDR A:0x296d018
y.create.l HWIO_PMIC_ARB5_CHNL174_RDATA0_ADDR A:0x2975018
y.create.l HWIO_PMIC_ARB5_CHNL175_RDATA0_ADDR A:0x297d018
y.create.l HWIO_PMIC_ARB5_CHNL176_RDATA0_ADDR A:0x2985018
y.create.l HWIO_PMIC_ARB5_CHNL177_RDATA0_ADDR A:0x298d018
y.create.l HWIO_PMIC_ARB5_CHNL178_RDATA0_ADDR A:0x2995018
y.create.l HWIO_PMIC_ARB5_CHNL179_RDATA0_ADDR A:0x299d018
y.create.l HWIO_PMIC_ARB5_CHNL180_RDATA0_ADDR A:0x29a5018
y.create.l HWIO_PMIC_ARB5_CHNL181_RDATA0_ADDR A:0x29ad018
y.create.l HWIO_PMIC_ARB5_CHNL182_RDATA0_ADDR A:0x29b5018
y.create.l HWIO_PMIC_ARB5_CHNL183_RDATA0_ADDR A:0x29bd018
y.create.l HWIO_PMIC_ARB5_CHNL184_RDATA0_ADDR A:0x29c5018
y.create.l HWIO_PMIC_ARB5_CHNL185_RDATA0_ADDR A:0x29cd018
y.create.l HWIO_PMIC_ARB5_CHNL186_RDATA0_ADDR A:0x29d5018
y.create.l HWIO_PMIC_ARB5_CHNL187_RDATA0_ADDR A:0x29dd018
y.create.l HWIO_PMIC_ARB5_CHNL188_RDATA0_ADDR A:0x29e5018
y.create.l HWIO_PMIC_ARB5_CHNL189_RDATA0_ADDR A:0x29ed018
y.create.l HWIO_PMIC_ARB5_CHNL190_RDATA0_ADDR A:0x29f5018
y.create.l HWIO_PMIC_ARB5_CHNL191_RDATA0_ADDR A:0x29fd018
y.create.l HWIO_PMIC_ARB5_CHNL192_RDATA0_ADDR A:0x2a05018
y.create.l HWIO_PMIC_ARB5_CHNL193_RDATA0_ADDR A:0x2a0d018
y.create.l HWIO_PMIC_ARB5_CHNL194_RDATA0_ADDR A:0x2a15018
y.create.l HWIO_PMIC_ARB5_CHNL195_RDATA0_ADDR A:0x2a1d018
y.create.l HWIO_PMIC_ARB5_CHNL196_RDATA0_ADDR A:0x2a25018
y.create.l HWIO_PMIC_ARB5_CHNL197_RDATA0_ADDR A:0x2a2d018
y.create.l HWIO_PMIC_ARB5_CHNL198_RDATA0_ADDR A:0x2a35018
y.create.l HWIO_PMIC_ARB5_CHNL199_RDATA0_ADDR A:0x2a3d018
y.create.l HWIO_PMIC_ARB5_CHNL200_RDATA0_ADDR A:0x2a45018
y.create.l HWIO_PMIC_ARB5_CHNL201_RDATA0_ADDR A:0x2a4d018
y.create.l HWIO_PMIC_ARB5_CHNL202_RDATA0_ADDR A:0x2a55018
y.create.l HWIO_PMIC_ARB5_CHNL203_RDATA0_ADDR A:0x2a5d018
y.create.l HWIO_PMIC_ARB5_CHNL204_RDATA0_ADDR A:0x2a65018
y.create.l HWIO_PMIC_ARB5_CHNL205_RDATA0_ADDR A:0x2a6d018
y.create.l HWIO_PMIC_ARB5_CHNL206_RDATA0_ADDR A:0x2a75018
y.create.l HWIO_PMIC_ARB5_CHNL207_RDATA0_ADDR A:0x2a7d018
y.create.l HWIO_PMIC_ARB5_CHNL208_RDATA0_ADDR A:0x2a85018
y.create.l HWIO_PMIC_ARB5_CHNL209_RDATA0_ADDR A:0x2a8d018
y.create.l HWIO_PMIC_ARB5_CHNL210_RDATA0_ADDR A:0x2a95018
y.create.l HWIO_PMIC_ARB5_CHNL211_RDATA0_ADDR A:0x2a9d018
y.create.l HWIO_PMIC_ARB5_CHNL212_RDATA0_ADDR A:0x2aa5018
y.create.l HWIO_PMIC_ARB5_CHNL213_RDATA0_ADDR A:0x2aad018
y.create.l HWIO_PMIC_ARB5_CHNL214_RDATA0_ADDR A:0x2ab5018
y.create.l HWIO_PMIC_ARB5_CHNL215_RDATA0_ADDR A:0x2abd018
y.create.l HWIO_PMIC_ARB5_CHNL216_RDATA0_ADDR A:0x2ac5018
y.create.l HWIO_PMIC_ARB5_CHNL217_RDATA0_ADDR A:0x2acd018
y.create.l HWIO_PMIC_ARB5_CHNL218_RDATA0_ADDR A:0x2ad5018
y.create.l HWIO_PMIC_ARB5_CHNL219_RDATA0_ADDR A:0x2add018
y.create.l HWIO_PMIC_ARB5_CHNL220_RDATA0_ADDR A:0x2ae5018
y.create.l HWIO_PMIC_ARB5_CHNL221_RDATA0_ADDR A:0x2aed018
y.create.l HWIO_PMIC_ARB5_CHNL222_RDATA0_ADDR A:0x2af5018
y.create.l HWIO_PMIC_ARB5_CHNL223_RDATA0_ADDR A:0x2afd018
y.create.l HWIO_PMIC_ARB5_CHNL224_RDATA0_ADDR A:0x2b05018
y.create.l HWIO_PMIC_ARB5_CHNL225_RDATA0_ADDR A:0x2b0d018
y.create.l HWIO_PMIC_ARB5_CHNL226_RDATA0_ADDR A:0x2b15018
y.create.l HWIO_PMIC_ARB5_CHNL227_RDATA0_ADDR A:0x2b1d018
y.create.l HWIO_PMIC_ARB5_CHNL228_RDATA0_ADDR A:0x2b25018
y.create.l HWIO_PMIC_ARB5_CHNL229_RDATA0_ADDR A:0x2b2d018
y.create.l HWIO_PMIC_ARB5_CHNL230_RDATA0_ADDR A:0x2b35018
y.create.l HWIO_PMIC_ARB5_CHNL231_RDATA0_ADDR A:0x2b3d018
y.create.l HWIO_PMIC_ARB5_CHNL232_RDATA0_ADDR A:0x2b45018
y.create.l HWIO_PMIC_ARB5_CHNL233_RDATA0_ADDR A:0x2b4d018
y.create.l HWIO_PMIC_ARB5_CHNL234_RDATA0_ADDR A:0x2b55018
y.create.l HWIO_PMIC_ARB5_CHNL235_RDATA0_ADDR A:0x2b5d018
y.create.l HWIO_PMIC_ARB5_CHNL236_RDATA0_ADDR A:0x2b65018
y.create.l HWIO_PMIC_ARB5_CHNL237_RDATA0_ADDR A:0x2b6d018
y.create.l HWIO_PMIC_ARB5_CHNL238_RDATA0_ADDR A:0x2b75018
y.create.l HWIO_PMIC_ARB5_CHNL239_RDATA0_ADDR A:0x2b7d018
y.create.l HWIO_PMIC_ARB5_CHNL240_RDATA0_ADDR A:0x2b85018
y.create.l HWIO_PMIC_ARB5_CHNL241_RDATA0_ADDR A:0x2b8d018
y.create.l HWIO_PMIC_ARB5_CHNL242_RDATA0_ADDR A:0x2b95018
y.create.l HWIO_PMIC_ARB5_CHNL243_RDATA0_ADDR A:0x2b9d018
y.create.l HWIO_PMIC_ARB5_CHNL244_RDATA0_ADDR A:0x2ba5018
y.create.l HWIO_PMIC_ARB5_CHNL245_RDATA0_ADDR A:0x2bad018
y.create.l HWIO_PMIC_ARB5_CHNL246_RDATA0_ADDR A:0x2bb5018
y.create.l HWIO_PMIC_ARB5_CHNL247_RDATA0_ADDR A:0x2bbd018
y.create.l HWIO_PMIC_ARB5_CHNL248_RDATA0_ADDR A:0x2bc5018
y.create.l HWIO_PMIC_ARB5_CHNL249_RDATA0_ADDR A:0x2bcd018
y.create.l HWIO_PMIC_ARB5_CHNL250_RDATA0_ADDR A:0x2bd5018
y.create.l HWIO_PMIC_ARB5_CHNL251_RDATA0_ADDR A:0x2bdd018
y.create.l HWIO_PMIC_ARB5_CHNL252_RDATA0_ADDR A:0x2be5018
y.create.l HWIO_PMIC_ARB5_CHNL253_RDATA0_ADDR A:0x2bed018
y.create.l HWIO_PMIC_ARB5_CHNL254_RDATA0_ADDR A:0x2bf5018
y.create.l HWIO_PMIC_ARB5_CHNL255_RDATA0_ADDR A:0x2bfd018
y.create.l HWIO_PMIC_ARB6_CHNL0_RDATA0_ADDR A:0x2406018
y.create.l HWIO_PMIC_ARB6_CHNL1_RDATA0_ADDR A:0x240e018
y.create.l HWIO_PMIC_ARB6_CHNL2_RDATA0_ADDR A:0x2416018
y.create.l HWIO_PMIC_ARB6_CHNL3_RDATA0_ADDR A:0x241e018
y.create.l HWIO_PMIC_ARB6_CHNL4_RDATA0_ADDR A:0x2426018
y.create.l HWIO_PMIC_ARB6_CHNL5_RDATA0_ADDR A:0x242e018
y.create.l HWIO_PMIC_ARB6_CHNL6_RDATA0_ADDR A:0x2436018
y.create.l HWIO_PMIC_ARB6_CHNL7_RDATA0_ADDR A:0x243e018
y.create.l HWIO_PMIC_ARB6_CHNL8_RDATA0_ADDR A:0x2446018
y.create.l HWIO_PMIC_ARB6_CHNL9_RDATA0_ADDR A:0x244e018
y.create.l HWIO_PMIC_ARB6_CHNL10_RDATA0_ADDR A:0x2456018
y.create.l HWIO_PMIC_ARB6_CHNL11_RDATA0_ADDR A:0x245e018
y.create.l HWIO_PMIC_ARB6_CHNL12_RDATA0_ADDR A:0x2466018
y.create.l HWIO_PMIC_ARB6_CHNL13_RDATA0_ADDR A:0x246e018
y.create.l HWIO_PMIC_ARB6_CHNL14_RDATA0_ADDR A:0x2476018
y.create.l HWIO_PMIC_ARB6_CHNL15_RDATA0_ADDR A:0x247e018
y.create.l HWIO_PMIC_ARB6_CHNL16_RDATA0_ADDR A:0x2486018
y.create.l HWIO_PMIC_ARB6_CHNL17_RDATA0_ADDR A:0x248e018
y.create.l HWIO_PMIC_ARB6_CHNL18_RDATA0_ADDR A:0x2496018
y.create.l HWIO_PMIC_ARB6_CHNL19_RDATA0_ADDR A:0x249e018
y.create.l HWIO_PMIC_ARB6_CHNL20_RDATA0_ADDR A:0x24a6018
y.create.l HWIO_PMIC_ARB6_CHNL21_RDATA0_ADDR A:0x24ae018
y.create.l HWIO_PMIC_ARB6_CHNL22_RDATA0_ADDR A:0x24b6018
y.create.l HWIO_PMIC_ARB6_CHNL23_RDATA0_ADDR A:0x24be018
y.create.l HWIO_PMIC_ARB6_CHNL24_RDATA0_ADDR A:0x24c6018
y.create.l HWIO_PMIC_ARB6_CHNL25_RDATA0_ADDR A:0x24ce018
y.create.l HWIO_PMIC_ARB6_CHNL26_RDATA0_ADDR A:0x24d6018
y.create.l HWIO_PMIC_ARB6_CHNL27_RDATA0_ADDR A:0x24de018
y.create.l HWIO_PMIC_ARB6_CHNL28_RDATA0_ADDR A:0x24e6018
y.create.l HWIO_PMIC_ARB6_CHNL29_RDATA0_ADDR A:0x24ee018
y.create.l HWIO_PMIC_ARB6_CHNL30_RDATA0_ADDR A:0x24f6018
y.create.l HWIO_PMIC_ARB6_CHNL31_RDATA0_ADDR A:0x24fe018
y.create.l HWIO_PMIC_ARB6_CHNL32_RDATA0_ADDR A:0x2506018
y.create.l HWIO_PMIC_ARB6_CHNL33_RDATA0_ADDR A:0x250e018
y.create.l HWIO_PMIC_ARB6_CHNL34_RDATA0_ADDR A:0x2516018
y.create.l HWIO_PMIC_ARB6_CHNL35_RDATA0_ADDR A:0x251e018
y.create.l HWIO_PMIC_ARB6_CHNL36_RDATA0_ADDR A:0x2526018
y.create.l HWIO_PMIC_ARB6_CHNL37_RDATA0_ADDR A:0x252e018
y.create.l HWIO_PMIC_ARB6_CHNL38_RDATA0_ADDR A:0x2536018
y.create.l HWIO_PMIC_ARB6_CHNL39_RDATA0_ADDR A:0x253e018
y.create.l HWIO_PMIC_ARB6_CHNL40_RDATA0_ADDR A:0x2546018
y.create.l HWIO_PMIC_ARB6_CHNL41_RDATA0_ADDR A:0x254e018
y.create.l HWIO_PMIC_ARB6_CHNL42_RDATA0_ADDR A:0x2556018
y.create.l HWIO_PMIC_ARB6_CHNL43_RDATA0_ADDR A:0x255e018
y.create.l HWIO_PMIC_ARB6_CHNL44_RDATA0_ADDR A:0x2566018
y.create.l HWIO_PMIC_ARB6_CHNL45_RDATA0_ADDR A:0x256e018
y.create.l HWIO_PMIC_ARB6_CHNL46_RDATA0_ADDR A:0x2576018
y.create.l HWIO_PMIC_ARB6_CHNL47_RDATA0_ADDR A:0x257e018
y.create.l HWIO_PMIC_ARB6_CHNL48_RDATA0_ADDR A:0x2586018
y.create.l HWIO_PMIC_ARB6_CHNL49_RDATA0_ADDR A:0x258e018
y.create.l HWIO_PMIC_ARB6_CHNL50_RDATA0_ADDR A:0x2596018
y.create.l HWIO_PMIC_ARB6_CHNL51_RDATA0_ADDR A:0x259e018
y.create.l HWIO_PMIC_ARB6_CHNL52_RDATA0_ADDR A:0x25a6018
y.create.l HWIO_PMIC_ARB6_CHNL53_RDATA0_ADDR A:0x25ae018
y.create.l HWIO_PMIC_ARB6_CHNL54_RDATA0_ADDR A:0x25b6018
y.create.l HWIO_PMIC_ARB6_CHNL55_RDATA0_ADDR A:0x25be018
y.create.l HWIO_PMIC_ARB6_CHNL56_RDATA0_ADDR A:0x25c6018
y.create.l HWIO_PMIC_ARB6_CHNL57_RDATA0_ADDR A:0x25ce018
y.create.l HWIO_PMIC_ARB6_CHNL58_RDATA0_ADDR A:0x25d6018
y.create.l HWIO_PMIC_ARB6_CHNL59_RDATA0_ADDR A:0x25de018
y.create.l HWIO_PMIC_ARB6_CHNL60_RDATA0_ADDR A:0x25e6018
y.create.l HWIO_PMIC_ARB6_CHNL61_RDATA0_ADDR A:0x25ee018
y.create.l HWIO_PMIC_ARB6_CHNL62_RDATA0_ADDR A:0x25f6018
y.create.l HWIO_PMIC_ARB6_CHNL63_RDATA0_ADDR A:0x25fe018
y.create.l HWIO_PMIC_ARB6_CHNL64_RDATA0_ADDR A:0x2606018
y.create.l HWIO_PMIC_ARB6_CHNL65_RDATA0_ADDR A:0x260e018
y.create.l HWIO_PMIC_ARB6_CHNL66_RDATA0_ADDR A:0x2616018
y.create.l HWIO_PMIC_ARB6_CHNL67_RDATA0_ADDR A:0x261e018
y.create.l HWIO_PMIC_ARB6_CHNL68_RDATA0_ADDR A:0x2626018
y.create.l HWIO_PMIC_ARB6_CHNL69_RDATA0_ADDR A:0x262e018
y.create.l HWIO_PMIC_ARB6_CHNL70_RDATA0_ADDR A:0x2636018
y.create.l HWIO_PMIC_ARB6_CHNL71_RDATA0_ADDR A:0x263e018
y.create.l HWIO_PMIC_ARB6_CHNL72_RDATA0_ADDR A:0x2646018
y.create.l HWIO_PMIC_ARB6_CHNL73_RDATA0_ADDR A:0x264e018
y.create.l HWIO_PMIC_ARB6_CHNL74_RDATA0_ADDR A:0x2656018
y.create.l HWIO_PMIC_ARB6_CHNL75_RDATA0_ADDR A:0x265e018
y.create.l HWIO_PMIC_ARB6_CHNL76_RDATA0_ADDR A:0x2666018
y.create.l HWIO_PMIC_ARB6_CHNL77_RDATA0_ADDR A:0x266e018
y.create.l HWIO_PMIC_ARB6_CHNL78_RDATA0_ADDR A:0x2676018
y.create.l HWIO_PMIC_ARB6_CHNL79_RDATA0_ADDR A:0x267e018
y.create.l HWIO_PMIC_ARB6_CHNL80_RDATA0_ADDR A:0x2686018
y.create.l HWIO_PMIC_ARB6_CHNL81_RDATA0_ADDR A:0x268e018
y.create.l HWIO_PMIC_ARB6_CHNL82_RDATA0_ADDR A:0x2696018
y.create.l HWIO_PMIC_ARB6_CHNL83_RDATA0_ADDR A:0x269e018
y.create.l HWIO_PMIC_ARB6_CHNL84_RDATA0_ADDR A:0x26a6018
y.create.l HWIO_PMIC_ARB6_CHNL85_RDATA0_ADDR A:0x26ae018
y.create.l HWIO_PMIC_ARB6_CHNL86_RDATA0_ADDR A:0x26b6018
y.create.l HWIO_PMIC_ARB6_CHNL87_RDATA0_ADDR A:0x26be018
y.create.l HWIO_PMIC_ARB6_CHNL88_RDATA0_ADDR A:0x26c6018
y.create.l HWIO_PMIC_ARB6_CHNL89_RDATA0_ADDR A:0x26ce018
y.create.l HWIO_PMIC_ARB6_CHNL90_RDATA0_ADDR A:0x26d6018
y.create.l HWIO_PMIC_ARB6_CHNL91_RDATA0_ADDR A:0x26de018
y.create.l HWIO_PMIC_ARB6_CHNL92_RDATA0_ADDR A:0x26e6018
y.create.l HWIO_PMIC_ARB6_CHNL93_RDATA0_ADDR A:0x26ee018
y.create.l HWIO_PMIC_ARB6_CHNL94_RDATA0_ADDR A:0x26f6018
y.create.l HWIO_PMIC_ARB6_CHNL95_RDATA0_ADDR A:0x26fe018
y.create.l HWIO_PMIC_ARB6_CHNL96_RDATA0_ADDR A:0x2706018
y.create.l HWIO_PMIC_ARB6_CHNL97_RDATA0_ADDR A:0x270e018
y.create.l HWIO_PMIC_ARB6_CHNL98_RDATA0_ADDR A:0x2716018
y.create.l HWIO_PMIC_ARB6_CHNL99_RDATA0_ADDR A:0x271e018
y.create.l HWIO_PMIC_ARB6_CHNL100_RDATA0_ADDR A:0x2726018
y.create.l HWIO_PMIC_ARB6_CHNL101_RDATA0_ADDR A:0x272e018
y.create.l HWIO_PMIC_ARB6_CHNL102_RDATA0_ADDR A:0x2736018
y.create.l HWIO_PMIC_ARB6_CHNL103_RDATA0_ADDR A:0x273e018
y.create.l HWIO_PMIC_ARB6_CHNL104_RDATA0_ADDR A:0x2746018
y.create.l HWIO_PMIC_ARB6_CHNL105_RDATA0_ADDR A:0x274e018
y.create.l HWIO_PMIC_ARB6_CHNL106_RDATA0_ADDR A:0x2756018
y.create.l HWIO_PMIC_ARB6_CHNL107_RDATA0_ADDR A:0x275e018
y.create.l HWIO_PMIC_ARB6_CHNL108_RDATA0_ADDR A:0x2766018
y.create.l HWIO_PMIC_ARB6_CHNL109_RDATA0_ADDR A:0x276e018
y.create.l HWIO_PMIC_ARB6_CHNL110_RDATA0_ADDR A:0x2776018
y.create.l HWIO_PMIC_ARB6_CHNL111_RDATA0_ADDR A:0x277e018
y.create.l HWIO_PMIC_ARB6_CHNL112_RDATA0_ADDR A:0x2786018
y.create.l HWIO_PMIC_ARB6_CHNL113_RDATA0_ADDR A:0x278e018
y.create.l HWIO_PMIC_ARB6_CHNL114_RDATA0_ADDR A:0x2796018
y.create.l HWIO_PMIC_ARB6_CHNL115_RDATA0_ADDR A:0x279e018
y.create.l HWIO_PMIC_ARB6_CHNL116_RDATA0_ADDR A:0x27a6018
y.create.l HWIO_PMIC_ARB6_CHNL117_RDATA0_ADDR A:0x27ae018
y.create.l HWIO_PMIC_ARB6_CHNL118_RDATA0_ADDR A:0x27b6018
y.create.l HWIO_PMIC_ARB6_CHNL119_RDATA0_ADDR A:0x27be018
y.create.l HWIO_PMIC_ARB6_CHNL120_RDATA0_ADDR A:0x27c6018
y.create.l HWIO_PMIC_ARB6_CHNL121_RDATA0_ADDR A:0x27ce018
y.create.l HWIO_PMIC_ARB6_CHNL122_RDATA0_ADDR A:0x27d6018
y.create.l HWIO_PMIC_ARB6_CHNL123_RDATA0_ADDR A:0x27de018
y.create.l HWIO_PMIC_ARB6_CHNL124_RDATA0_ADDR A:0x27e6018
y.create.l HWIO_PMIC_ARB6_CHNL125_RDATA0_ADDR A:0x27ee018
y.create.l HWIO_PMIC_ARB6_CHNL126_RDATA0_ADDR A:0x27f6018
y.create.l HWIO_PMIC_ARB6_CHNL127_RDATA0_ADDR A:0x27fe018
y.create.l HWIO_PMIC_ARB6_CHNL128_RDATA0_ADDR A:0x2806018
y.create.l HWIO_PMIC_ARB6_CHNL129_RDATA0_ADDR A:0x280e018
y.create.l HWIO_PMIC_ARB6_CHNL130_RDATA0_ADDR A:0x2816018
y.create.l HWIO_PMIC_ARB6_CHNL131_RDATA0_ADDR A:0x281e018
y.create.l HWIO_PMIC_ARB6_CHNL132_RDATA0_ADDR A:0x2826018
y.create.l HWIO_PMIC_ARB6_CHNL133_RDATA0_ADDR A:0x282e018
y.create.l HWIO_PMIC_ARB6_CHNL134_RDATA0_ADDR A:0x2836018
y.create.l HWIO_PMIC_ARB6_CHNL135_RDATA0_ADDR A:0x283e018
y.create.l HWIO_PMIC_ARB6_CHNL136_RDATA0_ADDR A:0x2846018
y.create.l HWIO_PMIC_ARB6_CHNL137_RDATA0_ADDR A:0x284e018
y.create.l HWIO_PMIC_ARB6_CHNL138_RDATA0_ADDR A:0x2856018
y.create.l HWIO_PMIC_ARB6_CHNL139_RDATA0_ADDR A:0x285e018
y.create.l HWIO_PMIC_ARB6_CHNL140_RDATA0_ADDR A:0x2866018
y.create.l HWIO_PMIC_ARB6_CHNL141_RDATA0_ADDR A:0x286e018
y.create.l HWIO_PMIC_ARB6_CHNL142_RDATA0_ADDR A:0x2876018
y.create.l HWIO_PMIC_ARB6_CHNL143_RDATA0_ADDR A:0x287e018
y.create.l HWIO_PMIC_ARB6_CHNL144_RDATA0_ADDR A:0x2886018
y.create.l HWIO_PMIC_ARB6_CHNL145_RDATA0_ADDR A:0x288e018
y.create.l HWIO_PMIC_ARB6_CHNL146_RDATA0_ADDR A:0x2896018
y.create.l HWIO_PMIC_ARB6_CHNL147_RDATA0_ADDR A:0x289e018
y.create.l HWIO_PMIC_ARB6_CHNL148_RDATA0_ADDR A:0x28a6018
y.create.l HWIO_PMIC_ARB6_CHNL149_RDATA0_ADDR A:0x28ae018
y.create.l HWIO_PMIC_ARB6_CHNL150_RDATA0_ADDR A:0x28b6018
y.create.l HWIO_PMIC_ARB6_CHNL151_RDATA0_ADDR A:0x28be018
y.create.l HWIO_PMIC_ARB6_CHNL152_RDATA0_ADDR A:0x28c6018
y.create.l HWIO_PMIC_ARB6_CHNL153_RDATA0_ADDR A:0x28ce018
y.create.l HWIO_PMIC_ARB6_CHNL154_RDATA0_ADDR A:0x28d6018
y.create.l HWIO_PMIC_ARB6_CHNL155_RDATA0_ADDR A:0x28de018
y.create.l HWIO_PMIC_ARB6_CHNL156_RDATA0_ADDR A:0x28e6018
y.create.l HWIO_PMIC_ARB6_CHNL157_RDATA0_ADDR A:0x28ee018
y.create.l HWIO_PMIC_ARB6_CHNL158_RDATA0_ADDR A:0x28f6018
y.create.l HWIO_PMIC_ARB6_CHNL159_RDATA0_ADDR A:0x28fe018
y.create.l HWIO_PMIC_ARB6_CHNL160_RDATA0_ADDR A:0x2906018
y.create.l HWIO_PMIC_ARB6_CHNL161_RDATA0_ADDR A:0x290e018
y.create.l HWIO_PMIC_ARB6_CHNL162_RDATA0_ADDR A:0x2916018
y.create.l HWIO_PMIC_ARB6_CHNL163_RDATA0_ADDR A:0x291e018
y.create.l HWIO_PMIC_ARB6_CHNL164_RDATA0_ADDR A:0x2926018
y.create.l HWIO_PMIC_ARB6_CHNL165_RDATA0_ADDR A:0x292e018
y.create.l HWIO_PMIC_ARB6_CHNL166_RDATA0_ADDR A:0x2936018
y.create.l HWIO_PMIC_ARB6_CHNL167_RDATA0_ADDR A:0x293e018
y.create.l HWIO_PMIC_ARB6_CHNL168_RDATA0_ADDR A:0x2946018
y.create.l HWIO_PMIC_ARB6_CHNL169_RDATA0_ADDR A:0x294e018
y.create.l HWIO_PMIC_ARB6_CHNL170_RDATA0_ADDR A:0x2956018
y.create.l HWIO_PMIC_ARB6_CHNL171_RDATA0_ADDR A:0x295e018
y.create.l HWIO_PMIC_ARB6_CHNL172_RDATA0_ADDR A:0x2966018
y.create.l HWIO_PMIC_ARB6_CHNL173_RDATA0_ADDR A:0x296e018
y.create.l HWIO_PMIC_ARB6_CHNL174_RDATA0_ADDR A:0x2976018
y.create.l HWIO_PMIC_ARB6_CHNL175_RDATA0_ADDR A:0x297e018
y.create.l HWIO_PMIC_ARB6_CHNL176_RDATA0_ADDR A:0x2986018
y.create.l HWIO_PMIC_ARB6_CHNL177_RDATA0_ADDR A:0x298e018
y.create.l HWIO_PMIC_ARB6_CHNL178_RDATA0_ADDR A:0x2996018
y.create.l HWIO_PMIC_ARB6_CHNL179_RDATA0_ADDR A:0x299e018
y.create.l HWIO_PMIC_ARB6_CHNL180_RDATA0_ADDR A:0x29a6018
y.create.l HWIO_PMIC_ARB6_CHNL181_RDATA0_ADDR A:0x29ae018
y.create.l HWIO_PMIC_ARB6_CHNL182_RDATA0_ADDR A:0x29b6018
y.create.l HWIO_PMIC_ARB6_CHNL183_RDATA0_ADDR A:0x29be018
y.create.l HWIO_PMIC_ARB6_CHNL184_RDATA0_ADDR A:0x29c6018
y.create.l HWIO_PMIC_ARB6_CHNL185_RDATA0_ADDR A:0x29ce018
y.create.l HWIO_PMIC_ARB6_CHNL186_RDATA0_ADDR A:0x29d6018
y.create.l HWIO_PMIC_ARB6_CHNL187_RDATA0_ADDR A:0x29de018
y.create.l HWIO_PMIC_ARB6_CHNL188_RDATA0_ADDR A:0x29e6018
y.create.l HWIO_PMIC_ARB6_CHNL189_RDATA0_ADDR A:0x29ee018
y.create.l HWIO_PMIC_ARB6_CHNL190_RDATA0_ADDR A:0x29f6018
y.create.l HWIO_PMIC_ARB6_CHNL191_RDATA0_ADDR A:0x29fe018
y.create.l HWIO_PMIC_ARB6_CHNL192_RDATA0_ADDR A:0x2a06018
y.create.l HWIO_PMIC_ARB6_CHNL193_RDATA0_ADDR A:0x2a0e018
y.create.l HWIO_PMIC_ARB6_CHNL194_RDATA0_ADDR A:0x2a16018
y.create.l HWIO_PMIC_ARB6_CHNL195_RDATA0_ADDR A:0x2a1e018
y.create.l HWIO_PMIC_ARB6_CHNL196_RDATA0_ADDR A:0x2a26018
y.create.l HWIO_PMIC_ARB6_CHNL197_RDATA0_ADDR A:0x2a2e018
y.create.l HWIO_PMIC_ARB6_CHNL198_RDATA0_ADDR A:0x2a36018
y.create.l HWIO_PMIC_ARB6_CHNL199_RDATA0_ADDR A:0x2a3e018
y.create.l HWIO_PMIC_ARB6_CHNL200_RDATA0_ADDR A:0x2a46018
y.create.l HWIO_PMIC_ARB6_CHNL201_RDATA0_ADDR A:0x2a4e018
y.create.l HWIO_PMIC_ARB6_CHNL202_RDATA0_ADDR A:0x2a56018
y.create.l HWIO_PMIC_ARB6_CHNL203_RDATA0_ADDR A:0x2a5e018
y.create.l HWIO_PMIC_ARB6_CHNL204_RDATA0_ADDR A:0x2a66018
y.create.l HWIO_PMIC_ARB6_CHNL205_RDATA0_ADDR A:0x2a6e018
y.create.l HWIO_PMIC_ARB6_CHNL206_RDATA0_ADDR A:0x2a76018
y.create.l HWIO_PMIC_ARB6_CHNL207_RDATA0_ADDR A:0x2a7e018
y.create.l HWIO_PMIC_ARB6_CHNL208_RDATA0_ADDR A:0x2a86018
y.create.l HWIO_PMIC_ARB6_CHNL209_RDATA0_ADDR A:0x2a8e018
y.create.l HWIO_PMIC_ARB6_CHNL210_RDATA0_ADDR A:0x2a96018
y.create.l HWIO_PMIC_ARB6_CHNL211_RDATA0_ADDR A:0x2a9e018
y.create.l HWIO_PMIC_ARB6_CHNL212_RDATA0_ADDR A:0x2aa6018
y.create.l HWIO_PMIC_ARB6_CHNL213_RDATA0_ADDR A:0x2aae018
y.create.l HWIO_PMIC_ARB6_CHNL214_RDATA0_ADDR A:0x2ab6018
y.create.l HWIO_PMIC_ARB6_CHNL215_RDATA0_ADDR A:0x2abe018
y.create.l HWIO_PMIC_ARB6_CHNL216_RDATA0_ADDR A:0x2ac6018
y.create.l HWIO_PMIC_ARB6_CHNL217_RDATA0_ADDR A:0x2ace018
y.create.l HWIO_PMIC_ARB6_CHNL218_RDATA0_ADDR A:0x2ad6018
y.create.l HWIO_PMIC_ARB6_CHNL219_RDATA0_ADDR A:0x2ade018
y.create.l HWIO_PMIC_ARB6_CHNL220_RDATA0_ADDR A:0x2ae6018
y.create.l HWIO_PMIC_ARB6_CHNL221_RDATA0_ADDR A:0x2aee018
y.create.l HWIO_PMIC_ARB6_CHNL222_RDATA0_ADDR A:0x2af6018
y.create.l HWIO_PMIC_ARB6_CHNL223_RDATA0_ADDR A:0x2afe018
y.create.l HWIO_PMIC_ARB6_CHNL224_RDATA0_ADDR A:0x2b06018
y.create.l HWIO_PMIC_ARB6_CHNL225_RDATA0_ADDR A:0x2b0e018
y.create.l HWIO_PMIC_ARB6_CHNL226_RDATA0_ADDR A:0x2b16018
y.create.l HWIO_PMIC_ARB6_CHNL227_RDATA0_ADDR A:0x2b1e018
y.create.l HWIO_PMIC_ARB6_CHNL228_RDATA0_ADDR A:0x2b26018
y.create.l HWIO_PMIC_ARB6_CHNL229_RDATA0_ADDR A:0x2b2e018
y.create.l HWIO_PMIC_ARB6_CHNL230_RDATA0_ADDR A:0x2b36018
y.create.l HWIO_PMIC_ARB6_CHNL231_RDATA0_ADDR A:0x2b3e018
y.create.l HWIO_PMIC_ARB6_CHNL232_RDATA0_ADDR A:0x2b46018
y.create.l HWIO_PMIC_ARB6_CHNL233_RDATA0_ADDR A:0x2b4e018
y.create.l HWIO_PMIC_ARB6_CHNL234_RDATA0_ADDR A:0x2b56018
y.create.l HWIO_PMIC_ARB6_CHNL235_RDATA0_ADDR A:0x2b5e018
y.create.l HWIO_PMIC_ARB6_CHNL236_RDATA0_ADDR A:0x2b66018
y.create.l HWIO_PMIC_ARB6_CHNL237_RDATA0_ADDR A:0x2b6e018
y.create.l HWIO_PMIC_ARB6_CHNL238_RDATA0_ADDR A:0x2b76018
y.create.l HWIO_PMIC_ARB6_CHNL239_RDATA0_ADDR A:0x2b7e018
y.create.l HWIO_PMIC_ARB6_CHNL240_RDATA0_ADDR A:0x2b86018
y.create.l HWIO_PMIC_ARB6_CHNL241_RDATA0_ADDR A:0x2b8e018
y.create.l HWIO_PMIC_ARB6_CHNL242_RDATA0_ADDR A:0x2b96018
y.create.l HWIO_PMIC_ARB6_CHNL243_RDATA0_ADDR A:0x2b9e018
y.create.l HWIO_PMIC_ARB6_CHNL244_RDATA0_ADDR A:0x2ba6018
y.create.l HWIO_PMIC_ARB6_CHNL245_RDATA0_ADDR A:0x2bae018
y.create.l HWIO_PMIC_ARB6_CHNL246_RDATA0_ADDR A:0x2bb6018
y.create.l HWIO_PMIC_ARB6_CHNL247_RDATA0_ADDR A:0x2bbe018
y.create.l HWIO_PMIC_ARB6_CHNL248_RDATA0_ADDR A:0x2bc6018
y.create.l HWIO_PMIC_ARB6_CHNL249_RDATA0_ADDR A:0x2bce018
y.create.l HWIO_PMIC_ARB6_CHNL250_RDATA0_ADDR A:0x2bd6018
y.create.l HWIO_PMIC_ARB6_CHNL251_RDATA0_ADDR A:0x2bde018
y.create.l HWIO_PMIC_ARB6_CHNL252_RDATA0_ADDR A:0x2be6018
y.create.l HWIO_PMIC_ARB6_CHNL253_RDATA0_ADDR A:0x2bee018
y.create.l HWIO_PMIC_ARB6_CHNL254_RDATA0_ADDR A:0x2bf6018
y.create.l HWIO_PMIC_ARB6_CHNL255_RDATA0_ADDR A:0x2bfe018
y.create.l HWIO_PMIC_ARB0_CHNL0_RDATA1_ADDR A:0x240001c
y.create.l HWIO_PMIC_ARB0_CHNL1_RDATA1_ADDR A:0x240801c
y.create.l HWIO_PMIC_ARB0_CHNL2_RDATA1_ADDR A:0x241001c
y.create.l HWIO_PMIC_ARB0_CHNL3_RDATA1_ADDR A:0x241801c
y.create.l HWIO_PMIC_ARB0_CHNL4_RDATA1_ADDR A:0x242001c
y.create.l HWIO_PMIC_ARB0_CHNL5_RDATA1_ADDR A:0x242801c
y.create.l HWIO_PMIC_ARB0_CHNL6_RDATA1_ADDR A:0x243001c
y.create.l HWIO_PMIC_ARB0_CHNL7_RDATA1_ADDR A:0x243801c
y.create.l HWIO_PMIC_ARB0_CHNL8_RDATA1_ADDR A:0x244001c
y.create.l HWIO_PMIC_ARB0_CHNL9_RDATA1_ADDR A:0x244801c
y.create.l HWIO_PMIC_ARB0_CHNL10_RDATA1_ADDR A:0x245001c
y.create.l HWIO_PMIC_ARB0_CHNL11_RDATA1_ADDR A:0x245801c
y.create.l HWIO_PMIC_ARB0_CHNL12_RDATA1_ADDR A:0x246001c
y.create.l HWIO_PMIC_ARB0_CHNL13_RDATA1_ADDR A:0x246801c
y.create.l HWIO_PMIC_ARB0_CHNL14_RDATA1_ADDR A:0x247001c
y.create.l HWIO_PMIC_ARB0_CHNL15_RDATA1_ADDR A:0x247801c
y.create.l HWIO_PMIC_ARB0_CHNL16_RDATA1_ADDR A:0x248001c
y.create.l HWIO_PMIC_ARB0_CHNL17_RDATA1_ADDR A:0x248801c
y.create.l HWIO_PMIC_ARB0_CHNL18_RDATA1_ADDR A:0x249001c
y.create.l HWIO_PMIC_ARB0_CHNL19_RDATA1_ADDR A:0x249801c
y.create.l HWIO_PMIC_ARB0_CHNL20_RDATA1_ADDR A:0x24a001c
y.create.l HWIO_PMIC_ARB0_CHNL21_RDATA1_ADDR A:0x24a801c
y.create.l HWIO_PMIC_ARB0_CHNL22_RDATA1_ADDR A:0x24b001c
y.create.l HWIO_PMIC_ARB0_CHNL23_RDATA1_ADDR A:0x24b801c
y.create.l HWIO_PMIC_ARB0_CHNL24_RDATA1_ADDR A:0x24c001c
y.create.l HWIO_PMIC_ARB0_CHNL25_RDATA1_ADDR A:0x24c801c
y.create.l HWIO_PMIC_ARB0_CHNL26_RDATA1_ADDR A:0x24d001c
y.create.l HWIO_PMIC_ARB0_CHNL27_RDATA1_ADDR A:0x24d801c
y.create.l HWIO_PMIC_ARB0_CHNL28_RDATA1_ADDR A:0x24e001c
y.create.l HWIO_PMIC_ARB0_CHNL29_RDATA1_ADDR A:0x24e801c
y.create.l HWIO_PMIC_ARB0_CHNL30_RDATA1_ADDR A:0x24f001c
y.create.l HWIO_PMIC_ARB0_CHNL31_RDATA1_ADDR A:0x24f801c
y.create.l HWIO_PMIC_ARB0_CHNL32_RDATA1_ADDR A:0x250001c
y.create.l HWIO_PMIC_ARB0_CHNL33_RDATA1_ADDR A:0x250801c
y.create.l HWIO_PMIC_ARB0_CHNL34_RDATA1_ADDR A:0x251001c
y.create.l HWIO_PMIC_ARB0_CHNL35_RDATA1_ADDR A:0x251801c
y.create.l HWIO_PMIC_ARB0_CHNL36_RDATA1_ADDR A:0x252001c
y.create.l HWIO_PMIC_ARB0_CHNL37_RDATA1_ADDR A:0x252801c
y.create.l HWIO_PMIC_ARB0_CHNL38_RDATA1_ADDR A:0x253001c
y.create.l HWIO_PMIC_ARB0_CHNL39_RDATA1_ADDR A:0x253801c
y.create.l HWIO_PMIC_ARB0_CHNL40_RDATA1_ADDR A:0x254001c
y.create.l HWIO_PMIC_ARB0_CHNL41_RDATA1_ADDR A:0x254801c
y.create.l HWIO_PMIC_ARB0_CHNL42_RDATA1_ADDR A:0x255001c
y.create.l HWIO_PMIC_ARB0_CHNL43_RDATA1_ADDR A:0x255801c
y.create.l HWIO_PMIC_ARB0_CHNL44_RDATA1_ADDR A:0x256001c
y.create.l HWIO_PMIC_ARB0_CHNL45_RDATA1_ADDR A:0x256801c
y.create.l HWIO_PMIC_ARB0_CHNL46_RDATA1_ADDR A:0x257001c
y.create.l HWIO_PMIC_ARB0_CHNL47_RDATA1_ADDR A:0x257801c
y.create.l HWIO_PMIC_ARB0_CHNL48_RDATA1_ADDR A:0x258001c
y.create.l HWIO_PMIC_ARB0_CHNL49_RDATA1_ADDR A:0x258801c
y.create.l HWIO_PMIC_ARB0_CHNL50_RDATA1_ADDR A:0x259001c
y.create.l HWIO_PMIC_ARB0_CHNL51_RDATA1_ADDR A:0x259801c
y.create.l HWIO_PMIC_ARB0_CHNL52_RDATA1_ADDR A:0x25a001c
y.create.l HWIO_PMIC_ARB0_CHNL53_RDATA1_ADDR A:0x25a801c
y.create.l HWIO_PMIC_ARB0_CHNL54_RDATA1_ADDR A:0x25b001c
y.create.l HWIO_PMIC_ARB0_CHNL55_RDATA1_ADDR A:0x25b801c
y.create.l HWIO_PMIC_ARB0_CHNL56_RDATA1_ADDR A:0x25c001c
y.create.l HWIO_PMIC_ARB0_CHNL57_RDATA1_ADDR A:0x25c801c
y.create.l HWIO_PMIC_ARB0_CHNL58_RDATA1_ADDR A:0x25d001c
y.create.l HWIO_PMIC_ARB0_CHNL59_RDATA1_ADDR A:0x25d801c
y.create.l HWIO_PMIC_ARB0_CHNL60_RDATA1_ADDR A:0x25e001c
y.create.l HWIO_PMIC_ARB0_CHNL61_RDATA1_ADDR A:0x25e801c
y.create.l HWIO_PMIC_ARB0_CHNL62_RDATA1_ADDR A:0x25f001c
y.create.l HWIO_PMIC_ARB0_CHNL63_RDATA1_ADDR A:0x25f801c
y.create.l HWIO_PMIC_ARB0_CHNL64_RDATA1_ADDR A:0x260001c
y.create.l HWIO_PMIC_ARB0_CHNL65_RDATA1_ADDR A:0x260801c
y.create.l HWIO_PMIC_ARB0_CHNL66_RDATA1_ADDR A:0x261001c
y.create.l HWIO_PMIC_ARB0_CHNL67_RDATA1_ADDR A:0x261801c
y.create.l HWIO_PMIC_ARB0_CHNL68_RDATA1_ADDR A:0x262001c
y.create.l HWIO_PMIC_ARB0_CHNL69_RDATA1_ADDR A:0x262801c
y.create.l HWIO_PMIC_ARB0_CHNL70_RDATA1_ADDR A:0x263001c
y.create.l HWIO_PMIC_ARB0_CHNL71_RDATA1_ADDR A:0x263801c
y.create.l HWIO_PMIC_ARB0_CHNL72_RDATA1_ADDR A:0x264001c
y.create.l HWIO_PMIC_ARB0_CHNL73_RDATA1_ADDR A:0x264801c
y.create.l HWIO_PMIC_ARB0_CHNL74_RDATA1_ADDR A:0x265001c
y.create.l HWIO_PMIC_ARB0_CHNL75_RDATA1_ADDR A:0x265801c
y.create.l HWIO_PMIC_ARB0_CHNL76_RDATA1_ADDR A:0x266001c
y.create.l HWIO_PMIC_ARB0_CHNL77_RDATA1_ADDR A:0x266801c
y.create.l HWIO_PMIC_ARB0_CHNL78_RDATA1_ADDR A:0x267001c
y.create.l HWIO_PMIC_ARB0_CHNL79_RDATA1_ADDR A:0x267801c
y.create.l HWIO_PMIC_ARB0_CHNL80_RDATA1_ADDR A:0x268001c
y.create.l HWIO_PMIC_ARB0_CHNL81_RDATA1_ADDR A:0x268801c
y.create.l HWIO_PMIC_ARB0_CHNL82_RDATA1_ADDR A:0x269001c
y.create.l HWIO_PMIC_ARB0_CHNL83_RDATA1_ADDR A:0x269801c
y.create.l HWIO_PMIC_ARB0_CHNL84_RDATA1_ADDR A:0x26a001c
y.create.l HWIO_PMIC_ARB0_CHNL85_RDATA1_ADDR A:0x26a801c
y.create.l HWIO_PMIC_ARB0_CHNL86_RDATA1_ADDR A:0x26b001c
y.create.l HWIO_PMIC_ARB0_CHNL87_RDATA1_ADDR A:0x26b801c
y.create.l HWIO_PMIC_ARB0_CHNL88_RDATA1_ADDR A:0x26c001c
y.create.l HWIO_PMIC_ARB0_CHNL89_RDATA1_ADDR A:0x26c801c
y.create.l HWIO_PMIC_ARB0_CHNL90_RDATA1_ADDR A:0x26d001c
y.create.l HWIO_PMIC_ARB0_CHNL91_RDATA1_ADDR A:0x26d801c
y.create.l HWIO_PMIC_ARB0_CHNL92_RDATA1_ADDR A:0x26e001c
y.create.l HWIO_PMIC_ARB0_CHNL93_RDATA1_ADDR A:0x26e801c
y.create.l HWIO_PMIC_ARB0_CHNL94_RDATA1_ADDR A:0x26f001c
y.create.l HWIO_PMIC_ARB0_CHNL95_RDATA1_ADDR A:0x26f801c
y.create.l HWIO_PMIC_ARB0_CHNL96_RDATA1_ADDR A:0x270001c
y.create.l HWIO_PMIC_ARB0_CHNL97_RDATA1_ADDR A:0x270801c
y.create.l HWIO_PMIC_ARB0_CHNL98_RDATA1_ADDR A:0x271001c
y.create.l HWIO_PMIC_ARB0_CHNL99_RDATA1_ADDR A:0x271801c
y.create.l HWIO_PMIC_ARB0_CHNL100_RDATA1_ADDR A:0x272001c
y.create.l HWIO_PMIC_ARB0_CHNL101_RDATA1_ADDR A:0x272801c
y.create.l HWIO_PMIC_ARB0_CHNL102_RDATA1_ADDR A:0x273001c
y.create.l HWIO_PMIC_ARB0_CHNL103_RDATA1_ADDR A:0x273801c
y.create.l HWIO_PMIC_ARB0_CHNL104_RDATA1_ADDR A:0x274001c
y.create.l HWIO_PMIC_ARB0_CHNL105_RDATA1_ADDR A:0x274801c
y.create.l HWIO_PMIC_ARB0_CHNL106_RDATA1_ADDR A:0x275001c
y.create.l HWIO_PMIC_ARB0_CHNL107_RDATA1_ADDR A:0x275801c
y.create.l HWIO_PMIC_ARB0_CHNL108_RDATA1_ADDR A:0x276001c
y.create.l HWIO_PMIC_ARB0_CHNL109_RDATA1_ADDR A:0x276801c
y.create.l HWIO_PMIC_ARB0_CHNL110_RDATA1_ADDR A:0x277001c
y.create.l HWIO_PMIC_ARB0_CHNL111_RDATA1_ADDR A:0x277801c
y.create.l HWIO_PMIC_ARB0_CHNL112_RDATA1_ADDR A:0x278001c
y.create.l HWIO_PMIC_ARB0_CHNL113_RDATA1_ADDR A:0x278801c
y.create.l HWIO_PMIC_ARB0_CHNL114_RDATA1_ADDR A:0x279001c
y.create.l HWIO_PMIC_ARB0_CHNL115_RDATA1_ADDR A:0x279801c
y.create.l HWIO_PMIC_ARB0_CHNL116_RDATA1_ADDR A:0x27a001c
y.create.l HWIO_PMIC_ARB0_CHNL117_RDATA1_ADDR A:0x27a801c
y.create.l HWIO_PMIC_ARB0_CHNL118_RDATA1_ADDR A:0x27b001c
y.create.l HWIO_PMIC_ARB0_CHNL119_RDATA1_ADDR A:0x27b801c
y.create.l HWIO_PMIC_ARB0_CHNL120_RDATA1_ADDR A:0x27c001c
y.create.l HWIO_PMIC_ARB0_CHNL121_RDATA1_ADDR A:0x27c801c
y.create.l HWIO_PMIC_ARB0_CHNL122_RDATA1_ADDR A:0x27d001c
y.create.l HWIO_PMIC_ARB0_CHNL123_RDATA1_ADDR A:0x27d801c
y.create.l HWIO_PMIC_ARB0_CHNL124_RDATA1_ADDR A:0x27e001c
y.create.l HWIO_PMIC_ARB0_CHNL125_RDATA1_ADDR A:0x27e801c
y.create.l HWIO_PMIC_ARB0_CHNL126_RDATA1_ADDR A:0x27f001c
y.create.l HWIO_PMIC_ARB0_CHNL127_RDATA1_ADDR A:0x27f801c
y.create.l HWIO_PMIC_ARB0_CHNL128_RDATA1_ADDR A:0x280001c
y.create.l HWIO_PMIC_ARB0_CHNL129_RDATA1_ADDR A:0x280801c
y.create.l HWIO_PMIC_ARB0_CHNL130_RDATA1_ADDR A:0x281001c
y.create.l HWIO_PMIC_ARB0_CHNL131_RDATA1_ADDR A:0x281801c
y.create.l HWIO_PMIC_ARB0_CHNL132_RDATA1_ADDR A:0x282001c
y.create.l HWIO_PMIC_ARB0_CHNL133_RDATA1_ADDR A:0x282801c
y.create.l HWIO_PMIC_ARB0_CHNL134_RDATA1_ADDR A:0x283001c
y.create.l HWIO_PMIC_ARB0_CHNL135_RDATA1_ADDR A:0x283801c
y.create.l HWIO_PMIC_ARB0_CHNL136_RDATA1_ADDR A:0x284001c
y.create.l HWIO_PMIC_ARB0_CHNL137_RDATA1_ADDR A:0x284801c
y.create.l HWIO_PMIC_ARB0_CHNL138_RDATA1_ADDR A:0x285001c
y.create.l HWIO_PMIC_ARB0_CHNL139_RDATA1_ADDR A:0x285801c
y.create.l HWIO_PMIC_ARB0_CHNL140_RDATA1_ADDR A:0x286001c
y.create.l HWIO_PMIC_ARB0_CHNL141_RDATA1_ADDR A:0x286801c
y.create.l HWIO_PMIC_ARB0_CHNL142_RDATA1_ADDR A:0x287001c
y.create.l HWIO_PMIC_ARB0_CHNL143_RDATA1_ADDR A:0x287801c
y.create.l HWIO_PMIC_ARB0_CHNL144_RDATA1_ADDR A:0x288001c
y.create.l HWIO_PMIC_ARB0_CHNL145_RDATA1_ADDR A:0x288801c
y.create.l HWIO_PMIC_ARB0_CHNL146_RDATA1_ADDR A:0x289001c
y.create.l HWIO_PMIC_ARB0_CHNL147_RDATA1_ADDR A:0x289801c
y.create.l HWIO_PMIC_ARB0_CHNL148_RDATA1_ADDR A:0x28a001c
y.create.l HWIO_PMIC_ARB0_CHNL149_RDATA1_ADDR A:0x28a801c
y.create.l HWIO_PMIC_ARB0_CHNL150_RDATA1_ADDR A:0x28b001c
y.create.l HWIO_PMIC_ARB0_CHNL151_RDATA1_ADDR A:0x28b801c
y.create.l HWIO_PMIC_ARB0_CHNL152_RDATA1_ADDR A:0x28c001c
y.create.l HWIO_PMIC_ARB0_CHNL153_RDATA1_ADDR A:0x28c801c
y.create.l HWIO_PMIC_ARB0_CHNL154_RDATA1_ADDR A:0x28d001c
y.create.l HWIO_PMIC_ARB0_CHNL155_RDATA1_ADDR A:0x28d801c
y.create.l HWIO_PMIC_ARB0_CHNL156_RDATA1_ADDR A:0x28e001c
y.create.l HWIO_PMIC_ARB0_CHNL157_RDATA1_ADDR A:0x28e801c
y.create.l HWIO_PMIC_ARB0_CHNL158_RDATA1_ADDR A:0x28f001c
y.create.l HWIO_PMIC_ARB0_CHNL159_RDATA1_ADDR A:0x28f801c
y.create.l HWIO_PMIC_ARB0_CHNL160_RDATA1_ADDR A:0x290001c
y.create.l HWIO_PMIC_ARB0_CHNL161_RDATA1_ADDR A:0x290801c
y.create.l HWIO_PMIC_ARB0_CHNL162_RDATA1_ADDR A:0x291001c
y.create.l HWIO_PMIC_ARB0_CHNL163_RDATA1_ADDR A:0x291801c
y.create.l HWIO_PMIC_ARB0_CHNL164_RDATA1_ADDR A:0x292001c
y.create.l HWIO_PMIC_ARB0_CHNL165_RDATA1_ADDR A:0x292801c
y.create.l HWIO_PMIC_ARB0_CHNL166_RDATA1_ADDR A:0x293001c
y.create.l HWIO_PMIC_ARB0_CHNL167_RDATA1_ADDR A:0x293801c
y.create.l HWIO_PMIC_ARB0_CHNL168_RDATA1_ADDR A:0x294001c
y.create.l HWIO_PMIC_ARB0_CHNL169_RDATA1_ADDR A:0x294801c
y.create.l HWIO_PMIC_ARB0_CHNL170_RDATA1_ADDR A:0x295001c
y.create.l HWIO_PMIC_ARB0_CHNL171_RDATA1_ADDR A:0x295801c
y.create.l HWIO_PMIC_ARB0_CHNL172_RDATA1_ADDR A:0x296001c
y.create.l HWIO_PMIC_ARB0_CHNL173_RDATA1_ADDR A:0x296801c
y.create.l HWIO_PMIC_ARB0_CHNL174_RDATA1_ADDR A:0x297001c
y.create.l HWIO_PMIC_ARB0_CHNL175_RDATA1_ADDR A:0x297801c
y.create.l HWIO_PMIC_ARB0_CHNL176_RDATA1_ADDR A:0x298001c
y.create.l HWIO_PMIC_ARB0_CHNL177_RDATA1_ADDR A:0x298801c
y.create.l HWIO_PMIC_ARB0_CHNL178_RDATA1_ADDR A:0x299001c
y.create.l HWIO_PMIC_ARB0_CHNL179_RDATA1_ADDR A:0x299801c
y.create.l HWIO_PMIC_ARB0_CHNL180_RDATA1_ADDR A:0x29a001c
y.create.l HWIO_PMIC_ARB0_CHNL181_RDATA1_ADDR A:0x29a801c
y.create.l HWIO_PMIC_ARB0_CHNL182_RDATA1_ADDR A:0x29b001c
y.create.l HWIO_PMIC_ARB0_CHNL183_RDATA1_ADDR A:0x29b801c
y.create.l HWIO_PMIC_ARB0_CHNL184_RDATA1_ADDR A:0x29c001c
y.create.l HWIO_PMIC_ARB0_CHNL185_RDATA1_ADDR A:0x29c801c
y.create.l HWIO_PMIC_ARB0_CHNL186_RDATA1_ADDR A:0x29d001c
y.create.l HWIO_PMIC_ARB0_CHNL187_RDATA1_ADDR A:0x29d801c
y.create.l HWIO_PMIC_ARB0_CHNL188_RDATA1_ADDR A:0x29e001c
y.create.l HWIO_PMIC_ARB0_CHNL189_RDATA1_ADDR A:0x29e801c
y.create.l HWIO_PMIC_ARB0_CHNL190_RDATA1_ADDR A:0x29f001c
y.create.l HWIO_PMIC_ARB0_CHNL191_RDATA1_ADDR A:0x29f801c
y.create.l HWIO_PMIC_ARB0_CHNL192_RDATA1_ADDR A:0x2a0001c
y.create.l HWIO_PMIC_ARB0_CHNL193_RDATA1_ADDR A:0x2a0801c
y.create.l HWIO_PMIC_ARB0_CHNL194_RDATA1_ADDR A:0x2a1001c
y.create.l HWIO_PMIC_ARB0_CHNL195_RDATA1_ADDR A:0x2a1801c
y.create.l HWIO_PMIC_ARB0_CHNL196_RDATA1_ADDR A:0x2a2001c
y.create.l HWIO_PMIC_ARB0_CHNL197_RDATA1_ADDR A:0x2a2801c
y.create.l HWIO_PMIC_ARB0_CHNL198_RDATA1_ADDR A:0x2a3001c
y.create.l HWIO_PMIC_ARB0_CHNL199_RDATA1_ADDR A:0x2a3801c
y.create.l HWIO_PMIC_ARB0_CHNL200_RDATA1_ADDR A:0x2a4001c
y.create.l HWIO_PMIC_ARB0_CHNL201_RDATA1_ADDR A:0x2a4801c
y.create.l HWIO_PMIC_ARB0_CHNL202_RDATA1_ADDR A:0x2a5001c
y.create.l HWIO_PMIC_ARB0_CHNL203_RDATA1_ADDR A:0x2a5801c
y.create.l HWIO_PMIC_ARB0_CHNL204_RDATA1_ADDR A:0x2a6001c
y.create.l HWIO_PMIC_ARB0_CHNL205_RDATA1_ADDR A:0x2a6801c
y.create.l HWIO_PMIC_ARB0_CHNL206_RDATA1_ADDR A:0x2a7001c
y.create.l HWIO_PMIC_ARB0_CHNL207_RDATA1_ADDR A:0x2a7801c
y.create.l HWIO_PMIC_ARB0_CHNL208_RDATA1_ADDR A:0x2a8001c
y.create.l HWIO_PMIC_ARB0_CHNL209_RDATA1_ADDR A:0x2a8801c
y.create.l HWIO_PMIC_ARB0_CHNL210_RDATA1_ADDR A:0x2a9001c
y.create.l HWIO_PMIC_ARB0_CHNL211_RDATA1_ADDR A:0x2a9801c
y.create.l HWIO_PMIC_ARB0_CHNL212_RDATA1_ADDR A:0x2aa001c
y.create.l HWIO_PMIC_ARB0_CHNL213_RDATA1_ADDR A:0x2aa801c
y.create.l HWIO_PMIC_ARB0_CHNL214_RDATA1_ADDR A:0x2ab001c
y.create.l HWIO_PMIC_ARB0_CHNL215_RDATA1_ADDR A:0x2ab801c
y.create.l HWIO_PMIC_ARB0_CHNL216_RDATA1_ADDR A:0x2ac001c
y.create.l HWIO_PMIC_ARB0_CHNL217_RDATA1_ADDR A:0x2ac801c
y.create.l HWIO_PMIC_ARB0_CHNL218_RDATA1_ADDR A:0x2ad001c
y.create.l HWIO_PMIC_ARB0_CHNL219_RDATA1_ADDR A:0x2ad801c
y.create.l HWIO_PMIC_ARB0_CHNL220_RDATA1_ADDR A:0x2ae001c
y.create.l HWIO_PMIC_ARB0_CHNL221_RDATA1_ADDR A:0x2ae801c
y.create.l HWIO_PMIC_ARB0_CHNL222_RDATA1_ADDR A:0x2af001c
y.create.l HWIO_PMIC_ARB0_CHNL223_RDATA1_ADDR A:0x2af801c
y.create.l HWIO_PMIC_ARB0_CHNL224_RDATA1_ADDR A:0x2b0001c
y.create.l HWIO_PMIC_ARB0_CHNL225_RDATA1_ADDR A:0x2b0801c
y.create.l HWIO_PMIC_ARB0_CHNL226_RDATA1_ADDR A:0x2b1001c
y.create.l HWIO_PMIC_ARB0_CHNL227_RDATA1_ADDR A:0x2b1801c
y.create.l HWIO_PMIC_ARB0_CHNL228_RDATA1_ADDR A:0x2b2001c
y.create.l HWIO_PMIC_ARB0_CHNL229_RDATA1_ADDR A:0x2b2801c
y.create.l HWIO_PMIC_ARB0_CHNL230_RDATA1_ADDR A:0x2b3001c
y.create.l HWIO_PMIC_ARB0_CHNL231_RDATA1_ADDR A:0x2b3801c
y.create.l HWIO_PMIC_ARB0_CHNL232_RDATA1_ADDR A:0x2b4001c
y.create.l HWIO_PMIC_ARB0_CHNL233_RDATA1_ADDR A:0x2b4801c
y.create.l HWIO_PMIC_ARB0_CHNL234_RDATA1_ADDR A:0x2b5001c
y.create.l HWIO_PMIC_ARB0_CHNL235_RDATA1_ADDR A:0x2b5801c
y.create.l HWIO_PMIC_ARB0_CHNL236_RDATA1_ADDR A:0x2b6001c
y.create.l HWIO_PMIC_ARB0_CHNL237_RDATA1_ADDR A:0x2b6801c
y.create.l HWIO_PMIC_ARB0_CHNL238_RDATA1_ADDR A:0x2b7001c
y.create.l HWIO_PMIC_ARB0_CHNL239_RDATA1_ADDR A:0x2b7801c
y.create.l HWIO_PMIC_ARB0_CHNL240_RDATA1_ADDR A:0x2b8001c
y.create.l HWIO_PMIC_ARB0_CHNL241_RDATA1_ADDR A:0x2b8801c
y.create.l HWIO_PMIC_ARB0_CHNL242_RDATA1_ADDR A:0x2b9001c
y.create.l HWIO_PMIC_ARB0_CHNL243_RDATA1_ADDR A:0x2b9801c
y.create.l HWIO_PMIC_ARB0_CHNL244_RDATA1_ADDR A:0x2ba001c
y.create.l HWIO_PMIC_ARB0_CHNL245_RDATA1_ADDR A:0x2ba801c
y.create.l HWIO_PMIC_ARB0_CHNL246_RDATA1_ADDR A:0x2bb001c
y.create.l HWIO_PMIC_ARB0_CHNL247_RDATA1_ADDR A:0x2bb801c
y.create.l HWIO_PMIC_ARB0_CHNL248_RDATA1_ADDR A:0x2bc001c
y.create.l HWIO_PMIC_ARB0_CHNL249_RDATA1_ADDR A:0x2bc801c
y.create.l HWIO_PMIC_ARB0_CHNL250_RDATA1_ADDR A:0x2bd001c
y.create.l HWIO_PMIC_ARB0_CHNL251_RDATA1_ADDR A:0x2bd801c
y.create.l HWIO_PMIC_ARB0_CHNL252_RDATA1_ADDR A:0x2be001c
y.create.l HWIO_PMIC_ARB0_CHNL253_RDATA1_ADDR A:0x2be801c
y.create.l HWIO_PMIC_ARB0_CHNL254_RDATA1_ADDR A:0x2bf001c
y.create.l HWIO_PMIC_ARB0_CHNL255_RDATA1_ADDR A:0x2bf801c
y.create.l HWIO_PMIC_ARB1_CHNL0_RDATA1_ADDR A:0x240101c
y.create.l HWIO_PMIC_ARB1_CHNL1_RDATA1_ADDR A:0x240901c
y.create.l HWIO_PMIC_ARB1_CHNL2_RDATA1_ADDR A:0x241101c
y.create.l HWIO_PMIC_ARB1_CHNL3_RDATA1_ADDR A:0x241901c
y.create.l HWIO_PMIC_ARB1_CHNL4_RDATA1_ADDR A:0x242101c
y.create.l HWIO_PMIC_ARB1_CHNL5_RDATA1_ADDR A:0x242901c
y.create.l HWIO_PMIC_ARB1_CHNL6_RDATA1_ADDR A:0x243101c
y.create.l HWIO_PMIC_ARB1_CHNL7_RDATA1_ADDR A:0x243901c
y.create.l HWIO_PMIC_ARB1_CHNL8_RDATA1_ADDR A:0x244101c
y.create.l HWIO_PMIC_ARB1_CHNL9_RDATA1_ADDR A:0x244901c
y.create.l HWIO_PMIC_ARB1_CHNL10_RDATA1_ADDR A:0x245101c
y.create.l HWIO_PMIC_ARB1_CHNL11_RDATA1_ADDR A:0x245901c
y.create.l HWIO_PMIC_ARB1_CHNL12_RDATA1_ADDR A:0x246101c
y.create.l HWIO_PMIC_ARB1_CHNL13_RDATA1_ADDR A:0x246901c
y.create.l HWIO_PMIC_ARB1_CHNL14_RDATA1_ADDR A:0x247101c
y.create.l HWIO_PMIC_ARB1_CHNL15_RDATA1_ADDR A:0x247901c
y.create.l HWIO_PMIC_ARB1_CHNL16_RDATA1_ADDR A:0x248101c
y.create.l HWIO_PMIC_ARB1_CHNL17_RDATA1_ADDR A:0x248901c
y.create.l HWIO_PMIC_ARB1_CHNL18_RDATA1_ADDR A:0x249101c
y.create.l HWIO_PMIC_ARB1_CHNL19_RDATA1_ADDR A:0x249901c
y.create.l HWIO_PMIC_ARB1_CHNL20_RDATA1_ADDR A:0x24a101c
y.create.l HWIO_PMIC_ARB1_CHNL21_RDATA1_ADDR A:0x24a901c
y.create.l HWIO_PMIC_ARB1_CHNL22_RDATA1_ADDR A:0x24b101c
y.create.l HWIO_PMIC_ARB1_CHNL23_RDATA1_ADDR A:0x24b901c
y.create.l HWIO_PMIC_ARB1_CHNL24_RDATA1_ADDR A:0x24c101c
y.create.l HWIO_PMIC_ARB1_CHNL25_RDATA1_ADDR A:0x24c901c
y.create.l HWIO_PMIC_ARB1_CHNL26_RDATA1_ADDR A:0x24d101c
y.create.l HWIO_PMIC_ARB1_CHNL27_RDATA1_ADDR A:0x24d901c
y.create.l HWIO_PMIC_ARB1_CHNL28_RDATA1_ADDR A:0x24e101c
y.create.l HWIO_PMIC_ARB1_CHNL29_RDATA1_ADDR A:0x24e901c
y.create.l HWIO_PMIC_ARB1_CHNL30_RDATA1_ADDR A:0x24f101c
y.create.l HWIO_PMIC_ARB1_CHNL31_RDATA1_ADDR A:0x24f901c
y.create.l HWIO_PMIC_ARB1_CHNL32_RDATA1_ADDR A:0x250101c
y.create.l HWIO_PMIC_ARB1_CHNL33_RDATA1_ADDR A:0x250901c
y.create.l HWIO_PMIC_ARB1_CHNL34_RDATA1_ADDR A:0x251101c
y.create.l HWIO_PMIC_ARB1_CHNL35_RDATA1_ADDR A:0x251901c
y.create.l HWIO_PMIC_ARB1_CHNL36_RDATA1_ADDR A:0x252101c
y.create.l HWIO_PMIC_ARB1_CHNL37_RDATA1_ADDR A:0x252901c
y.create.l HWIO_PMIC_ARB1_CHNL38_RDATA1_ADDR A:0x253101c
y.create.l HWIO_PMIC_ARB1_CHNL39_RDATA1_ADDR A:0x253901c
y.create.l HWIO_PMIC_ARB1_CHNL40_RDATA1_ADDR A:0x254101c
y.create.l HWIO_PMIC_ARB1_CHNL41_RDATA1_ADDR A:0x254901c
y.create.l HWIO_PMIC_ARB1_CHNL42_RDATA1_ADDR A:0x255101c
y.create.l HWIO_PMIC_ARB1_CHNL43_RDATA1_ADDR A:0x255901c
y.create.l HWIO_PMIC_ARB1_CHNL44_RDATA1_ADDR A:0x256101c
y.create.l HWIO_PMIC_ARB1_CHNL45_RDATA1_ADDR A:0x256901c
y.create.l HWIO_PMIC_ARB1_CHNL46_RDATA1_ADDR A:0x257101c
y.create.l HWIO_PMIC_ARB1_CHNL47_RDATA1_ADDR A:0x257901c
y.create.l HWIO_PMIC_ARB1_CHNL48_RDATA1_ADDR A:0x258101c
y.create.l HWIO_PMIC_ARB1_CHNL49_RDATA1_ADDR A:0x258901c
y.create.l HWIO_PMIC_ARB1_CHNL50_RDATA1_ADDR A:0x259101c
y.create.l HWIO_PMIC_ARB1_CHNL51_RDATA1_ADDR A:0x259901c
y.create.l HWIO_PMIC_ARB1_CHNL52_RDATA1_ADDR A:0x25a101c
y.create.l HWIO_PMIC_ARB1_CHNL53_RDATA1_ADDR A:0x25a901c
y.create.l HWIO_PMIC_ARB1_CHNL54_RDATA1_ADDR A:0x25b101c
y.create.l HWIO_PMIC_ARB1_CHNL55_RDATA1_ADDR A:0x25b901c
y.create.l HWIO_PMIC_ARB1_CHNL56_RDATA1_ADDR A:0x25c101c
y.create.l HWIO_PMIC_ARB1_CHNL57_RDATA1_ADDR A:0x25c901c
y.create.l HWIO_PMIC_ARB1_CHNL58_RDATA1_ADDR A:0x25d101c
y.create.l HWIO_PMIC_ARB1_CHNL59_RDATA1_ADDR A:0x25d901c
y.create.l HWIO_PMIC_ARB1_CHNL60_RDATA1_ADDR A:0x25e101c
y.create.l HWIO_PMIC_ARB1_CHNL61_RDATA1_ADDR A:0x25e901c
y.create.l HWIO_PMIC_ARB1_CHNL62_RDATA1_ADDR A:0x25f101c
y.create.l HWIO_PMIC_ARB1_CHNL63_RDATA1_ADDR A:0x25f901c
y.create.l HWIO_PMIC_ARB1_CHNL64_RDATA1_ADDR A:0x260101c
y.create.l HWIO_PMIC_ARB1_CHNL65_RDATA1_ADDR A:0x260901c
y.create.l HWIO_PMIC_ARB1_CHNL66_RDATA1_ADDR A:0x261101c
y.create.l HWIO_PMIC_ARB1_CHNL67_RDATA1_ADDR A:0x261901c
y.create.l HWIO_PMIC_ARB1_CHNL68_RDATA1_ADDR A:0x262101c
y.create.l HWIO_PMIC_ARB1_CHNL69_RDATA1_ADDR A:0x262901c
y.create.l HWIO_PMIC_ARB1_CHNL70_RDATA1_ADDR A:0x263101c
y.create.l HWIO_PMIC_ARB1_CHNL71_RDATA1_ADDR A:0x263901c
y.create.l HWIO_PMIC_ARB1_CHNL72_RDATA1_ADDR A:0x264101c
y.create.l HWIO_PMIC_ARB1_CHNL73_RDATA1_ADDR A:0x264901c
y.create.l HWIO_PMIC_ARB1_CHNL74_RDATA1_ADDR A:0x265101c
y.create.l HWIO_PMIC_ARB1_CHNL75_RDATA1_ADDR A:0x265901c
y.create.l HWIO_PMIC_ARB1_CHNL76_RDATA1_ADDR A:0x266101c
y.create.l HWIO_PMIC_ARB1_CHNL77_RDATA1_ADDR A:0x266901c
y.create.l HWIO_PMIC_ARB1_CHNL78_RDATA1_ADDR A:0x267101c
y.create.l HWIO_PMIC_ARB1_CHNL79_RDATA1_ADDR A:0x267901c
y.create.l HWIO_PMIC_ARB1_CHNL80_RDATA1_ADDR A:0x268101c
y.create.l HWIO_PMIC_ARB1_CHNL81_RDATA1_ADDR A:0x268901c
y.create.l HWIO_PMIC_ARB1_CHNL82_RDATA1_ADDR A:0x269101c
y.create.l HWIO_PMIC_ARB1_CHNL83_RDATA1_ADDR A:0x269901c
y.create.l HWIO_PMIC_ARB1_CHNL84_RDATA1_ADDR A:0x26a101c
y.create.l HWIO_PMIC_ARB1_CHNL85_RDATA1_ADDR A:0x26a901c
y.create.l HWIO_PMIC_ARB1_CHNL86_RDATA1_ADDR A:0x26b101c
y.create.l HWIO_PMIC_ARB1_CHNL87_RDATA1_ADDR A:0x26b901c
y.create.l HWIO_PMIC_ARB1_CHNL88_RDATA1_ADDR A:0x26c101c
y.create.l HWIO_PMIC_ARB1_CHNL89_RDATA1_ADDR A:0x26c901c
y.create.l HWIO_PMIC_ARB1_CHNL90_RDATA1_ADDR A:0x26d101c
y.create.l HWIO_PMIC_ARB1_CHNL91_RDATA1_ADDR A:0x26d901c
y.create.l HWIO_PMIC_ARB1_CHNL92_RDATA1_ADDR A:0x26e101c
y.create.l HWIO_PMIC_ARB1_CHNL93_RDATA1_ADDR A:0x26e901c
y.create.l HWIO_PMIC_ARB1_CHNL94_RDATA1_ADDR A:0x26f101c
y.create.l HWIO_PMIC_ARB1_CHNL95_RDATA1_ADDR A:0x26f901c
y.create.l HWIO_PMIC_ARB1_CHNL96_RDATA1_ADDR A:0x270101c
y.create.l HWIO_PMIC_ARB1_CHNL97_RDATA1_ADDR A:0x270901c
y.create.l HWIO_PMIC_ARB1_CHNL98_RDATA1_ADDR A:0x271101c
y.create.l HWIO_PMIC_ARB1_CHNL99_RDATA1_ADDR A:0x271901c
y.create.l HWIO_PMIC_ARB1_CHNL100_RDATA1_ADDR A:0x272101c
y.create.l HWIO_PMIC_ARB1_CHNL101_RDATA1_ADDR A:0x272901c
y.create.l HWIO_PMIC_ARB1_CHNL102_RDATA1_ADDR A:0x273101c
y.create.l HWIO_PMIC_ARB1_CHNL103_RDATA1_ADDR A:0x273901c
y.create.l HWIO_PMIC_ARB1_CHNL104_RDATA1_ADDR A:0x274101c
y.create.l HWIO_PMIC_ARB1_CHNL105_RDATA1_ADDR A:0x274901c
y.create.l HWIO_PMIC_ARB1_CHNL106_RDATA1_ADDR A:0x275101c
y.create.l HWIO_PMIC_ARB1_CHNL107_RDATA1_ADDR A:0x275901c
y.create.l HWIO_PMIC_ARB1_CHNL108_RDATA1_ADDR A:0x276101c
y.create.l HWIO_PMIC_ARB1_CHNL109_RDATA1_ADDR A:0x276901c
y.create.l HWIO_PMIC_ARB1_CHNL110_RDATA1_ADDR A:0x277101c
y.create.l HWIO_PMIC_ARB1_CHNL111_RDATA1_ADDR A:0x277901c
y.create.l HWIO_PMIC_ARB1_CHNL112_RDATA1_ADDR A:0x278101c
y.create.l HWIO_PMIC_ARB1_CHNL113_RDATA1_ADDR A:0x278901c
y.create.l HWIO_PMIC_ARB1_CHNL114_RDATA1_ADDR A:0x279101c
y.create.l HWIO_PMIC_ARB1_CHNL115_RDATA1_ADDR A:0x279901c
y.create.l HWIO_PMIC_ARB1_CHNL116_RDATA1_ADDR A:0x27a101c
y.create.l HWIO_PMIC_ARB1_CHNL117_RDATA1_ADDR A:0x27a901c
y.create.l HWIO_PMIC_ARB1_CHNL118_RDATA1_ADDR A:0x27b101c
y.create.l HWIO_PMIC_ARB1_CHNL119_RDATA1_ADDR A:0x27b901c
y.create.l HWIO_PMIC_ARB1_CHNL120_RDATA1_ADDR A:0x27c101c
y.create.l HWIO_PMIC_ARB1_CHNL121_RDATA1_ADDR A:0x27c901c
y.create.l HWIO_PMIC_ARB1_CHNL122_RDATA1_ADDR A:0x27d101c
y.create.l HWIO_PMIC_ARB1_CHNL123_RDATA1_ADDR A:0x27d901c
y.create.l HWIO_PMIC_ARB1_CHNL124_RDATA1_ADDR A:0x27e101c
y.create.l HWIO_PMIC_ARB1_CHNL125_RDATA1_ADDR A:0x27e901c
y.create.l HWIO_PMIC_ARB1_CHNL126_RDATA1_ADDR A:0x27f101c
y.create.l HWIO_PMIC_ARB1_CHNL127_RDATA1_ADDR A:0x27f901c
y.create.l HWIO_PMIC_ARB1_CHNL128_RDATA1_ADDR A:0x280101c
y.create.l HWIO_PMIC_ARB1_CHNL129_RDATA1_ADDR A:0x280901c
y.create.l HWIO_PMIC_ARB1_CHNL130_RDATA1_ADDR A:0x281101c
y.create.l HWIO_PMIC_ARB1_CHNL131_RDATA1_ADDR A:0x281901c
y.create.l HWIO_PMIC_ARB1_CHNL132_RDATA1_ADDR A:0x282101c
y.create.l HWIO_PMIC_ARB1_CHNL133_RDATA1_ADDR A:0x282901c
y.create.l HWIO_PMIC_ARB1_CHNL134_RDATA1_ADDR A:0x283101c
y.create.l HWIO_PMIC_ARB1_CHNL135_RDATA1_ADDR A:0x283901c
y.create.l HWIO_PMIC_ARB1_CHNL136_RDATA1_ADDR A:0x284101c
y.create.l HWIO_PMIC_ARB1_CHNL137_RDATA1_ADDR A:0x284901c
y.create.l HWIO_PMIC_ARB1_CHNL138_RDATA1_ADDR A:0x285101c
y.create.l HWIO_PMIC_ARB1_CHNL139_RDATA1_ADDR A:0x285901c
y.create.l HWIO_PMIC_ARB1_CHNL140_RDATA1_ADDR A:0x286101c
y.create.l HWIO_PMIC_ARB1_CHNL141_RDATA1_ADDR A:0x286901c
y.create.l HWIO_PMIC_ARB1_CHNL142_RDATA1_ADDR A:0x287101c
y.create.l HWIO_PMIC_ARB1_CHNL143_RDATA1_ADDR A:0x287901c
y.create.l HWIO_PMIC_ARB1_CHNL144_RDATA1_ADDR A:0x288101c
y.create.l HWIO_PMIC_ARB1_CHNL145_RDATA1_ADDR A:0x288901c
y.create.l HWIO_PMIC_ARB1_CHNL146_RDATA1_ADDR A:0x289101c
y.create.l HWIO_PMIC_ARB1_CHNL147_RDATA1_ADDR A:0x289901c
y.create.l HWIO_PMIC_ARB1_CHNL148_RDATA1_ADDR A:0x28a101c
y.create.l HWIO_PMIC_ARB1_CHNL149_RDATA1_ADDR A:0x28a901c
y.create.l HWIO_PMIC_ARB1_CHNL150_RDATA1_ADDR A:0x28b101c
y.create.l HWIO_PMIC_ARB1_CHNL151_RDATA1_ADDR A:0x28b901c
y.create.l HWIO_PMIC_ARB1_CHNL152_RDATA1_ADDR A:0x28c101c
y.create.l HWIO_PMIC_ARB1_CHNL153_RDATA1_ADDR A:0x28c901c
y.create.l HWIO_PMIC_ARB1_CHNL154_RDATA1_ADDR A:0x28d101c
y.create.l HWIO_PMIC_ARB1_CHNL155_RDATA1_ADDR A:0x28d901c
y.create.l HWIO_PMIC_ARB1_CHNL156_RDATA1_ADDR A:0x28e101c
y.create.l HWIO_PMIC_ARB1_CHNL157_RDATA1_ADDR A:0x28e901c
y.create.l HWIO_PMIC_ARB1_CHNL158_RDATA1_ADDR A:0x28f101c
y.create.l HWIO_PMIC_ARB1_CHNL159_RDATA1_ADDR A:0x28f901c
y.create.l HWIO_PMIC_ARB1_CHNL160_RDATA1_ADDR A:0x290101c
y.create.l HWIO_PMIC_ARB1_CHNL161_RDATA1_ADDR A:0x290901c
y.create.l HWIO_PMIC_ARB1_CHNL162_RDATA1_ADDR A:0x291101c
y.create.l HWIO_PMIC_ARB1_CHNL163_RDATA1_ADDR A:0x291901c
y.create.l HWIO_PMIC_ARB1_CHNL164_RDATA1_ADDR A:0x292101c
y.create.l HWIO_PMIC_ARB1_CHNL165_RDATA1_ADDR A:0x292901c
y.create.l HWIO_PMIC_ARB1_CHNL166_RDATA1_ADDR A:0x293101c
y.create.l HWIO_PMIC_ARB1_CHNL167_RDATA1_ADDR A:0x293901c
y.create.l HWIO_PMIC_ARB1_CHNL168_RDATA1_ADDR A:0x294101c
y.create.l HWIO_PMIC_ARB1_CHNL169_RDATA1_ADDR A:0x294901c
y.create.l HWIO_PMIC_ARB1_CHNL170_RDATA1_ADDR A:0x295101c
y.create.l HWIO_PMIC_ARB1_CHNL171_RDATA1_ADDR A:0x295901c
y.create.l HWIO_PMIC_ARB1_CHNL172_RDATA1_ADDR A:0x296101c
y.create.l HWIO_PMIC_ARB1_CHNL173_RDATA1_ADDR A:0x296901c
y.create.l HWIO_PMIC_ARB1_CHNL174_RDATA1_ADDR A:0x297101c
y.create.l HWIO_PMIC_ARB1_CHNL175_RDATA1_ADDR A:0x297901c
y.create.l HWIO_PMIC_ARB1_CHNL176_RDATA1_ADDR A:0x298101c
y.create.l HWIO_PMIC_ARB1_CHNL177_RDATA1_ADDR A:0x298901c
y.create.l HWIO_PMIC_ARB1_CHNL178_RDATA1_ADDR A:0x299101c
y.create.l HWIO_PMIC_ARB1_CHNL179_RDATA1_ADDR A:0x299901c
y.create.l HWIO_PMIC_ARB1_CHNL180_RDATA1_ADDR A:0x29a101c
y.create.l HWIO_PMIC_ARB1_CHNL181_RDATA1_ADDR A:0x29a901c
y.create.l HWIO_PMIC_ARB1_CHNL182_RDATA1_ADDR A:0x29b101c
y.create.l HWIO_PMIC_ARB1_CHNL183_RDATA1_ADDR A:0x29b901c
y.create.l HWIO_PMIC_ARB1_CHNL184_RDATA1_ADDR A:0x29c101c
y.create.l HWIO_PMIC_ARB1_CHNL185_RDATA1_ADDR A:0x29c901c
y.create.l HWIO_PMIC_ARB1_CHNL186_RDATA1_ADDR A:0x29d101c
y.create.l HWIO_PMIC_ARB1_CHNL187_RDATA1_ADDR A:0x29d901c
y.create.l HWIO_PMIC_ARB1_CHNL188_RDATA1_ADDR A:0x29e101c
y.create.l HWIO_PMIC_ARB1_CHNL189_RDATA1_ADDR A:0x29e901c
y.create.l HWIO_PMIC_ARB1_CHNL190_RDATA1_ADDR A:0x29f101c
y.create.l HWIO_PMIC_ARB1_CHNL191_RDATA1_ADDR A:0x29f901c
y.create.l HWIO_PMIC_ARB1_CHNL192_RDATA1_ADDR A:0x2a0101c
y.create.l HWIO_PMIC_ARB1_CHNL193_RDATA1_ADDR A:0x2a0901c
y.create.l HWIO_PMIC_ARB1_CHNL194_RDATA1_ADDR A:0x2a1101c
y.create.l HWIO_PMIC_ARB1_CHNL195_RDATA1_ADDR A:0x2a1901c
y.create.l HWIO_PMIC_ARB1_CHNL196_RDATA1_ADDR A:0x2a2101c
y.create.l HWIO_PMIC_ARB1_CHNL197_RDATA1_ADDR A:0x2a2901c
y.create.l HWIO_PMIC_ARB1_CHNL198_RDATA1_ADDR A:0x2a3101c
y.create.l HWIO_PMIC_ARB1_CHNL199_RDATA1_ADDR A:0x2a3901c
y.create.l HWIO_PMIC_ARB1_CHNL200_RDATA1_ADDR A:0x2a4101c
y.create.l HWIO_PMIC_ARB1_CHNL201_RDATA1_ADDR A:0x2a4901c
y.create.l HWIO_PMIC_ARB1_CHNL202_RDATA1_ADDR A:0x2a5101c
y.create.l HWIO_PMIC_ARB1_CHNL203_RDATA1_ADDR A:0x2a5901c
y.create.l HWIO_PMIC_ARB1_CHNL204_RDATA1_ADDR A:0x2a6101c
y.create.l HWIO_PMIC_ARB1_CHNL205_RDATA1_ADDR A:0x2a6901c
y.create.l HWIO_PMIC_ARB1_CHNL206_RDATA1_ADDR A:0x2a7101c
y.create.l HWIO_PMIC_ARB1_CHNL207_RDATA1_ADDR A:0x2a7901c
y.create.l HWIO_PMIC_ARB1_CHNL208_RDATA1_ADDR A:0x2a8101c
y.create.l HWIO_PMIC_ARB1_CHNL209_RDATA1_ADDR A:0x2a8901c
y.create.l HWIO_PMIC_ARB1_CHNL210_RDATA1_ADDR A:0x2a9101c
y.create.l HWIO_PMIC_ARB1_CHNL211_RDATA1_ADDR A:0x2a9901c
y.create.l HWIO_PMIC_ARB1_CHNL212_RDATA1_ADDR A:0x2aa101c
y.create.l HWIO_PMIC_ARB1_CHNL213_RDATA1_ADDR A:0x2aa901c
y.create.l HWIO_PMIC_ARB1_CHNL214_RDATA1_ADDR A:0x2ab101c
y.create.l HWIO_PMIC_ARB1_CHNL215_RDATA1_ADDR A:0x2ab901c
y.create.l HWIO_PMIC_ARB1_CHNL216_RDATA1_ADDR A:0x2ac101c
y.create.l HWIO_PMIC_ARB1_CHNL217_RDATA1_ADDR A:0x2ac901c
y.create.l HWIO_PMIC_ARB1_CHNL218_RDATA1_ADDR A:0x2ad101c
y.create.l HWIO_PMIC_ARB1_CHNL219_RDATA1_ADDR A:0x2ad901c
y.create.l HWIO_PMIC_ARB1_CHNL220_RDATA1_ADDR A:0x2ae101c
y.create.l HWIO_PMIC_ARB1_CHNL221_RDATA1_ADDR A:0x2ae901c
y.create.l HWIO_PMIC_ARB1_CHNL222_RDATA1_ADDR A:0x2af101c
y.create.l HWIO_PMIC_ARB1_CHNL223_RDATA1_ADDR A:0x2af901c
y.create.l HWIO_PMIC_ARB1_CHNL224_RDATA1_ADDR A:0x2b0101c
y.create.l HWIO_PMIC_ARB1_CHNL225_RDATA1_ADDR A:0x2b0901c
y.create.l HWIO_PMIC_ARB1_CHNL226_RDATA1_ADDR A:0x2b1101c
y.create.l HWIO_PMIC_ARB1_CHNL227_RDATA1_ADDR A:0x2b1901c
y.create.l HWIO_PMIC_ARB1_CHNL228_RDATA1_ADDR A:0x2b2101c
y.create.l HWIO_PMIC_ARB1_CHNL229_RDATA1_ADDR A:0x2b2901c
y.create.l HWIO_PMIC_ARB1_CHNL230_RDATA1_ADDR A:0x2b3101c
y.create.l HWIO_PMIC_ARB1_CHNL231_RDATA1_ADDR A:0x2b3901c
y.create.l HWIO_PMIC_ARB1_CHNL232_RDATA1_ADDR A:0x2b4101c
y.create.l HWIO_PMIC_ARB1_CHNL233_RDATA1_ADDR A:0x2b4901c
y.create.l HWIO_PMIC_ARB1_CHNL234_RDATA1_ADDR A:0x2b5101c
y.create.l HWIO_PMIC_ARB1_CHNL235_RDATA1_ADDR A:0x2b5901c
y.create.l HWIO_PMIC_ARB1_CHNL236_RDATA1_ADDR A:0x2b6101c
y.create.l HWIO_PMIC_ARB1_CHNL237_RDATA1_ADDR A:0x2b6901c
y.create.l HWIO_PMIC_ARB1_CHNL238_RDATA1_ADDR A:0x2b7101c
y.create.l HWIO_PMIC_ARB1_CHNL239_RDATA1_ADDR A:0x2b7901c
y.create.l HWIO_PMIC_ARB1_CHNL240_RDATA1_ADDR A:0x2b8101c
y.create.l HWIO_PMIC_ARB1_CHNL241_RDATA1_ADDR A:0x2b8901c
y.create.l HWIO_PMIC_ARB1_CHNL242_RDATA1_ADDR A:0x2b9101c
y.create.l HWIO_PMIC_ARB1_CHNL243_RDATA1_ADDR A:0x2b9901c
y.create.l HWIO_PMIC_ARB1_CHNL244_RDATA1_ADDR A:0x2ba101c
y.create.l HWIO_PMIC_ARB1_CHNL245_RDATA1_ADDR A:0x2ba901c
y.create.l HWIO_PMIC_ARB1_CHNL246_RDATA1_ADDR A:0x2bb101c
y.create.l HWIO_PMIC_ARB1_CHNL247_RDATA1_ADDR A:0x2bb901c
y.create.l HWIO_PMIC_ARB1_CHNL248_RDATA1_ADDR A:0x2bc101c
y.create.l HWIO_PMIC_ARB1_CHNL249_RDATA1_ADDR A:0x2bc901c
y.create.l HWIO_PMIC_ARB1_CHNL250_RDATA1_ADDR A:0x2bd101c
y.create.l HWIO_PMIC_ARB1_CHNL251_RDATA1_ADDR A:0x2bd901c
y.create.l HWIO_PMIC_ARB1_CHNL252_RDATA1_ADDR A:0x2be101c
y.create.l HWIO_PMIC_ARB1_CHNL253_RDATA1_ADDR A:0x2be901c
y.create.l HWIO_PMIC_ARB1_CHNL254_RDATA1_ADDR A:0x2bf101c
y.create.l HWIO_PMIC_ARB1_CHNL255_RDATA1_ADDR A:0x2bf901c
y.create.l HWIO_PMIC_ARB2_CHNL0_RDATA1_ADDR A:0x240201c
y.create.l HWIO_PMIC_ARB2_CHNL1_RDATA1_ADDR A:0x240a01c
y.create.l HWIO_PMIC_ARB2_CHNL2_RDATA1_ADDR A:0x241201c
y.create.l HWIO_PMIC_ARB2_CHNL3_RDATA1_ADDR A:0x241a01c
y.create.l HWIO_PMIC_ARB2_CHNL4_RDATA1_ADDR A:0x242201c
y.create.l HWIO_PMIC_ARB2_CHNL5_RDATA1_ADDR A:0x242a01c
y.create.l HWIO_PMIC_ARB2_CHNL6_RDATA1_ADDR A:0x243201c
y.create.l HWIO_PMIC_ARB2_CHNL7_RDATA1_ADDR A:0x243a01c
y.create.l HWIO_PMIC_ARB2_CHNL8_RDATA1_ADDR A:0x244201c
y.create.l HWIO_PMIC_ARB2_CHNL9_RDATA1_ADDR A:0x244a01c
y.create.l HWIO_PMIC_ARB2_CHNL10_RDATA1_ADDR A:0x245201c
y.create.l HWIO_PMIC_ARB2_CHNL11_RDATA1_ADDR A:0x245a01c
y.create.l HWIO_PMIC_ARB2_CHNL12_RDATA1_ADDR A:0x246201c
y.create.l HWIO_PMIC_ARB2_CHNL13_RDATA1_ADDR A:0x246a01c
y.create.l HWIO_PMIC_ARB2_CHNL14_RDATA1_ADDR A:0x247201c
y.create.l HWIO_PMIC_ARB2_CHNL15_RDATA1_ADDR A:0x247a01c
y.create.l HWIO_PMIC_ARB2_CHNL16_RDATA1_ADDR A:0x248201c
y.create.l HWIO_PMIC_ARB2_CHNL17_RDATA1_ADDR A:0x248a01c
y.create.l HWIO_PMIC_ARB2_CHNL18_RDATA1_ADDR A:0x249201c
y.create.l HWIO_PMIC_ARB2_CHNL19_RDATA1_ADDR A:0x249a01c
y.create.l HWIO_PMIC_ARB2_CHNL20_RDATA1_ADDR A:0x24a201c
y.create.l HWIO_PMIC_ARB2_CHNL21_RDATA1_ADDR A:0x24aa01c
y.create.l HWIO_PMIC_ARB2_CHNL22_RDATA1_ADDR A:0x24b201c
y.create.l HWIO_PMIC_ARB2_CHNL23_RDATA1_ADDR A:0x24ba01c
y.create.l HWIO_PMIC_ARB2_CHNL24_RDATA1_ADDR A:0x24c201c
y.create.l HWIO_PMIC_ARB2_CHNL25_RDATA1_ADDR A:0x24ca01c
y.create.l HWIO_PMIC_ARB2_CHNL26_RDATA1_ADDR A:0x24d201c
y.create.l HWIO_PMIC_ARB2_CHNL27_RDATA1_ADDR A:0x24da01c
y.create.l HWIO_PMIC_ARB2_CHNL28_RDATA1_ADDR A:0x24e201c
y.create.l HWIO_PMIC_ARB2_CHNL29_RDATA1_ADDR A:0x24ea01c
y.create.l HWIO_PMIC_ARB2_CHNL30_RDATA1_ADDR A:0x24f201c
y.create.l HWIO_PMIC_ARB2_CHNL31_RDATA1_ADDR A:0x24fa01c
y.create.l HWIO_PMIC_ARB2_CHNL32_RDATA1_ADDR A:0x250201c
y.create.l HWIO_PMIC_ARB2_CHNL33_RDATA1_ADDR A:0x250a01c
y.create.l HWIO_PMIC_ARB2_CHNL34_RDATA1_ADDR A:0x251201c
y.create.l HWIO_PMIC_ARB2_CHNL35_RDATA1_ADDR A:0x251a01c
y.create.l HWIO_PMIC_ARB2_CHNL36_RDATA1_ADDR A:0x252201c
y.create.l HWIO_PMIC_ARB2_CHNL37_RDATA1_ADDR A:0x252a01c
y.create.l HWIO_PMIC_ARB2_CHNL38_RDATA1_ADDR A:0x253201c
y.create.l HWIO_PMIC_ARB2_CHNL39_RDATA1_ADDR A:0x253a01c
y.create.l HWIO_PMIC_ARB2_CHNL40_RDATA1_ADDR A:0x254201c
y.create.l HWIO_PMIC_ARB2_CHNL41_RDATA1_ADDR A:0x254a01c
y.create.l HWIO_PMIC_ARB2_CHNL42_RDATA1_ADDR A:0x255201c
y.create.l HWIO_PMIC_ARB2_CHNL43_RDATA1_ADDR A:0x255a01c
y.create.l HWIO_PMIC_ARB2_CHNL44_RDATA1_ADDR A:0x256201c
y.create.l HWIO_PMIC_ARB2_CHNL45_RDATA1_ADDR A:0x256a01c
y.create.l HWIO_PMIC_ARB2_CHNL46_RDATA1_ADDR A:0x257201c
y.create.l HWIO_PMIC_ARB2_CHNL47_RDATA1_ADDR A:0x257a01c
y.create.l HWIO_PMIC_ARB2_CHNL48_RDATA1_ADDR A:0x258201c
y.create.l HWIO_PMIC_ARB2_CHNL49_RDATA1_ADDR A:0x258a01c
y.create.l HWIO_PMIC_ARB2_CHNL50_RDATA1_ADDR A:0x259201c
y.create.l HWIO_PMIC_ARB2_CHNL51_RDATA1_ADDR A:0x259a01c
y.create.l HWIO_PMIC_ARB2_CHNL52_RDATA1_ADDR A:0x25a201c
y.create.l HWIO_PMIC_ARB2_CHNL53_RDATA1_ADDR A:0x25aa01c
y.create.l HWIO_PMIC_ARB2_CHNL54_RDATA1_ADDR A:0x25b201c
y.create.l HWIO_PMIC_ARB2_CHNL55_RDATA1_ADDR A:0x25ba01c
y.create.l HWIO_PMIC_ARB2_CHNL56_RDATA1_ADDR A:0x25c201c
y.create.l HWIO_PMIC_ARB2_CHNL57_RDATA1_ADDR A:0x25ca01c
y.create.l HWIO_PMIC_ARB2_CHNL58_RDATA1_ADDR A:0x25d201c
y.create.l HWIO_PMIC_ARB2_CHNL59_RDATA1_ADDR A:0x25da01c
y.create.l HWIO_PMIC_ARB2_CHNL60_RDATA1_ADDR A:0x25e201c
y.create.l HWIO_PMIC_ARB2_CHNL61_RDATA1_ADDR A:0x25ea01c
y.create.l HWIO_PMIC_ARB2_CHNL62_RDATA1_ADDR A:0x25f201c
y.create.l HWIO_PMIC_ARB2_CHNL63_RDATA1_ADDR A:0x25fa01c
y.create.l HWIO_PMIC_ARB2_CHNL64_RDATA1_ADDR A:0x260201c
y.create.l HWIO_PMIC_ARB2_CHNL65_RDATA1_ADDR A:0x260a01c
y.create.l HWIO_PMIC_ARB2_CHNL66_RDATA1_ADDR A:0x261201c
y.create.l HWIO_PMIC_ARB2_CHNL67_RDATA1_ADDR A:0x261a01c
y.create.l HWIO_PMIC_ARB2_CHNL68_RDATA1_ADDR A:0x262201c
y.create.l HWIO_PMIC_ARB2_CHNL69_RDATA1_ADDR A:0x262a01c
y.create.l HWIO_PMIC_ARB2_CHNL70_RDATA1_ADDR A:0x263201c
y.create.l HWIO_PMIC_ARB2_CHNL71_RDATA1_ADDR A:0x263a01c
y.create.l HWIO_PMIC_ARB2_CHNL72_RDATA1_ADDR A:0x264201c
y.create.l HWIO_PMIC_ARB2_CHNL73_RDATA1_ADDR A:0x264a01c
y.create.l HWIO_PMIC_ARB2_CHNL74_RDATA1_ADDR A:0x265201c
y.create.l HWIO_PMIC_ARB2_CHNL75_RDATA1_ADDR A:0x265a01c
y.create.l HWIO_PMIC_ARB2_CHNL76_RDATA1_ADDR A:0x266201c
y.create.l HWIO_PMIC_ARB2_CHNL77_RDATA1_ADDR A:0x266a01c
y.create.l HWIO_PMIC_ARB2_CHNL78_RDATA1_ADDR A:0x267201c
y.create.l HWIO_PMIC_ARB2_CHNL79_RDATA1_ADDR A:0x267a01c
y.create.l HWIO_PMIC_ARB2_CHNL80_RDATA1_ADDR A:0x268201c
y.create.l HWIO_PMIC_ARB2_CHNL81_RDATA1_ADDR A:0x268a01c
y.create.l HWIO_PMIC_ARB2_CHNL82_RDATA1_ADDR A:0x269201c
y.create.l HWIO_PMIC_ARB2_CHNL83_RDATA1_ADDR A:0x269a01c
y.create.l HWIO_PMIC_ARB2_CHNL84_RDATA1_ADDR A:0x26a201c
y.create.l HWIO_PMIC_ARB2_CHNL85_RDATA1_ADDR A:0x26aa01c
y.create.l HWIO_PMIC_ARB2_CHNL86_RDATA1_ADDR A:0x26b201c
y.create.l HWIO_PMIC_ARB2_CHNL87_RDATA1_ADDR A:0x26ba01c
y.create.l HWIO_PMIC_ARB2_CHNL88_RDATA1_ADDR A:0x26c201c
y.create.l HWIO_PMIC_ARB2_CHNL89_RDATA1_ADDR A:0x26ca01c
y.create.l HWIO_PMIC_ARB2_CHNL90_RDATA1_ADDR A:0x26d201c
y.create.l HWIO_PMIC_ARB2_CHNL91_RDATA1_ADDR A:0x26da01c
y.create.l HWIO_PMIC_ARB2_CHNL92_RDATA1_ADDR A:0x26e201c
y.create.l HWIO_PMIC_ARB2_CHNL93_RDATA1_ADDR A:0x26ea01c
y.create.l HWIO_PMIC_ARB2_CHNL94_RDATA1_ADDR A:0x26f201c
y.create.l HWIO_PMIC_ARB2_CHNL95_RDATA1_ADDR A:0x26fa01c
y.create.l HWIO_PMIC_ARB2_CHNL96_RDATA1_ADDR A:0x270201c
y.create.l HWIO_PMIC_ARB2_CHNL97_RDATA1_ADDR A:0x270a01c
y.create.l HWIO_PMIC_ARB2_CHNL98_RDATA1_ADDR A:0x271201c
y.create.l HWIO_PMIC_ARB2_CHNL99_RDATA1_ADDR A:0x271a01c
y.create.l HWIO_PMIC_ARB2_CHNL100_RDATA1_ADDR A:0x272201c
y.create.l HWIO_PMIC_ARB2_CHNL101_RDATA1_ADDR A:0x272a01c
y.create.l HWIO_PMIC_ARB2_CHNL102_RDATA1_ADDR A:0x273201c
y.create.l HWIO_PMIC_ARB2_CHNL103_RDATA1_ADDR A:0x273a01c
y.create.l HWIO_PMIC_ARB2_CHNL104_RDATA1_ADDR A:0x274201c
y.create.l HWIO_PMIC_ARB2_CHNL105_RDATA1_ADDR A:0x274a01c
y.create.l HWIO_PMIC_ARB2_CHNL106_RDATA1_ADDR A:0x275201c
y.create.l HWIO_PMIC_ARB2_CHNL107_RDATA1_ADDR A:0x275a01c
y.create.l HWIO_PMIC_ARB2_CHNL108_RDATA1_ADDR A:0x276201c
y.create.l HWIO_PMIC_ARB2_CHNL109_RDATA1_ADDR A:0x276a01c
y.create.l HWIO_PMIC_ARB2_CHNL110_RDATA1_ADDR A:0x277201c
y.create.l HWIO_PMIC_ARB2_CHNL111_RDATA1_ADDR A:0x277a01c
y.create.l HWIO_PMIC_ARB2_CHNL112_RDATA1_ADDR A:0x278201c
y.create.l HWIO_PMIC_ARB2_CHNL113_RDATA1_ADDR A:0x278a01c
y.create.l HWIO_PMIC_ARB2_CHNL114_RDATA1_ADDR A:0x279201c
y.create.l HWIO_PMIC_ARB2_CHNL115_RDATA1_ADDR A:0x279a01c
y.create.l HWIO_PMIC_ARB2_CHNL116_RDATA1_ADDR A:0x27a201c
y.create.l HWIO_PMIC_ARB2_CHNL117_RDATA1_ADDR A:0x27aa01c
y.create.l HWIO_PMIC_ARB2_CHNL118_RDATA1_ADDR A:0x27b201c
y.create.l HWIO_PMIC_ARB2_CHNL119_RDATA1_ADDR A:0x27ba01c
y.create.l HWIO_PMIC_ARB2_CHNL120_RDATA1_ADDR A:0x27c201c
y.create.l HWIO_PMIC_ARB2_CHNL121_RDATA1_ADDR A:0x27ca01c
y.create.l HWIO_PMIC_ARB2_CHNL122_RDATA1_ADDR A:0x27d201c
y.create.l HWIO_PMIC_ARB2_CHNL123_RDATA1_ADDR A:0x27da01c
y.create.l HWIO_PMIC_ARB2_CHNL124_RDATA1_ADDR A:0x27e201c
y.create.l HWIO_PMIC_ARB2_CHNL125_RDATA1_ADDR A:0x27ea01c
y.create.l HWIO_PMIC_ARB2_CHNL126_RDATA1_ADDR A:0x27f201c
y.create.l HWIO_PMIC_ARB2_CHNL127_RDATA1_ADDR A:0x27fa01c
y.create.l HWIO_PMIC_ARB2_CHNL128_RDATA1_ADDR A:0x280201c
y.create.l HWIO_PMIC_ARB2_CHNL129_RDATA1_ADDR A:0x280a01c
y.create.l HWIO_PMIC_ARB2_CHNL130_RDATA1_ADDR A:0x281201c
y.create.l HWIO_PMIC_ARB2_CHNL131_RDATA1_ADDR A:0x281a01c
y.create.l HWIO_PMIC_ARB2_CHNL132_RDATA1_ADDR A:0x282201c
y.create.l HWIO_PMIC_ARB2_CHNL133_RDATA1_ADDR A:0x282a01c
y.create.l HWIO_PMIC_ARB2_CHNL134_RDATA1_ADDR A:0x283201c
y.create.l HWIO_PMIC_ARB2_CHNL135_RDATA1_ADDR A:0x283a01c
y.create.l HWIO_PMIC_ARB2_CHNL136_RDATA1_ADDR A:0x284201c
y.create.l HWIO_PMIC_ARB2_CHNL137_RDATA1_ADDR A:0x284a01c
y.create.l HWIO_PMIC_ARB2_CHNL138_RDATA1_ADDR A:0x285201c
y.create.l HWIO_PMIC_ARB2_CHNL139_RDATA1_ADDR A:0x285a01c
y.create.l HWIO_PMIC_ARB2_CHNL140_RDATA1_ADDR A:0x286201c
y.create.l HWIO_PMIC_ARB2_CHNL141_RDATA1_ADDR A:0x286a01c
y.create.l HWIO_PMIC_ARB2_CHNL142_RDATA1_ADDR A:0x287201c
y.create.l HWIO_PMIC_ARB2_CHNL143_RDATA1_ADDR A:0x287a01c
y.create.l HWIO_PMIC_ARB2_CHNL144_RDATA1_ADDR A:0x288201c
y.create.l HWIO_PMIC_ARB2_CHNL145_RDATA1_ADDR A:0x288a01c
y.create.l HWIO_PMIC_ARB2_CHNL146_RDATA1_ADDR A:0x289201c
y.create.l HWIO_PMIC_ARB2_CHNL147_RDATA1_ADDR A:0x289a01c
y.create.l HWIO_PMIC_ARB2_CHNL148_RDATA1_ADDR A:0x28a201c
y.create.l HWIO_PMIC_ARB2_CHNL149_RDATA1_ADDR A:0x28aa01c
y.create.l HWIO_PMIC_ARB2_CHNL150_RDATA1_ADDR A:0x28b201c
y.create.l HWIO_PMIC_ARB2_CHNL151_RDATA1_ADDR A:0x28ba01c
y.create.l HWIO_PMIC_ARB2_CHNL152_RDATA1_ADDR A:0x28c201c
y.create.l HWIO_PMIC_ARB2_CHNL153_RDATA1_ADDR A:0x28ca01c
y.create.l HWIO_PMIC_ARB2_CHNL154_RDATA1_ADDR A:0x28d201c
y.create.l HWIO_PMIC_ARB2_CHNL155_RDATA1_ADDR A:0x28da01c
y.create.l HWIO_PMIC_ARB2_CHNL156_RDATA1_ADDR A:0x28e201c
y.create.l HWIO_PMIC_ARB2_CHNL157_RDATA1_ADDR A:0x28ea01c
y.create.l HWIO_PMIC_ARB2_CHNL158_RDATA1_ADDR A:0x28f201c
y.create.l HWIO_PMIC_ARB2_CHNL159_RDATA1_ADDR A:0x28fa01c
y.create.l HWIO_PMIC_ARB2_CHNL160_RDATA1_ADDR A:0x290201c
y.create.l HWIO_PMIC_ARB2_CHNL161_RDATA1_ADDR A:0x290a01c
y.create.l HWIO_PMIC_ARB2_CHNL162_RDATA1_ADDR A:0x291201c
y.create.l HWIO_PMIC_ARB2_CHNL163_RDATA1_ADDR A:0x291a01c
y.create.l HWIO_PMIC_ARB2_CHNL164_RDATA1_ADDR A:0x292201c
y.create.l HWIO_PMIC_ARB2_CHNL165_RDATA1_ADDR A:0x292a01c
y.create.l HWIO_PMIC_ARB2_CHNL166_RDATA1_ADDR A:0x293201c
y.create.l HWIO_PMIC_ARB2_CHNL167_RDATA1_ADDR A:0x293a01c
y.create.l HWIO_PMIC_ARB2_CHNL168_RDATA1_ADDR A:0x294201c
y.create.l HWIO_PMIC_ARB2_CHNL169_RDATA1_ADDR A:0x294a01c
y.create.l HWIO_PMIC_ARB2_CHNL170_RDATA1_ADDR A:0x295201c
y.create.l HWIO_PMIC_ARB2_CHNL171_RDATA1_ADDR A:0x295a01c
y.create.l HWIO_PMIC_ARB2_CHNL172_RDATA1_ADDR A:0x296201c
y.create.l HWIO_PMIC_ARB2_CHNL173_RDATA1_ADDR A:0x296a01c
y.create.l HWIO_PMIC_ARB2_CHNL174_RDATA1_ADDR A:0x297201c
y.create.l HWIO_PMIC_ARB2_CHNL175_RDATA1_ADDR A:0x297a01c
y.create.l HWIO_PMIC_ARB2_CHNL176_RDATA1_ADDR A:0x298201c
y.create.l HWIO_PMIC_ARB2_CHNL177_RDATA1_ADDR A:0x298a01c
y.create.l HWIO_PMIC_ARB2_CHNL178_RDATA1_ADDR A:0x299201c
y.create.l HWIO_PMIC_ARB2_CHNL179_RDATA1_ADDR A:0x299a01c
y.create.l HWIO_PMIC_ARB2_CHNL180_RDATA1_ADDR A:0x29a201c
y.create.l HWIO_PMIC_ARB2_CHNL181_RDATA1_ADDR A:0x29aa01c
y.create.l HWIO_PMIC_ARB2_CHNL182_RDATA1_ADDR A:0x29b201c
y.create.l HWIO_PMIC_ARB2_CHNL183_RDATA1_ADDR A:0x29ba01c
y.create.l HWIO_PMIC_ARB2_CHNL184_RDATA1_ADDR A:0x29c201c
y.create.l HWIO_PMIC_ARB2_CHNL185_RDATA1_ADDR A:0x29ca01c
y.create.l HWIO_PMIC_ARB2_CHNL186_RDATA1_ADDR A:0x29d201c
y.create.l HWIO_PMIC_ARB2_CHNL187_RDATA1_ADDR A:0x29da01c
y.create.l HWIO_PMIC_ARB2_CHNL188_RDATA1_ADDR A:0x29e201c
y.create.l HWIO_PMIC_ARB2_CHNL189_RDATA1_ADDR A:0x29ea01c
y.create.l HWIO_PMIC_ARB2_CHNL190_RDATA1_ADDR A:0x29f201c
y.create.l HWIO_PMIC_ARB2_CHNL191_RDATA1_ADDR A:0x29fa01c
y.create.l HWIO_PMIC_ARB2_CHNL192_RDATA1_ADDR A:0x2a0201c
y.create.l HWIO_PMIC_ARB2_CHNL193_RDATA1_ADDR A:0x2a0a01c
y.create.l HWIO_PMIC_ARB2_CHNL194_RDATA1_ADDR A:0x2a1201c
y.create.l HWIO_PMIC_ARB2_CHNL195_RDATA1_ADDR A:0x2a1a01c
y.create.l HWIO_PMIC_ARB2_CHNL196_RDATA1_ADDR A:0x2a2201c
y.create.l HWIO_PMIC_ARB2_CHNL197_RDATA1_ADDR A:0x2a2a01c
y.create.l HWIO_PMIC_ARB2_CHNL198_RDATA1_ADDR A:0x2a3201c
y.create.l HWIO_PMIC_ARB2_CHNL199_RDATA1_ADDR A:0x2a3a01c
y.create.l HWIO_PMIC_ARB2_CHNL200_RDATA1_ADDR A:0x2a4201c
y.create.l HWIO_PMIC_ARB2_CHNL201_RDATA1_ADDR A:0x2a4a01c
y.create.l HWIO_PMIC_ARB2_CHNL202_RDATA1_ADDR A:0x2a5201c
y.create.l HWIO_PMIC_ARB2_CHNL203_RDATA1_ADDR A:0x2a5a01c
y.create.l HWIO_PMIC_ARB2_CHNL204_RDATA1_ADDR A:0x2a6201c
y.create.l HWIO_PMIC_ARB2_CHNL205_RDATA1_ADDR A:0x2a6a01c
y.create.l HWIO_PMIC_ARB2_CHNL206_RDATA1_ADDR A:0x2a7201c
y.create.l HWIO_PMIC_ARB2_CHNL207_RDATA1_ADDR A:0x2a7a01c
y.create.l HWIO_PMIC_ARB2_CHNL208_RDATA1_ADDR A:0x2a8201c
y.create.l HWIO_PMIC_ARB2_CHNL209_RDATA1_ADDR A:0x2a8a01c
y.create.l HWIO_PMIC_ARB2_CHNL210_RDATA1_ADDR A:0x2a9201c
y.create.l HWIO_PMIC_ARB2_CHNL211_RDATA1_ADDR A:0x2a9a01c
y.create.l HWIO_PMIC_ARB2_CHNL212_RDATA1_ADDR A:0x2aa201c
y.create.l HWIO_PMIC_ARB2_CHNL213_RDATA1_ADDR A:0x2aaa01c
y.create.l HWIO_PMIC_ARB2_CHNL214_RDATA1_ADDR A:0x2ab201c
y.create.l HWIO_PMIC_ARB2_CHNL215_RDATA1_ADDR A:0x2aba01c
y.create.l HWIO_PMIC_ARB2_CHNL216_RDATA1_ADDR A:0x2ac201c
y.create.l HWIO_PMIC_ARB2_CHNL217_RDATA1_ADDR A:0x2aca01c
y.create.l HWIO_PMIC_ARB2_CHNL218_RDATA1_ADDR A:0x2ad201c
y.create.l HWIO_PMIC_ARB2_CHNL219_RDATA1_ADDR A:0x2ada01c
y.create.l HWIO_PMIC_ARB2_CHNL220_RDATA1_ADDR A:0x2ae201c
y.create.l HWIO_PMIC_ARB2_CHNL221_RDATA1_ADDR A:0x2aea01c
y.create.l HWIO_PMIC_ARB2_CHNL222_RDATA1_ADDR A:0x2af201c
y.create.l HWIO_PMIC_ARB2_CHNL223_RDATA1_ADDR A:0x2afa01c
y.create.l HWIO_PMIC_ARB2_CHNL224_RDATA1_ADDR A:0x2b0201c
y.create.l HWIO_PMIC_ARB2_CHNL225_RDATA1_ADDR A:0x2b0a01c
y.create.l HWIO_PMIC_ARB2_CHNL226_RDATA1_ADDR A:0x2b1201c
y.create.l HWIO_PMIC_ARB2_CHNL227_RDATA1_ADDR A:0x2b1a01c
y.create.l HWIO_PMIC_ARB2_CHNL228_RDATA1_ADDR A:0x2b2201c
y.create.l HWIO_PMIC_ARB2_CHNL229_RDATA1_ADDR A:0x2b2a01c
y.create.l HWIO_PMIC_ARB2_CHNL230_RDATA1_ADDR A:0x2b3201c
y.create.l HWIO_PMIC_ARB2_CHNL231_RDATA1_ADDR A:0x2b3a01c
y.create.l HWIO_PMIC_ARB2_CHNL232_RDATA1_ADDR A:0x2b4201c
y.create.l HWIO_PMIC_ARB2_CHNL233_RDATA1_ADDR A:0x2b4a01c
y.create.l HWIO_PMIC_ARB2_CHNL234_RDATA1_ADDR A:0x2b5201c
y.create.l HWIO_PMIC_ARB2_CHNL235_RDATA1_ADDR A:0x2b5a01c
y.create.l HWIO_PMIC_ARB2_CHNL236_RDATA1_ADDR A:0x2b6201c
y.create.l HWIO_PMIC_ARB2_CHNL237_RDATA1_ADDR A:0x2b6a01c
y.create.l HWIO_PMIC_ARB2_CHNL238_RDATA1_ADDR A:0x2b7201c
y.create.l HWIO_PMIC_ARB2_CHNL239_RDATA1_ADDR A:0x2b7a01c
y.create.l HWIO_PMIC_ARB2_CHNL240_RDATA1_ADDR A:0x2b8201c
y.create.l HWIO_PMIC_ARB2_CHNL241_RDATA1_ADDR A:0x2b8a01c
y.create.l HWIO_PMIC_ARB2_CHNL242_RDATA1_ADDR A:0x2b9201c
y.create.l HWIO_PMIC_ARB2_CHNL243_RDATA1_ADDR A:0x2b9a01c
y.create.l HWIO_PMIC_ARB2_CHNL244_RDATA1_ADDR A:0x2ba201c
y.create.l HWIO_PMIC_ARB2_CHNL245_RDATA1_ADDR A:0x2baa01c
y.create.l HWIO_PMIC_ARB2_CHNL246_RDATA1_ADDR A:0x2bb201c
y.create.l HWIO_PMIC_ARB2_CHNL247_RDATA1_ADDR A:0x2bba01c
y.create.l HWIO_PMIC_ARB2_CHNL248_RDATA1_ADDR A:0x2bc201c
y.create.l HWIO_PMIC_ARB2_CHNL249_RDATA1_ADDR A:0x2bca01c
y.create.l HWIO_PMIC_ARB2_CHNL250_RDATA1_ADDR A:0x2bd201c
y.create.l HWIO_PMIC_ARB2_CHNL251_RDATA1_ADDR A:0x2bda01c
y.create.l HWIO_PMIC_ARB2_CHNL252_RDATA1_ADDR A:0x2be201c
y.create.l HWIO_PMIC_ARB2_CHNL253_RDATA1_ADDR A:0x2bea01c
y.create.l HWIO_PMIC_ARB2_CHNL254_RDATA1_ADDR A:0x2bf201c
y.create.l HWIO_PMIC_ARB2_CHNL255_RDATA1_ADDR A:0x2bfa01c
y.create.l HWIO_PMIC_ARB3_CHNL0_RDATA1_ADDR A:0x240301c
y.create.l HWIO_PMIC_ARB3_CHNL1_RDATA1_ADDR A:0x240b01c
y.create.l HWIO_PMIC_ARB3_CHNL2_RDATA1_ADDR A:0x241301c
y.create.l HWIO_PMIC_ARB3_CHNL3_RDATA1_ADDR A:0x241b01c
y.create.l HWIO_PMIC_ARB3_CHNL4_RDATA1_ADDR A:0x242301c
y.create.l HWIO_PMIC_ARB3_CHNL5_RDATA1_ADDR A:0x242b01c
y.create.l HWIO_PMIC_ARB3_CHNL6_RDATA1_ADDR A:0x243301c
y.create.l HWIO_PMIC_ARB3_CHNL7_RDATA1_ADDR A:0x243b01c
y.create.l HWIO_PMIC_ARB3_CHNL8_RDATA1_ADDR A:0x244301c
y.create.l HWIO_PMIC_ARB3_CHNL9_RDATA1_ADDR A:0x244b01c
y.create.l HWIO_PMIC_ARB3_CHNL10_RDATA1_ADDR A:0x245301c
y.create.l HWIO_PMIC_ARB3_CHNL11_RDATA1_ADDR A:0x245b01c
y.create.l HWIO_PMIC_ARB3_CHNL12_RDATA1_ADDR A:0x246301c
y.create.l HWIO_PMIC_ARB3_CHNL13_RDATA1_ADDR A:0x246b01c
y.create.l HWIO_PMIC_ARB3_CHNL14_RDATA1_ADDR A:0x247301c
y.create.l HWIO_PMIC_ARB3_CHNL15_RDATA1_ADDR A:0x247b01c
y.create.l HWIO_PMIC_ARB3_CHNL16_RDATA1_ADDR A:0x248301c
y.create.l HWIO_PMIC_ARB3_CHNL17_RDATA1_ADDR A:0x248b01c
y.create.l HWIO_PMIC_ARB3_CHNL18_RDATA1_ADDR A:0x249301c
y.create.l HWIO_PMIC_ARB3_CHNL19_RDATA1_ADDR A:0x249b01c
y.create.l HWIO_PMIC_ARB3_CHNL20_RDATA1_ADDR A:0x24a301c
y.create.l HWIO_PMIC_ARB3_CHNL21_RDATA1_ADDR A:0x24ab01c
y.create.l HWIO_PMIC_ARB3_CHNL22_RDATA1_ADDR A:0x24b301c
y.create.l HWIO_PMIC_ARB3_CHNL23_RDATA1_ADDR A:0x24bb01c
y.create.l HWIO_PMIC_ARB3_CHNL24_RDATA1_ADDR A:0x24c301c
y.create.l HWIO_PMIC_ARB3_CHNL25_RDATA1_ADDR A:0x24cb01c
y.create.l HWIO_PMIC_ARB3_CHNL26_RDATA1_ADDR A:0x24d301c
y.create.l HWIO_PMIC_ARB3_CHNL27_RDATA1_ADDR A:0x24db01c
y.create.l HWIO_PMIC_ARB3_CHNL28_RDATA1_ADDR A:0x24e301c
y.create.l HWIO_PMIC_ARB3_CHNL29_RDATA1_ADDR A:0x24eb01c
y.create.l HWIO_PMIC_ARB3_CHNL30_RDATA1_ADDR A:0x24f301c
y.create.l HWIO_PMIC_ARB3_CHNL31_RDATA1_ADDR A:0x24fb01c
y.create.l HWIO_PMIC_ARB3_CHNL32_RDATA1_ADDR A:0x250301c
y.create.l HWIO_PMIC_ARB3_CHNL33_RDATA1_ADDR A:0x250b01c
y.create.l HWIO_PMIC_ARB3_CHNL34_RDATA1_ADDR A:0x251301c
y.create.l HWIO_PMIC_ARB3_CHNL35_RDATA1_ADDR A:0x251b01c
y.create.l HWIO_PMIC_ARB3_CHNL36_RDATA1_ADDR A:0x252301c
y.create.l HWIO_PMIC_ARB3_CHNL37_RDATA1_ADDR A:0x252b01c
y.create.l HWIO_PMIC_ARB3_CHNL38_RDATA1_ADDR A:0x253301c
y.create.l HWIO_PMIC_ARB3_CHNL39_RDATA1_ADDR A:0x253b01c
y.create.l HWIO_PMIC_ARB3_CHNL40_RDATA1_ADDR A:0x254301c
y.create.l HWIO_PMIC_ARB3_CHNL41_RDATA1_ADDR A:0x254b01c
y.create.l HWIO_PMIC_ARB3_CHNL42_RDATA1_ADDR A:0x255301c
y.create.l HWIO_PMIC_ARB3_CHNL43_RDATA1_ADDR A:0x255b01c
y.create.l HWIO_PMIC_ARB3_CHNL44_RDATA1_ADDR A:0x256301c
y.create.l HWIO_PMIC_ARB3_CHNL45_RDATA1_ADDR A:0x256b01c
y.create.l HWIO_PMIC_ARB3_CHNL46_RDATA1_ADDR A:0x257301c
y.create.l HWIO_PMIC_ARB3_CHNL47_RDATA1_ADDR A:0x257b01c
y.create.l HWIO_PMIC_ARB3_CHNL48_RDATA1_ADDR A:0x258301c
y.create.l HWIO_PMIC_ARB3_CHNL49_RDATA1_ADDR A:0x258b01c
y.create.l HWIO_PMIC_ARB3_CHNL50_RDATA1_ADDR A:0x259301c
y.create.l HWIO_PMIC_ARB3_CHNL51_RDATA1_ADDR A:0x259b01c
y.create.l HWIO_PMIC_ARB3_CHNL52_RDATA1_ADDR A:0x25a301c
y.create.l HWIO_PMIC_ARB3_CHNL53_RDATA1_ADDR A:0x25ab01c
y.create.l HWIO_PMIC_ARB3_CHNL54_RDATA1_ADDR A:0x25b301c
y.create.l HWIO_PMIC_ARB3_CHNL55_RDATA1_ADDR A:0x25bb01c
y.create.l HWIO_PMIC_ARB3_CHNL56_RDATA1_ADDR A:0x25c301c
y.create.l HWIO_PMIC_ARB3_CHNL57_RDATA1_ADDR A:0x25cb01c
y.create.l HWIO_PMIC_ARB3_CHNL58_RDATA1_ADDR A:0x25d301c
y.create.l HWIO_PMIC_ARB3_CHNL59_RDATA1_ADDR A:0x25db01c
y.create.l HWIO_PMIC_ARB3_CHNL60_RDATA1_ADDR A:0x25e301c
y.create.l HWIO_PMIC_ARB3_CHNL61_RDATA1_ADDR A:0x25eb01c
y.create.l HWIO_PMIC_ARB3_CHNL62_RDATA1_ADDR A:0x25f301c
y.create.l HWIO_PMIC_ARB3_CHNL63_RDATA1_ADDR A:0x25fb01c
y.create.l HWIO_PMIC_ARB3_CHNL64_RDATA1_ADDR A:0x260301c
y.create.l HWIO_PMIC_ARB3_CHNL65_RDATA1_ADDR A:0x260b01c
y.create.l HWIO_PMIC_ARB3_CHNL66_RDATA1_ADDR A:0x261301c
y.create.l HWIO_PMIC_ARB3_CHNL67_RDATA1_ADDR A:0x261b01c
y.create.l HWIO_PMIC_ARB3_CHNL68_RDATA1_ADDR A:0x262301c
y.create.l HWIO_PMIC_ARB3_CHNL69_RDATA1_ADDR A:0x262b01c
y.create.l HWIO_PMIC_ARB3_CHNL70_RDATA1_ADDR A:0x263301c
y.create.l HWIO_PMIC_ARB3_CHNL71_RDATA1_ADDR A:0x263b01c
y.create.l HWIO_PMIC_ARB3_CHNL72_RDATA1_ADDR A:0x264301c
y.create.l HWIO_PMIC_ARB3_CHNL73_RDATA1_ADDR A:0x264b01c
y.create.l HWIO_PMIC_ARB3_CHNL74_RDATA1_ADDR A:0x265301c
y.create.l HWIO_PMIC_ARB3_CHNL75_RDATA1_ADDR A:0x265b01c
y.create.l HWIO_PMIC_ARB3_CHNL76_RDATA1_ADDR A:0x266301c
y.create.l HWIO_PMIC_ARB3_CHNL77_RDATA1_ADDR A:0x266b01c
y.create.l HWIO_PMIC_ARB3_CHNL78_RDATA1_ADDR A:0x267301c
y.create.l HWIO_PMIC_ARB3_CHNL79_RDATA1_ADDR A:0x267b01c
y.create.l HWIO_PMIC_ARB3_CHNL80_RDATA1_ADDR A:0x268301c
y.create.l HWIO_PMIC_ARB3_CHNL81_RDATA1_ADDR A:0x268b01c
y.create.l HWIO_PMIC_ARB3_CHNL82_RDATA1_ADDR A:0x269301c
y.create.l HWIO_PMIC_ARB3_CHNL83_RDATA1_ADDR A:0x269b01c
y.create.l HWIO_PMIC_ARB3_CHNL84_RDATA1_ADDR A:0x26a301c
y.create.l HWIO_PMIC_ARB3_CHNL85_RDATA1_ADDR A:0x26ab01c
y.create.l HWIO_PMIC_ARB3_CHNL86_RDATA1_ADDR A:0x26b301c
y.create.l HWIO_PMIC_ARB3_CHNL87_RDATA1_ADDR A:0x26bb01c
y.create.l HWIO_PMIC_ARB3_CHNL88_RDATA1_ADDR A:0x26c301c
y.create.l HWIO_PMIC_ARB3_CHNL89_RDATA1_ADDR A:0x26cb01c
y.create.l HWIO_PMIC_ARB3_CHNL90_RDATA1_ADDR A:0x26d301c
y.create.l HWIO_PMIC_ARB3_CHNL91_RDATA1_ADDR A:0x26db01c
y.create.l HWIO_PMIC_ARB3_CHNL92_RDATA1_ADDR A:0x26e301c
y.create.l HWIO_PMIC_ARB3_CHNL93_RDATA1_ADDR A:0x26eb01c
y.create.l HWIO_PMIC_ARB3_CHNL94_RDATA1_ADDR A:0x26f301c
y.create.l HWIO_PMIC_ARB3_CHNL95_RDATA1_ADDR A:0x26fb01c
y.create.l HWIO_PMIC_ARB3_CHNL96_RDATA1_ADDR A:0x270301c
y.create.l HWIO_PMIC_ARB3_CHNL97_RDATA1_ADDR A:0x270b01c
y.create.l HWIO_PMIC_ARB3_CHNL98_RDATA1_ADDR A:0x271301c
y.create.l HWIO_PMIC_ARB3_CHNL99_RDATA1_ADDR A:0x271b01c
y.create.l HWIO_PMIC_ARB3_CHNL100_RDATA1_ADDR A:0x272301c
y.create.l HWIO_PMIC_ARB3_CHNL101_RDATA1_ADDR A:0x272b01c
y.create.l HWIO_PMIC_ARB3_CHNL102_RDATA1_ADDR A:0x273301c
y.create.l HWIO_PMIC_ARB3_CHNL103_RDATA1_ADDR A:0x273b01c
y.create.l HWIO_PMIC_ARB3_CHNL104_RDATA1_ADDR A:0x274301c
y.create.l HWIO_PMIC_ARB3_CHNL105_RDATA1_ADDR A:0x274b01c
y.create.l HWIO_PMIC_ARB3_CHNL106_RDATA1_ADDR A:0x275301c
y.create.l HWIO_PMIC_ARB3_CHNL107_RDATA1_ADDR A:0x275b01c
y.create.l HWIO_PMIC_ARB3_CHNL108_RDATA1_ADDR A:0x276301c
y.create.l HWIO_PMIC_ARB3_CHNL109_RDATA1_ADDR A:0x276b01c
y.create.l HWIO_PMIC_ARB3_CHNL110_RDATA1_ADDR A:0x277301c
y.create.l HWIO_PMIC_ARB3_CHNL111_RDATA1_ADDR A:0x277b01c
y.create.l HWIO_PMIC_ARB3_CHNL112_RDATA1_ADDR A:0x278301c
y.create.l HWIO_PMIC_ARB3_CHNL113_RDATA1_ADDR A:0x278b01c
y.create.l HWIO_PMIC_ARB3_CHNL114_RDATA1_ADDR A:0x279301c
y.create.l HWIO_PMIC_ARB3_CHNL115_RDATA1_ADDR A:0x279b01c
y.create.l HWIO_PMIC_ARB3_CHNL116_RDATA1_ADDR A:0x27a301c
y.create.l HWIO_PMIC_ARB3_CHNL117_RDATA1_ADDR A:0x27ab01c
y.create.l HWIO_PMIC_ARB3_CHNL118_RDATA1_ADDR A:0x27b301c
y.create.l HWIO_PMIC_ARB3_CHNL119_RDATA1_ADDR A:0x27bb01c
y.create.l HWIO_PMIC_ARB3_CHNL120_RDATA1_ADDR A:0x27c301c
y.create.l HWIO_PMIC_ARB3_CHNL121_RDATA1_ADDR A:0x27cb01c
y.create.l HWIO_PMIC_ARB3_CHNL122_RDATA1_ADDR A:0x27d301c
y.create.l HWIO_PMIC_ARB3_CHNL123_RDATA1_ADDR A:0x27db01c
y.create.l HWIO_PMIC_ARB3_CHNL124_RDATA1_ADDR A:0x27e301c
y.create.l HWIO_PMIC_ARB3_CHNL125_RDATA1_ADDR A:0x27eb01c
y.create.l HWIO_PMIC_ARB3_CHNL126_RDATA1_ADDR A:0x27f301c
y.create.l HWIO_PMIC_ARB3_CHNL127_RDATA1_ADDR A:0x27fb01c
y.create.l HWIO_PMIC_ARB3_CHNL128_RDATA1_ADDR A:0x280301c
y.create.l HWIO_PMIC_ARB3_CHNL129_RDATA1_ADDR A:0x280b01c
y.create.l HWIO_PMIC_ARB3_CHNL130_RDATA1_ADDR A:0x281301c
y.create.l HWIO_PMIC_ARB3_CHNL131_RDATA1_ADDR A:0x281b01c
y.create.l HWIO_PMIC_ARB3_CHNL132_RDATA1_ADDR A:0x282301c
y.create.l HWIO_PMIC_ARB3_CHNL133_RDATA1_ADDR A:0x282b01c
y.create.l HWIO_PMIC_ARB3_CHNL134_RDATA1_ADDR A:0x283301c
y.create.l HWIO_PMIC_ARB3_CHNL135_RDATA1_ADDR A:0x283b01c
y.create.l HWIO_PMIC_ARB3_CHNL136_RDATA1_ADDR A:0x284301c
y.create.l HWIO_PMIC_ARB3_CHNL137_RDATA1_ADDR A:0x284b01c
y.create.l HWIO_PMIC_ARB3_CHNL138_RDATA1_ADDR A:0x285301c
y.create.l HWIO_PMIC_ARB3_CHNL139_RDATA1_ADDR A:0x285b01c
y.create.l HWIO_PMIC_ARB3_CHNL140_RDATA1_ADDR A:0x286301c
y.create.l HWIO_PMIC_ARB3_CHNL141_RDATA1_ADDR A:0x286b01c
y.create.l HWIO_PMIC_ARB3_CHNL142_RDATA1_ADDR A:0x287301c
y.create.l HWIO_PMIC_ARB3_CHNL143_RDATA1_ADDR A:0x287b01c
y.create.l HWIO_PMIC_ARB3_CHNL144_RDATA1_ADDR A:0x288301c
y.create.l HWIO_PMIC_ARB3_CHNL145_RDATA1_ADDR A:0x288b01c
y.create.l HWIO_PMIC_ARB3_CHNL146_RDATA1_ADDR A:0x289301c
y.create.l HWIO_PMIC_ARB3_CHNL147_RDATA1_ADDR A:0x289b01c
y.create.l HWIO_PMIC_ARB3_CHNL148_RDATA1_ADDR A:0x28a301c
y.create.l HWIO_PMIC_ARB3_CHNL149_RDATA1_ADDR A:0x28ab01c
y.create.l HWIO_PMIC_ARB3_CHNL150_RDATA1_ADDR A:0x28b301c
y.create.l HWIO_PMIC_ARB3_CHNL151_RDATA1_ADDR A:0x28bb01c
y.create.l HWIO_PMIC_ARB3_CHNL152_RDATA1_ADDR A:0x28c301c
y.create.l HWIO_PMIC_ARB3_CHNL153_RDATA1_ADDR A:0x28cb01c
y.create.l HWIO_PMIC_ARB3_CHNL154_RDATA1_ADDR A:0x28d301c
y.create.l HWIO_PMIC_ARB3_CHNL155_RDATA1_ADDR A:0x28db01c
y.create.l HWIO_PMIC_ARB3_CHNL156_RDATA1_ADDR A:0x28e301c
y.create.l HWIO_PMIC_ARB3_CHNL157_RDATA1_ADDR A:0x28eb01c
y.create.l HWIO_PMIC_ARB3_CHNL158_RDATA1_ADDR A:0x28f301c
y.create.l HWIO_PMIC_ARB3_CHNL159_RDATA1_ADDR A:0x28fb01c
y.create.l HWIO_PMIC_ARB3_CHNL160_RDATA1_ADDR A:0x290301c
y.create.l HWIO_PMIC_ARB3_CHNL161_RDATA1_ADDR A:0x290b01c
y.create.l HWIO_PMIC_ARB3_CHNL162_RDATA1_ADDR A:0x291301c
y.create.l HWIO_PMIC_ARB3_CHNL163_RDATA1_ADDR A:0x291b01c
y.create.l HWIO_PMIC_ARB3_CHNL164_RDATA1_ADDR A:0x292301c
y.create.l HWIO_PMIC_ARB3_CHNL165_RDATA1_ADDR A:0x292b01c
y.create.l HWIO_PMIC_ARB3_CHNL166_RDATA1_ADDR A:0x293301c
y.create.l HWIO_PMIC_ARB3_CHNL167_RDATA1_ADDR A:0x293b01c
y.create.l HWIO_PMIC_ARB3_CHNL168_RDATA1_ADDR A:0x294301c
y.create.l HWIO_PMIC_ARB3_CHNL169_RDATA1_ADDR A:0x294b01c
y.create.l HWIO_PMIC_ARB3_CHNL170_RDATA1_ADDR A:0x295301c
y.create.l HWIO_PMIC_ARB3_CHNL171_RDATA1_ADDR A:0x295b01c
y.create.l HWIO_PMIC_ARB3_CHNL172_RDATA1_ADDR A:0x296301c
y.create.l HWIO_PMIC_ARB3_CHNL173_RDATA1_ADDR A:0x296b01c
y.create.l HWIO_PMIC_ARB3_CHNL174_RDATA1_ADDR A:0x297301c
y.create.l HWIO_PMIC_ARB3_CHNL175_RDATA1_ADDR A:0x297b01c
y.create.l HWIO_PMIC_ARB3_CHNL176_RDATA1_ADDR A:0x298301c
y.create.l HWIO_PMIC_ARB3_CHNL177_RDATA1_ADDR A:0x298b01c
y.create.l HWIO_PMIC_ARB3_CHNL178_RDATA1_ADDR A:0x299301c
y.create.l HWIO_PMIC_ARB3_CHNL179_RDATA1_ADDR A:0x299b01c
y.create.l HWIO_PMIC_ARB3_CHNL180_RDATA1_ADDR A:0x29a301c
y.create.l HWIO_PMIC_ARB3_CHNL181_RDATA1_ADDR A:0x29ab01c
y.create.l HWIO_PMIC_ARB3_CHNL182_RDATA1_ADDR A:0x29b301c
y.create.l HWIO_PMIC_ARB3_CHNL183_RDATA1_ADDR A:0x29bb01c
y.create.l HWIO_PMIC_ARB3_CHNL184_RDATA1_ADDR A:0x29c301c
y.create.l HWIO_PMIC_ARB3_CHNL185_RDATA1_ADDR A:0x29cb01c
y.create.l HWIO_PMIC_ARB3_CHNL186_RDATA1_ADDR A:0x29d301c
y.create.l HWIO_PMIC_ARB3_CHNL187_RDATA1_ADDR A:0x29db01c
y.create.l HWIO_PMIC_ARB3_CHNL188_RDATA1_ADDR A:0x29e301c
y.create.l HWIO_PMIC_ARB3_CHNL189_RDATA1_ADDR A:0x29eb01c
y.create.l HWIO_PMIC_ARB3_CHNL190_RDATA1_ADDR A:0x29f301c
y.create.l HWIO_PMIC_ARB3_CHNL191_RDATA1_ADDR A:0x29fb01c
y.create.l HWIO_PMIC_ARB3_CHNL192_RDATA1_ADDR A:0x2a0301c
y.create.l HWIO_PMIC_ARB3_CHNL193_RDATA1_ADDR A:0x2a0b01c
y.create.l HWIO_PMIC_ARB3_CHNL194_RDATA1_ADDR A:0x2a1301c
y.create.l HWIO_PMIC_ARB3_CHNL195_RDATA1_ADDR A:0x2a1b01c
y.create.l HWIO_PMIC_ARB3_CHNL196_RDATA1_ADDR A:0x2a2301c
y.create.l HWIO_PMIC_ARB3_CHNL197_RDATA1_ADDR A:0x2a2b01c
y.create.l HWIO_PMIC_ARB3_CHNL198_RDATA1_ADDR A:0x2a3301c
y.create.l HWIO_PMIC_ARB3_CHNL199_RDATA1_ADDR A:0x2a3b01c
y.create.l HWIO_PMIC_ARB3_CHNL200_RDATA1_ADDR A:0x2a4301c
y.create.l HWIO_PMIC_ARB3_CHNL201_RDATA1_ADDR A:0x2a4b01c
y.create.l HWIO_PMIC_ARB3_CHNL202_RDATA1_ADDR A:0x2a5301c
y.create.l HWIO_PMIC_ARB3_CHNL203_RDATA1_ADDR A:0x2a5b01c
y.create.l HWIO_PMIC_ARB3_CHNL204_RDATA1_ADDR A:0x2a6301c
y.create.l HWIO_PMIC_ARB3_CHNL205_RDATA1_ADDR A:0x2a6b01c
y.create.l HWIO_PMIC_ARB3_CHNL206_RDATA1_ADDR A:0x2a7301c
y.create.l HWIO_PMIC_ARB3_CHNL207_RDATA1_ADDR A:0x2a7b01c
y.create.l HWIO_PMIC_ARB3_CHNL208_RDATA1_ADDR A:0x2a8301c
y.create.l HWIO_PMIC_ARB3_CHNL209_RDATA1_ADDR A:0x2a8b01c
y.create.l HWIO_PMIC_ARB3_CHNL210_RDATA1_ADDR A:0x2a9301c
y.create.l HWIO_PMIC_ARB3_CHNL211_RDATA1_ADDR A:0x2a9b01c
y.create.l HWIO_PMIC_ARB3_CHNL212_RDATA1_ADDR A:0x2aa301c
y.create.l HWIO_PMIC_ARB3_CHNL213_RDATA1_ADDR A:0x2aab01c
y.create.l HWIO_PMIC_ARB3_CHNL214_RDATA1_ADDR A:0x2ab301c
y.create.l HWIO_PMIC_ARB3_CHNL215_RDATA1_ADDR A:0x2abb01c
y.create.l HWIO_PMIC_ARB3_CHNL216_RDATA1_ADDR A:0x2ac301c
y.create.l HWIO_PMIC_ARB3_CHNL217_RDATA1_ADDR A:0x2acb01c
y.create.l HWIO_PMIC_ARB3_CHNL218_RDATA1_ADDR A:0x2ad301c
y.create.l HWIO_PMIC_ARB3_CHNL219_RDATA1_ADDR A:0x2adb01c
y.create.l HWIO_PMIC_ARB3_CHNL220_RDATA1_ADDR A:0x2ae301c
y.create.l HWIO_PMIC_ARB3_CHNL221_RDATA1_ADDR A:0x2aeb01c
y.create.l HWIO_PMIC_ARB3_CHNL222_RDATA1_ADDR A:0x2af301c
y.create.l HWIO_PMIC_ARB3_CHNL223_RDATA1_ADDR A:0x2afb01c
y.create.l HWIO_PMIC_ARB3_CHNL224_RDATA1_ADDR A:0x2b0301c
y.create.l HWIO_PMIC_ARB3_CHNL225_RDATA1_ADDR A:0x2b0b01c
y.create.l HWIO_PMIC_ARB3_CHNL226_RDATA1_ADDR A:0x2b1301c
y.create.l HWIO_PMIC_ARB3_CHNL227_RDATA1_ADDR A:0x2b1b01c
y.create.l HWIO_PMIC_ARB3_CHNL228_RDATA1_ADDR A:0x2b2301c
y.create.l HWIO_PMIC_ARB3_CHNL229_RDATA1_ADDR A:0x2b2b01c
y.create.l HWIO_PMIC_ARB3_CHNL230_RDATA1_ADDR A:0x2b3301c
y.create.l HWIO_PMIC_ARB3_CHNL231_RDATA1_ADDR A:0x2b3b01c
y.create.l HWIO_PMIC_ARB3_CHNL232_RDATA1_ADDR A:0x2b4301c
y.create.l HWIO_PMIC_ARB3_CHNL233_RDATA1_ADDR A:0x2b4b01c
y.create.l HWIO_PMIC_ARB3_CHNL234_RDATA1_ADDR A:0x2b5301c
y.create.l HWIO_PMIC_ARB3_CHNL235_RDATA1_ADDR A:0x2b5b01c
y.create.l HWIO_PMIC_ARB3_CHNL236_RDATA1_ADDR A:0x2b6301c
y.create.l HWIO_PMIC_ARB3_CHNL237_RDATA1_ADDR A:0x2b6b01c
y.create.l HWIO_PMIC_ARB3_CHNL238_RDATA1_ADDR A:0x2b7301c
y.create.l HWIO_PMIC_ARB3_CHNL239_RDATA1_ADDR A:0x2b7b01c
y.create.l HWIO_PMIC_ARB3_CHNL240_RDATA1_ADDR A:0x2b8301c
y.create.l HWIO_PMIC_ARB3_CHNL241_RDATA1_ADDR A:0x2b8b01c
y.create.l HWIO_PMIC_ARB3_CHNL242_RDATA1_ADDR A:0x2b9301c
y.create.l HWIO_PMIC_ARB3_CHNL243_RDATA1_ADDR A:0x2b9b01c
y.create.l HWIO_PMIC_ARB3_CHNL244_RDATA1_ADDR A:0x2ba301c
y.create.l HWIO_PMIC_ARB3_CHNL245_RDATA1_ADDR A:0x2bab01c
y.create.l HWIO_PMIC_ARB3_CHNL246_RDATA1_ADDR A:0x2bb301c
y.create.l HWIO_PMIC_ARB3_CHNL247_RDATA1_ADDR A:0x2bbb01c
y.create.l HWIO_PMIC_ARB3_CHNL248_RDATA1_ADDR A:0x2bc301c
y.create.l HWIO_PMIC_ARB3_CHNL249_RDATA1_ADDR A:0x2bcb01c
y.create.l HWIO_PMIC_ARB3_CHNL250_RDATA1_ADDR A:0x2bd301c
y.create.l HWIO_PMIC_ARB3_CHNL251_RDATA1_ADDR A:0x2bdb01c
y.create.l HWIO_PMIC_ARB3_CHNL252_RDATA1_ADDR A:0x2be301c
y.create.l HWIO_PMIC_ARB3_CHNL253_RDATA1_ADDR A:0x2beb01c
y.create.l HWIO_PMIC_ARB3_CHNL254_RDATA1_ADDR A:0x2bf301c
y.create.l HWIO_PMIC_ARB3_CHNL255_RDATA1_ADDR A:0x2bfb01c
y.create.l HWIO_PMIC_ARB4_CHNL0_RDATA1_ADDR A:0x240401c
y.create.l HWIO_PMIC_ARB4_CHNL1_RDATA1_ADDR A:0x240c01c
y.create.l HWIO_PMIC_ARB4_CHNL2_RDATA1_ADDR A:0x241401c
y.create.l HWIO_PMIC_ARB4_CHNL3_RDATA1_ADDR A:0x241c01c
y.create.l HWIO_PMIC_ARB4_CHNL4_RDATA1_ADDR A:0x242401c
y.create.l HWIO_PMIC_ARB4_CHNL5_RDATA1_ADDR A:0x242c01c
y.create.l HWIO_PMIC_ARB4_CHNL6_RDATA1_ADDR A:0x243401c
y.create.l HWIO_PMIC_ARB4_CHNL7_RDATA1_ADDR A:0x243c01c
y.create.l HWIO_PMIC_ARB4_CHNL8_RDATA1_ADDR A:0x244401c
y.create.l HWIO_PMIC_ARB4_CHNL9_RDATA1_ADDR A:0x244c01c
y.create.l HWIO_PMIC_ARB4_CHNL10_RDATA1_ADDR A:0x245401c
y.create.l HWIO_PMIC_ARB4_CHNL11_RDATA1_ADDR A:0x245c01c
y.create.l HWIO_PMIC_ARB4_CHNL12_RDATA1_ADDR A:0x246401c
y.create.l HWIO_PMIC_ARB4_CHNL13_RDATA1_ADDR A:0x246c01c
y.create.l HWIO_PMIC_ARB4_CHNL14_RDATA1_ADDR A:0x247401c
y.create.l HWIO_PMIC_ARB4_CHNL15_RDATA1_ADDR A:0x247c01c
y.create.l HWIO_PMIC_ARB4_CHNL16_RDATA1_ADDR A:0x248401c
y.create.l HWIO_PMIC_ARB4_CHNL17_RDATA1_ADDR A:0x248c01c
y.create.l HWIO_PMIC_ARB4_CHNL18_RDATA1_ADDR A:0x249401c
y.create.l HWIO_PMIC_ARB4_CHNL19_RDATA1_ADDR A:0x249c01c
y.create.l HWIO_PMIC_ARB4_CHNL20_RDATA1_ADDR A:0x24a401c
y.create.l HWIO_PMIC_ARB4_CHNL21_RDATA1_ADDR A:0x24ac01c
y.create.l HWIO_PMIC_ARB4_CHNL22_RDATA1_ADDR A:0x24b401c
y.create.l HWIO_PMIC_ARB4_CHNL23_RDATA1_ADDR A:0x24bc01c
y.create.l HWIO_PMIC_ARB4_CHNL24_RDATA1_ADDR A:0x24c401c
y.create.l HWIO_PMIC_ARB4_CHNL25_RDATA1_ADDR A:0x24cc01c
y.create.l HWIO_PMIC_ARB4_CHNL26_RDATA1_ADDR A:0x24d401c
y.create.l HWIO_PMIC_ARB4_CHNL27_RDATA1_ADDR A:0x24dc01c
y.create.l HWIO_PMIC_ARB4_CHNL28_RDATA1_ADDR A:0x24e401c
y.create.l HWIO_PMIC_ARB4_CHNL29_RDATA1_ADDR A:0x24ec01c
y.create.l HWIO_PMIC_ARB4_CHNL30_RDATA1_ADDR A:0x24f401c
y.create.l HWIO_PMIC_ARB4_CHNL31_RDATA1_ADDR A:0x24fc01c
y.create.l HWIO_PMIC_ARB4_CHNL32_RDATA1_ADDR A:0x250401c
y.create.l HWIO_PMIC_ARB4_CHNL33_RDATA1_ADDR A:0x250c01c
y.create.l HWIO_PMIC_ARB4_CHNL34_RDATA1_ADDR A:0x251401c
y.create.l HWIO_PMIC_ARB4_CHNL35_RDATA1_ADDR A:0x251c01c
y.create.l HWIO_PMIC_ARB4_CHNL36_RDATA1_ADDR A:0x252401c
y.create.l HWIO_PMIC_ARB4_CHNL37_RDATA1_ADDR A:0x252c01c
y.create.l HWIO_PMIC_ARB4_CHNL38_RDATA1_ADDR A:0x253401c
y.create.l HWIO_PMIC_ARB4_CHNL39_RDATA1_ADDR A:0x253c01c
y.create.l HWIO_PMIC_ARB4_CHNL40_RDATA1_ADDR A:0x254401c
y.create.l HWIO_PMIC_ARB4_CHNL41_RDATA1_ADDR A:0x254c01c
y.create.l HWIO_PMIC_ARB4_CHNL42_RDATA1_ADDR A:0x255401c
y.create.l HWIO_PMIC_ARB4_CHNL43_RDATA1_ADDR A:0x255c01c
y.create.l HWIO_PMIC_ARB4_CHNL44_RDATA1_ADDR A:0x256401c
y.create.l HWIO_PMIC_ARB4_CHNL45_RDATA1_ADDR A:0x256c01c
y.create.l HWIO_PMIC_ARB4_CHNL46_RDATA1_ADDR A:0x257401c
y.create.l HWIO_PMIC_ARB4_CHNL47_RDATA1_ADDR A:0x257c01c
y.create.l HWIO_PMIC_ARB4_CHNL48_RDATA1_ADDR A:0x258401c
y.create.l HWIO_PMIC_ARB4_CHNL49_RDATA1_ADDR A:0x258c01c
y.create.l HWIO_PMIC_ARB4_CHNL50_RDATA1_ADDR A:0x259401c
y.create.l HWIO_PMIC_ARB4_CHNL51_RDATA1_ADDR A:0x259c01c
y.create.l HWIO_PMIC_ARB4_CHNL52_RDATA1_ADDR A:0x25a401c
y.create.l HWIO_PMIC_ARB4_CHNL53_RDATA1_ADDR A:0x25ac01c
y.create.l HWIO_PMIC_ARB4_CHNL54_RDATA1_ADDR A:0x25b401c
y.create.l HWIO_PMIC_ARB4_CHNL55_RDATA1_ADDR A:0x25bc01c
y.create.l HWIO_PMIC_ARB4_CHNL56_RDATA1_ADDR A:0x25c401c
y.create.l HWIO_PMIC_ARB4_CHNL57_RDATA1_ADDR A:0x25cc01c
y.create.l HWIO_PMIC_ARB4_CHNL58_RDATA1_ADDR A:0x25d401c
y.create.l HWIO_PMIC_ARB4_CHNL59_RDATA1_ADDR A:0x25dc01c
y.create.l HWIO_PMIC_ARB4_CHNL60_RDATA1_ADDR A:0x25e401c
y.create.l HWIO_PMIC_ARB4_CHNL61_RDATA1_ADDR A:0x25ec01c
y.create.l HWIO_PMIC_ARB4_CHNL62_RDATA1_ADDR A:0x25f401c
y.create.l HWIO_PMIC_ARB4_CHNL63_RDATA1_ADDR A:0x25fc01c
y.create.l HWIO_PMIC_ARB4_CHNL64_RDATA1_ADDR A:0x260401c
y.create.l HWIO_PMIC_ARB4_CHNL65_RDATA1_ADDR A:0x260c01c
y.create.l HWIO_PMIC_ARB4_CHNL66_RDATA1_ADDR A:0x261401c
y.create.l HWIO_PMIC_ARB4_CHNL67_RDATA1_ADDR A:0x261c01c
y.create.l HWIO_PMIC_ARB4_CHNL68_RDATA1_ADDR A:0x262401c
y.create.l HWIO_PMIC_ARB4_CHNL69_RDATA1_ADDR A:0x262c01c
y.create.l HWIO_PMIC_ARB4_CHNL70_RDATA1_ADDR A:0x263401c
y.create.l HWIO_PMIC_ARB4_CHNL71_RDATA1_ADDR A:0x263c01c
y.create.l HWIO_PMIC_ARB4_CHNL72_RDATA1_ADDR A:0x264401c
y.create.l HWIO_PMIC_ARB4_CHNL73_RDATA1_ADDR A:0x264c01c
y.create.l HWIO_PMIC_ARB4_CHNL74_RDATA1_ADDR A:0x265401c
y.create.l HWIO_PMIC_ARB4_CHNL75_RDATA1_ADDR A:0x265c01c
y.create.l HWIO_PMIC_ARB4_CHNL76_RDATA1_ADDR A:0x266401c
y.create.l HWIO_PMIC_ARB4_CHNL77_RDATA1_ADDR A:0x266c01c
y.create.l HWIO_PMIC_ARB4_CHNL78_RDATA1_ADDR A:0x267401c
y.create.l HWIO_PMIC_ARB4_CHNL79_RDATA1_ADDR A:0x267c01c
y.create.l HWIO_PMIC_ARB4_CHNL80_RDATA1_ADDR A:0x268401c
y.create.l HWIO_PMIC_ARB4_CHNL81_RDATA1_ADDR A:0x268c01c
y.create.l HWIO_PMIC_ARB4_CHNL82_RDATA1_ADDR A:0x269401c
y.create.l HWIO_PMIC_ARB4_CHNL83_RDATA1_ADDR A:0x269c01c
y.create.l HWIO_PMIC_ARB4_CHNL84_RDATA1_ADDR A:0x26a401c
y.create.l HWIO_PMIC_ARB4_CHNL85_RDATA1_ADDR A:0x26ac01c
y.create.l HWIO_PMIC_ARB4_CHNL86_RDATA1_ADDR A:0x26b401c
y.create.l HWIO_PMIC_ARB4_CHNL87_RDATA1_ADDR A:0x26bc01c
y.create.l HWIO_PMIC_ARB4_CHNL88_RDATA1_ADDR A:0x26c401c
y.create.l HWIO_PMIC_ARB4_CHNL89_RDATA1_ADDR A:0x26cc01c
y.create.l HWIO_PMIC_ARB4_CHNL90_RDATA1_ADDR A:0x26d401c
y.create.l HWIO_PMIC_ARB4_CHNL91_RDATA1_ADDR A:0x26dc01c
y.create.l HWIO_PMIC_ARB4_CHNL92_RDATA1_ADDR A:0x26e401c
y.create.l HWIO_PMIC_ARB4_CHNL93_RDATA1_ADDR A:0x26ec01c
y.create.l HWIO_PMIC_ARB4_CHNL94_RDATA1_ADDR A:0x26f401c
y.create.l HWIO_PMIC_ARB4_CHNL95_RDATA1_ADDR A:0x26fc01c
y.create.l HWIO_PMIC_ARB4_CHNL96_RDATA1_ADDR A:0x270401c
y.create.l HWIO_PMIC_ARB4_CHNL97_RDATA1_ADDR A:0x270c01c
y.create.l HWIO_PMIC_ARB4_CHNL98_RDATA1_ADDR A:0x271401c
y.create.l HWIO_PMIC_ARB4_CHNL99_RDATA1_ADDR A:0x271c01c
y.create.l HWIO_PMIC_ARB4_CHNL100_RDATA1_ADDR A:0x272401c
y.create.l HWIO_PMIC_ARB4_CHNL101_RDATA1_ADDR A:0x272c01c
y.create.l HWIO_PMIC_ARB4_CHNL102_RDATA1_ADDR A:0x273401c
y.create.l HWIO_PMIC_ARB4_CHNL103_RDATA1_ADDR A:0x273c01c
y.create.l HWIO_PMIC_ARB4_CHNL104_RDATA1_ADDR A:0x274401c
y.create.l HWIO_PMIC_ARB4_CHNL105_RDATA1_ADDR A:0x274c01c
y.create.l HWIO_PMIC_ARB4_CHNL106_RDATA1_ADDR A:0x275401c
y.create.l HWIO_PMIC_ARB4_CHNL107_RDATA1_ADDR A:0x275c01c
y.create.l HWIO_PMIC_ARB4_CHNL108_RDATA1_ADDR A:0x276401c
y.create.l HWIO_PMIC_ARB4_CHNL109_RDATA1_ADDR A:0x276c01c
y.create.l HWIO_PMIC_ARB4_CHNL110_RDATA1_ADDR A:0x277401c
y.create.l HWIO_PMIC_ARB4_CHNL111_RDATA1_ADDR A:0x277c01c
y.create.l HWIO_PMIC_ARB4_CHNL112_RDATA1_ADDR A:0x278401c
y.create.l HWIO_PMIC_ARB4_CHNL113_RDATA1_ADDR A:0x278c01c
y.create.l HWIO_PMIC_ARB4_CHNL114_RDATA1_ADDR A:0x279401c
y.create.l HWIO_PMIC_ARB4_CHNL115_RDATA1_ADDR A:0x279c01c
y.create.l HWIO_PMIC_ARB4_CHNL116_RDATA1_ADDR A:0x27a401c
y.create.l HWIO_PMIC_ARB4_CHNL117_RDATA1_ADDR A:0x27ac01c
y.create.l HWIO_PMIC_ARB4_CHNL118_RDATA1_ADDR A:0x27b401c
y.create.l HWIO_PMIC_ARB4_CHNL119_RDATA1_ADDR A:0x27bc01c
y.create.l HWIO_PMIC_ARB4_CHNL120_RDATA1_ADDR A:0x27c401c
y.create.l HWIO_PMIC_ARB4_CHNL121_RDATA1_ADDR A:0x27cc01c
y.create.l HWIO_PMIC_ARB4_CHNL122_RDATA1_ADDR A:0x27d401c
y.create.l HWIO_PMIC_ARB4_CHNL123_RDATA1_ADDR A:0x27dc01c
y.create.l HWIO_PMIC_ARB4_CHNL124_RDATA1_ADDR A:0x27e401c
y.create.l HWIO_PMIC_ARB4_CHNL125_RDATA1_ADDR A:0x27ec01c
y.create.l HWIO_PMIC_ARB4_CHNL126_RDATA1_ADDR A:0x27f401c
y.create.l HWIO_PMIC_ARB4_CHNL127_RDATA1_ADDR A:0x27fc01c
y.create.l HWIO_PMIC_ARB4_CHNL128_RDATA1_ADDR A:0x280401c
y.create.l HWIO_PMIC_ARB4_CHNL129_RDATA1_ADDR A:0x280c01c
y.create.l HWIO_PMIC_ARB4_CHNL130_RDATA1_ADDR A:0x281401c
y.create.l HWIO_PMIC_ARB4_CHNL131_RDATA1_ADDR A:0x281c01c
y.create.l HWIO_PMIC_ARB4_CHNL132_RDATA1_ADDR A:0x282401c
y.create.l HWIO_PMIC_ARB4_CHNL133_RDATA1_ADDR A:0x282c01c
y.create.l HWIO_PMIC_ARB4_CHNL134_RDATA1_ADDR A:0x283401c
y.create.l HWIO_PMIC_ARB4_CHNL135_RDATA1_ADDR A:0x283c01c
y.create.l HWIO_PMIC_ARB4_CHNL136_RDATA1_ADDR A:0x284401c
y.create.l HWIO_PMIC_ARB4_CHNL137_RDATA1_ADDR A:0x284c01c
y.create.l HWIO_PMIC_ARB4_CHNL138_RDATA1_ADDR A:0x285401c
y.create.l HWIO_PMIC_ARB4_CHNL139_RDATA1_ADDR A:0x285c01c
y.create.l HWIO_PMIC_ARB4_CHNL140_RDATA1_ADDR A:0x286401c
y.create.l HWIO_PMIC_ARB4_CHNL141_RDATA1_ADDR A:0x286c01c
y.create.l HWIO_PMIC_ARB4_CHNL142_RDATA1_ADDR A:0x287401c
y.create.l HWIO_PMIC_ARB4_CHNL143_RDATA1_ADDR A:0x287c01c
y.create.l HWIO_PMIC_ARB4_CHNL144_RDATA1_ADDR A:0x288401c
y.create.l HWIO_PMIC_ARB4_CHNL145_RDATA1_ADDR A:0x288c01c
y.create.l HWIO_PMIC_ARB4_CHNL146_RDATA1_ADDR A:0x289401c
y.create.l HWIO_PMIC_ARB4_CHNL147_RDATA1_ADDR A:0x289c01c
y.create.l HWIO_PMIC_ARB4_CHNL148_RDATA1_ADDR A:0x28a401c
y.create.l HWIO_PMIC_ARB4_CHNL149_RDATA1_ADDR A:0x28ac01c
y.create.l HWIO_PMIC_ARB4_CHNL150_RDATA1_ADDR A:0x28b401c
y.create.l HWIO_PMIC_ARB4_CHNL151_RDATA1_ADDR A:0x28bc01c
y.create.l HWIO_PMIC_ARB4_CHNL152_RDATA1_ADDR A:0x28c401c
y.create.l HWIO_PMIC_ARB4_CHNL153_RDATA1_ADDR A:0x28cc01c
y.create.l HWIO_PMIC_ARB4_CHNL154_RDATA1_ADDR A:0x28d401c
y.create.l HWIO_PMIC_ARB4_CHNL155_RDATA1_ADDR A:0x28dc01c
y.create.l HWIO_PMIC_ARB4_CHNL156_RDATA1_ADDR A:0x28e401c
y.create.l HWIO_PMIC_ARB4_CHNL157_RDATA1_ADDR A:0x28ec01c
y.create.l HWIO_PMIC_ARB4_CHNL158_RDATA1_ADDR A:0x28f401c
y.create.l HWIO_PMIC_ARB4_CHNL159_RDATA1_ADDR A:0x28fc01c
y.create.l HWIO_PMIC_ARB4_CHNL160_RDATA1_ADDR A:0x290401c
y.create.l HWIO_PMIC_ARB4_CHNL161_RDATA1_ADDR A:0x290c01c
y.create.l HWIO_PMIC_ARB4_CHNL162_RDATA1_ADDR A:0x291401c
y.create.l HWIO_PMIC_ARB4_CHNL163_RDATA1_ADDR A:0x291c01c
y.create.l HWIO_PMIC_ARB4_CHNL164_RDATA1_ADDR A:0x292401c
y.create.l HWIO_PMIC_ARB4_CHNL165_RDATA1_ADDR A:0x292c01c
y.create.l HWIO_PMIC_ARB4_CHNL166_RDATA1_ADDR A:0x293401c
y.create.l HWIO_PMIC_ARB4_CHNL167_RDATA1_ADDR A:0x293c01c
y.create.l HWIO_PMIC_ARB4_CHNL168_RDATA1_ADDR A:0x294401c
y.create.l HWIO_PMIC_ARB4_CHNL169_RDATA1_ADDR A:0x294c01c
y.create.l HWIO_PMIC_ARB4_CHNL170_RDATA1_ADDR A:0x295401c
y.create.l HWIO_PMIC_ARB4_CHNL171_RDATA1_ADDR A:0x295c01c
y.create.l HWIO_PMIC_ARB4_CHNL172_RDATA1_ADDR A:0x296401c
y.create.l HWIO_PMIC_ARB4_CHNL173_RDATA1_ADDR A:0x296c01c
y.create.l HWIO_PMIC_ARB4_CHNL174_RDATA1_ADDR A:0x297401c
y.create.l HWIO_PMIC_ARB4_CHNL175_RDATA1_ADDR A:0x297c01c
y.create.l HWIO_PMIC_ARB4_CHNL176_RDATA1_ADDR A:0x298401c
y.create.l HWIO_PMIC_ARB4_CHNL177_RDATA1_ADDR A:0x298c01c
y.create.l HWIO_PMIC_ARB4_CHNL178_RDATA1_ADDR A:0x299401c
y.create.l HWIO_PMIC_ARB4_CHNL179_RDATA1_ADDR A:0x299c01c
y.create.l HWIO_PMIC_ARB4_CHNL180_RDATA1_ADDR A:0x29a401c
y.create.l HWIO_PMIC_ARB4_CHNL181_RDATA1_ADDR A:0x29ac01c
y.create.l HWIO_PMIC_ARB4_CHNL182_RDATA1_ADDR A:0x29b401c
y.create.l HWIO_PMIC_ARB4_CHNL183_RDATA1_ADDR A:0x29bc01c
y.create.l HWIO_PMIC_ARB4_CHNL184_RDATA1_ADDR A:0x29c401c
y.create.l HWIO_PMIC_ARB4_CHNL185_RDATA1_ADDR A:0x29cc01c
y.create.l HWIO_PMIC_ARB4_CHNL186_RDATA1_ADDR A:0x29d401c
y.create.l HWIO_PMIC_ARB4_CHNL187_RDATA1_ADDR A:0x29dc01c
y.create.l HWIO_PMIC_ARB4_CHNL188_RDATA1_ADDR A:0x29e401c
y.create.l HWIO_PMIC_ARB4_CHNL189_RDATA1_ADDR A:0x29ec01c
y.create.l HWIO_PMIC_ARB4_CHNL190_RDATA1_ADDR A:0x29f401c
y.create.l HWIO_PMIC_ARB4_CHNL191_RDATA1_ADDR A:0x29fc01c
y.create.l HWIO_PMIC_ARB4_CHNL192_RDATA1_ADDR A:0x2a0401c
y.create.l HWIO_PMIC_ARB4_CHNL193_RDATA1_ADDR A:0x2a0c01c
y.create.l HWIO_PMIC_ARB4_CHNL194_RDATA1_ADDR A:0x2a1401c
y.create.l HWIO_PMIC_ARB4_CHNL195_RDATA1_ADDR A:0x2a1c01c
y.create.l HWIO_PMIC_ARB4_CHNL196_RDATA1_ADDR A:0x2a2401c
y.create.l HWIO_PMIC_ARB4_CHNL197_RDATA1_ADDR A:0x2a2c01c
y.create.l HWIO_PMIC_ARB4_CHNL198_RDATA1_ADDR A:0x2a3401c
y.create.l HWIO_PMIC_ARB4_CHNL199_RDATA1_ADDR A:0x2a3c01c
y.create.l HWIO_PMIC_ARB4_CHNL200_RDATA1_ADDR A:0x2a4401c
y.create.l HWIO_PMIC_ARB4_CHNL201_RDATA1_ADDR A:0x2a4c01c
y.create.l HWIO_PMIC_ARB4_CHNL202_RDATA1_ADDR A:0x2a5401c
y.create.l HWIO_PMIC_ARB4_CHNL203_RDATA1_ADDR A:0x2a5c01c
y.create.l HWIO_PMIC_ARB4_CHNL204_RDATA1_ADDR A:0x2a6401c
y.create.l HWIO_PMIC_ARB4_CHNL205_RDATA1_ADDR A:0x2a6c01c
y.create.l HWIO_PMIC_ARB4_CHNL206_RDATA1_ADDR A:0x2a7401c
y.create.l HWIO_PMIC_ARB4_CHNL207_RDATA1_ADDR A:0x2a7c01c
y.create.l HWIO_PMIC_ARB4_CHNL208_RDATA1_ADDR A:0x2a8401c
y.create.l HWIO_PMIC_ARB4_CHNL209_RDATA1_ADDR A:0x2a8c01c
y.create.l HWIO_PMIC_ARB4_CHNL210_RDATA1_ADDR A:0x2a9401c
y.create.l HWIO_PMIC_ARB4_CHNL211_RDATA1_ADDR A:0x2a9c01c
y.create.l HWIO_PMIC_ARB4_CHNL212_RDATA1_ADDR A:0x2aa401c
y.create.l HWIO_PMIC_ARB4_CHNL213_RDATA1_ADDR A:0x2aac01c
y.create.l HWIO_PMIC_ARB4_CHNL214_RDATA1_ADDR A:0x2ab401c
y.create.l HWIO_PMIC_ARB4_CHNL215_RDATA1_ADDR A:0x2abc01c
y.create.l HWIO_PMIC_ARB4_CHNL216_RDATA1_ADDR A:0x2ac401c
y.create.l HWIO_PMIC_ARB4_CHNL217_RDATA1_ADDR A:0x2acc01c
y.create.l HWIO_PMIC_ARB4_CHNL218_RDATA1_ADDR A:0x2ad401c
y.create.l HWIO_PMIC_ARB4_CHNL219_RDATA1_ADDR A:0x2adc01c
y.create.l HWIO_PMIC_ARB4_CHNL220_RDATA1_ADDR A:0x2ae401c
y.create.l HWIO_PMIC_ARB4_CHNL221_RDATA1_ADDR A:0x2aec01c
y.create.l HWIO_PMIC_ARB4_CHNL222_RDATA1_ADDR A:0x2af401c
y.create.l HWIO_PMIC_ARB4_CHNL223_RDATA1_ADDR A:0x2afc01c
y.create.l HWIO_PMIC_ARB4_CHNL224_RDATA1_ADDR A:0x2b0401c
y.create.l HWIO_PMIC_ARB4_CHNL225_RDATA1_ADDR A:0x2b0c01c
y.create.l HWIO_PMIC_ARB4_CHNL226_RDATA1_ADDR A:0x2b1401c
y.create.l HWIO_PMIC_ARB4_CHNL227_RDATA1_ADDR A:0x2b1c01c
y.create.l HWIO_PMIC_ARB4_CHNL228_RDATA1_ADDR A:0x2b2401c
y.create.l HWIO_PMIC_ARB4_CHNL229_RDATA1_ADDR A:0x2b2c01c
y.create.l HWIO_PMIC_ARB4_CHNL230_RDATA1_ADDR A:0x2b3401c
y.create.l HWIO_PMIC_ARB4_CHNL231_RDATA1_ADDR A:0x2b3c01c
y.create.l HWIO_PMIC_ARB4_CHNL232_RDATA1_ADDR A:0x2b4401c
y.create.l HWIO_PMIC_ARB4_CHNL233_RDATA1_ADDR A:0x2b4c01c
y.create.l HWIO_PMIC_ARB4_CHNL234_RDATA1_ADDR A:0x2b5401c
y.create.l HWIO_PMIC_ARB4_CHNL235_RDATA1_ADDR A:0x2b5c01c
y.create.l HWIO_PMIC_ARB4_CHNL236_RDATA1_ADDR A:0x2b6401c
y.create.l HWIO_PMIC_ARB4_CHNL237_RDATA1_ADDR A:0x2b6c01c
y.create.l HWIO_PMIC_ARB4_CHNL238_RDATA1_ADDR A:0x2b7401c
y.create.l HWIO_PMIC_ARB4_CHNL239_RDATA1_ADDR A:0x2b7c01c
y.create.l HWIO_PMIC_ARB4_CHNL240_RDATA1_ADDR A:0x2b8401c
y.create.l HWIO_PMIC_ARB4_CHNL241_RDATA1_ADDR A:0x2b8c01c
y.create.l HWIO_PMIC_ARB4_CHNL242_RDATA1_ADDR A:0x2b9401c
y.create.l HWIO_PMIC_ARB4_CHNL243_RDATA1_ADDR A:0x2b9c01c
y.create.l HWIO_PMIC_ARB4_CHNL244_RDATA1_ADDR A:0x2ba401c
y.create.l HWIO_PMIC_ARB4_CHNL245_RDATA1_ADDR A:0x2bac01c
y.create.l HWIO_PMIC_ARB4_CHNL246_RDATA1_ADDR A:0x2bb401c
y.create.l HWIO_PMIC_ARB4_CHNL247_RDATA1_ADDR A:0x2bbc01c
y.create.l HWIO_PMIC_ARB4_CHNL248_RDATA1_ADDR A:0x2bc401c
y.create.l HWIO_PMIC_ARB4_CHNL249_RDATA1_ADDR A:0x2bcc01c
y.create.l HWIO_PMIC_ARB4_CHNL250_RDATA1_ADDR A:0x2bd401c
y.create.l HWIO_PMIC_ARB4_CHNL251_RDATA1_ADDR A:0x2bdc01c
y.create.l HWIO_PMIC_ARB4_CHNL252_RDATA1_ADDR A:0x2be401c
y.create.l HWIO_PMIC_ARB4_CHNL253_RDATA1_ADDR A:0x2bec01c
y.create.l HWIO_PMIC_ARB4_CHNL254_RDATA1_ADDR A:0x2bf401c
y.create.l HWIO_PMIC_ARB4_CHNL255_RDATA1_ADDR A:0x2bfc01c
y.create.l HWIO_PMIC_ARB5_CHNL0_RDATA1_ADDR A:0x240501c
y.create.l HWIO_PMIC_ARB5_CHNL1_RDATA1_ADDR A:0x240d01c
y.create.l HWIO_PMIC_ARB5_CHNL2_RDATA1_ADDR A:0x241501c
y.create.l HWIO_PMIC_ARB5_CHNL3_RDATA1_ADDR A:0x241d01c
y.create.l HWIO_PMIC_ARB5_CHNL4_RDATA1_ADDR A:0x242501c
y.create.l HWIO_PMIC_ARB5_CHNL5_RDATA1_ADDR A:0x242d01c
y.create.l HWIO_PMIC_ARB5_CHNL6_RDATA1_ADDR A:0x243501c
y.create.l HWIO_PMIC_ARB5_CHNL7_RDATA1_ADDR A:0x243d01c
y.create.l HWIO_PMIC_ARB5_CHNL8_RDATA1_ADDR A:0x244501c
y.create.l HWIO_PMIC_ARB5_CHNL9_RDATA1_ADDR A:0x244d01c
y.create.l HWIO_PMIC_ARB5_CHNL10_RDATA1_ADDR A:0x245501c
y.create.l HWIO_PMIC_ARB5_CHNL11_RDATA1_ADDR A:0x245d01c
y.create.l HWIO_PMIC_ARB5_CHNL12_RDATA1_ADDR A:0x246501c
y.create.l HWIO_PMIC_ARB5_CHNL13_RDATA1_ADDR A:0x246d01c
y.create.l HWIO_PMIC_ARB5_CHNL14_RDATA1_ADDR A:0x247501c
y.create.l HWIO_PMIC_ARB5_CHNL15_RDATA1_ADDR A:0x247d01c
y.create.l HWIO_PMIC_ARB5_CHNL16_RDATA1_ADDR A:0x248501c
y.create.l HWIO_PMIC_ARB5_CHNL17_RDATA1_ADDR A:0x248d01c
y.create.l HWIO_PMIC_ARB5_CHNL18_RDATA1_ADDR A:0x249501c
y.create.l HWIO_PMIC_ARB5_CHNL19_RDATA1_ADDR A:0x249d01c
y.create.l HWIO_PMIC_ARB5_CHNL20_RDATA1_ADDR A:0x24a501c
y.create.l HWIO_PMIC_ARB5_CHNL21_RDATA1_ADDR A:0x24ad01c
y.create.l HWIO_PMIC_ARB5_CHNL22_RDATA1_ADDR A:0x24b501c
y.create.l HWIO_PMIC_ARB5_CHNL23_RDATA1_ADDR A:0x24bd01c
y.create.l HWIO_PMIC_ARB5_CHNL24_RDATA1_ADDR A:0x24c501c
y.create.l HWIO_PMIC_ARB5_CHNL25_RDATA1_ADDR A:0x24cd01c
y.create.l HWIO_PMIC_ARB5_CHNL26_RDATA1_ADDR A:0x24d501c
y.create.l HWIO_PMIC_ARB5_CHNL27_RDATA1_ADDR A:0x24dd01c
y.create.l HWIO_PMIC_ARB5_CHNL28_RDATA1_ADDR A:0x24e501c
y.create.l HWIO_PMIC_ARB5_CHNL29_RDATA1_ADDR A:0x24ed01c
y.create.l HWIO_PMIC_ARB5_CHNL30_RDATA1_ADDR A:0x24f501c
y.create.l HWIO_PMIC_ARB5_CHNL31_RDATA1_ADDR A:0x24fd01c
y.create.l HWIO_PMIC_ARB5_CHNL32_RDATA1_ADDR A:0x250501c
y.create.l HWIO_PMIC_ARB5_CHNL33_RDATA1_ADDR A:0x250d01c
y.create.l HWIO_PMIC_ARB5_CHNL34_RDATA1_ADDR A:0x251501c
y.create.l HWIO_PMIC_ARB5_CHNL35_RDATA1_ADDR A:0x251d01c
y.create.l HWIO_PMIC_ARB5_CHNL36_RDATA1_ADDR A:0x252501c
y.create.l HWIO_PMIC_ARB5_CHNL37_RDATA1_ADDR A:0x252d01c
y.create.l HWIO_PMIC_ARB5_CHNL38_RDATA1_ADDR A:0x253501c
y.create.l HWIO_PMIC_ARB5_CHNL39_RDATA1_ADDR A:0x253d01c
y.create.l HWIO_PMIC_ARB5_CHNL40_RDATA1_ADDR A:0x254501c
y.create.l HWIO_PMIC_ARB5_CHNL41_RDATA1_ADDR A:0x254d01c
y.create.l HWIO_PMIC_ARB5_CHNL42_RDATA1_ADDR A:0x255501c
y.create.l HWIO_PMIC_ARB5_CHNL43_RDATA1_ADDR A:0x255d01c
y.create.l HWIO_PMIC_ARB5_CHNL44_RDATA1_ADDR A:0x256501c
y.create.l HWIO_PMIC_ARB5_CHNL45_RDATA1_ADDR A:0x256d01c
y.create.l HWIO_PMIC_ARB5_CHNL46_RDATA1_ADDR A:0x257501c
y.create.l HWIO_PMIC_ARB5_CHNL47_RDATA1_ADDR A:0x257d01c
y.create.l HWIO_PMIC_ARB5_CHNL48_RDATA1_ADDR A:0x258501c
y.create.l HWIO_PMIC_ARB5_CHNL49_RDATA1_ADDR A:0x258d01c
y.create.l HWIO_PMIC_ARB5_CHNL50_RDATA1_ADDR A:0x259501c
y.create.l HWIO_PMIC_ARB5_CHNL51_RDATA1_ADDR A:0x259d01c
y.create.l HWIO_PMIC_ARB5_CHNL52_RDATA1_ADDR A:0x25a501c
y.create.l HWIO_PMIC_ARB5_CHNL53_RDATA1_ADDR A:0x25ad01c
y.create.l HWIO_PMIC_ARB5_CHNL54_RDATA1_ADDR A:0x25b501c
y.create.l HWIO_PMIC_ARB5_CHNL55_RDATA1_ADDR A:0x25bd01c
y.create.l HWIO_PMIC_ARB5_CHNL56_RDATA1_ADDR A:0x25c501c
y.create.l HWIO_PMIC_ARB5_CHNL57_RDATA1_ADDR A:0x25cd01c
y.create.l HWIO_PMIC_ARB5_CHNL58_RDATA1_ADDR A:0x25d501c
y.create.l HWIO_PMIC_ARB5_CHNL59_RDATA1_ADDR A:0x25dd01c
y.create.l HWIO_PMIC_ARB5_CHNL60_RDATA1_ADDR A:0x25e501c
y.create.l HWIO_PMIC_ARB5_CHNL61_RDATA1_ADDR A:0x25ed01c
y.create.l HWIO_PMIC_ARB5_CHNL62_RDATA1_ADDR A:0x25f501c
y.create.l HWIO_PMIC_ARB5_CHNL63_RDATA1_ADDR A:0x25fd01c
y.create.l HWIO_PMIC_ARB5_CHNL64_RDATA1_ADDR A:0x260501c
y.create.l HWIO_PMIC_ARB5_CHNL65_RDATA1_ADDR A:0x260d01c
y.create.l HWIO_PMIC_ARB5_CHNL66_RDATA1_ADDR A:0x261501c
y.create.l HWIO_PMIC_ARB5_CHNL67_RDATA1_ADDR A:0x261d01c
y.create.l HWIO_PMIC_ARB5_CHNL68_RDATA1_ADDR A:0x262501c
y.create.l HWIO_PMIC_ARB5_CHNL69_RDATA1_ADDR A:0x262d01c
y.create.l HWIO_PMIC_ARB5_CHNL70_RDATA1_ADDR A:0x263501c
y.create.l HWIO_PMIC_ARB5_CHNL71_RDATA1_ADDR A:0x263d01c
y.create.l HWIO_PMIC_ARB5_CHNL72_RDATA1_ADDR A:0x264501c
y.create.l HWIO_PMIC_ARB5_CHNL73_RDATA1_ADDR A:0x264d01c
y.create.l HWIO_PMIC_ARB5_CHNL74_RDATA1_ADDR A:0x265501c
y.create.l HWIO_PMIC_ARB5_CHNL75_RDATA1_ADDR A:0x265d01c
y.create.l HWIO_PMIC_ARB5_CHNL76_RDATA1_ADDR A:0x266501c
y.create.l HWIO_PMIC_ARB5_CHNL77_RDATA1_ADDR A:0x266d01c
y.create.l HWIO_PMIC_ARB5_CHNL78_RDATA1_ADDR A:0x267501c
y.create.l HWIO_PMIC_ARB5_CHNL79_RDATA1_ADDR A:0x267d01c
y.create.l HWIO_PMIC_ARB5_CHNL80_RDATA1_ADDR A:0x268501c
y.create.l HWIO_PMIC_ARB5_CHNL81_RDATA1_ADDR A:0x268d01c
y.create.l HWIO_PMIC_ARB5_CHNL82_RDATA1_ADDR A:0x269501c
y.create.l HWIO_PMIC_ARB5_CHNL83_RDATA1_ADDR A:0x269d01c
y.create.l HWIO_PMIC_ARB5_CHNL84_RDATA1_ADDR A:0x26a501c
y.create.l HWIO_PMIC_ARB5_CHNL85_RDATA1_ADDR A:0x26ad01c
y.create.l HWIO_PMIC_ARB5_CHNL86_RDATA1_ADDR A:0x26b501c
y.create.l HWIO_PMIC_ARB5_CHNL87_RDATA1_ADDR A:0x26bd01c
y.create.l HWIO_PMIC_ARB5_CHNL88_RDATA1_ADDR A:0x26c501c
y.create.l HWIO_PMIC_ARB5_CHNL89_RDATA1_ADDR A:0x26cd01c
y.create.l HWIO_PMIC_ARB5_CHNL90_RDATA1_ADDR A:0x26d501c
y.create.l HWIO_PMIC_ARB5_CHNL91_RDATA1_ADDR A:0x26dd01c
y.create.l HWIO_PMIC_ARB5_CHNL92_RDATA1_ADDR A:0x26e501c
y.create.l HWIO_PMIC_ARB5_CHNL93_RDATA1_ADDR A:0x26ed01c
y.create.l HWIO_PMIC_ARB5_CHNL94_RDATA1_ADDR A:0x26f501c
y.create.l HWIO_PMIC_ARB5_CHNL95_RDATA1_ADDR A:0x26fd01c
y.create.l HWIO_PMIC_ARB5_CHNL96_RDATA1_ADDR A:0x270501c
y.create.l HWIO_PMIC_ARB5_CHNL97_RDATA1_ADDR A:0x270d01c
y.create.l HWIO_PMIC_ARB5_CHNL98_RDATA1_ADDR A:0x271501c
y.create.l HWIO_PMIC_ARB5_CHNL99_RDATA1_ADDR A:0x271d01c
y.create.l HWIO_PMIC_ARB5_CHNL100_RDATA1_ADDR A:0x272501c
y.create.l HWIO_PMIC_ARB5_CHNL101_RDATA1_ADDR A:0x272d01c
y.create.l HWIO_PMIC_ARB5_CHNL102_RDATA1_ADDR A:0x273501c
y.create.l HWIO_PMIC_ARB5_CHNL103_RDATA1_ADDR A:0x273d01c
y.create.l HWIO_PMIC_ARB5_CHNL104_RDATA1_ADDR A:0x274501c
y.create.l HWIO_PMIC_ARB5_CHNL105_RDATA1_ADDR A:0x274d01c
y.create.l HWIO_PMIC_ARB5_CHNL106_RDATA1_ADDR A:0x275501c
y.create.l HWIO_PMIC_ARB5_CHNL107_RDATA1_ADDR A:0x275d01c
y.create.l HWIO_PMIC_ARB5_CHNL108_RDATA1_ADDR A:0x276501c
y.create.l HWIO_PMIC_ARB5_CHNL109_RDATA1_ADDR A:0x276d01c
y.create.l HWIO_PMIC_ARB5_CHNL110_RDATA1_ADDR A:0x277501c
y.create.l HWIO_PMIC_ARB5_CHNL111_RDATA1_ADDR A:0x277d01c
y.create.l HWIO_PMIC_ARB5_CHNL112_RDATA1_ADDR A:0x278501c
y.create.l HWIO_PMIC_ARB5_CHNL113_RDATA1_ADDR A:0x278d01c
y.create.l HWIO_PMIC_ARB5_CHNL114_RDATA1_ADDR A:0x279501c
y.create.l HWIO_PMIC_ARB5_CHNL115_RDATA1_ADDR A:0x279d01c
y.create.l HWIO_PMIC_ARB5_CHNL116_RDATA1_ADDR A:0x27a501c
y.create.l HWIO_PMIC_ARB5_CHNL117_RDATA1_ADDR A:0x27ad01c
y.create.l HWIO_PMIC_ARB5_CHNL118_RDATA1_ADDR A:0x27b501c
y.create.l HWIO_PMIC_ARB5_CHNL119_RDATA1_ADDR A:0x27bd01c
y.create.l HWIO_PMIC_ARB5_CHNL120_RDATA1_ADDR A:0x27c501c
y.create.l HWIO_PMIC_ARB5_CHNL121_RDATA1_ADDR A:0x27cd01c
y.create.l HWIO_PMIC_ARB5_CHNL122_RDATA1_ADDR A:0x27d501c
y.create.l HWIO_PMIC_ARB5_CHNL123_RDATA1_ADDR A:0x27dd01c
y.create.l HWIO_PMIC_ARB5_CHNL124_RDATA1_ADDR A:0x27e501c
y.create.l HWIO_PMIC_ARB5_CHNL125_RDATA1_ADDR A:0x27ed01c
y.create.l HWIO_PMIC_ARB5_CHNL126_RDATA1_ADDR A:0x27f501c
y.create.l HWIO_PMIC_ARB5_CHNL127_RDATA1_ADDR A:0x27fd01c
y.create.l HWIO_PMIC_ARB5_CHNL128_RDATA1_ADDR A:0x280501c
y.create.l HWIO_PMIC_ARB5_CHNL129_RDATA1_ADDR A:0x280d01c
y.create.l HWIO_PMIC_ARB5_CHNL130_RDATA1_ADDR A:0x281501c
y.create.l HWIO_PMIC_ARB5_CHNL131_RDATA1_ADDR A:0x281d01c
y.create.l HWIO_PMIC_ARB5_CHNL132_RDATA1_ADDR A:0x282501c
y.create.l HWIO_PMIC_ARB5_CHNL133_RDATA1_ADDR A:0x282d01c
y.create.l HWIO_PMIC_ARB5_CHNL134_RDATA1_ADDR A:0x283501c
y.create.l HWIO_PMIC_ARB5_CHNL135_RDATA1_ADDR A:0x283d01c
y.create.l HWIO_PMIC_ARB5_CHNL136_RDATA1_ADDR A:0x284501c
y.create.l HWIO_PMIC_ARB5_CHNL137_RDATA1_ADDR A:0x284d01c
y.create.l HWIO_PMIC_ARB5_CHNL138_RDATA1_ADDR A:0x285501c
y.create.l HWIO_PMIC_ARB5_CHNL139_RDATA1_ADDR A:0x285d01c
y.create.l HWIO_PMIC_ARB5_CHNL140_RDATA1_ADDR A:0x286501c
y.create.l HWIO_PMIC_ARB5_CHNL141_RDATA1_ADDR A:0x286d01c
y.create.l HWIO_PMIC_ARB5_CHNL142_RDATA1_ADDR A:0x287501c
y.create.l HWIO_PMIC_ARB5_CHNL143_RDATA1_ADDR A:0x287d01c
y.create.l HWIO_PMIC_ARB5_CHNL144_RDATA1_ADDR A:0x288501c
y.create.l HWIO_PMIC_ARB5_CHNL145_RDATA1_ADDR A:0x288d01c
y.create.l HWIO_PMIC_ARB5_CHNL146_RDATA1_ADDR A:0x289501c
y.create.l HWIO_PMIC_ARB5_CHNL147_RDATA1_ADDR A:0x289d01c
y.create.l HWIO_PMIC_ARB5_CHNL148_RDATA1_ADDR A:0x28a501c
y.create.l HWIO_PMIC_ARB5_CHNL149_RDATA1_ADDR A:0x28ad01c
y.create.l HWIO_PMIC_ARB5_CHNL150_RDATA1_ADDR A:0x28b501c
y.create.l HWIO_PMIC_ARB5_CHNL151_RDATA1_ADDR A:0x28bd01c
y.create.l HWIO_PMIC_ARB5_CHNL152_RDATA1_ADDR A:0x28c501c
y.create.l HWIO_PMIC_ARB5_CHNL153_RDATA1_ADDR A:0x28cd01c
y.create.l HWIO_PMIC_ARB5_CHNL154_RDATA1_ADDR A:0x28d501c
y.create.l HWIO_PMIC_ARB5_CHNL155_RDATA1_ADDR A:0x28dd01c
y.create.l HWIO_PMIC_ARB5_CHNL156_RDATA1_ADDR A:0x28e501c
y.create.l HWIO_PMIC_ARB5_CHNL157_RDATA1_ADDR A:0x28ed01c
y.create.l HWIO_PMIC_ARB5_CHNL158_RDATA1_ADDR A:0x28f501c
y.create.l HWIO_PMIC_ARB5_CHNL159_RDATA1_ADDR A:0x28fd01c
y.create.l HWIO_PMIC_ARB5_CHNL160_RDATA1_ADDR A:0x290501c
y.create.l HWIO_PMIC_ARB5_CHNL161_RDATA1_ADDR A:0x290d01c
y.create.l HWIO_PMIC_ARB5_CHNL162_RDATA1_ADDR A:0x291501c
y.create.l HWIO_PMIC_ARB5_CHNL163_RDATA1_ADDR A:0x291d01c
y.create.l HWIO_PMIC_ARB5_CHNL164_RDATA1_ADDR A:0x292501c
y.create.l HWIO_PMIC_ARB5_CHNL165_RDATA1_ADDR A:0x292d01c
y.create.l HWIO_PMIC_ARB5_CHNL166_RDATA1_ADDR A:0x293501c
y.create.l HWIO_PMIC_ARB5_CHNL167_RDATA1_ADDR A:0x293d01c
y.create.l HWIO_PMIC_ARB5_CHNL168_RDATA1_ADDR A:0x294501c
y.create.l HWIO_PMIC_ARB5_CHNL169_RDATA1_ADDR A:0x294d01c
y.create.l HWIO_PMIC_ARB5_CHNL170_RDATA1_ADDR A:0x295501c
y.create.l HWIO_PMIC_ARB5_CHNL171_RDATA1_ADDR A:0x295d01c
y.create.l HWIO_PMIC_ARB5_CHNL172_RDATA1_ADDR A:0x296501c
y.create.l HWIO_PMIC_ARB5_CHNL173_RDATA1_ADDR A:0x296d01c
y.create.l HWIO_PMIC_ARB5_CHNL174_RDATA1_ADDR A:0x297501c
y.create.l HWIO_PMIC_ARB5_CHNL175_RDATA1_ADDR A:0x297d01c
y.create.l HWIO_PMIC_ARB5_CHNL176_RDATA1_ADDR A:0x298501c
y.create.l HWIO_PMIC_ARB5_CHNL177_RDATA1_ADDR A:0x298d01c
y.create.l HWIO_PMIC_ARB5_CHNL178_RDATA1_ADDR A:0x299501c
y.create.l HWIO_PMIC_ARB5_CHNL179_RDATA1_ADDR A:0x299d01c
y.create.l HWIO_PMIC_ARB5_CHNL180_RDATA1_ADDR A:0x29a501c
y.create.l HWIO_PMIC_ARB5_CHNL181_RDATA1_ADDR A:0x29ad01c
y.create.l HWIO_PMIC_ARB5_CHNL182_RDATA1_ADDR A:0x29b501c
y.create.l HWIO_PMIC_ARB5_CHNL183_RDATA1_ADDR A:0x29bd01c
y.create.l HWIO_PMIC_ARB5_CHNL184_RDATA1_ADDR A:0x29c501c
y.create.l HWIO_PMIC_ARB5_CHNL185_RDATA1_ADDR A:0x29cd01c
y.create.l HWIO_PMIC_ARB5_CHNL186_RDATA1_ADDR A:0x29d501c
y.create.l HWIO_PMIC_ARB5_CHNL187_RDATA1_ADDR A:0x29dd01c
y.create.l HWIO_PMIC_ARB5_CHNL188_RDATA1_ADDR A:0x29e501c
y.create.l HWIO_PMIC_ARB5_CHNL189_RDATA1_ADDR A:0x29ed01c
y.create.l HWIO_PMIC_ARB5_CHNL190_RDATA1_ADDR A:0x29f501c
y.create.l HWIO_PMIC_ARB5_CHNL191_RDATA1_ADDR A:0x29fd01c
y.create.l HWIO_PMIC_ARB5_CHNL192_RDATA1_ADDR A:0x2a0501c
y.create.l HWIO_PMIC_ARB5_CHNL193_RDATA1_ADDR A:0x2a0d01c
y.create.l HWIO_PMIC_ARB5_CHNL194_RDATA1_ADDR A:0x2a1501c
y.create.l HWIO_PMIC_ARB5_CHNL195_RDATA1_ADDR A:0x2a1d01c
y.create.l HWIO_PMIC_ARB5_CHNL196_RDATA1_ADDR A:0x2a2501c
y.create.l HWIO_PMIC_ARB5_CHNL197_RDATA1_ADDR A:0x2a2d01c
y.create.l HWIO_PMIC_ARB5_CHNL198_RDATA1_ADDR A:0x2a3501c
y.create.l HWIO_PMIC_ARB5_CHNL199_RDATA1_ADDR A:0x2a3d01c
y.create.l HWIO_PMIC_ARB5_CHNL200_RDATA1_ADDR A:0x2a4501c
y.create.l HWIO_PMIC_ARB5_CHNL201_RDATA1_ADDR A:0x2a4d01c
y.create.l HWIO_PMIC_ARB5_CHNL202_RDATA1_ADDR A:0x2a5501c
y.create.l HWIO_PMIC_ARB5_CHNL203_RDATA1_ADDR A:0x2a5d01c
y.create.l HWIO_PMIC_ARB5_CHNL204_RDATA1_ADDR A:0x2a6501c
y.create.l HWIO_PMIC_ARB5_CHNL205_RDATA1_ADDR A:0x2a6d01c
y.create.l HWIO_PMIC_ARB5_CHNL206_RDATA1_ADDR A:0x2a7501c
y.create.l HWIO_PMIC_ARB5_CHNL207_RDATA1_ADDR A:0x2a7d01c
y.create.l HWIO_PMIC_ARB5_CHNL208_RDATA1_ADDR A:0x2a8501c
y.create.l HWIO_PMIC_ARB5_CHNL209_RDATA1_ADDR A:0x2a8d01c
y.create.l HWIO_PMIC_ARB5_CHNL210_RDATA1_ADDR A:0x2a9501c
y.create.l HWIO_PMIC_ARB5_CHNL211_RDATA1_ADDR A:0x2a9d01c
y.create.l HWIO_PMIC_ARB5_CHNL212_RDATA1_ADDR A:0x2aa501c
y.create.l HWIO_PMIC_ARB5_CHNL213_RDATA1_ADDR A:0x2aad01c
y.create.l HWIO_PMIC_ARB5_CHNL214_RDATA1_ADDR A:0x2ab501c
y.create.l HWIO_PMIC_ARB5_CHNL215_RDATA1_ADDR A:0x2abd01c
y.create.l HWIO_PMIC_ARB5_CHNL216_RDATA1_ADDR A:0x2ac501c
y.create.l HWIO_PMIC_ARB5_CHNL217_RDATA1_ADDR A:0x2acd01c
y.create.l HWIO_PMIC_ARB5_CHNL218_RDATA1_ADDR A:0x2ad501c
y.create.l HWIO_PMIC_ARB5_CHNL219_RDATA1_ADDR A:0x2add01c
y.create.l HWIO_PMIC_ARB5_CHNL220_RDATA1_ADDR A:0x2ae501c
y.create.l HWIO_PMIC_ARB5_CHNL221_RDATA1_ADDR A:0x2aed01c
y.create.l HWIO_PMIC_ARB5_CHNL222_RDATA1_ADDR A:0x2af501c
y.create.l HWIO_PMIC_ARB5_CHNL223_RDATA1_ADDR A:0x2afd01c
y.create.l HWIO_PMIC_ARB5_CHNL224_RDATA1_ADDR A:0x2b0501c
y.create.l HWIO_PMIC_ARB5_CHNL225_RDATA1_ADDR A:0x2b0d01c
y.create.l HWIO_PMIC_ARB5_CHNL226_RDATA1_ADDR A:0x2b1501c
y.create.l HWIO_PMIC_ARB5_CHNL227_RDATA1_ADDR A:0x2b1d01c
y.create.l HWIO_PMIC_ARB5_CHNL228_RDATA1_ADDR A:0x2b2501c
y.create.l HWIO_PMIC_ARB5_CHNL229_RDATA1_ADDR A:0x2b2d01c
y.create.l HWIO_PMIC_ARB5_CHNL230_RDATA1_ADDR A:0x2b3501c
y.create.l HWIO_PMIC_ARB5_CHNL231_RDATA1_ADDR A:0x2b3d01c
y.create.l HWIO_PMIC_ARB5_CHNL232_RDATA1_ADDR A:0x2b4501c
y.create.l HWIO_PMIC_ARB5_CHNL233_RDATA1_ADDR A:0x2b4d01c
y.create.l HWIO_PMIC_ARB5_CHNL234_RDATA1_ADDR A:0x2b5501c
y.create.l HWIO_PMIC_ARB5_CHNL235_RDATA1_ADDR A:0x2b5d01c
y.create.l HWIO_PMIC_ARB5_CHNL236_RDATA1_ADDR A:0x2b6501c
y.create.l HWIO_PMIC_ARB5_CHNL237_RDATA1_ADDR A:0x2b6d01c
y.create.l HWIO_PMIC_ARB5_CHNL238_RDATA1_ADDR A:0x2b7501c
y.create.l HWIO_PMIC_ARB5_CHNL239_RDATA1_ADDR A:0x2b7d01c
y.create.l HWIO_PMIC_ARB5_CHNL240_RDATA1_ADDR A:0x2b8501c
y.create.l HWIO_PMIC_ARB5_CHNL241_RDATA1_ADDR A:0x2b8d01c
y.create.l HWIO_PMIC_ARB5_CHNL242_RDATA1_ADDR A:0x2b9501c
y.create.l HWIO_PMIC_ARB5_CHNL243_RDATA1_ADDR A:0x2b9d01c
y.create.l HWIO_PMIC_ARB5_CHNL244_RDATA1_ADDR A:0x2ba501c
y.create.l HWIO_PMIC_ARB5_CHNL245_RDATA1_ADDR A:0x2bad01c
y.create.l HWIO_PMIC_ARB5_CHNL246_RDATA1_ADDR A:0x2bb501c
y.create.l HWIO_PMIC_ARB5_CHNL247_RDATA1_ADDR A:0x2bbd01c
y.create.l HWIO_PMIC_ARB5_CHNL248_RDATA1_ADDR A:0x2bc501c
y.create.l HWIO_PMIC_ARB5_CHNL249_RDATA1_ADDR A:0x2bcd01c
y.create.l HWIO_PMIC_ARB5_CHNL250_RDATA1_ADDR A:0x2bd501c
y.create.l HWIO_PMIC_ARB5_CHNL251_RDATA1_ADDR A:0x2bdd01c
y.create.l HWIO_PMIC_ARB5_CHNL252_RDATA1_ADDR A:0x2be501c
y.create.l HWIO_PMIC_ARB5_CHNL253_RDATA1_ADDR A:0x2bed01c
y.create.l HWIO_PMIC_ARB5_CHNL254_RDATA1_ADDR A:0x2bf501c
y.create.l HWIO_PMIC_ARB5_CHNL255_RDATA1_ADDR A:0x2bfd01c
y.create.l HWIO_PMIC_ARB6_CHNL0_RDATA1_ADDR A:0x240601c
y.create.l HWIO_PMIC_ARB6_CHNL1_RDATA1_ADDR A:0x240e01c
y.create.l HWIO_PMIC_ARB6_CHNL2_RDATA1_ADDR A:0x241601c
y.create.l HWIO_PMIC_ARB6_CHNL3_RDATA1_ADDR A:0x241e01c
y.create.l HWIO_PMIC_ARB6_CHNL4_RDATA1_ADDR A:0x242601c
y.create.l HWIO_PMIC_ARB6_CHNL5_RDATA1_ADDR A:0x242e01c
y.create.l HWIO_PMIC_ARB6_CHNL6_RDATA1_ADDR A:0x243601c
y.create.l HWIO_PMIC_ARB6_CHNL7_RDATA1_ADDR A:0x243e01c
y.create.l HWIO_PMIC_ARB6_CHNL8_RDATA1_ADDR A:0x244601c
y.create.l HWIO_PMIC_ARB6_CHNL9_RDATA1_ADDR A:0x244e01c
y.create.l HWIO_PMIC_ARB6_CHNL10_RDATA1_ADDR A:0x245601c
y.create.l HWIO_PMIC_ARB6_CHNL11_RDATA1_ADDR A:0x245e01c
y.create.l HWIO_PMIC_ARB6_CHNL12_RDATA1_ADDR A:0x246601c
y.create.l HWIO_PMIC_ARB6_CHNL13_RDATA1_ADDR A:0x246e01c
y.create.l HWIO_PMIC_ARB6_CHNL14_RDATA1_ADDR A:0x247601c
y.create.l HWIO_PMIC_ARB6_CHNL15_RDATA1_ADDR A:0x247e01c
y.create.l HWIO_PMIC_ARB6_CHNL16_RDATA1_ADDR A:0x248601c
y.create.l HWIO_PMIC_ARB6_CHNL17_RDATA1_ADDR A:0x248e01c
y.create.l HWIO_PMIC_ARB6_CHNL18_RDATA1_ADDR A:0x249601c
y.create.l HWIO_PMIC_ARB6_CHNL19_RDATA1_ADDR A:0x249e01c
y.create.l HWIO_PMIC_ARB6_CHNL20_RDATA1_ADDR A:0x24a601c
y.create.l HWIO_PMIC_ARB6_CHNL21_RDATA1_ADDR A:0x24ae01c
y.create.l HWIO_PMIC_ARB6_CHNL22_RDATA1_ADDR A:0x24b601c
y.create.l HWIO_PMIC_ARB6_CHNL23_RDATA1_ADDR A:0x24be01c
y.create.l HWIO_PMIC_ARB6_CHNL24_RDATA1_ADDR A:0x24c601c
y.create.l HWIO_PMIC_ARB6_CHNL25_RDATA1_ADDR A:0x24ce01c
y.create.l HWIO_PMIC_ARB6_CHNL26_RDATA1_ADDR A:0x24d601c
y.create.l HWIO_PMIC_ARB6_CHNL27_RDATA1_ADDR A:0x24de01c
y.create.l HWIO_PMIC_ARB6_CHNL28_RDATA1_ADDR A:0x24e601c
y.create.l HWIO_PMIC_ARB6_CHNL29_RDATA1_ADDR A:0x24ee01c
y.create.l HWIO_PMIC_ARB6_CHNL30_RDATA1_ADDR A:0x24f601c
y.create.l HWIO_PMIC_ARB6_CHNL31_RDATA1_ADDR A:0x24fe01c
y.create.l HWIO_PMIC_ARB6_CHNL32_RDATA1_ADDR A:0x250601c
y.create.l HWIO_PMIC_ARB6_CHNL33_RDATA1_ADDR A:0x250e01c
y.create.l HWIO_PMIC_ARB6_CHNL34_RDATA1_ADDR A:0x251601c
y.create.l HWIO_PMIC_ARB6_CHNL35_RDATA1_ADDR A:0x251e01c
y.create.l HWIO_PMIC_ARB6_CHNL36_RDATA1_ADDR A:0x252601c
y.create.l HWIO_PMIC_ARB6_CHNL37_RDATA1_ADDR A:0x252e01c
y.create.l HWIO_PMIC_ARB6_CHNL38_RDATA1_ADDR A:0x253601c
y.create.l HWIO_PMIC_ARB6_CHNL39_RDATA1_ADDR A:0x253e01c
y.create.l HWIO_PMIC_ARB6_CHNL40_RDATA1_ADDR A:0x254601c
y.create.l HWIO_PMIC_ARB6_CHNL41_RDATA1_ADDR A:0x254e01c
y.create.l HWIO_PMIC_ARB6_CHNL42_RDATA1_ADDR A:0x255601c
y.create.l HWIO_PMIC_ARB6_CHNL43_RDATA1_ADDR A:0x255e01c
y.create.l HWIO_PMIC_ARB6_CHNL44_RDATA1_ADDR A:0x256601c
y.create.l HWIO_PMIC_ARB6_CHNL45_RDATA1_ADDR A:0x256e01c
y.create.l HWIO_PMIC_ARB6_CHNL46_RDATA1_ADDR A:0x257601c
y.create.l HWIO_PMIC_ARB6_CHNL47_RDATA1_ADDR A:0x257e01c
y.create.l HWIO_PMIC_ARB6_CHNL48_RDATA1_ADDR A:0x258601c
y.create.l HWIO_PMIC_ARB6_CHNL49_RDATA1_ADDR A:0x258e01c
y.create.l HWIO_PMIC_ARB6_CHNL50_RDATA1_ADDR A:0x259601c
y.create.l HWIO_PMIC_ARB6_CHNL51_RDATA1_ADDR A:0x259e01c
y.create.l HWIO_PMIC_ARB6_CHNL52_RDATA1_ADDR A:0x25a601c
y.create.l HWIO_PMIC_ARB6_CHNL53_RDATA1_ADDR A:0x25ae01c
y.create.l HWIO_PMIC_ARB6_CHNL54_RDATA1_ADDR A:0x25b601c
y.create.l HWIO_PMIC_ARB6_CHNL55_RDATA1_ADDR A:0x25be01c
y.create.l HWIO_PMIC_ARB6_CHNL56_RDATA1_ADDR A:0x25c601c
y.create.l HWIO_PMIC_ARB6_CHNL57_RDATA1_ADDR A:0x25ce01c
y.create.l HWIO_PMIC_ARB6_CHNL58_RDATA1_ADDR A:0x25d601c
y.create.l HWIO_PMIC_ARB6_CHNL59_RDATA1_ADDR A:0x25de01c
y.create.l HWIO_PMIC_ARB6_CHNL60_RDATA1_ADDR A:0x25e601c
y.create.l HWIO_PMIC_ARB6_CHNL61_RDATA1_ADDR A:0x25ee01c
y.create.l HWIO_PMIC_ARB6_CHNL62_RDATA1_ADDR A:0x25f601c
y.create.l HWIO_PMIC_ARB6_CHNL63_RDATA1_ADDR A:0x25fe01c
y.create.l HWIO_PMIC_ARB6_CHNL64_RDATA1_ADDR A:0x260601c
y.create.l HWIO_PMIC_ARB6_CHNL65_RDATA1_ADDR A:0x260e01c
y.create.l HWIO_PMIC_ARB6_CHNL66_RDATA1_ADDR A:0x261601c
y.create.l HWIO_PMIC_ARB6_CHNL67_RDATA1_ADDR A:0x261e01c
y.create.l HWIO_PMIC_ARB6_CHNL68_RDATA1_ADDR A:0x262601c
y.create.l HWIO_PMIC_ARB6_CHNL69_RDATA1_ADDR A:0x262e01c
y.create.l HWIO_PMIC_ARB6_CHNL70_RDATA1_ADDR A:0x263601c
y.create.l HWIO_PMIC_ARB6_CHNL71_RDATA1_ADDR A:0x263e01c
y.create.l HWIO_PMIC_ARB6_CHNL72_RDATA1_ADDR A:0x264601c
y.create.l HWIO_PMIC_ARB6_CHNL73_RDATA1_ADDR A:0x264e01c
y.create.l HWIO_PMIC_ARB6_CHNL74_RDATA1_ADDR A:0x265601c
y.create.l HWIO_PMIC_ARB6_CHNL75_RDATA1_ADDR A:0x265e01c
y.create.l HWIO_PMIC_ARB6_CHNL76_RDATA1_ADDR A:0x266601c
y.create.l HWIO_PMIC_ARB6_CHNL77_RDATA1_ADDR A:0x266e01c
y.create.l HWIO_PMIC_ARB6_CHNL78_RDATA1_ADDR A:0x267601c
y.create.l HWIO_PMIC_ARB6_CHNL79_RDATA1_ADDR A:0x267e01c
y.create.l HWIO_PMIC_ARB6_CHNL80_RDATA1_ADDR A:0x268601c
y.create.l HWIO_PMIC_ARB6_CHNL81_RDATA1_ADDR A:0x268e01c
y.create.l HWIO_PMIC_ARB6_CHNL82_RDATA1_ADDR A:0x269601c
y.create.l HWIO_PMIC_ARB6_CHNL83_RDATA1_ADDR A:0x269e01c
y.create.l HWIO_PMIC_ARB6_CHNL84_RDATA1_ADDR A:0x26a601c
y.create.l HWIO_PMIC_ARB6_CHNL85_RDATA1_ADDR A:0x26ae01c
y.create.l HWIO_PMIC_ARB6_CHNL86_RDATA1_ADDR A:0x26b601c
y.create.l HWIO_PMIC_ARB6_CHNL87_RDATA1_ADDR A:0x26be01c
y.create.l HWIO_PMIC_ARB6_CHNL88_RDATA1_ADDR A:0x26c601c
y.create.l HWIO_PMIC_ARB6_CHNL89_RDATA1_ADDR A:0x26ce01c
y.create.l HWIO_PMIC_ARB6_CHNL90_RDATA1_ADDR A:0x26d601c
y.create.l HWIO_PMIC_ARB6_CHNL91_RDATA1_ADDR A:0x26de01c
y.create.l HWIO_PMIC_ARB6_CHNL92_RDATA1_ADDR A:0x26e601c
y.create.l HWIO_PMIC_ARB6_CHNL93_RDATA1_ADDR A:0x26ee01c
y.create.l HWIO_PMIC_ARB6_CHNL94_RDATA1_ADDR A:0x26f601c
y.create.l HWIO_PMIC_ARB6_CHNL95_RDATA1_ADDR A:0x26fe01c
y.create.l HWIO_PMIC_ARB6_CHNL96_RDATA1_ADDR A:0x270601c
y.create.l HWIO_PMIC_ARB6_CHNL97_RDATA1_ADDR A:0x270e01c
y.create.l HWIO_PMIC_ARB6_CHNL98_RDATA1_ADDR A:0x271601c
y.create.l HWIO_PMIC_ARB6_CHNL99_RDATA1_ADDR A:0x271e01c
y.create.l HWIO_PMIC_ARB6_CHNL100_RDATA1_ADDR A:0x272601c
y.create.l HWIO_PMIC_ARB6_CHNL101_RDATA1_ADDR A:0x272e01c
y.create.l HWIO_PMIC_ARB6_CHNL102_RDATA1_ADDR A:0x273601c
y.create.l HWIO_PMIC_ARB6_CHNL103_RDATA1_ADDR A:0x273e01c
y.create.l HWIO_PMIC_ARB6_CHNL104_RDATA1_ADDR A:0x274601c
y.create.l HWIO_PMIC_ARB6_CHNL105_RDATA1_ADDR A:0x274e01c
y.create.l HWIO_PMIC_ARB6_CHNL106_RDATA1_ADDR A:0x275601c
y.create.l HWIO_PMIC_ARB6_CHNL107_RDATA1_ADDR A:0x275e01c
y.create.l HWIO_PMIC_ARB6_CHNL108_RDATA1_ADDR A:0x276601c
y.create.l HWIO_PMIC_ARB6_CHNL109_RDATA1_ADDR A:0x276e01c
y.create.l HWIO_PMIC_ARB6_CHNL110_RDATA1_ADDR A:0x277601c
y.create.l HWIO_PMIC_ARB6_CHNL111_RDATA1_ADDR A:0x277e01c
y.create.l HWIO_PMIC_ARB6_CHNL112_RDATA1_ADDR A:0x278601c
y.create.l HWIO_PMIC_ARB6_CHNL113_RDATA1_ADDR A:0x278e01c
y.create.l HWIO_PMIC_ARB6_CHNL114_RDATA1_ADDR A:0x279601c
y.create.l HWIO_PMIC_ARB6_CHNL115_RDATA1_ADDR A:0x279e01c
y.create.l HWIO_PMIC_ARB6_CHNL116_RDATA1_ADDR A:0x27a601c
y.create.l HWIO_PMIC_ARB6_CHNL117_RDATA1_ADDR A:0x27ae01c
y.create.l HWIO_PMIC_ARB6_CHNL118_RDATA1_ADDR A:0x27b601c
y.create.l HWIO_PMIC_ARB6_CHNL119_RDATA1_ADDR A:0x27be01c
y.create.l HWIO_PMIC_ARB6_CHNL120_RDATA1_ADDR A:0x27c601c
y.create.l HWIO_PMIC_ARB6_CHNL121_RDATA1_ADDR A:0x27ce01c
y.create.l HWIO_PMIC_ARB6_CHNL122_RDATA1_ADDR A:0x27d601c
y.create.l HWIO_PMIC_ARB6_CHNL123_RDATA1_ADDR A:0x27de01c
y.create.l HWIO_PMIC_ARB6_CHNL124_RDATA1_ADDR A:0x27e601c
y.create.l HWIO_PMIC_ARB6_CHNL125_RDATA1_ADDR A:0x27ee01c
y.create.l HWIO_PMIC_ARB6_CHNL126_RDATA1_ADDR A:0x27f601c
y.create.l HWIO_PMIC_ARB6_CHNL127_RDATA1_ADDR A:0x27fe01c
y.create.l HWIO_PMIC_ARB6_CHNL128_RDATA1_ADDR A:0x280601c
y.create.l HWIO_PMIC_ARB6_CHNL129_RDATA1_ADDR A:0x280e01c
y.create.l HWIO_PMIC_ARB6_CHNL130_RDATA1_ADDR A:0x281601c
y.create.l HWIO_PMIC_ARB6_CHNL131_RDATA1_ADDR A:0x281e01c
y.create.l HWIO_PMIC_ARB6_CHNL132_RDATA1_ADDR A:0x282601c
y.create.l HWIO_PMIC_ARB6_CHNL133_RDATA1_ADDR A:0x282e01c
y.create.l HWIO_PMIC_ARB6_CHNL134_RDATA1_ADDR A:0x283601c
y.create.l HWIO_PMIC_ARB6_CHNL135_RDATA1_ADDR A:0x283e01c
y.create.l HWIO_PMIC_ARB6_CHNL136_RDATA1_ADDR A:0x284601c
y.create.l HWIO_PMIC_ARB6_CHNL137_RDATA1_ADDR A:0x284e01c
y.create.l HWIO_PMIC_ARB6_CHNL138_RDATA1_ADDR A:0x285601c
y.create.l HWIO_PMIC_ARB6_CHNL139_RDATA1_ADDR A:0x285e01c
y.create.l HWIO_PMIC_ARB6_CHNL140_RDATA1_ADDR A:0x286601c
y.create.l HWIO_PMIC_ARB6_CHNL141_RDATA1_ADDR A:0x286e01c
y.create.l HWIO_PMIC_ARB6_CHNL142_RDATA1_ADDR A:0x287601c
y.create.l HWIO_PMIC_ARB6_CHNL143_RDATA1_ADDR A:0x287e01c
y.create.l HWIO_PMIC_ARB6_CHNL144_RDATA1_ADDR A:0x288601c
y.create.l HWIO_PMIC_ARB6_CHNL145_RDATA1_ADDR A:0x288e01c
y.create.l HWIO_PMIC_ARB6_CHNL146_RDATA1_ADDR A:0x289601c
y.create.l HWIO_PMIC_ARB6_CHNL147_RDATA1_ADDR A:0x289e01c
y.create.l HWIO_PMIC_ARB6_CHNL148_RDATA1_ADDR A:0x28a601c
y.create.l HWIO_PMIC_ARB6_CHNL149_RDATA1_ADDR A:0x28ae01c
y.create.l HWIO_PMIC_ARB6_CHNL150_RDATA1_ADDR A:0x28b601c
y.create.l HWIO_PMIC_ARB6_CHNL151_RDATA1_ADDR A:0x28be01c
y.create.l HWIO_PMIC_ARB6_CHNL152_RDATA1_ADDR A:0x28c601c
y.create.l HWIO_PMIC_ARB6_CHNL153_RDATA1_ADDR A:0x28ce01c
y.create.l HWIO_PMIC_ARB6_CHNL154_RDATA1_ADDR A:0x28d601c
y.create.l HWIO_PMIC_ARB6_CHNL155_RDATA1_ADDR A:0x28de01c
y.create.l HWIO_PMIC_ARB6_CHNL156_RDATA1_ADDR A:0x28e601c
y.create.l HWIO_PMIC_ARB6_CHNL157_RDATA1_ADDR A:0x28ee01c
y.create.l HWIO_PMIC_ARB6_CHNL158_RDATA1_ADDR A:0x28f601c
y.create.l HWIO_PMIC_ARB6_CHNL159_RDATA1_ADDR A:0x28fe01c
y.create.l HWIO_PMIC_ARB6_CHNL160_RDATA1_ADDR A:0x290601c
y.create.l HWIO_PMIC_ARB6_CHNL161_RDATA1_ADDR A:0x290e01c
y.create.l HWIO_PMIC_ARB6_CHNL162_RDATA1_ADDR A:0x291601c
y.create.l HWIO_PMIC_ARB6_CHNL163_RDATA1_ADDR A:0x291e01c
y.create.l HWIO_PMIC_ARB6_CHNL164_RDATA1_ADDR A:0x292601c
y.create.l HWIO_PMIC_ARB6_CHNL165_RDATA1_ADDR A:0x292e01c
y.create.l HWIO_PMIC_ARB6_CHNL166_RDATA1_ADDR A:0x293601c
y.create.l HWIO_PMIC_ARB6_CHNL167_RDATA1_ADDR A:0x293e01c
y.create.l HWIO_PMIC_ARB6_CHNL168_RDATA1_ADDR A:0x294601c
y.create.l HWIO_PMIC_ARB6_CHNL169_RDATA1_ADDR A:0x294e01c
y.create.l HWIO_PMIC_ARB6_CHNL170_RDATA1_ADDR A:0x295601c
y.create.l HWIO_PMIC_ARB6_CHNL171_RDATA1_ADDR A:0x295e01c
y.create.l HWIO_PMIC_ARB6_CHNL172_RDATA1_ADDR A:0x296601c
y.create.l HWIO_PMIC_ARB6_CHNL173_RDATA1_ADDR A:0x296e01c
y.create.l HWIO_PMIC_ARB6_CHNL174_RDATA1_ADDR A:0x297601c
y.create.l HWIO_PMIC_ARB6_CHNL175_RDATA1_ADDR A:0x297e01c
y.create.l HWIO_PMIC_ARB6_CHNL176_RDATA1_ADDR A:0x298601c
y.create.l HWIO_PMIC_ARB6_CHNL177_RDATA1_ADDR A:0x298e01c
y.create.l HWIO_PMIC_ARB6_CHNL178_RDATA1_ADDR A:0x299601c
y.create.l HWIO_PMIC_ARB6_CHNL179_RDATA1_ADDR A:0x299e01c
y.create.l HWIO_PMIC_ARB6_CHNL180_RDATA1_ADDR A:0x29a601c
y.create.l HWIO_PMIC_ARB6_CHNL181_RDATA1_ADDR A:0x29ae01c
y.create.l HWIO_PMIC_ARB6_CHNL182_RDATA1_ADDR A:0x29b601c
y.create.l HWIO_PMIC_ARB6_CHNL183_RDATA1_ADDR A:0x29be01c
y.create.l HWIO_PMIC_ARB6_CHNL184_RDATA1_ADDR A:0x29c601c
y.create.l HWIO_PMIC_ARB6_CHNL185_RDATA1_ADDR A:0x29ce01c
y.create.l HWIO_PMIC_ARB6_CHNL186_RDATA1_ADDR A:0x29d601c
y.create.l HWIO_PMIC_ARB6_CHNL187_RDATA1_ADDR A:0x29de01c
y.create.l HWIO_PMIC_ARB6_CHNL188_RDATA1_ADDR A:0x29e601c
y.create.l HWIO_PMIC_ARB6_CHNL189_RDATA1_ADDR A:0x29ee01c
y.create.l HWIO_PMIC_ARB6_CHNL190_RDATA1_ADDR A:0x29f601c
y.create.l HWIO_PMIC_ARB6_CHNL191_RDATA1_ADDR A:0x29fe01c
y.create.l HWIO_PMIC_ARB6_CHNL192_RDATA1_ADDR A:0x2a0601c
y.create.l HWIO_PMIC_ARB6_CHNL193_RDATA1_ADDR A:0x2a0e01c
y.create.l HWIO_PMIC_ARB6_CHNL194_RDATA1_ADDR A:0x2a1601c
y.create.l HWIO_PMIC_ARB6_CHNL195_RDATA1_ADDR A:0x2a1e01c
y.create.l HWIO_PMIC_ARB6_CHNL196_RDATA1_ADDR A:0x2a2601c
y.create.l HWIO_PMIC_ARB6_CHNL197_RDATA1_ADDR A:0x2a2e01c
y.create.l HWIO_PMIC_ARB6_CHNL198_RDATA1_ADDR A:0x2a3601c
y.create.l HWIO_PMIC_ARB6_CHNL199_RDATA1_ADDR A:0x2a3e01c
y.create.l HWIO_PMIC_ARB6_CHNL200_RDATA1_ADDR A:0x2a4601c
y.create.l HWIO_PMIC_ARB6_CHNL201_RDATA1_ADDR A:0x2a4e01c
y.create.l HWIO_PMIC_ARB6_CHNL202_RDATA1_ADDR A:0x2a5601c
y.create.l HWIO_PMIC_ARB6_CHNL203_RDATA1_ADDR A:0x2a5e01c
y.create.l HWIO_PMIC_ARB6_CHNL204_RDATA1_ADDR A:0x2a6601c
y.create.l HWIO_PMIC_ARB6_CHNL205_RDATA1_ADDR A:0x2a6e01c
y.create.l HWIO_PMIC_ARB6_CHNL206_RDATA1_ADDR A:0x2a7601c
y.create.l HWIO_PMIC_ARB6_CHNL207_RDATA1_ADDR A:0x2a7e01c
y.create.l HWIO_PMIC_ARB6_CHNL208_RDATA1_ADDR A:0x2a8601c
y.create.l HWIO_PMIC_ARB6_CHNL209_RDATA1_ADDR A:0x2a8e01c
y.create.l HWIO_PMIC_ARB6_CHNL210_RDATA1_ADDR A:0x2a9601c
y.create.l HWIO_PMIC_ARB6_CHNL211_RDATA1_ADDR A:0x2a9e01c
y.create.l HWIO_PMIC_ARB6_CHNL212_RDATA1_ADDR A:0x2aa601c
y.create.l HWIO_PMIC_ARB6_CHNL213_RDATA1_ADDR A:0x2aae01c
y.create.l HWIO_PMIC_ARB6_CHNL214_RDATA1_ADDR A:0x2ab601c
y.create.l HWIO_PMIC_ARB6_CHNL215_RDATA1_ADDR A:0x2abe01c
y.create.l HWIO_PMIC_ARB6_CHNL216_RDATA1_ADDR A:0x2ac601c
y.create.l HWIO_PMIC_ARB6_CHNL217_RDATA1_ADDR A:0x2ace01c
y.create.l HWIO_PMIC_ARB6_CHNL218_RDATA1_ADDR A:0x2ad601c
y.create.l HWIO_PMIC_ARB6_CHNL219_RDATA1_ADDR A:0x2ade01c
y.create.l HWIO_PMIC_ARB6_CHNL220_RDATA1_ADDR A:0x2ae601c
y.create.l HWIO_PMIC_ARB6_CHNL221_RDATA1_ADDR A:0x2aee01c
y.create.l HWIO_PMIC_ARB6_CHNL222_RDATA1_ADDR A:0x2af601c
y.create.l HWIO_PMIC_ARB6_CHNL223_RDATA1_ADDR A:0x2afe01c
y.create.l HWIO_PMIC_ARB6_CHNL224_RDATA1_ADDR A:0x2b0601c
y.create.l HWIO_PMIC_ARB6_CHNL225_RDATA1_ADDR A:0x2b0e01c
y.create.l HWIO_PMIC_ARB6_CHNL226_RDATA1_ADDR A:0x2b1601c
y.create.l HWIO_PMIC_ARB6_CHNL227_RDATA1_ADDR A:0x2b1e01c
y.create.l HWIO_PMIC_ARB6_CHNL228_RDATA1_ADDR A:0x2b2601c
y.create.l HWIO_PMIC_ARB6_CHNL229_RDATA1_ADDR A:0x2b2e01c
y.create.l HWIO_PMIC_ARB6_CHNL230_RDATA1_ADDR A:0x2b3601c
y.create.l HWIO_PMIC_ARB6_CHNL231_RDATA1_ADDR A:0x2b3e01c
y.create.l HWIO_PMIC_ARB6_CHNL232_RDATA1_ADDR A:0x2b4601c
y.create.l HWIO_PMIC_ARB6_CHNL233_RDATA1_ADDR A:0x2b4e01c
y.create.l HWIO_PMIC_ARB6_CHNL234_RDATA1_ADDR A:0x2b5601c
y.create.l HWIO_PMIC_ARB6_CHNL235_RDATA1_ADDR A:0x2b5e01c
y.create.l HWIO_PMIC_ARB6_CHNL236_RDATA1_ADDR A:0x2b6601c
y.create.l HWIO_PMIC_ARB6_CHNL237_RDATA1_ADDR A:0x2b6e01c
y.create.l HWIO_PMIC_ARB6_CHNL238_RDATA1_ADDR A:0x2b7601c
y.create.l HWIO_PMIC_ARB6_CHNL239_RDATA1_ADDR A:0x2b7e01c
y.create.l HWIO_PMIC_ARB6_CHNL240_RDATA1_ADDR A:0x2b8601c
y.create.l HWIO_PMIC_ARB6_CHNL241_RDATA1_ADDR A:0x2b8e01c
y.create.l HWIO_PMIC_ARB6_CHNL242_RDATA1_ADDR A:0x2b9601c
y.create.l HWIO_PMIC_ARB6_CHNL243_RDATA1_ADDR A:0x2b9e01c
y.create.l HWIO_PMIC_ARB6_CHNL244_RDATA1_ADDR A:0x2ba601c
y.create.l HWIO_PMIC_ARB6_CHNL245_RDATA1_ADDR A:0x2bae01c
y.create.l HWIO_PMIC_ARB6_CHNL246_RDATA1_ADDR A:0x2bb601c
y.create.l HWIO_PMIC_ARB6_CHNL247_RDATA1_ADDR A:0x2bbe01c
y.create.l HWIO_PMIC_ARB6_CHNL248_RDATA1_ADDR A:0x2bc601c
y.create.l HWIO_PMIC_ARB6_CHNL249_RDATA1_ADDR A:0x2bce01c
y.create.l HWIO_PMIC_ARB6_CHNL250_RDATA1_ADDR A:0x2bd601c
y.create.l HWIO_PMIC_ARB6_CHNL251_RDATA1_ADDR A:0x2bde01c
y.create.l HWIO_PMIC_ARB6_CHNL252_RDATA1_ADDR A:0x2be601c
y.create.l HWIO_PMIC_ARB6_CHNL253_RDATA1_ADDR A:0x2bee01c
y.create.l HWIO_PMIC_ARB6_CHNL254_RDATA1_ADDR A:0x2bf601c
y.create.l HWIO_PMIC_ARB6_CHNL255_RDATA1_ADDR A:0x2bfe01c
y.create.l HWIO_PMIC_ARB0_CHNL0_RDATA2_ADDR A:0x2400020
y.create.l HWIO_PMIC_ARB0_CHNL1_RDATA2_ADDR A:0x2408020
y.create.l HWIO_PMIC_ARB0_CHNL2_RDATA2_ADDR A:0x2410020
y.create.l HWIO_PMIC_ARB0_CHNL3_RDATA2_ADDR A:0x2418020
y.create.l HWIO_PMIC_ARB0_CHNL4_RDATA2_ADDR A:0x2420020
y.create.l HWIO_PMIC_ARB0_CHNL5_RDATA2_ADDR A:0x2428020
y.create.l HWIO_PMIC_ARB0_CHNL6_RDATA2_ADDR A:0x2430020
y.create.l HWIO_PMIC_ARB0_CHNL7_RDATA2_ADDR A:0x2438020
y.create.l HWIO_PMIC_ARB0_CHNL8_RDATA2_ADDR A:0x2440020
y.create.l HWIO_PMIC_ARB0_CHNL9_RDATA2_ADDR A:0x2448020
y.create.l HWIO_PMIC_ARB0_CHNL10_RDATA2_ADDR A:0x2450020
y.create.l HWIO_PMIC_ARB0_CHNL11_RDATA2_ADDR A:0x2458020
y.create.l HWIO_PMIC_ARB0_CHNL12_RDATA2_ADDR A:0x2460020
y.create.l HWIO_PMIC_ARB0_CHNL13_RDATA2_ADDR A:0x2468020
y.create.l HWIO_PMIC_ARB0_CHNL14_RDATA2_ADDR A:0x2470020
y.create.l HWIO_PMIC_ARB0_CHNL15_RDATA2_ADDR A:0x2478020
y.create.l HWIO_PMIC_ARB0_CHNL16_RDATA2_ADDR A:0x2480020
y.create.l HWIO_PMIC_ARB0_CHNL17_RDATA2_ADDR A:0x2488020
y.create.l HWIO_PMIC_ARB0_CHNL18_RDATA2_ADDR A:0x2490020
y.create.l HWIO_PMIC_ARB0_CHNL19_RDATA2_ADDR A:0x2498020
y.create.l HWIO_PMIC_ARB0_CHNL20_RDATA2_ADDR A:0x24a0020
y.create.l HWIO_PMIC_ARB0_CHNL21_RDATA2_ADDR A:0x24a8020
y.create.l HWIO_PMIC_ARB0_CHNL22_RDATA2_ADDR A:0x24b0020
y.create.l HWIO_PMIC_ARB0_CHNL23_RDATA2_ADDR A:0x24b8020
y.create.l HWIO_PMIC_ARB0_CHNL24_RDATA2_ADDR A:0x24c0020
y.create.l HWIO_PMIC_ARB0_CHNL25_RDATA2_ADDR A:0x24c8020
y.create.l HWIO_PMIC_ARB0_CHNL26_RDATA2_ADDR A:0x24d0020
y.create.l HWIO_PMIC_ARB0_CHNL27_RDATA2_ADDR A:0x24d8020
y.create.l HWIO_PMIC_ARB0_CHNL28_RDATA2_ADDR A:0x24e0020
y.create.l HWIO_PMIC_ARB0_CHNL29_RDATA2_ADDR A:0x24e8020
y.create.l HWIO_PMIC_ARB0_CHNL30_RDATA2_ADDR A:0x24f0020
y.create.l HWIO_PMIC_ARB0_CHNL31_RDATA2_ADDR A:0x24f8020
y.create.l HWIO_PMIC_ARB0_CHNL32_RDATA2_ADDR A:0x2500020
y.create.l HWIO_PMIC_ARB0_CHNL33_RDATA2_ADDR A:0x2508020
y.create.l HWIO_PMIC_ARB0_CHNL34_RDATA2_ADDR A:0x2510020
y.create.l HWIO_PMIC_ARB0_CHNL35_RDATA2_ADDR A:0x2518020
y.create.l HWIO_PMIC_ARB0_CHNL36_RDATA2_ADDR A:0x2520020
y.create.l HWIO_PMIC_ARB0_CHNL37_RDATA2_ADDR A:0x2528020
y.create.l HWIO_PMIC_ARB0_CHNL38_RDATA2_ADDR A:0x2530020
y.create.l HWIO_PMIC_ARB0_CHNL39_RDATA2_ADDR A:0x2538020
y.create.l HWIO_PMIC_ARB0_CHNL40_RDATA2_ADDR A:0x2540020
y.create.l HWIO_PMIC_ARB0_CHNL41_RDATA2_ADDR A:0x2548020
y.create.l HWIO_PMIC_ARB0_CHNL42_RDATA2_ADDR A:0x2550020
y.create.l HWIO_PMIC_ARB0_CHNL43_RDATA2_ADDR A:0x2558020
y.create.l HWIO_PMIC_ARB0_CHNL44_RDATA2_ADDR A:0x2560020
y.create.l HWIO_PMIC_ARB0_CHNL45_RDATA2_ADDR A:0x2568020
y.create.l HWIO_PMIC_ARB0_CHNL46_RDATA2_ADDR A:0x2570020
y.create.l HWIO_PMIC_ARB0_CHNL47_RDATA2_ADDR A:0x2578020
y.create.l HWIO_PMIC_ARB0_CHNL48_RDATA2_ADDR A:0x2580020
y.create.l HWIO_PMIC_ARB0_CHNL49_RDATA2_ADDR A:0x2588020
y.create.l HWIO_PMIC_ARB0_CHNL50_RDATA2_ADDR A:0x2590020
y.create.l HWIO_PMIC_ARB0_CHNL51_RDATA2_ADDR A:0x2598020
y.create.l HWIO_PMIC_ARB0_CHNL52_RDATA2_ADDR A:0x25a0020
y.create.l HWIO_PMIC_ARB0_CHNL53_RDATA2_ADDR A:0x25a8020
y.create.l HWIO_PMIC_ARB0_CHNL54_RDATA2_ADDR A:0x25b0020
y.create.l HWIO_PMIC_ARB0_CHNL55_RDATA2_ADDR A:0x25b8020
y.create.l HWIO_PMIC_ARB0_CHNL56_RDATA2_ADDR A:0x25c0020
y.create.l HWIO_PMIC_ARB0_CHNL57_RDATA2_ADDR A:0x25c8020
y.create.l HWIO_PMIC_ARB0_CHNL58_RDATA2_ADDR A:0x25d0020
y.create.l HWIO_PMIC_ARB0_CHNL59_RDATA2_ADDR A:0x25d8020
y.create.l HWIO_PMIC_ARB0_CHNL60_RDATA2_ADDR A:0x25e0020
y.create.l HWIO_PMIC_ARB0_CHNL61_RDATA2_ADDR A:0x25e8020
y.create.l HWIO_PMIC_ARB0_CHNL62_RDATA2_ADDR A:0x25f0020
y.create.l HWIO_PMIC_ARB0_CHNL63_RDATA2_ADDR A:0x25f8020
y.create.l HWIO_PMIC_ARB0_CHNL64_RDATA2_ADDR A:0x2600020
y.create.l HWIO_PMIC_ARB0_CHNL65_RDATA2_ADDR A:0x2608020
y.create.l HWIO_PMIC_ARB0_CHNL66_RDATA2_ADDR A:0x2610020
y.create.l HWIO_PMIC_ARB0_CHNL67_RDATA2_ADDR A:0x2618020
y.create.l HWIO_PMIC_ARB0_CHNL68_RDATA2_ADDR A:0x2620020
y.create.l HWIO_PMIC_ARB0_CHNL69_RDATA2_ADDR A:0x2628020
y.create.l HWIO_PMIC_ARB0_CHNL70_RDATA2_ADDR A:0x2630020
y.create.l HWIO_PMIC_ARB0_CHNL71_RDATA2_ADDR A:0x2638020
y.create.l HWIO_PMIC_ARB0_CHNL72_RDATA2_ADDR A:0x2640020
y.create.l HWIO_PMIC_ARB0_CHNL73_RDATA2_ADDR A:0x2648020
y.create.l HWIO_PMIC_ARB0_CHNL74_RDATA2_ADDR A:0x2650020
y.create.l HWIO_PMIC_ARB0_CHNL75_RDATA2_ADDR A:0x2658020
y.create.l HWIO_PMIC_ARB0_CHNL76_RDATA2_ADDR A:0x2660020
y.create.l HWIO_PMIC_ARB0_CHNL77_RDATA2_ADDR A:0x2668020
y.create.l HWIO_PMIC_ARB0_CHNL78_RDATA2_ADDR A:0x2670020
y.create.l HWIO_PMIC_ARB0_CHNL79_RDATA2_ADDR A:0x2678020
y.create.l HWIO_PMIC_ARB0_CHNL80_RDATA2_ADDR A:0x2680020
y.create.l HWIO_PMIC_ARB0_CHNL81_RDATA2_ADDR A:0x2688020
y.create.l HWIO_PMIC_ARB0_CHNL82_RDATA2_ADDR A:0x2690020
y.create.l HWIO_PMIC_ARB0_CHNL83_RDATA2_ADDR A:0x2698020
y.create.l HWIO_PMIC_ARB0_CHNL84_RDATA2_ADDR A:0x26a0020
y.create.l HWIO_PMIC_ARB0_CHNL85_RDATA2_ADDR A:0x26a8020
y.create.l HWIO_PMIC_ARB0_CHNL86_RDATA2_ADDR A:0x26b0020
y.create.l HWIO_PMIC_ARB0_CHNL87_RDATA2_ADDR A:0x26b8020
y.create.l HWIO_PMIC_ARB0_CHNL88_RDATA2_ADDR A:0x26c0020
y.create.l HWIO_PMIC_ARB0_CHNL89_RDATA2_ADDR A:0x26c8020
y.create.l HWIO_PMIC_ARB0_CHNL90_RDATA2_ADDR A:0x26d0020
y.create.l HWIO_PMIC_ARB0_CHNL91_RDATA2_ADDR A:0x26d8020
y.create.l HWIO_PMIC_ARB0_CHNL92_RDATA2_ADDR A:0x26e0020
y.create.l HWIO_PMIC_ARB0_CHNL93_RDATA2_ADDR A:0x26e8020
y.create.l HWIO_PMIC_ARB0_CHNL94_RDATA2_ADDR A:0x26f0020
y.create.l HWIO_PMIC_ARB0_CHNL95_RDATA2_ADDR A:0x26f8020
y.create.l HWIO_PMIC_ARB0_CHNL96_RDATA2_ADDR A:0x2700020
y.create.l HWIO_PMIC_ARB0_CHNL97_RDATA2_ADDR A:0x2708020
y.create.l HWIO_PMIC_ARB0_CHNL98_RDATA2_ADDR A:0x2710020
y.create.l HWIO_PMIC_ARB0_CHNL99_RDATA2_ADDR A:0x2718020
y.create.l HWIO_PMIC_ARB0_CHNL100_RDATA2_ADDR A:0x2720020
y.create.l HWIO_PMIC_ARB0_CHNL101_RDATA2_ADDR A:0x2728020
y.create.l HWIO_PMIC_ARB0_CHNL102_RDATA2_ADDR A:0x2730020
y.create.l HWIO_PMIC_ARB0_CHNL103_RDATA2_ADDR A:0x2738020
y.create.l HWIO_PMIC_ARB0_CHNL104_RDATA2_ADDR A:0x2740020
y.create.l HWIO_PMIC_ARB0_CHNL105_RDATA2_ADDR A:0x2748020
y.create.l HWIO_PMIC_ARB0_CHNL106_RDATA2_ADDR A:0x2750020
y.create.l HWIO_PMIC_ARB0_CHNL107_RDATA2_ADDR A:0x2758020
y.create.l HWIO_PMIC_ARB0_CHNL108_RDATA2_ADDR A:0x2760020
y.create.l HWIO_PMIC_ARB0_CHNL109_RDATA2_ADDR A:0x2768020
y.create.l HWIO_PMIC_ARB0_CHNL110_RDATA2_ADDR A:0x2770020
y.create.l HWIO_PMIC_ARB0_CHNL111_RDATA2_ADDR A:0x2778020
y.create.l HWIO_PMIC_ARB0_CHNL112_RDATA2_ADDR A:0x2780020
y.create.l HWIO_PMIC_ARB0_CHNL113_RDATA2_ADDR A:0x2788020
y.create.l HWIO_PMIC_ARB0_CHNL114_RDATA2_ADDR A:0x2790020
y.create.l HWIO_PMIC_ARB0_CHNL115_RDATA2_ADDR A:0x2798020
y.create.l HWIO_PMIC_ARB0_CHNL116_RDATA2_ADDR A:0x27a0020
y.create.l HWIO_PMIC_ARB0_CHNL117_RDATA2_ADDR A:0x27a8020
y.create.l HWIO_PMIC_ARB0_CHNL118_RDATA2_ADDR A:0x27b0020
y.create.l HWIO_PMIC_ARB0_CHNL119_RDATA2_ADDR A:0x27b8020
y.create.l HWIO_PMIC_ARB0_CHNL120_RDATA2_ADDR A:0x27c0020
y.create.l HWIO_PMIC_ARB0_CHNL121_RDATA2_ADDR A:0x27c8020
y.create.l HWIO_PMIC_ARB0_CHNL122_RDATA2_ADDR A:0x27d0020
y.create.l HWIO_PMIC_ARB0_CHNL123_RDATA2_ADDR A:0x27d8020
y.create.l HWIO_PMIC_ARB0_CHNL124_RDATA2_ADDR A:0x27e0020
y.create.l HWIO_PMIC_ARB0_CHNL125_RDATA2_ADDR A:0x27e8020
y.create.l HWIO_PMIC_ARB0_CHNL126_RDATA2_ADDR A:0x27f0020
y.create.l HWIO_PMIC_ARB0_CHNL127_RDATA2_ADDR A:0x27f8020
y.create.l HWIO_PMIC_ARB0_CHNL128_RDATA2_ADDR A:0x2800020
y.create.l HWIO_PMIC_ARB0_CHNL129_RDATA2_ADDR A:0x2808020
y.create.l HWIO_PMIC_ARB0_CHNL130_RDATA2_ADDR A:0x2810020
y.create.l HWIO_PMIC_ARB0_CHNL131_RDATA2_ADDR A:0x2818020
y.create.l HWIO_PMIC_ARB0_CHNL132_RDATA2_ADDR A:0x2820020
y.create.l HWIO_PMIC_ARB0_CHNL133_RDATA2_ADDR A:0x2828020
y.create.l HWIO_PMIC_ARB0_CHNL134_RDATA2_ADDR A:0x2830020
y.create.l HWIO_PMIC_ARB0_CHNL135_RDATA2_ADDR A:0x2838020
y.create.l HWIO_PMIC_ARB0_CHNL136_RDATA2_ADDR A:0x2840020
y.create.l HWIO_PMIC_ARB0_CHNL137_RDATA2_ADDR A:0x2848020
y.create.l HWIO_PMIC_ARB0_CHNL138_RDATA2_ADDR A:0x2850020
y.create.l HWIO_PMIC_ARB0_CHNL139_RDATA2_ADDR A:0x2858020
y.create.l HWIO_PMIC_ARB0_CHNL140_RDATA2_ADDR A:0x2860020
y.create.l HWIO_PMIC_ARB0_CHNL141_RDATA2_ADDR A:0x2868020
y.create.l HWIO_PMIC_ARB0_CHNL142_RDATA2_ADDR A:0x2870020
y.create.l HWIO_PMIC_ARB0_CHNL143_RDATA2_ADDR A:0x2878020
y.create.l HWIO_PMIC_ARB0_CHNL144_RDATA2_ADDR A:0x2880020
y.create.l HWIO_PMIC_ARB0_CHNL145_RDATA2_ADDR A:0x2888020
y.create.l HWIO_PMIC_ARB0_CHNL146_RDATA2_ADDR A:0x2890020
y.create.l HWIO_PMIC_ARB0_CHNL147_RDATA2_ADDR A:0x2898020
y.create.l HWIO_PMIC_ARB0_CHNL148_RDATA2_ADDR A:0x28a0020
y.create.l HWIO_PMIC_ARB0_CHNL149_RDATA2_ADDR A:0x28a8020
y.create.l HWIO_PMIC_ARB0_CHNL150_RDATA2_ADDR A:0x28b0020
y.create.l HWIO_PMIC_ARB0_CHNL151_RDATA2_ADDR A:0x28b8020
y.create.l HWIO_PMIC_ARB0_CHNL152_RDATA2_ADDR A:0x28c0020
y.create.l HWIO_PMIC_ARB0_CHNL153_RDATA2_ADDR A:0x28c8020
y.create.l HWIO_PMIC_ARB0_CHNL154_RDATA2_ADDR A:0x28d0020
y.create.l HWIO_PMIC_ARB0_CHNL155_RDATA2_ADDR A:0x28d8020
y.create.l HWIO_PMIC_ARB0_CHNL156_RDATA2_ADDR A:0x28e0020
y.create.l HWIO_PMIC_ARB0_CHNL157_RDATA2_ADDR A:0x28e8020
y.create.l HWIO_PMIC_ARB0_CHNL158_RDATA2_ADDR A:0x28f0020
y.create.l HWIO_PMIC_ARB0_CHNL159_RDATA2_ADDR A:0x28f8020
y.create.l HWIO_PMIC_ARB0_CHNL160_RDATA2_ADDR A:0x2900020
y.create.l HWIO_PMIC_ARB0_CHNL161_RDATA2_ADDR A:0x2908020
y.create.l HWIO_PMIC_ARB0_CHNL162_RDATA2_ADDR A:0x2910020
y.create.l HWIO_PMIC_ARB0_CHNL163_RDATA2_ADDR A:0x2918020
y.create.l HWIO_PMIC_ARB0_CHNL164_RDATA2_ADDR A:0x2920020
y.create.l HWIO_PMIC_ARB0_CHNL165_RDATA2_ADDR A:0x2928020
y.create.l HWIO_PMIC_ARB0_CHNL166_RDATA2_ADDR A:0x2930020
y.create.l HWIO_PMIC_ARB0_CHNL167_RDATA2_ADDR A:0x2938020
y.create.l HWIO_PMIC_ARB0_CHNL168_RDATA2_ADDR A:0x2940020
y.create.l HWIO_PMIC_ARB0_CHNL169_RDATA2_ADDR A:0x2948020
y.create.l HWIO_PMIC_ARB0_CHNL170_RDATA2_ADDR A:0x2950020
y.create.l HWIO_PMIC_ARB0_CHNL171_RDATA2_ADDR A:0x2958020
y.create.l HWIO_PMIC_ARB0_CHNL172_RDATA2_ADDR A:0x2960020
y.create.l HWIO_PMIC_ARB0_CHNL173_RDATA2_ADDR A:0x2968020
y.create.l HWIO_PMIC_ARB0_CHNL174_RDATA2_ADDR A:0x2970020
y.create.l HWIO_PMIC_ARB0_CHNL175_RDATA2_ADDR A:0x2978020
y.create.l HWIO_PMIC_ARB0_CHNL176_RDATA2_ADDR A:0x2980020
y.create.l HWIO_PMIC_ARB0_CHNL177_RDATA2_ADDR A:0x2988020
y.create.l HWIO_PMIC_ARB0_CHNL178_RDATA2_ADDR A:0x2990020
y.create.l HWIO_PMIC_ARB0_CHNL179_RDATA2_ADDR A:0x2998020
y.create.l HWIO_PMIC_ARB0_CHNL180_RDATA2_ADDR A:0x29a0020
y.create.l HWIO_PMIC_ARB0_CHNL181_RDATA2_ADDR A:0x29a8020
y.create.l HWIO_PMIC_ARB0_CHNL182_RDATA2_ADDR A:0x29b0020
y.create.l HWIO_PMIC_ARB0_CHNL183_RDATA2_ADDR A:0x29b8020
y.create.l HWIO_PMIC_ARB0_CHNL184_RDATA2_ADDR A:0x29c0020
y.create.l HWIO_PMIC_ARB0_CHNL185_RDATA2_ADDR A:0x29c8020
y.create.l HWIO_PMIC_ARB0_CHNL186_RDATA2_ADDR A:0x29d0020
y.create.l HWIO_PMIC_ARB0_CHNL187_RDATA2_ADDR A:0x29d8020
y.create.l HWIO_PMIC_ARB0_CHNL188_RDATA2_ADDR A:0x29e0020
y.create.l HWIO_PMIC_ARB0_CHNL189_RDATA2_ADDR A:0x29e8020
y.create.l HWIO_PMIC_ARB0_CHNL190_RDATA2_ADDR A:0x29f0020
y.create.l HWIO_PMIC_ARB0_CHNL191_RDATA2_ADDR A:0x29f8020
y.create.l HWIO_PMIC_ARB0_CHNL192_RDATA2_ADDR A:0x2a00020
y.create.l HWIO_PMIC_ARB0_CHNL193_RDATA2_ADDR A:0x2a08020
y.create.l HWIO_PMIC_ARB0_CHNL194_RDATA2_ADDR A:0x2a10020
y.create.l HWIO_PMIC_ARB0_CHNL195_RDATA2_ADDR A:0x2a18020
y.create.l HWIO_PMIC_ARB0_CHNL196_RDATA2_ADDR A:0x2a20020
y.create.l HWIO_PMIC_ARB0_CHNL197_RDATA2_ADDR A:0x2a28020
y.create.l HWIO_PMIC_ARB0_CHNL198_RDATA2_ADDR A:0x2a30020
y.create.l HWIO_PMIC_ARB0_CHNL199_RDATA2_ADDR A:0x2a38020
y.create.l HWIO_PMIC_ARB0_CHNL200_RDATA2_ADDR A:0x2a40020
y.create.l HWIO_PMIC_ARB0_CHNL201_RDATA2_ADDR A:0x2a48020
y.create.l HWIO_PMIC_ARB0_CHNL202_RDATA2_ADDR A:0x2a50020
y.create.l HWIO_PMIC_ARB0_CHNL203_RDATA2_ADDR A:0x2a58020
y.create.l HWIO_PMIC_ARB0_CHNL204_RDATA2_ADDR A:0x2a60020
y.create.l HWIO_PMIC_ARB0_CHNL205_RDATA2_ADDR A:0x2a68020
y.create.l HWIO_PMIC_ARB0_CHNL206_RDATA2_ADDR A:0x2a70020
y.create.l HWIO_PMIC_ARB0_CHNL207_RDATA2_ADDR A:0x2a78020
y.create.l HWIO_PMIC_ARB0_CHNL208_RDATA2_ADDR A:0x2a80020
y.create.l HWIO_PMIC_ARB0_CHNL209_RDATA2_ADDR A:0x2a88020
y.create.l HWIO_PMIC_ARB0_CHNL210_RDATA2_ADDR A:0x2a90020
y.create.l HWIO_PMIC_ARB0_CHNL211_RDATA2_ADDR A:0x2a98020
y.create.l HWIO_PMIC_ARB0_CHNL212_RDATA2_ADDR A:0x2aa0020
y.create.l HWIO_PMIC_ARB0_CHNL213_RDATA2_ADDR A:0x2aa8020
y.create.l HWIO_PMIC_ARB0_CHNL214_RDATA2_ADDR A:0x2ab0020
y.create.l HWIO_PMIC_ARB0_CHNL215_RDATA2_ADDR A:0x2ab8020
y.create.l HWIO_PMIC_ARB0_CHNL216_RDATA2_ADDR A:0x2ac0020
y.create.l HWIO_PMIC_ARB0_CHNL217_RDATA2_ADDR A:0x2ac8020
y.create.l HWIO_PMIC_ARB0_CHNL218_RDATA2_ADDR A:0x2ad0020
y.create.l HWIO_PMIC_ARB0_CHNL219_RDATA2_ADDR A:0x2ad8020
y.create.l HWIO_PMIC_ARB0_CHNL220_RDATA2_ADDR A:0x2ae0020
y.create.l HWIO_PMIC_ARB0_CHNL221_RDATA2_ADDR A:0x2ae8020
y.create.l HWIO_PMIC_ARB0_CHNL222_RDATA2_ADDR A:0x2af0020
y.create.l HWIO_PMIC_ARB0_CHNL223_RDATA2_ADDR A:0x2af8020
y.create.l HWIO_PMIC_ARB0_CHNL224_RDATA2_ADDR A:0x2b00020
y.create.l HWIO_PMIC_ARB0_CHNL225_RDATA2_ADDR A:0x2b08020
y.create.l HWIO_PMIC_ARB0_CHNL226_RDATA2_ADDR A:0x2b10020
y.create.l HWIO_PMIC_ARB0_CHNL227_RDATA2_ADDR A:0x2b18020
y.create.l HWIO_PMIC_ARB0_CHNL228_RDATA2_ADDR A:0x2b20020
y.create.l HWIO_PMIC_ARB0_CHNL229_RDATA2_ADDR A:0x2b28020
y.create.l HWIO_PMIC_ARB0_CHNL230_RDATA2_ADDR A:0x2b30020
y.create.l HWIO_PMIC_ARB0_CHNL231_RDATA2_ADDR A:0x2b38020
y.create.l HWIO_PMIC_ARB0_CHNL232_RDATA2_ADDR A:0x2b40020
y.create.l HWIO_PMIC_ARB0_CHNL233_RDATA2_ADDR A:0x2b48020
y.create.l HWIO_PMIC_ARB0_CHNL234_RDATA2_ADDR A:0x2b50020
y.create.l HWIO_PMIC_ARB0_CHNL235_RDATA2_ADDR A:0x2b58020
y.create.l HWIO_PMIC_ARB0_CHNL236_RDATA2_ADDR A:0x2b60020
y.create.l HWIO_PMIC_ARB0_CHNL237_RDATA2_ADDR A:0x2b68020
y.create.l HWIO_PMIC_ARB0_CHNL238_RDATA2_ADDR A:0x2b70020
y.create.l HWIO_PMIC_ARB0_CHNL239_RDATA2_ADDR A:0x2b78020
y.create.l HWIO_PMIC_ARB0_CHNL240_RDATA2_ADDR A:0x2b80020
y.create.l HWIO_PMIC_ARB0_CHNL241_RDATA2_ADDR A:0x2b88020
y.create.l HWIO_PMIC_ARB0_CHNL242_RDATA2_ADDR A:0x2b90020
y.create.l HWIO_PMIC_ARB0_CHNL243_RDATA2_ADDR A:0x2b98020
y.create.l HWIO_PMIC_ARB0_CHNL244_RDATA2_ADDR A:0x2ba0020
y.create.l HWIO_PMIC_ARB0_CHNL245_RDATA2_ADDR A:0x2ba8020
y.create.l HWIO_PMIC_ARB0_CHNL246_RDATA2_ADDR A:0x2bb0020
y.create.l HWIO_PMIC_ARB0_CHNL247_RDATA2_ADDR A:0x2bb8020
y.create.l HWIO_PMIC_ARB0_CHNL248_RDATA2_ADDR A:0x2bc0020
y.create.l HWIO_PMIC_ARB0_CHNL249_RDATA2_ADDR A:0x2bc8020
y.create.l HWIO_PMIC_ARB0_CHNL250_RDATA2_ADDR A:0x2bd0020
y.create.l HWIO_PMIC_ARB0_CHNL251_RDATA2_ADDR A:0x2bd8020
y.create.l HWIO_PMIC_ARB0_CHNL252_RDATA2_ADDR A:0x2be0020
y.create.l HWIO_PMIC_ARB0_CHNL253_RDATA2_ADDR A:0x2be8020
y.create.l HWIO_PMIC_ARB0_CHNL254_RDATA2_ADDR A:0x2bf0020
y.create.l HWIO_PMIC_ARB0_CHNL255_RDATA2_ADDR A:0x2bf8020
y.create.l HWIO_PMIC_ARB1_CHNL0_RDATA2_ADDR A:0x2401020
y.create.l HWIO_PMIC_ARB1_CHNL1_RDATA2_ADDR A:0x2409020
y.create.l HWIO_PMIC_ARB1_CHNL2_RDATA2_ADDR A:0x2411020
y.create.l HWIO_PMIC_ARB1_CHNL3_RDATA2_ADDR A:0x2419020
y.create.l HWIO_PMIC_ARB1_CHNL4_RDATA2_ADDR A:0x2421020
y.create.l HWIO_PMIC_ARB1_CHNL5_RDATA2_ADDR A:0x2429020
y.create.l HWIO_PMIC_ARB1_CHNL6_RDATA2_ADDR A:0x2431020
y.create.l HWIO_PMIC_ARB1_CHNL7_RDATA2_ADDR A:0x2439020
y.create.l HWIO_PMIC_ARB1_CHNL8_RDATA2_ADDR A:0x2441020
y.create.l HWIO_PMIC_ARB1_CHNL9_RDATA2_ADDR A:0x2449020
y.create.l HWIO_PMIC_ARB1_CHNL10_RDATA2_ADDR A:0x2451020
y.create.l HWIO_PMIC_ARB1_CHNL11_RDATA2_ADDR A:0x2459020
y.create.l HWIO_PMIC_ARB1_CHNL12_RDATA2_ADDR A:0x2461020
y.create.l HWIO_PMIC_ARB1_CHNL13_RDATA2_ADDR A:0x2469020
y.create.l HWIO_PMIC_ARB1_CHNL14_RDATA2_ADDR A:0x2471020
y.create.l HWIO_PMIC_ARB1_CHNL15_RDATA2_ADDR A:0x2479020
y.create.l HWIO_PMIC_ARB1_CHNL16_RDATA2_ADDR A:0x2481020
y.create.l HWIO_PMIC_ARB1_CHNL17_RDATA2_ADDR A:0x2489020
y.create.l HWIO_PMIC_ARB1_CHNL18_RDATA2_ADDR A:0x2491020
y.create.l HWIO_PMIC_ARB1_CHNL19_RDATA2_ADDR A:0x2499020
y.create.l HWIO_PMIC_ARB1_CHNL20_RDATA2_ADDR A:0x24a1020
y.create.l HWIO_PMIC_ARB1_CHNL21_RDATA2_ADDR A:0x24a9020
y.create.l HWIO_PMIC_ARB1_CHNL22_RDATA2_ADDR A:0x24b1020
y.create.l HWIO_PMIC_ARB1_CHNL23_RDATA2_ADDR A:0x24b9020
y.create.l HWIO_PMIC_ARB1_CHNL24_RDATA2_ADDR A:0x24c1020
y.create.l HWIO_PMIC_ARB1_CHNL25_RDATA2_ADDR A:0x24c9020
y.create.l HWIO_PMIC_ARB1_CHNL26_RDATA2_ADDR A:0x24d1020
y.create.l HWIO_PMIC_ARB1_CHNL27_RDATA2_ADDR A:0x24d9020
y.create.l HWIO_PMIC_ARB1_CHNL28_RDATA2_ADDR A:0x24e1020
y.create.l HWIO_PMIC_ARB1_CHNL29_RDATA2_ADDR A:0x24e9020
y.create.l HWIO_PMIC_ARB1_CHNL30_RDATA2_ADDR A:0x24f1020
y.create.l HWIO_PMIC_ARB1_CHNL31_RDATA2_ADDR A:0x24f9020
y.create.l HWIO_PMIC_ARB1_CHNL32_RDATA2_ADDR A:0x2501020
y.create.l HWIO_PMIC_ARB1_CHNL33_RDATA2_ADDR A:0x2509020
y.create.l HWIO_PMIC_ARB1_CHNL34_RDATA2_ADDR A:0x2511020
y.create.l HWIO_PMIC_ARB1_CHNL35_RDATA2_ADDR A:0x2519020
y.create.l HWIO_PMIC_ARB1_CHNL36_RDATA2_ADDR A:0x2521020
y.create.l HWIO_PMIC_ARB1_CHNL37_RDATA2_ADDR A:0x2529020
y.create.l HWIO_PMIC_ARB1_CHNL38_RDATA2_ADDR A:0x2531020
y.create.l HWIO_PMIC_ARB1_CHNL39_RDATA2_ADDR A:0x2539020
y.create.l HWIO_PMIC_ARB1_CHNL40_RDATA2_ADDR A:0x2541020
y.create.l HWIO_PMIC_ARB1_CHNL41_RDATA2_ADDR A:0x2549020
y.create.l HWIO_PMIC_ARB1_CHNL42_RDATA2_ADDR A:0x2551020
y.create.l HWIO_PMIC_ARB1_CHNL43_RDATA2_ADDR A:0x2559020
y.create.l HWIO_PMIC_ARB1_CHNL44_RDATA2_ADDR A:0x2561020
y.create.l HWIO_PMIC_ARB1_CHNL45_RDATA2_ADDR A:0x2569020
y.create.l HWIO_PMIC_ARB1_CHNL46_RDATA2_ADDR A:0x2571020
y.create.l HWIO_PMIC_ARB1_CHNL47_RDATA2_ADDR A:0x2579020
y.create.l HWIO_PMIC_ARB1_CHNL48_RDATA2_ADDR A:0x2581020
y.create.l HWIO_PMIC_ARB1_CHNL49_RDATA2_ADDR A:0x2589020
y.create.l HWIO_PMIC_ARB1_CHNL50_RDATA2_ADDR A:0x2591020
y.create.l HWIO_PMIC_ARB1_CHNL51_RDATA2_ADDR A:0x2599020
y.create.l HWIO_PMIC_ARB1_CHNL52_RDATA2_ADDR A:0x25a1020
y.create.l HWIO_PMIC_ARB1_CHNL53_RDATA2_ADDR A:0x25a9020
y.create.l HWIO_PMIC_ARB1_CHNL54_RDATA2_ADDR A:0x25b1020
y.create.l HWIO_PMIC_ARB1_CHNL55_RDATA2_ADDR A:0x25b9020
y.create.l HWIO_PMIC_ARB1_CHNL56_RDATA2_ADDR A:0x25c1020
y.create.l HWIO_PMIC_ARB1_CHNL57_RDATA2_ADDR A:0x25c9020
y.create.l HWIO_PMIC_ARB1_CHNL58_RDATA2_ADDR A:0x25d1020
y.create.l HWIO_PMIC_ARB1_CHNL59_RDATA2_ADDR A:0x25d9020
y.create.l HWIO_PMIC_ARB1_CHNL60_RDATA2_ADDR A:0x25e1020
y.create.l HWIO_PMIC_ARB1_CHNL61_RDATA2_ADDR A:0x25e9020
y.create.l HWIO_PMIC_ARB1_CHNL62_RDATA2_ADDR A:0x25f1020
y.create.l HWIO_PMIC_ARB1_CHNL63_RDATA2_ADDR A:0x25f9020
y.create.l HWIO_PMIC_ARB1_CHNL64_RDATA2_ADDR A:0x2601020
y.create.l HWIO_PMIC_ARB1_CHNL65_RDATA2_ADDR A:0x2609020
y.create.l HWIO_PMIC_ARB1_CHNL66_RDATA2_ADDR A:0x2611020
y.create.l HWIO_PMIC_ARB1_CHNL67_RDATA2_ADDR A:0x2619020
y.create.l HWIO_PMIC_ARB1_CHNL68_RDATA2_ADDR A:0x2621020
y.create.l HWIO_PMIC_ARB1_CHNL69_RDATA2_ADDR A:0x2629020
y.create.l HWIO_PMIC_ARB1_CHNL70_RDATA2_ADDR A:0x2631020
y.create.l HWIO_PMIC_ARB1_CHNL71_RDATA2_ADDR A:0x2639020
y.create.l HWIO_PMIC_ARB1_CHNL72_RDATA2_ADDR A:0x2641020
y.create.l HWIO_PMIC_ARB1_CHNL73_RDATA2_ADDR A:0x2649020
y.create.l HWIO_PMIC_ARB1_CHNL74_RDATA2_ADDR A:0x2651020
y.create.l HWIO_PMIC_ARB1_CHNL75_RDATA2_ADDR A:0x2659020
y.create.l HWIO_PMIC_ARB1_CHNL76_RDATA2_ADDR A:0x2661020
y.create.l HWIO_PMIC_ARB1_CHNL77_RDATA2_ADDR A:0x2669020
y.create.l HWIO_PMIC_ARB1_CHNL78_RDATA2_ADDR A:0x2671020
y.create.l HWIO_PMIC_ARB1_CHNL79_RDATA2_ADDR A:0x2679020
y.create.l HWIO_PMIC_ARB1_CHNL80_RDATA2_ADDR A:0x2681020
y.create.l HWIO_PMIC_ARB1_CHNL81_RDATA2_ADDR A:0x2689020
y.create.l HWIO_PMIC_ARB1_CHNL82_RDATA2_ADDR A:0x2691020
y.create.l HWIO_PMIC_ARB1_CHNL83_RDATA2_ADDR A:0x2699020
y.create.l HWIO_PMIC_ARB1_CHNL84_RDATA2_ADDR A:0x26a1020
y.create.l HWIO_PMIC_ARB1_CHNL85_RDATA2_ADDR A:0x26a9020
y.create.l HWIO_PMIC_ARB1_CHNL86_RDATA2_ADDR A:0x26b1020
y.create.l HWIO_PMIC_ARB1_CHNL87_RDATA2_ADDR A:0x26b9020
y.create.l HWIO_PMIC_ARB1_CHNL88_RDATA2_ADDR A:0x26c1020
y.create.l HWIO_PMIC_ARB1_CHNL89_RDATA2_ADDR A:0x26c9020
y.create.l HWIO_PMIC_ARB1_CHNL90_RDATA2_ADDR A:0x26d1020
y.create.l HWIO_PMIC_ARB1_CHNL91_RDATA2_ADDR A:0x26d9020
y.create.l HWIO_PMIC_ARB1_CHNL92_RDATA2_ADDR A:0x26e1020
y.create.l HWIO_PMIC_ARB1_CHNL93_RDATA2_ADDR A:0x26e9020
y.create.l HWIO_PMIC_ARB1_CHNL94_RDATA2_ADDR A:0x26f1020
y.create.l HWIO_PMIC_ARB1_CHNL95_RDATA2_ADDR A:0x26f9020
y.create.l HWIO_PMIC_ARB1_CHNL96_RDATA2_ADDR A:0x2701020
y.create.l HWIO_PMIC_ARB1_CHNL97_RDATA2_ADDR A:0x2709020
y.create.l HWIO_PMIC_ARB1_CHNL98_RDATA2_ADDR A:0x2711020
y.create.l HWIO_PMIC_ARB1_CHNL99_RDATA2_ADDR A:0x2719020
y.create.l HWIO_PMIC_ARB1_CHNL100_RDATA2_ADDR A:0x2721020
y.create.l HWIO_PMIC_ARB1_CHNL101_RDATA2_ADDR A:0x2729020
y.create.l HWIO_PMIC_ARB1_CHNL102_RDATA2_ADDR A:0x2731020
y.create.l HWIO_PMIC_ARB1_CHNL103_RDATA2_ADDR A:0x2739020
y.create.l HWIO_PMIC_ARB1_CHNL104_RDATA2_ADDR A:0x2741020
y.create.l HWIO_PMIC_ARB1_CHNL105_RDATA2_ADDR A:0x2749020
y.create.l HWIO_PMIC_ARB1_CHNL106_RDATA2_ADDR A:0x2751020
y.create.l HWIO_PMIC_ARB1_CHNL107_RDATA2_ADDR A:0x2759020
y.create.l HWIO_PMIC_ARB1_CHNL108_RDATA2_ADDR A:0x2761020
y.create.l HWIO_PMIC_ARB1_CHNL109_RDATA2_ADDR A:0x2769020
y.create.l HWIO_PMIC_ARB1_CHNL110_RDATA2_ADDR A:0x2771020
y.create.l HWIO_PMIC_ARB1_CHNL111_RDATA2_ADDR A:0x2779020
y.create.l HWIO_PMIC_ARB1_CHNL112_RDATA2_ADDR A:0x2781020
y.create.l HWIO_PMIC_ARB1_CHNL113_RDATA2_ADDR A:0x2789020
y.create.l HWIO_PMIC_ARB1_CHNL114_RDATA2_ADDR A:0x2791020
y.create.l HWIO_PMIC_ARB1_CHNL115_RDATA2_ADDR A:0x2799020
y.create.l HWIO_PMIC_ARB1_CHNL116_RDATA2_ADDR A:0x27a1020
y.create.l HWIO_PMIC_ARB1_CHNL117_RDATA2_ADDR A:0x27a9020
y.create.l HWIO_PMIC_ARB1_CHNL118_RDATA2_ADDR A:0x27b1020
y.create.l HWIO_PMIC_ARB1_CHNL119_RDATA2_ADDR A:0x27b9020
y.create.l HWIO_PMIC_ARB1_CHNL120_RDATA2_ADDR A:0x27c1020
y.create.l HWIO_PMIC_ARB1_CHNL121_RDATA2_ADDR A:0x27c9020
y.create.l HWIO_PMIC_ARB1_CHNL122_RDATA2_ADDR A:0x27d1020
y.create.l HWIO_PMIC_ARB1_CHNL123_RDATA2_ADDR A:0x27d9020
y.create.l HWIO_PMIC_ARB1_CHNL124_RDATA2_ADDR A:0x27e1020
y.create.l HWIO_PMIC_ARB1_CHNL125_RDATA2_ADDR A:0x27e9020
y.create.l HWIO_PMIC_ARB1_CHNL126_RDATA2_ADDR A:0x27f1020
y.create.l HWIO_PMIC_ARB1_CHNL127_RDATA2_ADDR A:0x27f9020
y.create.l HWIO_PMIC_ARB1_CHNL128_RDATA2_ADDR A:0x2801020
y.create.l HWIO_PMIC_ARB1_CHNL129_RDATA2_ADDR A:0x2809020
y.create.l HWIO_PMIC_ARB1_CHNL130_RDATA2_ADDR A:0x2811020
y.create.l HWIO_PMIC_ARB1_CHNL131_RDATA2_ADDR A:0x2819020
y.create.l HWIO_PMIC_ARB1_CHNL132_RDATA2_ADDR A:0x2821020
y.create.l HWIO_PMIC_ARB1_CHNL133_RDATA2_ADDR A:0x2829020
y.create.l HWIO_PMIC_ARB1_CHNL134_RDATA2_ADDR A:0x2831020
y.create.l HWIO_PMIC_ARB1_CHNL135_RDATA2_ADDR A:0x2839020
y.create.l HWIO_PMIC_ARB1_CHNL136_RDATA2_ADDR A:0x2841020
y.create.l HWIO_PMIC_ARB1_CHNL137_RDATA2_ADDR A:0x2849020
y.create.l HWIO_PMIC_ARB1_CHNL138_RDATA2_ADDR A:0x2851020
y.create.l HWIO_PMIC_ARB1_CHNL139_RDATA2_ADDR A:0x2859020
y.create.l HWIO_PMIC_ARB1_CHNL140_RDATA2_ADDR A:0x2861020
y.create.l HWIO_PMIC_ARB1_CHNL141_RDATA2_ADDR A:0x2869020
y.create.l HWIO_PMIC_ARB1_CHNL142_RDATA2_ADDR A:0x2871020
y.create.l HWIO_PMIC_ARB1_CHNL143_RDATA2_ADDR A:0x2879020
y.create.l HWIO_PMIC_ARB1_CHNL144_RDATA2_ADDR A:0x2881020
y.create.l HWIO_PMIC_ARB1_CHNL145_RDATA2_ADDR A:0x2889020
y.create.l HWIO_PMIC_ARB1_CHNL146_RDATA2_ADDR A:0x2891020
y.create.l HWIO_PMIC_ARB1_CHNL147_RDATA2_ADDR A:0x2899020
y.create.l HWIO_PMIC_ARB1_CHNL148_RDATA2_ADDR A:0x28a1020
y.create.l HWIO_PMIC_ARB1_CHNL149_RDATA2_ADDR A:0x28a9020
y.create.l HWIO_PMIC_ARB1_CHNL150_RDATA2_ADDR A:0x28b1020
y.create.l HWIO_PMIC_ARB1_CHNL151_RDATA2_ADDR A:0x28b9020
y.create.l HWIO_PMIC_ARB1_CHNL152_RDATA2_ADDR A:0x28c1020
y.create.l HWIO_PMIC_ARB1_CHNL153_RDATA2_ADDR A:0x28c9020
y.create.l HWIO_PMIC_ARB1_CHNL154_RDATA2_ADDR A:0x28d1020
y.create.l HWIO_PMIC_ARB1_CHNL155_RDATA2_ADDR A:0x28d9020
y.create.l HWIO_PMIC_ARB1_CHNL156_RDATA2_ADDR A:0x28e1020
y.create.l HWIO_PMIC_ARB1_CHNL157_RDATA2_ADDR A:0x28e9020
y.create.l HWIO_PMIC_ARB1_CHNL158_RDATA2_ADDR A:0x28f1020
y.create.l HWIO_PMIC_ARB1_CHNL159_RDATA2_ADDR A:0x28f9020
y.create.l HWIO_PMIC_ARB1_CHNL160_RDATA2_ADDR A:0x2901020
y.create.l HWIO_PMIC_ARB1_CHNL161_RDATA2_ADDR A:0x2909020
y.create.l HWIO_PMIC_ARB1_CHNL162_RDATA2_ADDR A:0x2911020
y.create.l HWIO_PMIC_ARB1_CHNL163_RDATA2_ADDR A:0x2919020
y.create.l HWIO_PMIC_ARB1_CHNL164_RDATA2_ADDR A:0x2921020
y.create.l HWIO_PMIC_ARB1_CHNL165_RDATA2_ADDR A:0x2929020
y.create.l HWIO_PMIC_ARB1_CHNL166_RDATA2_ADDR A:0x2931020
y.create.l HWIO_PMIC_ARB1_CHNL167_RDATA2_ADDR A:0x2939020
y.create.l HWIO_PMIC_ARB1_CHNL168_RDATA2_ADDR A:0x2941020
y.create.l HWIO_PMIC_ARB1_CHNL169_RDATA2_ADDR A:0x2949020
y.create.l HWIO_PMIC_ARB1_CHNL170_RDATA2_ADDR A:0x2951020
y.create.l HWIO_PMIC_ARB1_CHNL171_RDATA2_ADDR A:0x2959020
y.create.l HWIO_PMIC_ARB1_CHNL172_RDATA2_ADDR A:0x2961020
y.create.l HWIO_PMIC_ARB1_CHNL173_RDATA2_ADDR A:0x2969020
y.create.l HWIO_PMIC_ARB1_CHNL174_RDATA2_ADDR A:0x2971020
y.create.l HWIO_PMIC_ARB1_CHNL175_RDATA2_ADDR A:0x2979020
y.create.l HWIO_PMIC_ARB1_CHNL176_RDATA2_ADDR A:0x2981020
y.create.l HWIO_PMIC_ARB1_CHNL177_RDATA2_ADDR A:0x2989020
y.create.l HWIO_PMIC_ARB1_CHNL178_RDATA2_ADDR A:0x2991020
y.create.l HWIO_PMIC_ARB1_CHNL179_RDATA2_ADDR A:0x2999020
y.create.l HWIO_PMIC_ARB1_CHNL180_RDATA2_ADDR A:0x29a1020
y.create.l HWIO_PMIC_ARB1_CHNL181_RDATA2_ADDR A:0x29a9020
y.create.l HWIO_PMIC_ARB1_CHNL182_RDATA2_ADDR A:0x29b1020
y.create.l HWIO_PMIC_ARB1_CHNL183_RDATA2_ADDR A:0x29b9020
y.create.l HWIO_PMIC_ARB1_CHNL184_RDATA2_ADDR A:0x29c1020
y.create.l HWIO_PMIC_ARB1_CHNL185_RDATA2_ADDR A:0x29c9020
y.create.l HWIO_PMIC_ARB1_CHNL186_RDATA2_ADDR A:0x29d1020
y.create.l HWIO_PMIC_ARB1_CHNL187_RDATA2_ADDR A:0x29d9020
y.create.l HWIO_PMIC_ARB1_CHNL188_RDATA2_ADDR A:0x29e1020
y.create.l HWIO_PMIC_ARB1_CHNL189_RDATA2_ADDR A:0x29e9020
y.create.l HWIO_PMIC_ARB1_CHNL190_RDATA2_ADDR A:0x29f1020
y.create.l HWIO_PMIC_ARB1_CHNL191_RDATA2_ADDR A:0x29f9020
y.create.l HWIO_PMIC_ARB1_CHNL192_RDATA2_ADDR A:0x2a01020
y.create.l HWIO_PMIC_ARB1_CHNL193_RDATA2_ADDR A:0x2a09020
y.create.l HWIO_PMIC_ARB1_CHNL194_RDATA2_ADDR A:0x2a11020
y.create.l HWIO_PMIC_ARB1_CHNL195_RDATA2_ADDR A:0x2a19020
y.create.l HWIO_PMIC_ARB1_CHNL196_RDATA2_ADDR A:0x2a21020
y.create.l HWIO_PMIC_ARB1_CHNL197_RDATA2_ADDR A:0x2a29020
y.create.l HWIO_PMIC_ARB1_CHNL198_RDATA2_ADDR A:0x2a31020
y.create.l HWIO_PMIC_ARB1_CHNL199_RDATA2_ADDR A:0x2a39020
y.create.l HWIO_PMIC_ARB1_CHNL200_RDATA2_ADDR A:0x2a41020
y.create.l HWIO_PMIC_ARB1_CHNL201_RDATA2_ADDR A:0x2a49020
y.create.l HWIO_PMIC_ARB1_CHNL202_RDATA2_ADDR A:0x2a51020
y.create.l HWIO_PMIC_ARB1_CHNL203_RDATA2_ADDR A:0x2a59020
y.create.l HWIO_PMIC_ARB1_CHNL204_RDATA2_ADDR A:0x2a61020
y.create.l HWIO_PMIC_ARB1_CHNL205_RDATA2_ADDR A:0x2a69020
y.create.l HWIO_PMIC_ARB1_CHNL206_RDATA2_ADDR A:0x2a71020
y.create.l HWIO_PMIC_ARB1_CHNL207_RDATA2_ADDR A:0x2a79020
y.create.l HWIO_PMIC_ARB1_CHNL208_RDATA2_ADDR A:0x2a81020
y.create.l HWIO_PMIC_ARB1_CHNL209_RDATA2_ADDR A:0x2a89020
y.create.l HWIO_PMIC_ARB1_CHNL210_RDATA2_ADDR A:0x2a91020
y.create.l HWIO_PMIC_ARB1_CHNL211_RDATA2_ADDR A:0x2a99020
y.create.l HWIO_PMIC_ARB1_CHNL212_RDATA2_ADDR A:0x2aa1020
y.create.l HWIO_PMIC_ARB1_CHNL213_RDATA2_ADDR A:0x2aa9020
y.create.l HWIO_PMIC_ARB1_CHNL214_RDATA2_ADDR A:0x2ab1020
y.create.l HWIO_PMIC_ARB1_CHNL215_RDATA2_ADDR A:0x2ab9020
y.create.l HWIO_PMIC_ARB1_CHNL216_RDATA2_ADDR A:0x2ac1020
y.create.l HWIO_PMIC_ARB1_CHNL217_RDATA2_ADDR A:0x2ac9020
y.create.l HWIO_PMIC_ARB1_CHNL218_RDATA2_ADDR A:0x2ad1020
y.create.l HWIO_PMIC_ARB1_CHNL219_RDATA2_ADDR A:0x2ad9020
y.create.l HWIO_PMIC_ARB1_CHNL220_RDATA2_ADDR A:0x2ae1020
y.create.l HWIO_PMIC_ARB1_CHNL221_RDATA2_ADDR A:0x2ae9020
y.create.l HWIO_PMIC_ARB1_CHNL222_RDATA2_ADDR A:0x2af1020
y.create.l HWIO_PMIC_ARB1_CHNL223_RDATA2_ADDR A:0x2af9020
y.create.l HWIO_PMIC_ARB1_CHNL224_RDATA2_ADDR A:0x2b01020
y.create.l HWIO_PMIC_ARB1_CHNL225_RDATA2_ADDR A:0x2b09020
y.create.l HWIO_PMIC_ARB1_CHNL226_RDATA2_ADDR A:0x2b11020
y.create.l HWIO_PMIC_ARB1_CHNL227_RDATA2_ADDR A:0x2b19020
y.create.l HWIO_PMIC_ARB1_CHNL228_RDATA2_ADDR A:0x2b21020
y.create.l HWIO_PMIC_ARB1_CHNL229_RDATA2_ADDR A:0x2b29020
y.create.l HWIO_PMIC_ARB1_CHNL230_RDATA2_ADDR A:0x2b31020
y.create.l HWIO_PMIC_ARB1_CHNL231_RDATA2_ADDR A:0x2b39020
y.create.l HWIO_PMIC_ARB1_CHNL232_RDATA2_ADDR A:0x2b41020
y.create.l HWIO_PMIC_ARB1_CHNL233_RDATA2_ADDR A:0x2b49020
y.create.l HWIO_PMIC_ARB1_CHNL234_RDATA2_ADDR A:0x2b51020
y.create.l HWIO_PMIC_ARB1_CHNL235_RDATA2_ADDR A:0x2b59020
y.create.l HWIO_PMIC_ARB1_CHNL236_RDATA2_ADDR A:0x2b61020
y.create.l HWIO_PMIC_ARB1_CHNL237_RDATA2_ADDR A:0x2b69020
y.create.l HWIO_PMIC_ARB1_CHNL238_RDATA2_ADDR A:0x2b71020
y.create.l HWIO_PMIC_ARB1_CHNL239_RDATA2_ADDR A:0x2b79020
y.create.l HWIO_PMIC_ARB1_CHNL240_RDATA2_ADDR A:0x2b81020
y.create.l HWIO_PMIC_ARB1_CHNL241_RDATA2_ADDR A:0x2b89020
y.create.l HWIO_PMIC_ARB1_CHNL242_RDATA2_ADDR A:0x2b91020
y.create.l HWIO_PMIC_ARB1_CHNL243_RDATA2_ADDR A:0x2b99020
y.create.l HWIO_PMIC_ARB1_CHNL244_RDATA2_ADDR A:0x2ba1020
y.create.l HWIO_PMIC_ARB1_CHNL245_RDATA2_ADDR A:0x2ba9020
y.create.l HWIO_PMIC_ARB1_CHNL246_RDATA2_ADDR A:0x2bb1020
y.create.l HWIO_PMIC_ARB1_CHNL247_RDATA2_ADDR A:0x2bb9020
y.create.l HWIO_PMIC_ARB1_CHNL248_RDATA2_ADDR A:0x2bc1020
y.create.l HWIO_PMIC_ARB1_CHNL249_RDATA2_ADDR A:0x2bc9020
y.create.l HWIO_PMIC_ARB1_CHNL250_RDATA2_ADDR A:0x2bd1020
y.create.l HWIO_PMIC_ARB1_CHNL251_RDATA2_ADDR A:0x2bd9020
y.create.l HWIO_PMIC_ARB1_CHNL252_RDATA2_ADDR A:0x2be1020
y.create.l HWIO_PMIC_ARB1_CHNL253_RDATA2_ADDR A:0x2be9020
y.create.l HWIO_PMIC_ARB1_CHNL254_RDATA2_ADDR A:0x2bf1020
y.create.l HWIO_PMIC_ARB1_CHNL255_RDATA2_ADDR A:0x2bf9020
y.create.l HWIO_PMIC_ARB2_CHNL0_RDATA2_ADDR A:0x2402020
y.create.l HWIO_PMIC_ARB2_CHNL1_RDATA2_ADDR A:0x240a020
y.create.l HWIO_PMIC_ARB2_CHNL2_RDATA2_ADDR A:0x2412020
y.create.l HWIO_PMIC_ARB2_CHNL3_RDATA2_ADDR A:0x241a020
y.create.l HWIO_PMIC_ARB2_CHNL4_RDATA2_ADDR A:0x2422020
y.create.l HWIO_PMIC_ARB2_CHNL5_RDATA2_ADDR A:0x242a020
y.create.l HWIO_PMIC_ARB2_CHNL6_RDATA2_ADDR A:0x2432020
y.create.l HWIO_PMIC_ARB2_CHNL7_RDATA2_ADDR A:0x243a020
y.create.l HWIO_PMIC_ARB2_CHNL8_RDATA2_ADDR A:0x2442020
y.create.l HWIO_PMIC_ARB2_CHNL9_RDATA2_ADDR A:0x244a020
y.create.l HWIO_PMIC_ARB2_CHNL10_RDATA2_ADDR A:0x2452020
y.create.l HWIO_PMIC_ARB2_CHNL11_RDATA2_ADDR A:0x245a020
y.create.l HWIO_PMIC_ARB2_CHNL12_RDATA2_ADDR A:0x2462020
y.create.l HWIO_PMIC_ARB2_CHNL13_RDATA2_ADDR A:0x246a020
y.create.l HWIO_PMIC_ARB2_CHNL14_RDATA2_ADDR A:0x2472020
y.create.l HWIO_PMIC_ARB2_CHNL15_RDATA2_ADDR A:0x247a020
y.create.l HWIO_PMIC_ARB2_CHNL16_RDATA2_ADDR A:0x2482020
y.create.l HWIO_PMIC_ARB2_CHNL17_RDATA2_ADDR A:0x248a020
y.create.l HWIO_PMIC_ARB2_CHNL18_RDATA2_ADDR A:0x2492020
y.create.l HWIO_PMIC_ARB2_CHNL19_RDATA2_ADDR A:0x249a020
y.create.l HWIO_PMIC_ARB2_CHNL20_RDATA2_ADDR A:0x24a2020
y.create.l HWIO_PMIC_ARB2_CHNL21_RDATA2_ADDR A:0x24aa020
y.create.l HWIO_PMIC_ARB2_CHNL22_RDATA2_ADDR A:0x24b2020
y.create.l HWIO_PMIC_ARB2_CHNL23_RDATA2_ADDR A:0x24ba020
y.create.l HWIO_PMIC_ARB2_CHNL24_RDATA2_ADDR A:0x24c2020
y.create.l HWIO_PMIC_ARB2_CHNL25_RDATA2_ADDR A:0x24ca020
y.create.l HWIO_PMIC_ARB2_CHNL26_RDATA2_ADDR A:0x24d2020
y.create.l HWIO_PMIC_ARB2_CHNL27_RDATA2_ADDR A:0x24da020
y.create.l HWIO_PMIC_ARB2_CHNL28_RDATA2_ADDR A:0x24e2020
y.create.l HWIO_PMIC_ARB2_CHNL29_RDATA2_ADDR A:0x24ea020
y.create.l HWIO_PMIC_ARB2_CHNL30_RDATA2_ADDR A:0x24f2020
y.create.l HWIO_PMIC_ARB2_CHNL31_RDATA2_ADDR A:0x24fa020
y.create.l HWIO_PMIC_ARB2_CHNL32_RDATA2_ADDR A:0x2502020
y.create.l HWIO_PMIC_ARB2_CHNL33_RDATA2_ADDR A:0x250a020
y.create.l HWIO_PMIC_ARB2_CHNL34_RDATA2_ADDR A:0x2512020
y.create.l HWIO_PMIC_ARB2_CHNL35_RDATA2_ADDR A:0x251a020
y.create.l HWIO_PMIC_ARB2_CHNL36_RDATA2_ADDR A:0x2522020
y.create.l HWIO_PMIC_ARB2_CHNL37_RDATA2_ADDR A:0x252a020
y.create.l HWIO_PMIC_ARB2_CHNL38_RDATA2_ADDR A:0x2532020
y.create.l HWIO_PMIC_ARB2_CHNL39_RDATA2_ADDR A:0x253a020
y.create.l HWIO_PMIC_ARB2_CHNL40_RDATA2_ADDR A:0x2542020
y.create.l HWIO_PMIC_ARB2_CHNL41_RDATA2_ADDR A:0x254a020
y.create.l HWIO_PMIC_ARB2_CHNL42_RDATA2_ADDR A:0x2552020
y.create.l HWIO_PMIC_ARB2_CHNL43_RDATA2_ADDR A:0x255a020
y.create.l HWIO_PMIC_ARB2_CHNL44_RDATA2_ADDR A:0x2562020
y.create.l HWIO_PMIC_ARB2_CHNL45_RDATA2_ADDR A:0x256a020
y.create.l HWIO_PMIC_ARB2_CHNL46_RDATA2_ADDR A:0x2572020
y.create.l HWIO_PMIC_ARB2_CHNL47_RDATA2_ADDR A:0x257a020
y.create.l HWIO_PMIC_ARB2_CHNL48_RDATA2_ADDR A:0x2582020
y.create.l HWIO_PMIC_ARB2_CHNL49_RDATA2_ADDR A:0x258a020
y.create.l HWIO_PMIC_ARB2_CHNL50_RDATA2_ADDR A:0x2592020
y.create.l HWIO_PMIC_ARB2_CHNL51_RDATA2_ADDR A:0x259a020
y.create.l HWIO_PMIC_ARB2_CHNL52_RDATA2_ADDR A:0x25a2020
y.create.l HWIO_PMIC_ARB2_CHNL53_RDATA2_ADDR A:0x25aa020
y.create.l HWIO_PMIC_ARB2_CHNL54_RDATA2_ADDR A:0x25b2020
y.create.l HWIO_PMIC_ARB2_CHNL55_RDATA2_ADDR A:0x25ba020
y.create.l HWIO_PMIC_ARB2_CHNL56_RDATA2_ADDR A:0x25c2020
y.create.l HWIO_PMIC_ARB2_CHNL57_RDATA2_ADDR A:0x25ca020
y.create.l HWIO_PMIC_ARB2_CHNL58_RDATA2_ADDR A:0x25d2020
y.create.l HWIO_PMIC_ARB2_CHNL59_RDATA2_ADDR A:0x25da020
y.create.l HWIO_PMIC_ARB2_CHNL60_RDATA2_ADDR A:0x25e2020
y.create.l HWIO_PMIC_ARB2_CHNL61_RDATA2_ADDR A:0x25ea020
y.create.l HWIO_PMIC_ARB2_CHNL62_RDATA2_ADDR A:0x25f2020
y.create.l HWIO_PMIC_ARB2_CHNL63_RDATA2_ADDR A:0x25fa020
y.create.l HWIO_PMIC_ARB2_CHNL64_RDATA2_ADDR A:0x2602020
y.create.l HWIO_PMIC_ARB2_CHNL65_RDATA2_ADDR A:0x260a020
y.create.l HWIO_PMIC_ARB2_CHNL66_RDATA2_ADDR A:0x2612020
y.create.l HWIO_PMIC_ARB2_CHNL67_RDATA2_ADDR A:0x261a020
y.create.l HWIO_PMIC_ARB2_CHNL68_RDATA2_ADDR A:0x2622020
y.create.l HWIO_PMIC_ARB2_CHNL69_RDATA2_ADDR A:0x262a020
y.create.l HWIO_PMIC_ARB2_CHNL70_RDATA2_ADDR A:0x2632020
y.create.l HWIO_PMIC_ARB2_CHNL71_RDATA2_ADDR A:0x263a020
y.create.l HWIO_PMIC_ARB2_CHNL72_RDATA2_ADDR A:0x2642020
y.create.l HWIO_PMIC_ARB2_CHNL73_RDATA2_ADDR A:0x264a020
y.create.l HWIO_PMIC_ARB2_CHNL74_RDATA2_ADDR A:0x2652020
y.create.l HWIO_PMIC_ARB2_CHNL75_RDATA2_ADDR A:0x265a020
y.create.l HWIO_PMIC_ARB2_CHNL76_RDATA2_ADDR A:0x2662020
y.create.l HWIO_PMIC_ARB2_CHNL77_RDATA2_ADDR A:0x266a020
y.create.l HWIO_PMIC_ARB2_CHNL78_RDATA2_ADDR A:0x2672020
y.create.l HWIO_PMIC_ARB2_CHNL79_RDATA2_ADDR A:0x267a020
y.create.l HWIO_PMIC_ARB2_CHNL80_RDATA2_ADDR A:0x2682020
y.create.l HWIO_PMIC_ARB2_CHNL81_RDATA2_ADDR A:0x268a020
y.create.l HWIO_PMIC_ARB2_CHNL82_RDATA2_ADDR A:0x2692020
y.create.l HWIO_PMIC_ARB2_CHNL83_RDATA2_ADDR A:0x269a020
y.create.l HWIO_PMIC_ARB2_CHNL84_RDATA2_ADDR A:0x26a2020
y.create.l HWIO_PMIC_ARB2_CHNL85_RDATA2_ADDR A:0x26aa020
y.create.l HWIO_PMIC_ARB2_CHNL86_RDATA2_ADDR A:0x26b2020
y.create.l HWIO_PMIC_ARB2_CHNL87_RDATA2_ADDR A:0x26ba020
y.create.l HWIO_PMIC_ARB2_CHNL88_RDATA2_ADDR A:0x26c2020
y.create.l HWIO_PMIC_ARB2_CHNL89_RDATA2_ADDR A:0x26ca020
y.create.l HWIO_PMIC_ARB2_CHNL90_RDATA2_ADDR A:0x26d2020
y.create.l HWIO_PMIC_ARB2_CHNL91_RDATA2_ADDR A:0x26da020
y.create.l HWIO_PMIC_ARB2_CHNL92_RDATA2_ADDR A:0x26e2020
y.create.l HWIO_PMIC_ARB2_CHNL93_RDATA2_ADDR A:0x26ea020
y.create.l HWIO_PMIC_ARB2_CHNL94_RDATA2_ADDR A:0x26f2020
y.create.l HWIO_PMIC_ARB2_CHNL95_RDATA2_ADDR A:0x26fa020
y.create.l HWIO_PMIC_ARB2_CHNL96_RDATA2_ADDR A:0x2702020
y.create.l HWIO_PMIC_ARB2_CHNL97_RDATA2_ADDR A:0x270a020
y.create.l HWIO_PMIC_ARB2_CHNL98_RDATA2_ADDR A:0x2712020
y.create.l HWIO_PMIC_ARB2_CHNL99_RDATA2_ADDR A:0x271a020
y.create.l HWIO_PMIC_ARB2_CHNL100_RDATA2_ADDR A:0x2722020
y.create.l HWIO_PMIC_ARB2_CHNL101_RDATA2_ADDR A:0x272a020
y.create.l HWIO_PMIC_ARB2_CHNL102_RDATA2_ADDR A:0x2732020
y.create.l HWIO_PMIC_ARB2_CHNL103_RDATA2_ADDR A:0x273a020
y.create.l HWIO_PMIC_ARB2_CHNL104_RDATA2_ADDR A:0x2742020
y.create.l HWIO_PMIC_ARB2_CHNL105_RDATA2_ADDR A:0x274a020
y.create.l HWIO_PMIC_ARB2_CHNL106_RDATA2_ADDR A:0x2752020
y.create.l HWIO_PMIC_ARB2_CHNL107_RDATA2_ADDR A:0x275a020
y.create.l HWIO_PMIC_ARB2_CHNL108_RDATA2_ADDR A:0x2762020
y.create.l HWIO_PMIC_ARB2_CHNL109_RDATA2_ADDR A:0x276a020
y.create.l HWIO_PMIC_ARB2_CHNL110_RDATA2_ADDR A:0x2772020
y.create.l HWIO_PMIC_ARB2_CHNL111_RDATA2_ADDR A:0x277a020
y.create.l HWIO_PMIC_ARB2_CHNL112_RDATA2_ADDR A:0x2782020
y.create.l HWIO_PMIC_ARB2_CHNL113_RDATA2_ADDR A:0x278a020
y.create.l HWIO_PMIC_ARB2_CHNL114_RDATA2_ADDR A:0x2792020
y.create.l HWIO_PMIC_ARB2_CHNL115_RDATA2_ADDR A:0x279a020
y.create.l HWIO_PMIC_ARB2_CHNL116_RDATA2_ADDR A:0x27a2020
y.create.l HWIO_PMIC_ARB2_CHNL117_RDATA2_ADDR A:0x27aa020
y.create.l HWIO_PMIC_ARB2_CHNL118_RDATA2_ADDR A:0x27b2020
y.create.l HWIO_PMIC_ARB2_CHNL119_RDATA2_ADDR A:0x27ba020
y.create.l HWIO_PMIC_ARB2_CHNL120_RDATA2_ADDR A:0x27c2020
y.create.l HWIO_PMIC_ARB2_CHNL121_RDATA2_ADDR A:0x27ca020
y.create.l HWIO_PMIC_ARB2_CHNL122_RDATA2_ADDR A:0x27d2020
y.create.l HWIO_PMIC_ARB2_CHNL123_RDATA2_ADDR A:0x27da020
y.create.l HWIO_PMIC_ARB2_CHNL124_RDATA2_ADDR A:0x27e2020
y.create.l HWIO_PMIC_ARB2_CHNL125_RDATA2_ADDR A:0x27ea020
y.create.l HWIO_PMIC_ARB2_CHNL126_RDATA2_ADDR A:0x27f2020
y.create.l HWIO_PMIC_ARB2_CHNL127_RDATA2_ADDR A:0x27fa020
y.create.l HWIO_PMIC_ARB2_CHNL128_RDATA2_ADDR A:0x2802020
y.create.l HWIO_PMIC_ARB2_CHNL129_RDATA2_ADDR A:0x280a020
y.create.l HWIO_PMIC_ARB2_CHNL130_RDATA2_ADDR A:0x2812020
y.create.l HWIO_PMIC_ARB2_CHNL131_RDATA2_ADDR A:0x281a020
y.create.l HWIO_PMIC_ARB2_CHNL132_RDATA2_ADDR A:0x2822020
y.create.l HWIO_PMIC_ARB2_CHNL133_RDATA2_ADDR A:0x282a020
y.create.l HWIO_PMIC_ARB2_CHNL134_RDATA2_ADDR A:0x2832020
y.create.l HWIO_PMIC_ARB2_CHNL135_RDATA2_ADDR A:0x283a020
y.create.l HWIO_PMIC_ARB2_CHNL136_RDATA2_ADDR A:0x2842020
y.create.l HWIO_PMIC_ARB2_CHNL137_RDATA2_ADDR A:0x284a020
y.create.l HWIO_PMIC_ARB2_CHNL138_RDATA2_ADDR A:0x2852020
y.create.l HWIO_PMIC_ARB2_CHNL139_RDATA2_ADDR A:0x285a020
y.create.l HWIO_PMIC_ARB2_CHNL140_RDATA2_ADDR A:0x2862020
y.create.l HWIO_PMIC_ARB2_CHNL141_RDATA2_ADDR A:0x286a020
y.create.l HWIO_PMIC_ARB2_CHNL142_RDATA2_ADDR A:0x2872020
y.create.l HWIO_PMIC_ARB2_CHNL143_RDATA2_ADDR A:0x287a020
y.create.l HWIO_PMIC_ARB2_CHNL144_RDATA2_ADDR A:0x2882020
y.create.l HWIO_PMIC_ARB2_CHNL145_RDATA2_ADDR A:0x288a020
y.create.l HWIO_PMIC_ARB2_CHNL146_RDATA2_ADDR A:0x2892020
y.create.l HWIO_PMIC_ARB2_CHNL147_RDATA2_ADDR A:0x289a020
y.create.l HWIO_PMIC_ARB2_CHNL148_RDATA2_ADDR A:0x28a2020
y.create.l HWIO_PMIC_ARB2_CHNL149_RDATA2_ADDR A:0x28aa020
y.create.l HWIO_PMIC_ARB2_CHNL150_RDATA2_ADDR A:0x28b2020
y.create.l HWIO_PMIC_ARB2_CHNL151_RDATA2_ADDR A:0x28ba020
y.create.l HWIO_PMIC_ARB2_CHNL152_RDATA2_ADDR A:0x28c2020
y.create.l HWIO_PMIC_ARB2_CHNL153_RDATA2_ADDR A:0x28ca020
y.create.l HWIO_PMIC_ARB2_CHNL154_RDATA2_ADDR A:0x28d2020
y.create.l HWIO_PMIC_ARB2_CHNL155_RDATA2_ADDR A:0x28da020
y.create.l HWIO_PMIC_ARB2_CHNL156_RDATA2_ADDR A:0x28e2020
y.create.l HWIO_PMIC_ARB2_CHNL157_RDATA2_ADDR A:0x28ea020
y.create.l HWIO_PMIC_ARB2_CHNL158_RDATA2_ADDR A:0x28f2020
y.create.l HWIO_PMIC_ARB2_CHNL159_RDATA2_ADDR A:0x28fa020
y.create.l HWIO_PMIC_ARB2_CHNL160_RDATA2_ADDR A:0x2902020
y.create.l HWIO_PMIC_ARB2_CHNL161_RDATA2_ADDR A:0x290a020
y.create.l HWIO_PMIC_ARB2_CHNL162_RDATA2_ADDR A:0x2912020
y.create.l HWIO_PMIC_ARB2_CHNL163_RDATA2_ADDR A:0x291a020
y.create.l HWIO_PMIC_ARB2_CHNL164_RDATA2_ADDR A:0x2922020
y.create.l HWIO_PMIC_ARB2_CHNL165_RDATA2_ADDR A:0x292a020
y.create.l HWIO_PMIC_ARB2_CHNL166_RDATA2_ADDR A:0x2932020
y.create.l HWIO_PMIC_ARB2_CHNL167_RDATA2_ADDR A:0x293a020
y.create.l HWIO_PMIC_ARB2_CHNL168_RDATA2_ADDR A:0x2942020
y.create.l HWIO_PMIC_ARB2_CHNL169_RDATA2_ADDR A:0x294a020
y.create.l HWIO_PMIC_ARB2_CHNL170_RDATA2_ADDR A:0x2952020
y.create.l HWIO_PMIC_ARB2_CHNL171_RDATA2_ADDR A:0x295a020
y.create.l HWIO_PMIC_ARB2_CHNL172_RDATA2_ADDR A:0x2962020
y.create.l HWIO_PMIC_ARB2_CHNL173_RDATA2_ADDR A:0x296a020
y.create.l HWIO_PMIC_ARB2_CHNL174_RDATA2_ADDR A:0x2972020
y.create.l HWIO_PMIC_ARB2_CHNL175_RDATA2_ADDR A:0x297a020
y.create.l HWIO_PMIC_ARB2_CHNL176_RDATA2_ADDR A:0x2982020
y.create.l HWIO_PMIC_ARB2_CHNL177_RDATA2_ADDR A:0x298a020
y.create.l HWIO_PMIC_ARB2_CHNL178_RDATA2_ADDR A:0x2992020
y.create.l HWIO_PMIC_ARB2_CHNL179_RDATA2_ADDR A:0x299a020
y.create.l HWIO_PMIC_ARB2_CHNL180_RDATA2_ADDR A:0x29a2020
y.create.l HWIO_PMIC_ARB2_CHNL181_RDATA2_ADDR A:0x29aa020
y.create.l HWIO_PMIC_ARB2_CHNL182_RDATA2_ADDR A:0x29b2020
y.create.l HWIO_PMIC_ARB2_CHNL183_RDATA2_ADDR A:0x29ba020
y.create.l HWIO_PMIC_ARB2_CHNL184_RDATA2_ADDR A:0x29c2020
y.create.l HWIO_PMIC_ARB2_CHNL185_RDATA2_ADDR A:0x29ca020
y.create.l HWIO_PMIC_ARB2_CHNL186_RDATA2_ADDR A:0x29d2020
y.create.l HWIO_PMIC_ARB2_CHNL187_RDATA2_ADDR A:0x29da020
y.create.l HWIO_PMIC_ARB2_CHNL188_RDATA2_ADDR A:0x29e2020
y.create.l HWIO_PMIC_ARB2_CHNL189_RDATA2_ADDR A:0x29ea020
y.create.l HWIO_PMIC_ARB2_CHNL190_RDATA2_ADDR A:0x29f2020
y.create.l HWIO_PMIC_ARB2_CHNL191_RDATA2_ADDR A:0x29fa020
y.create.l HWIO_PMIC_ARB2_CHNL192_RDATA2_ADDR A:0x2a02020
y.create.l HWIO_PMIC_ARB2_CHNL193_RDATA2_ADDR A:0x2a0a020
y.create.l HWIO_PMIC_ARB2_CHNL194_RDATA2_ADDR A:0x2a12020
y.create.l HWIO_PMIC_ARB2_CHNL195_RDATA2_ADDR A:0x2a1a020
y.create.l HWIO_PMIC_ARB2_CHNL196_RDATA2_ADDR A:0x2a22020
y.create.l HWIO_PMIC_ARB2_CHNL197_RDATA2_ADDR A:0x2a2a020
y.create.l HWIO_PMIC_ARB2_CHNL198_RDATA2_ADDR A:0x2a32020
y.create.l HWIO_PMIC_ARB2_CHNL199_RDATA2_ADDR A:0x2a3a020
y.create.l HWIO_PMIC_ARB2_CHNL200_RDATA2_ADDR A:0x2a42020
y.create.l HWIO_PMIC_ARB2_CHNL201_RDATA2_ADDR A:0x2a4a020
y.create.l HWIO_PMIC_ARB2_CHNL202_RDATA2_ADDR A:0x2a52020
y.create.l HWIO_PMIC_ARB2_CHNL203_RDATA2_ADDR A:0x2a5a020
y.create.l HWIO_PMIC_ARB2_CHNL204_RDATA2_ADDR A:0x2a62020
y.create.l HWIO_PMIC_ARB2_CHNL205_RDATA2_ADDR A:0x2a6a020
y.create.l HWIO_PMIC_ARB2_CHNL206_RDATA2_ADDR A:0x2a72020
y.create.l HWIO_PMIC_ARB2_CHNL207_RDATA2_ADDR A:0x2a7a020
y.create.l HWIO_PMIC_ARB2_CHNL208_RDATA2_ADDR A:0x2a82020
y.create.l HWIO_PMIC_ARB2_CHNL209_RDATA2_ADDR A:0x2a8a020
y.create.l HWIO_PMIC_ARB2_CHNL210_RDATA2_ADDR A:0x2a92020
y.create.l HWIO_PMIC_ARB2_CHNL211_RDATA2_ADDR A:0x2a9a020
y.create.l HWIO_PMIC_ARB2_CHNL212_RDATA2_ADDR A:0x2aa2020
y.create.l HWIO_PMIC_ARB2_CHNL213_RDATA2_ADDR A:0x2aaa020
y.create.l HWIO_PMIC_ARB2_CHNL214_RDATA2_ADDR A:0x2ab2020
y.create.l HWIO_PMIC_ARB2_CHNL215_RDATA2_ADDR A:0x2aba020
y.create.l HWIO_PMIC_ARB2_CHNL216_RDATA2_ADDR A:0x2ac2020
y.create.l HWIO_PMIC_ARB2_CHNL217_RDATA2_ADDR A:0x2aca020
y.create.l HWIO_PMIC_ARB2_CHNL218_RDATA2_ADDR A:0x2ad2020
y.create.l HWIO_PMIC_ARB2_CHNL219_RDATA2_ADDR A:0x2ada020
y.create.l HWIO_PMIC_ARB2_CHNL220_RDATA2_ADDR A:0x2ae2020
y.create.l HWIO_PMIC_ARB2_CHNL221_RDATA2_ADDR A:0x2aea020
y.create.l HWIO_PMIC_ARB2_CHNL222_RDATA2_ADDR A:0x2af2020
y.create.l HWIO_PMIC_ARB2_CHNL223_RDATA2_ADDR A:0x2afa020
y.create.l HWIO_PMIC_ARB2_CHNL224_RDATA2_ADDR A:0x2b02020
y.create.l HWIO_PMIC_ARB2_CHNL225_RDATA2_ADDR A:0x2b0a020
y.create.l HWIO_PMIC_ARB2_CHNL226_RDATA2_ADDR A:0x2b12020
y.create.l HWIO_PMIC_ARB2_CHNL227_RDATA2_ADDR A:0x2b1a020
y.create.l HWIO_PMIC_ARB2_CHNL228_RDATA2_ADDR A:0x2b22020
y.create.l HWIO_PMIC_ARB2_CHNL229_RDATA2_ADDR A:0x2b2a020
y.create.l HWIO_PMIC_ARB2_CHNL230_RDATA2_ADDR A:0x2b32020
y.create.l HWIO_PMIC_ARB2_CHNL231_RDATA2_ADDR A:0x2b3a020
y.create.l HWIO_PMIC_ARB2_CHNL232_RDATA2_ADDR A:0x2b42020
y.create.l HWIO_PMIC_ARB2_CHNL233_RDATA2_ADDR A:0x2b4a020
y.create.l HWIO_PMIC_ARB2_CHNL234_RDATA2_ADDR A:0x2b52020
y.create.l HWIO_PMIC_ARB2_CHNL235_RDATA2_ADDR A:0x2b5a020
y.create.l HWIO_PMIC_ARB2_CHNL236_RDATA2_ADDR A:0x2b62020
y.create.l HWIO_PMIC_ARB2_CHNL237_RDATA2_ADDR A:0x2b6a020
y.create.l HWIO_PMIC_ARB2_CHNL238_RDATA2_ADDR A:0x2b72020
y.create.l HWIO_PMIC_ARB2_CHNL239_RDATA2_ADDR A:0x2b7a020
y.create.l HWIO_PMIC_ARB2_CHNL240_RDATA2_ADDR A:0x2b82020
y.create.l HWIO_PMIC_ARB2_CHNL241_RDATA2_ADDR A:0x2b8a020
y.create.l HWIO_PMIC_ARB2_CHNL242_RDATA2_ADDR A:0x2b92020
y.create.l HWIO_PMIC_ARB2_CHNL243_RDATA2_ADDR A:0x2b9a020
y.create.l HWIO_PMIC_ARB2_CHNL244_RDATA2_ADDR A:0x2ba2020
y.create.l HWIO_PMIC_ARB2_CHNL245_RDATA2_ADDR A:0x2baa020
y.create.l HWIO_PMIC_ARB2_CHNL246_RDATA2_ADDR A:0x2bb2020
y.create.l HWIO_PMIC_ARB2_CHNL247_RDATA2_ADDR A:0x2bba020
y.create.l HWIO_PMIC_ARB2_CHNL248_RDATA2_ADDR A:0x2bc2020
y.create.l HWIO_PMIC_ARB2_CHNL249_RDATA2_ADDR A:0x2bca020
y.create.l HWIO_PMIC_ARB2_CHNL250_RDATA2_ADDR A:0x2bd2020
y.create.l HWIO_PMIC_ARB2_CHNL251_RDATA2_ADDR A:0x2bda020
y.create.l HWIO_PMIC_ARB2_CHNL252_RDATA2_ADDR A:0x2be2020
y.create.l HWIO_PMIC_ARB2_CHNL253_RDATA2_ADDR A:0x2bea020
y.create.l HWIO_PMIC_ARB2_CHNL254_RDATA2_ADDR A:0x2bf2020
y.create.l HWIO_PMIC_ARB2_CHNL255_RDATA2_ADDR A:0x2bfa020
y.create.l HWIO_PMIC_ARB3_CHNL0_RDATA2_ADDR A:0x2403020
y.create.l HWIO_PMIC_ARB3_CHNL1_RDATA2_ADDR A:0x240b020
y.create.l HWIO_PMIC_ARB3_CHNL2_RDATA2_ADDR A:0x2413020
y.create.l HWIO_PMIC_ARB3_CHNL3_RDATA2_ADDR A:0x241b020
y.create.l HWIO_PMIC_ARB3_CHNL4_RDATA2_ADDR A:0x2423020
y.create.l HWIO_PMIC_ARB3_CHNL5_RDATA2_ADDR A:0x242b020
y.create.l HWIO_PMIC_ARB3_CHNL6_RDATA2_ADDR A:0x2433020
y.create.l HWIO_PMIC_ARB3_CHNL7_RDATA2_ADDR A:0x243b020
y.create.l HWIO_PMIC_ARB3_CHNL8_RDATA2_ADDR A:0x2443020
y.create.l HWIO_PMIC_ARB3_CHNL9_RDATA2_ADDR A:0x244b020
y.create.l HWIO_PMIC_ARB3_CHNL10_RDATA2_ADDR A:0x2453020
y.create.l HWIO_PMIC_ARB3_CHNL11_RDATA2_ADDR A:0x245b020
y.create.l HWIO_PMIC_ARB3_CHNL12_RDATA2_ADDR A:0x2463020
y.create.l HWIO_PMIC_ARB3_CHNL13_RDATA2_ADDR A:0x246b020
y.create.l HWIO_PMIC_ARB3_CHNL14_RDATA2_ADDR A:0x2473020
y.create.l HWIO_PMIC_ARB3_CHNL15_RDATA2_ADDR A:0x247b020
y.create.l HWIO_PMIC_ARB3_CHNL16_RDATA2_ADDR A:0x2483020
y.create.l HWIO_PMIC_ARB3_CHNL17_RDATA2_ADDR A:0x248b020
y.create.l HWIO_PMIC_ARB3_CHNL18_RDATA2_ADDR A:0x2493020
y.create.l HWIO_PMIC_ARB3_CHNL19_RDATA2_ADDR A:0x249b020
y.create.l HWIO_PMIC_ARB3_CHNL20_RDATA2_ADDR A:0x24a3020
y.create.l HWIO_PMIC_ARB3_CHNL21_RDATA2_ADDR A:0x24ab020
y.create.l HWIO_PMIC_ARB3_CHNL22_RDATA2_ADDR A:0x24b3020
y.create.l HWIO_PMIC_ARB3_CHNL23_RDATA2_ADDR A:0x24bb020
y.create.l HWIO_PMIC_ARB3_CHNL24_RDATA2_ADDR A:0x24c3020
y.create.l HWIO_PMIC_ARB3_CHNL25_RDATA2_ADDR A:0x24cb020
y.create.l HWIO_PMIC_ARB3_CHNL26_RDATA2_ADDR A:0x24d3020
y.create.l HWIO_PMIC_ARB3_CHNL27_RDATA2_ADDR A:0x24db020
y.create.l HWIO_PMIC_ARB3_CHNL28_RDATA2_ADDR A:0x24e3020
y.create.l HWIO_PMIC_ARB3_CHNL29_RDATA2_ADDR A:0x24eb020
y.create.l HWIO_PMIC_ARB3_CHNL30_RDATA2_ADDR A:0x24f3020
y.create.l HWIO_PMIC_ARB3_CHNL31_RDATA2_ADDR A:0x24fb020
y.create.l HWIO_PMIC_ARB3_CHNL32_RDATA2_ADDR A:0x2503020
y.create.l HWIO_PMIC_ARB3_CHNL33_RDATA2_ADDR A:0x250b020
y.create.l HWIO_PMIC_ARB3_CHNL34_RDATA2_ADDR A:0x2513020
y.create.l HWIO_PMIC_ARB3_CHNL35_RDATA2_ADDR A:0x251b020
y.create.l HWIO_PMIC_ARB3_CHNL36_RDATA2_ADDR A:0x2523020
y.create.l HWIO_PMIC_ARB3_CHNL37_RDATA2_ADDR A:0x252b020
y.create.l HWIO_PMIC_ARB3_CHNL38_RDATA2_ADDR A:0x2533020
y.create.l HWIO_PMIC_ARB3_CHNL39_RDATA2_ADDR A:0x253b020
y.create.l HWIO_PMIC_ARB3_CHNL40_RDATA2_ADDR A:0x2543020
y.create.l HWIO_PMIC_ARB3_CHNL41_RDATA2_ADDR A:0x254b020
y.create.l HWIO_PMIC_ARB3_CHNL42_RDATA2_ADDR A:0x2553020
y.create.l HWIO_PMIC_ARB3_CHNL43_RDATA2_ADDR A:0x255b020
y.create.l HWIO_PMIC_ARB3_CHNL44_RDATA2_ADDR A:0x2563020
y.create.l HWIO_PMIC_ARB3_CHNL45_RDATA2_ADDR A:0x256b020
y.create.l HWIO_PMIC_ARB3_CHNL46_RDATA2_ADDR A:0x2573020
y.create.l HWIO_PMIC_ARB3_CHNL47_RDATA2_ADDR A:0x257b020
y.create.l HWIO_PMIC_ARB3_CHNL48_RDATA2_ADDR A:0x2583020
y.create.l HWIO_PMIC_ARB3_CHNL49_RDATA2_ADDR A:0x258b020
y.create.l HWIO_PMIC_ARB3_CHNL50_RDATA2_ADDR A:0x2593020
y.create.l HWIO_PMIC_ARB3_CHNL51_RDATA2_ADDR A:0x259b020
y.create.l HWIO_PMIC_ARB3_CHNL52_RDATA2_ADDR A:0x25a3020
y.create.l HWIO_PMIC_ARB3_CHNL53_RDATA2_ADDR A:0x25ab020
y.create.l HWIO_PMIC_ARB3_CHNL54_RDATA2_ADDR A:0x25b3020
y.create.l HWIO_PMIC_ARB3_CHNL55_RDATA2_ADDR A:0x25bb020
y.create.l HWIO_PMIC_ARB3_CHNL56_RDATA2_ADDR A:0x25c3020
y.create.l HWIO_PMIC_ARB3_CHNL57_RDATA2_ADDR A:0x25cb020
y.create.l HWIO_PMIC_ARB3_CHNL58_RDATA2_ADDR A:0x25d3020
y.create.l HWIO_PMIC_ARB3_CHNL59_RDATA2_ADDR A:0x25db020
y.create.l HWIO_PMIC_ARB3_CHNL60_RDATA2_ADDR A:0x25e3020
y.create.l HWIO_PMIC_ARB3_CHNL61_RDATA2_ADDR A:0x25eb020
y.create.l HWIO_PMIC_ARB3_CHNL62_RDATA2_ADDR A:0x25f3020
y.create.l HWIO_PMIC_ARB3_CHNL63_RDATA2_ADDR A:0x25fb020
y.create.l HWIO_PMIC_ARB3_CHNL64_RDATA2_ADDR A:0x2603020
y.create.l HWIO_PMIC_ARB3_CHNL65_RDATA2_ADDR A:0x260b020
y.create.l HWIO_PMIC_ARB3_CHNL66_RDATA2_ADDR A:0x2613020
y.create.l HWIO_PMIC_ARB3_CHNL67_RDATA2_ADDR A:0x261b020
y.create.l HWIO_PMIC_ARB3_CHNL68_RDATA2_ADDR A:0x2623020
y.create.l HWIO_PMIC_ARB3_CHNL69_RDATA2_ADDR A:0x262b020
y.create.l HWIO_PMIC_ARB3_CHNL70_RDATA2_ADDR A:0x2633020
y.create.l HWIO_PMIC_ARB3_CHNL71_RDATA2_ADDR A:0x263b020
y.create.l HWIO_PMIC_ARB3_CHNL72_RDATA2_ADDR A:0x2643020
y.create.l HWIO_PMIC_ARB3_CHNL73_RDATA2_ADDR A:0x264b020
y.create.l HWIO_PMIC_ARB3_CHNL74_RDATA2_ADDR A:0x2653020
y.create.l HWIO_PMIC_ARB3_CHNL75_RDATA2_ADDR A:0x265b020
y.create.l HWIO_PMIC_ARB3_CHNL76_RDATA2_ADDR A:0x2663020
y.create.l HWIO_PMIC_ARB3_CHNL77_RDATA2_ADDR A:0x266b020
y.create.l HWIO_PMIC_ARB3_CHNL78_RDATA2_ADDR A:0x2673020
y.create.l HWIO_PMIC_ARB3_CHNL79_RDATA2_ADDR A:0x267b020
y.create.l HWIO_PMIC_ARB3_CHNL80_RDATA2_ADDR A:0x2683020
y.create.l HWIO_PMIC_ARB3_CHNL81_RDATA2_ADDR A:0x268b020
y.create.l HWIO_PMIC_ARB3_CHNL82_RDATA2_ADDR A:0x2693020
y.create.l HWIO_PMIC_ARB3_CHNL83_RDATA2_ADDR A:0x269b020
y.create.l HWIO_PMIC_ARB3_CHNL84_RDATA2_ADDR A:0x26a3020
y.create.l HWIO_PMIC_ARB3_CHNL85_RDATA2_ADDR A:0x26ab020
y.create.l HWIO_PMIC_ARB3_CHNL86_RDATA2_ADDR A:0x26b3020
y.create.l HWIO_PMIC_ARB3_CHNL87_RDATA2_ADDR A:0x26bb020
y.create.l HWIO_PMIC_ARB3_CHNL88_RDATA2_ADDR A:0x26c3020
y.create.l HWIO_PMIC_ARB3_CHNL89_RDATA2_ADDR A:0x26cb020
y.create.l HWIO_PMIC_ARB3_CHNL90_RDATA2_ADDR A:0x26d3020
y.create.l HWIO_PMIC_ARB3_CHNL91_RDATA2_ADDR A:0x26db020
y.create.l HWIO_PMIC_ARB3_CHNL92_RDATA2_ADDR A:0x26e3020
y.create.l HWIO_PMIC_ARB3_CHNL93_RDATA2_ADDR A:0x26eb020
y.create.l HWIO_PMIC_ARB3_CHNL94_RDATA2_ADDR A:0x26f3020
y.create.l HWIO_PMIC_ARB3_CHNL95_RDATA2_ADDR A:0x26fb020
y.create.l HWIO_PMIC_ARB3_CHNL96_RDATA2_ADDR A:0x2703020
y.create.l HWIO_PMIC_ARB3_CHNL97_RDATA2_ADDR A:0x270b020
y.create.l HWIO_PMIC_ARB3_CHNL98_RDATA2_ADDR A:0x2713020
y.create.l HWIO_PMIC_ARB3_CHNL99_RDATA2_ADDR A:0x271b020
y.create.l HWIO_PMIC_ARB3_CHNL100_RDATA2_ADDR A:0x2723020
y.create.l HWIO_PMIC_ARB3_CHNL101_RDATA2_ADDR A:0x272b020
y.create.l HWIO_PMIC_ARB3_CHNL102_RDATA2_ADDR A:0x2733020
y.create.l HWIO_PMIC_ARB3_CHNL103_RDATA2_ADDR A:0x273b020
y.create.l HWIO_PMIC_ARB3_CHNL104_RDATA2_ADDR A:0x2743020
y.create.l HWIO_PMIC_ARB3_CHNL105_RDATA2_ADDR A:0x274b020
y.create.l HWIO_PMIC_ARB3_CHNL106_RDATA2_ADDR A:0x2753020
y.create.l HWIO_PMIC_ARB3_CHNL107_RDATA2_ADDR A:0x275b020
y.create.l HWIO_PMIC_ARB3_CHNL108_RDATA2_ADDR A:0x2763020
y.create.l HWIO_PMIC_ARB3_CHNL109_RDATA2_ADDR A:0x276b020
y.create.l HWIO_PMIC_ARB3_CHNL110_RDATA2_ADDR A:0x2773020
y.create.l HWIO_PMIC_ARB3_CHNL111_RDATA2_ADDR A:0x277b020
y.create.l HWIO_PMIC_ARB3_CHNL112_RDATA2_ADDR A:0x2783020
y.create.l HWIO_PMIC_ARB3_CHNL113_RDATA2_ADDR A:0x278b020
y.create.l HWIO_PMIC_ARB3_CHNL114_RDATA2_ADDR A:0x2793020
y.create.l HWIO_PMIC_ARB3_CHNL115_RDATA2_ADDR A:0x279b020
y.create.l HWIO_PMIC_ARB3_CHNL116_RDATA2_ADDR A:0x27a3020
y.create.l HWIO_PMIC_ARB3_CHNL117_RDATA2_ADDR A:0x27ab020
y.create.l HWIO_PMIC_ARB3_CHNL118_RDATA2_ADDR A:0x27b3020
y.create.l HWIO_PMIC_ARB3_CHNL119_RDATA2_ADDR A:0x27bb020
y.create.l HWIO_PMIC_ARB3_CHNL120_RDATA2_ADDR A:0x27c3020
y.create.l HWIO_PMIC_ARB3_CHNL121_RDATA2_ADDR A:0x27cb020
y.create.l HWIO_PMIC_ARB3_CHNL122_RDATA2_ADDR A:0x27d3020
y.create.l HWIO_PMIC_ARB3_CHNL123_RDATA2_ADDR A:0x27db020
y.create.l HWIO_PMIC_ARB3_CHNL124_RDATA2_ADDR A:0x27e3020
y.create.l HWIO_PMIC_ARB3_CHNL125_RDATA2_ADDR A:0x27eb020
y.create.l HWIO_PMIC_ARB3_CHNL126_RDATA2_ADDR A:0x27f3020
y.create.l HWIO_PMIC_ARB3_CHNL127_RDATA2_ADDR A:0x27fb020
y.create.l HWIO_PMIC_ARB3_CHNL128_RDATA2_ADDR A:0x2803020
y.create.l HWIO_PMIC_ARB3_CHNL129_RDATA2_ADDR A:0x280b020
y.create.l HWIO_PMIC_ARB3_CHNL130_RDATA2_ADDR A:0x2813020
y.create.l HWIO_PMIC_ARB3_CHNL131_RDATA2_ADDR A:0x281b020
y.create.l HWIO_PMIC_ARB3_CHNL132_RDATA2_ADDR A:0x2823020
y.create.l HWIO_PMIC_ARB3_CHNL133_RDATA2_ADDR A:0x282b020
y.create.l HWIO_PMIC_ARB3_CHNL134_RDATA2_ADDR A:0x2833020
y.create.l HWIO_PMIC_ARB3_CHNL135_RDATA2_ADDR A:0x283b020
y.create.l HWIO_PMIC_ARB3_CHNL136_RDATA2_ADDR A:0x2843020
y.create.l HWIO_PMIC_ARB3_CHNL137_RDATA2_ADDR A:0x284b020
y.create.l HWIO_PMIC_ARB3_CHNL138_RDATA2_ADDR A:0x2853020
y.create.l HWIO_PMIC_ARB3_CHNL139_RDATA2_ADDR A:0x285b020
y.create.l HWIO_PMIC_ARB3_CHNL140_RDATA2_ADDR A:0x2863020
y.create.l HWIO_PMIC_ARB3_CHNL141_RDATA2_ADDR A:0x286b020
y.create.l HWIO_PMIC_ARB3_CHNL142_RDATA2_ADDR A:0x2873020
y.create.l HWIO_PMIC_ARB3_CHNL143_RDATA2_ADDR A:0x287b020
y.create.l HWIO_PMIC_ARB3_CHNL144_RDATA2_ADDR A:0x2883020
y.create.l HWIO_PMIC_ARB3_CHNL145_RDATA2_ADDR A:0x288b020
y.create.l HWIO_PMIC_ARB3_CHNL146_RDATA2_ADDR A:0x2893020
y.create.l HWIO_PMIC_ARB3_CHNL147_RDATA2_ADDR A:0x289b020
y.create.l HWIO_PMIC_ARB3_CHNL148_RDATA2_ADDR A:0x28a3020
y.create.l HWIO_PMIC_ARB3_CHNL149_RDATA2_ADDR A:0x28ab020
y.create.l HWIO_PMIC_ARB3_CHNL150_RDATA2_ADDR A:0x28b3020
y.create.l HWIO_PMIC_ARB3_CHNL151_RDATA2_ADDR A:0x28bb020
y.create.l HWIO_PMIC_ARB3_CHNL152_RDATA2_ADDR A:0x28c3020
y.create.l HWIO_PMIC_ARB3_CHNL153_RDATA2_ADDR A:0x28cb020
y.create.l HWIO_PMIC_ARB3_CHNL154_RDATA2_ADDR A:0x28d3020
y.create.l HWIO_PMIC_ARB3_CHNL155_RDATA2_ADDR A:0x28db020
y.create.l HWIO_PMIC_ARB3_CHNL156_RDATA2_ADDR A:0x28e3020
y.create.l HWIO_PMIC_ARB3_CHNL157_RDATA2_ADDR A:0x28eb020
y.create.l HWIO_PMIC_ARB3_CHNL158_RDATA2_ADDR A:0x28f3020
y.create.l HWIO_PMIC_ARB3_CHNL159_RDATA2_ADDR A:0x28fb020
y.create.l HWIO_PMIC_ARB3_CHNL160_RDATA2_ADDR A:0x2903020
y.create.l HWIO_PMIC_ARB3_CHNL161_RDATA2_ADDR A:0x290b020
y.create.l HWIO_PMIC_ARB3_CHNL162_RDATA2_ADDR A:0x2913020
y.create.l HWIO_PMIC_ARB3_CHNL163_RDATA2_ADDR A:0x291b020
y.create.l HWIO_PMIC_ARB3_CHNL164_RDATA2_ADDR A:0x2923020
y.create.l HWIO_PMIC_ARB3_CHNL165_RDATA2_ADDR A:0x292b020
y.create.l HWIO_PMIC_ARB3_CHNL166_RDATA2_ADDR A:0x2933020
y.create.l HWIO_PMIC_ARB3_CHNL167_RDATA2_ADDR A:0x293b020
y.create.l HWIO_PMIC_ARB3_CHNL168_RDATA2_ADDR A:0x2943020
y.create.l HWIO_PMIC_ARB3_CHNL169_RDATA2_ADDR A:0x294b020
y.create.l HWIO_PMIC_ARB3_CHNL170_RDATA2_ADDR A:0x2953020
y.create.l HWIO_PMIC_ARB3_CHNL171_RDATA2_ADDR A:0x295b020
y.create.l HWIO_PMIC_ARB3_CHNL172_RDATA2_ADDR A:0x2963020
y.create.l HWIO_PMIC_ARB3_CHNL173_RDATA2_ADDR A:0x296b020
y.create.l HWIO_PMIC_ARB3_CHNL174_RDATA2_ADDR A:0x2973020
y.create.l HWIO_PMIC_ARB3_CHNL175_RDATA2_ADDR A:0x297b020
y.create.l HWIO_PMIC_ARB3_CHNL176_RDATA2_ADDR A:0x2983020
y.create.l HWIO_PMIC_ARB3_CHNL177_RDATA2_ADDR A:0x298b020
y.create.l HWIO_PMIC_ARB3_CHNL178_RDATA2_ADDR A:0x2993020
y.create.l HWIO_PMIC_ARB3_CHNL179_RDATA2_ADDR A:0x299b020
y.create.l HWIO_PMIC_ARB3_CHNL180_RDATA2_ADDR A:0x29a3020
y.create.l HWIO_PMIC_ARB3_CHNL181_RDATA2_ADDR A:0x29ab020
y.create.l HWIO_PMIC_ARB3_CHNL182_RDATA2_ADDR A:0x29b3020
y.create.l HWIO_PMIC_ARB3_CHNL183_RDATA2_ADDR A:0x29bb020
y.create.l HWIO_PMIC_ARB3_CHNL184_RDATA2_ADDR A:0x29c3020
y.create.l HWIO_PMIC_ARB3_CHNL185_RDATA2_ADDR A:0x29cb020
y.create.l HWIO_PMIC_ARB3_CHNL186_RDATA2_ADDR A:0x29d3020
y.create.l HWIO_PMIC_ARB3_CHNL187_RDATA2_ADDR A:0x29db020
y.create.l HWIO_PMIC_ARB3_CHNL188_RDATA2_ADDR A:0x29e3020
y.create.l HWIO_PMIC_ARB3_CHNL189_RDATA2_ADDR A:0x29eb020
y.create.l HWIO_PMIC_ARB3_CHNL190_RDATA2_ADDR A:0x29f3020
y.create.l HWIO_PMIC_ARB3_CHNL191_RDATA2_ADDR A:0x29fb020
y.create.l HWIO_PMIC_ARB3_CHNL192_RDATA2_ADDR A:0x2a03020
y.create.l HWIO_PMIC_ARB3_CHNL193_RDATA2_ADDR A:0x2a0b020
y.create.l HWIO_PMIC_ARB3_CHNL194_RDATA2_ADDR A:0x2a13020
y.create.l HWIO_PMIC_ARB3_CHNL195_RDATA2_ADDR A:0x2a1b020
y.create.l HWIO_PMIC_ARB3_CHNL196_RDATA2_ADDR A:0x2a23020
y.create.l HWIO_PMIC_ARB3_CHNL197_RDATA2_ADDR A:0x2a2b020
y.create.l HWIO_PMIC_ARB3_CHNL198_RDATA2_ADDR A:0x2a33020
y.create.l HWIO_PMIC_ARB3_CHNL199_RDATA2_ADDR A:0x2a3b020
y.create.l HWIO_PMIC_ARB3_CHNL200_RDATA2_ADDR A:0x2a43020
y.create.l HWIO_PMIC_ARB3_CHNL201_RDATA2_ADDR A:0x2a4b020
y.create.l HWIO_PMIC_ARB3_CHNL202_RDATA2_ADDR A:0x2a53020
y.create.l HWIO_PMIC_ARB3_CHNL203_RDATA2_ADDR A:0x2a5b020
y.create.l HWIO_PMIC_ARB3_CHNL204_RDATA2_ADDR A:0x2a63020
y.create.l HWIO_PMIC_ARB3_CHNL205_RDATA2_ADDR A:0x2a6b020
y.create.l HWIO_PMIC_ARB3_CHNL206_RDATA2_ADDR A:0x2a73020
y.create.l HWIO_PMIC_ARB3_CHNL207_RDATA2_ADDR A:0x2a7b020
y.create.l HWIO_PMIC_ARB3_CHNL208_RDATA2_ADDR A:0x2a83020
y.create.l HWIO_PMIC_ARB3_CHNL209_RDATA2_ADDR A:0x2a8b020
y.create.l HWIO_PMIC_ARB3_CHNL210_RDATA2_ADDR A:0x2a93020
y.create.l HWIO_PMIC_ARB3_CHNL211_RDATA2_ADDR A:0x2a9b020
y.create.l HWIO_PMIC_ARB3_CHNL212_RDATA2_ADDR A:0x2aa3020
y.create.l HWIO_PMIC_ARB3_CHNL213_RDATA2_ADDR A:0x2aab020
y.create.l HWIO_PMIC_ARB3_CHNL214_RDATA2_ADDR A:0x2ab3020
y.create.l HWIO_PMIC_ARB3_CHNL215_RDATA2_ADDR A:0x2abb020
y.create.l HWIO_PMIC_ARB3_CHNL216_RDATA2_ADDR A:0x2ac3020
y.create.l HWIO_PMIC_ARB3_CHNL217_RDATA2_ADDR A:0x2acb020
y.create.l HWIO_PMIC_ARB3_CHNL218_RDATA2_ADDR A:0x2ad3020
y.create.l HWIO_PMIC_ARB3_CHNL219_RDATA2_ADDR A:0x2adb020
y.create.l HWIO_PMIC_ARB3_CHNL220_RDATA2_ADDR A:0x2ae3020
y.create.l HWIO_PMIC_ARB3_CHNL221_RDATA2_ADDR A:0x2aeb020
y.create.l HWIO_PMIC_ARB3_CHNL222_RDATA2_ADDR A:0x2af3020
y.create.l HWIO_PMIC_ARB3_CHNL223_RDATA2_ADDR A:0x2afb020
y.create.l HWIO_PMIC_ARB3_CHNL224_RDATA2_ADDR A:0x2b03020
y.create.l HWIO_PMIC_ARB3_CHNL225_RDATA2_ADDR A:0x2b0b020
y.create.l HWIO_PMIC_ARB3_CHNL226_RDATA2_ADDR A:0x2b13020
y.create.l HWIO_PMIC_ARB3_CHNL227_RDATA2_ADDR A:0x2b1b020
y.create.l HWIO_PMIC_ARB3_CHNL228_RDATA2_ADDR A:0x2b23020
y.create.l HWIO_PMIC_ARB3_CHNL229_RDATA2_ADDR A:0x2b2b020
y.create.l HWIO_PMIC_ARB3_CHNL230_RDATA2_ADDR A:0x2b33020
y.create.l HWIO_PMIC_ARB3_CHNL231_RDATA2_ADDR A:0x2b3b020
y.create.l HWIO_PMIC_ARB3_CHNL232_RDATA2_ADDR A:0x2b43020
y.create.l HWIO_PMIC_ARB3_CHNL233_RDATA2_ADDR A:0x2b4b020
y.create.l HWIO_PMIC_ARB3_CHNL234_RDATA2_ADDR A:0x2b53020
y.create.l HWIO_PMIC_ARB3_CHNL235_RDATA2_ADDR A:0x2b5b020
y.create.l HWIO_PMIC_ARB3_CHNL236_RDATA2_ADDR A:0x2b63020
y.create.l HWIO_PMIC_ARB3_CHNL237_RDATA2_ADDR A:0x2b6b020
y.create.l HWIO_PMIC_ARB3_CHNL238_RDATA2_ADDR A:0x2b73020
y.create.l HWIO_PMIC_ARB3_CHNL239_RDATA2_ADDR A:0x2b7b020
y.create.l HWIO_PMIC_ARB3_CHNL240_RDATA2_ADDR A:0x2b83020
y.create.l HWIO_PMIC_ARB3_CHNL241_RDATA2_ADDR A:0x2b8b020
y.create.l HWIO_PMIC_ARB3_CHNL242_RDATA2_ADDR A:0x2b93020
y.create.l HWIO_PMIC_ARB3_CHNL243_RDATA2_ADDR A:0x2b9b020
y.create.l HWIO_PMIC_ARB3_CHNL244_RDATA2_ADDR A:0x2ba3020
y.create.l HWIO_PMIC_ARB3_CHNL245_RDATA2_ADDR A:0x2bab020
y.create.l HWIO_PMIC_ARB3_CHNL246_RDATA2_ADDR A:0x2bb3020
y.create.l HWIO_PMIC_ARB3_CHNL247_RDATA2_ADDR A:0x2bbb020
y.create.l HWIO_PMIC_ARB3_CHNL248_RDATA2_ADDR A:0x2bc3020
y.create.l HWIO_PMIC_ARB3_CHNL249_RDATA2_ADDR A:0x2bcb020
y.create.l HWIO_PMIC_ARB3_CHNL250_RDATA2_ADDR A:0x2bd3020
y.create.l HWIO_PMIC_ARB3_CHNL251_RDATA2_ADDR A:0x2bdb020
y.create.l HWIO_PMIC_ARB3_CHNL252_RDATA2_ADDR A:0x2be3020
y.create.l HWIO_PMIC_ARB3_CHNL253_RDATA2_ADDR A:0x2beb020
y.create.l HWIO_PMIC_ARB3_CHNL254_RDATA2_ADDR A:0x2bf3020
y.create.l HWIO_PMIC_ARB3_CHNL255_RDATA2_ADDR A:0x2bfb020
y.create.l HWIO_PMIC_ARB4_CHNL0_RDATA2_ADDR A:0x2404020
y.create.l HWIO_PMIC_ARB4_CHNL1_RDATA2_ADDR A:0x240c020
y.create.l HWIO_PMIC_ARB4_CHNL2_RDATA2_ADDR A:0x2414020
y.create.l HWIO_PMIC_ARB4_CHNL3_RDATA2_ADDR A:0x241c020
y.create.l HWIO_PMIC_ARB4_CHNL4_RDATA2_ADDR A:0x2424020
y.create.l HWIO_PMIC_ARB4_CHNL5_RDATA2_ADDR A:0x242c020
y.create.l HWIO_PMIC_ARB4_CHNL6_RDATA2_ADDR A:0x2434020
y.create.l HWIO_PMIC_ARB4_CHNL7_RDATA2_ADDR A:0x243c020
y.create.l HWIO_PMIC_ARB4_CHNL8_RDATA2_ADDR A:0x2444020
y.create.l HWIO_PMIC_ARB4_CHNL9_RDATA2_ADDR A:0x244c020
y.create.l HWIO_PMIC_ARB4_CHNL10_RDATA2_ADDR A:0x2454020
y.create.l HWIO_PMIC_ARB4_CHNL11_RDATA2_ADDR A:0x245c020
y.create.l HWIO_PMIC_ARB4_CHNL12_RDATA2_ADDR A:0x2464020
y.create.l HWIO_PMIC_ARB4_CHNL13_RDATA2_ADDR A:0x246c020
y.create.l HWIO_PMIC_ARB4_CHNL14_RDATA2_ADDR A:0x2474020
y.create.l HWIO_PMIC_ARB4_CHNL15_RDATA2_ADDR A:0x247c020
y.create.l HWIO_PMIC_ARB4_CHNL16_RDATA2_ADDR A:0x2484020
y.create.l HWIO_PMIC_ARB4_CHNL17_RDATA2_ADDR A:0x248c020
y.create.l HWIO_PMIC_ARB4_CHNL18_RDATA2_ADDR A:0x2494020
y.create.l HWIO_PMIC_ARB4_CHNL19_RDATA2_ADDR A:0x249c020
y.create.l HWIO_PMIC_ARB4_CHNL20_RDATA2_ADDR A:0x24a4020
y.create.l HWIO_PMIC_ARB4_CHNL21_RDATA2_ADDR A:0x24ac020
y.create.l HWIO_PMIC_ARB4_CHNL22_RDATA2_ADDR A:0x24b4020
y.create.l HWIO_PMIC_ARB4_CHNL23_RDATA2_ADDR A:0x24bc020
y.create.l HWIO_PMIC_ARB4_CHNL24_RDATA2_ADDR A:0x24c4020
y.create.l HWIO_PMIC_ARB4_CHNL25_RDATA2_ADDR A:0x24cc020
y.create.l HWIO_PMIC_ARB4_CHNL26_RDATA2_ADDR A:0x24d4020
y.create.l HWIO_PMIC_ARB4_CHNL27_RDATA2_ADDR A:0x24dc020
y.create.l HWIO_PMIC_ARB4_CHNL28_RDATA2_ADDR A:0x24e4020
y.create.l HWIO_PMIC_ARB4_CHNL29_RDATA2_ADDR A:0x24ec020
y.create.l HWIO_PMIC_ARB4_CHNL30_RDATA2_ADDR A:0x24f4020
y.create.l HWIO_PMIC_ARB4_CHNL31_RDATA2_ADDR A:0x24fc020
y.create.l HWIO_PMIC_ARB4_CHNL32_RDATA2_ADDR A:0x2504020
y.create.l HWIO_PMIC_ARB4_CHNL33_RDATA2_ADDR A:0x250c020
y.create.l HWIO_PMIC_ARB4_CHNL34_RDATA2_ADDR A:0x2514020
y.create.l HWIO_PMIC_ARB4_CHNL35_RDATA2_ADDR A:0x251c020
y.create.l HWIO_PMIC_ARB4_CHNL36_RDATA2_ADDR A:0x2524020
y.create.l HWIO_PMIC_ARB4_CHNL37_RDATA2_ADDR A:0x252c020
y.create.l HWIO_PMIC_ARB4_CHNL38_RDATA2_ADDR A:0x2534020
y.create.l HWIO_PMIC_ARB4_CHNL39_RDATA2_ADDR A:0x253c020
y.create.l HWIO_PMIC_ARB4_CHNL40_RDATA2_ADDR A:0x2544020
y.create.l HWIO_PMIC_ARB4_CHNL41_RDATA2_ADDR A:0x254c020
y.create.l HWIO_PMIC_ARB4_CHNL42_RDATA2_ADDR A:0x2554020
y.create.l HWIO_PMIC_ARB4_CHNL43_RDATA2_ADDR A:0x255c020
y.create.l HWIO_PMIC_ARB4_CHNL44_RDATA2_ADDR A:0x2564020
y.create.l HWIO_PMIC_ARB4_CHNL45_RDATA2_ADDR A:0x256c020
y.create.l HWIO_PMIC_ARB4_CHNL46_RDATA2_ADDR A:0x2574020
y.create.l HWIO_PMIC_ARB4_CHNL47_RDATA2_ADDR A:0x257c020
y.create.l HWIO_PMIC_ARB4_CHNL48_RDATA2_ADDR A:0x2584020
y.create.l HWIO_PMIC_ARB4_CHNL49_RDATA2_ADDR A:0x258c020
y.create.l HWIO_PMIC_ARB4_CHNL50_RDATA2_ADDR A:0x2594020
y.create.l HWIO_PMIC_ARB4_CHNL51_RDATA2_ADDR A:0x259c020
y.create.l HWIO_PMIC_ARB4_CHNL52_RDATA2_ADDR A:0x25a4020
y.create.l HWIO_PMIC_ARB4_CHNL53_RDATA2_ADDR A:0x25ac020
y.create.l HWIO_PMIC_ARB4_CHNL54_RDATA2_ADDR A:0x25b4020
y.create.l HWIO_PMIC_ARB4_CHNL55_RDATA2_ADDR A:0x25bc020
y.create.l HWIO_PMIC_ARB4_CHNL56_RDATA2_ADDR A:0x25c4020
y.create.l HWIO_PMIC_ARB4_CHNL57_RDATA2_ADDR A:0x25cc020
y.create.l HWIO_PMIC_ARB4_CHNL58_RDATA2_ADDR A:0x25d4020
y.create.l HWIO_PMIC_ARB4_CHNL59_RDATA2_ADDR A:0x25dc020
y.create.l HWIO_PMIC_ARB4_CHNL60_RDATA2_ADDR A:0x25e4020
y.create.l HWIO_PMIC_ARB4_CHNL61_RDATA2_ADDR A:0x25ec020
y.create.l HWIO_PMIC_ARB4_CHNL62_RDATA2_ADDR A:0x25f4020
y.create.l HWIO_PMIC_ARB4_CHNL63_RDATA2_ADDR A:0x25fc020
y.create.l HWIO_PMIC_ARB4_CHNL64_RDATA2_ADDR A:0x2604020
y.create.l HWIO_PMIC_ARB4_CHNL65_RDATA2_ADDR A:0x260c020
y.create.l HWIO_PMIC_ARB4_CHNL66_RDATA2_ADDR A:0x2614020
y.create.l HWIO_PMIC_ARB4_CHNL67_RDATA2_ADDR A:0x261c020
y.create.l HWIO_PMIC_ARB4_CHNL68_RDATA2_ADDR A:0x2624020
y.create.l HWIO_PMIC_ARB4_CHNL69_RDATA2_ADDR A:0x262c020
y.create.l HWIO_PMIC_ARB4_CHNL70_RDATA2_ADDR A:0x2634020
y.create.l HWIO_PMIC_ARB4_CHNL71_RDATA2_ADDR A:0x263c020
y.create.l HWIO_PMIC_ARB4_CHNL72_RDATA2_ADDR A:0x2644020
y.create.l HWIO_PMIC_ARB4_CHNL73_RDATA2_ADDR A:0x264c020
y.create.l HWIO_PMIC_ARB4_CHNL74_RDATA2_ADDR A:0x2654020
y.create.l HWIO_PMIC_ARB4_CHNL75_RDATA2_ADDR A:0x265c020
y.create.l HWIO_PMIC_ARB4_CHNL76_RDATA2_ADDR A:0x2664020
y.create.l HWIO_PMIC_ARB4_CHNL77_RDATA2_ADDR A:0x266c020
y.create.l HWIO_PMIC_ARB4_CHNL78_RDATA2_ADDR A:0x2674020
y.create.l HWIO_PMIC_ARB4_CHNL79_RDATA2_ADDR A:0x267c020
y.create.l HWIO_PMIC_ARB4_CHNL80_RDATA2_ADDR A:0x2684020
y.create.l HWIO_PMIC_ARB4_CHNL81_RDATA2_ADDR A:0x268c020
y.create.l HWIO_PMIC_ARB4_CHNL82_RDATA2_ADDR A:0x2694020
y.create.l HWIO_PMIC_ARB4_CHNL83_RDATA2_ADDR A:0x269c020
y.create.l HWIO_PMIC_ARB4_CHNL84_RDATA2_ADDR A:0x26a4020
y.create.l HWIO_PMIC_ARB4_CHNL85_RDATA2_ADDR A:0x26ac020
y.create.l HWIO_PMIC_ARB4_CHNL86_RDATA2_ADDR A:0x26b4020
y.create.l HWIO_PMIC_ARB4_CHNL87_RDATA2_ADDR A:0x26bc020
y.create.l HWIO_PMIC_ARB4_CHNL88_RDATA2_ADDR A:0x26c4020
y.create.l HWIO_PMIC_ARB4_CHNL89_RDATA2_ADDR A:0x26cc020
y.create.l HWIO_PMIC_ARB4_CHNL90_RDATA2_ADDR A:0x26d4020
y.create.l HWIO_PMIC_ARB4_CHNL91_RDATA2_ADDR A:0x26dc020
y.create.l HWIO_PMIC_ARB4_CHNL92_RDATA2_ADDR A:0x26e4020
y.create.l HWIO_PMIC_ARB4_CHNL93_RDATA2_ADDR A:0x26ec020
y.create.l HWIO_PMIC_ARB4_CHNL94_RDATA2_ADDR A:0x26f4020
y.create.l HWIO_PMIC_ARB4_CHNL95_RDATA2_ADDR A:0x26fc020
y.create.l HWIO_PMIC_ARB4_CHNL96_RDATA2_ADDR A:0x2704020
y.create.l HWIO_PMIC_ARB4_CHNL97_RDATA2_ADDR A:0x270c020
y.create.l HWIO_PMIC_ARB4_CHNL98_RDATA2_ADDR A:0x2714020
y.create.l HWIO_PMIC_ARB4_CHNL99_RDATA2_ADDR A:0x271c020
y.create.l HWIO_PMIC_ARB4_CHNL100_RDATA2_ADDR A:0x2724020
y.create.l HWIO_PMIC_ARB4_CHNL101_RDATA2_ADDR A:0x272c020
y.create.l HWIO_PMIC_ARB4_CHNL102_RDATA2_ADDR A:0x2734020
y.create.l HWIO_PMIC_ARB4_CHNL103_RDATA2_ADDR A:0x273c020
y.create.l HWIO_PMIC_ARB4_CHNL104_RDATA2_ADDR A:0x2744020
y.create.l HWIO_PMIC_ARB4_CHNL105_RDATA2_ADDR A:0x274c020
y.create.l HWIO_PMIC_ARB4_CHNL106_RDATA2_ADDR A:0x2754020
y.create.l HWIO_PMIC_ARB4_CHNL107_RDATA2_ADDR A:0x275c020
y.create.l HWIO_PMIC_ARB4_CHNL108_RDATA2_ADDR A:0x2764020
y.create.l HWIO_PMIC_ARB4_CHNL109_RDATA2_ADDR A:0x276c020
y.create.l HWIO_PMIC_ARB4_CHNL110_RDATA2_ADDR A:0x2774020
y.create.l HWIO_PMIC_ARB4_CHNL111_RDATA2_ADDR A:0x277c020
y.create.l HWIO_PMIC_ARB4_CHNL112_RDATA2_ADDR A:0x2784020
y.create.l HWIO_PMIC_ARB4_CHNL113_RDATA2_ADDR A:0x278c020
y.create.l HWIO_PMIC_ARB4_CHNL114_RDATA2_ADDR A:0x2794020
y.create.l HWIO_PMIC_ARB4_CHNL115_RDATA2_ADDR A:0x279c020
y.create.l HWIO_PMIC_ARB4_CHNL116_RDATA2_ADDR A:0x27a4020
y.create.l HWIO_PMIC_ARB4_CHNL117_RDATA2_ADDR A:0x27ac020
y.create.l HWIO_PMIC_ARB4_CHNL118_RDATA2_ADDR A:0x27b4020
y.create.l HWIO_PMIC_ARB4_CHNL119_RDATA2_ADDR A:0x27bc020
y.create.l HWIO_PMIC_ARB4_CHNL120_RDATA2_ADDR A:0x27c4020
y.create.l HWIO_PMIC_ARB4_CHNL121_RDATA2_ADDR A:0x27cc020
y.create.l HWIO_PMIC_ARB4_CHNL122_RDATA2_ADDR A:0x27d4020
y.create.l HWIO_PMIC_ARB4_CHNL123_RDATA2_ADDR A:0x27dc020
y.create.l HWIO_PMIC_ARB4_CHNL124_RDATA2_ADDR A:0x27e4020
y.create.l HWIO_PMIC_ARB4_CHNL125_RDATA2_ADDR A:0x27ec020
y.create.l HWIO_PMIC_ARB4_CHNL126_RDATA2_ADDR A:0x27f4020
y.create.l HWIO_PMIC_ARB4_CHNL127_RDATA2_ADDR A:0x27fc020
y.create.l HWIO_PMIC_ARB4_CHNL128_RDATA2_ADDR A:0x2804020
y.create.l HWIO_PMIC_ARB4_CHNL129_RDATA2_ADDR A:0x280c020
y.create.l HWIO_PMIC_ARB4_CHNL130_RDATA2_ADDR A:0x2814020
y.create.l HWIO_PMIC_ARB4_CHNL131_RDATA2_ADDR A:0x281c020
y.create.l HWIO_PMIC_ARB4_CHNL132_RDATA2_ADDR A:0x2824020
y.create.l HWIO_PMIC_ARB4_CHNL133_RDATA2_ADDR A:0x282c020
y.create.l HWIO_PMIC_ARB4_CHNL134_RDATA2_ADDR A:0x2834020
y.create.l HWIO_PMIC_ARB4_CHNL135_RDATA2_ADDR A:0x283c020
y.create.l HWIO_PMIC_ARB4_CHNL136_RDATA2_ADDR A:0x2844020
y.create.l HWIO_PMIC_ARB4_CHNL137_RDATA2_ADDR A:0x284c020
y.create.l HWIO_PMIC_ARB4_CHNL138_RDATA2_ADDR A:0x2854020
y.create.l HWIO_PMIC_ARB4_CHNL139_RDATA2_ADDR A:0x285c020
y.create.l HWIO_PMIC_ARB4_CHNL140_RDATA2_ADDR A:0x2864020
y.create.l HWIO_PMIC_ARB4_CHNL141_RDATA2_ADDR A:0x286c020
y.create.l HWIO_PMIC_ARB4_CHNL142_RDATA2_ADDR A:0x2874020
y.create.l HWIO_PMIC_ARB4_CHNL143_RDATA2_ADDR A:0x287c020
y.create.l HWIO_PMIC_ARB4_CHNL144_RDATA2_ADDR A:0x2884020
y.create.l HWIO_PMIC_ARB4_CHNL145_RDATA2_ADDR A:0x288c020
y.create.l HWIO_PMIC_ARB4_CHNL146_RDATA2_ADDR A:0x2894020
y.create.l HWIO_PMIC_ARB4_CHNL147_RDATA2_ADDR A:0x289c020
y.create.l HWIO_PMIC_ARB4_CHNL148_RDATA2_ADDR A:0x28a4020
y.create.l HWIO_PMIC_ARB4_CHNL149_RDATA2_ADDR A:0x28ac020
y.create.l HWIO_PMIC_ARB4_CHNL150_RDATA2_ADDR A:0x28b4020
y.create.l HWIO_PMIC_ARB4_CHNL151_RDATA2_ADDR A:0x28bc020
y.create.l HWIO_PMIC_ARB4_CHNL152_RDATA2_ADDR A:0x28c4020
y.create.l HWIO_PMIC_ARB4_CHNL153_RDATA2_ADDR A:0x28cc020
y.create.l HWIO_PMIC_ARB4_CHNL154_RDATA2_ADDR A:0x28d4020
y.create.l HWIO_PMIC_ARB4_CHNL155_RDATA2_ADDR A:0x28dc020
y.create.l HWIO_PMIC_ARB4_CHNL156_RDATA2_ADDR A:0x28e4020
y.create.l HWIO_PMIC_ARB4_CHNL157_RDATA2_ADDR A:0x28ec020
y.create.l HWIO_PMIC_ARB4_CHNL158_RDATA2_ADDR A:0x28f4020
y.create.l HWIO_PMIC_ARB4_CHNL159_RDATA2_ADDR A:0x28fc020
y.create.l HWIO_PMIC_ARB4_CHNL160_RDATA2_ADDR A:0x2904020
y.create.l HWIO_PMIC_ARB4_CHNL161_RDATA2_ADDR A:0x290c020
y.create.l HWIO_PMIC_ARB4_CHNL162_RDATA2_ADDR A:0x2914020
y.create.l HWIO_PMIC_ARB4_CHNL163_RDATA2_ADDR A:0x291c020
y.create.l HWIO_PMIC_ARB4_CHNL164_RDATA2_ADDR A:0x2924020
y.create.l HWIO_PMIC_ARB4_CHNL165_RDATA2_ADDR A:0x292c020
y.create.l HWIO_PMIC_ARB4_CHNL166_RDATA2_ADDR A:0x2934020
y.create.l HWIO_PMIC_ARB4_CHNL167_RDATA2_ADDR A:0x293c020
y.create.l HWIO_PMIC_ARB4_CHNL168_RDATA2_ADDR A:0x2944020
y.create.l HWIO_PMIC_ARB4_CHNL169_RDATA2_ADDR A:0x294c020
y.create.l HWIO_PMIC_ARB4_CHNL170_RDATA2_ADDR A:0x2954020
y.create.l HWIO_PMIC_ARB4_CHNL171_RDATA2_ADDR A:0x295c020
y.create.l HWIO_PMIC_ARB4_CHNL172_RDATA2_ADDR A:0x2964020
y.create.l HWIO_PMIC_ARB4_CHNL173_RDATA2_ADDR A:0x296c020
y.create.l HWIO_PMIC_ARB4_CHNL174_RDATA2_ADDR A:0x2974020
y.create.l HWIO_PMIC_ARB4_CHNL175_RDATA2_ADDR A:0x297c020
y.create.l HWIO_PMIC_ARB4_CHNL176_RDATA2_ADDR A:0x2984020
y.create.l HWIO_PMIC_ARB4_CHNL177_RDATA2_ADDR A:0x298c020
y.create.l HWIO_PMIC_ARB4_CHNL178_RDATA2_ADDR A:0x2994020
y.create.l HWIO_PMIC_ARB4_CHNL179_RDATA2_ADDR A:0x299c020
y.create.l HWIO_PMIC_ARB4_CHNL180_RDATA2_ADDR A:0x29a4020
y.create.l HWIO_PMIC_ARB4_CHNL181_RDATA2_ADDR A:0x29ac020
y.create.l HWIO_PMIC_ARB4_CHNL182_RDATA2_ADDR A:0x29b4020
y.create.l HWIO_PMIC_ARB4_CHNL183_RDATA2_ADDR A:0x29bc020
y.create.l HWIO_PMIC_ARB4_CHNL184_RDATA2_ADDR A:0x29c4020
y.create.l HWIO_PMIC_ARB4_CHNL185_RDATA2_ADDR A:0x29cc020
y.create.l HWIO_PMIC_ARB4_CHNL186_RDATA2_ADDR A:0x29d4020
y.create.l HWIO_PMIC_ARB4_CHNL187_RDATA2_ADDR A:0x29dc020
y.create.l HWIO_PMIC_ARB4_CHNL188_RDATA2_ADDR A:0x29e4020
y.create.l HWIO_PMIC_ARB4_CHNL189_RDATA2_ADDR A:0x29ec020
y.create.l HWIO_PMIC_ARB4_CHNL190_RDATA2_ADDR A:0x29f4020
y.create.l HWIO_PMIC_ARB4_CHNL191_RDATA2_ADDR A:0x29fc020
y.create.l HWIO_PMIC_ARB4_CHNL192_RDATA2_ADDR A:0x2a04020
y.create.l HWIO_PMIC_ARB4_CHNL193_RDATA2_ADDR A:0x2a0c020
y.create.l HWIO_PMIC_ARB4_CHNL194_RDATA2_ADDR A:0x2a14020
y.create.l HWIO_PMIC_ARB4_CHNL195_RDATA2_ADDR A:0x2a1c020
y.create.l HWIO_PMIC_ARB4_CHNL196_RDATA2_ADDR A:0x2a24020
y.create.l HWIO_PMIC_ARB4_CHNL197_RDATA2_ADDR A:0x2a2c020
y.create.l HWIO_PMIC_ARB4_CHNL198_RDATA2_ADDR A:0x2a34020
y.create.l HWIO_PMIC_ARB4_CHNL199_RDATA2_ADDR A:0x2a3c020
y.create.l HWIO_PMIC_ARB4_CHNL200_RDATA2_ADDR A:0x2a44020
y.create.l HWIO_PMIC_ARB4_CHNL201_RDATA2_ADDR A:0x2a4c020
y.create.l HWIO_PMIC_ARB4_CHNL202_RDATA2_ADDR A:0x2a54020
y.create.l HWIO_PMIC_ARB4_CHNL203_RDATA2_ADDR A:0x2a5c020
y.create.l HWIO_PMIC_ARB4_CHNL204_RDATA2_ADDR A:0x2a64020
y.create.l HWIO_PMIC_ARB4_CHNL205_RDATA2_ADDR A:0x2a6c020
y.create.l HWIO_PMIC_ARB4_CHNL206_RDATA2_ADDR A:0x2a74020
y.create.l HWIO_PMIC_ARB4_CHNL207_RDATA2_ADDR A:0x2a7c020
y.create.l HWIO_PMIC_ARB4_CHNL208_RDATA2_ADDR A:0x2a84020
y.create.l HWIO_PMIC_ARB4_CHNL209_RDATA2_ADDR A:0x2a8c020
y.create.l HWIO_PMIC_ARB4_CHNL210_RDATA2_ADDR A:0x2a94020
y.create.l HWIO_PMIC_ARB4_CHNL211_RDATA2_ADDR A:0x2a9c020
y.create.l HWIO_PMIC_ARB4_CHNL212_RDATA2_ADDR A:0x2aa4020
y.create.l HWIO_PMIC_ARB4_CHNL213_RDATA2_ADDR A:0x2aac020
y.create.l HWIO_PMIC_ARB4_CHNL214_RDATA2_ADDR A:0x2ab4020
y.create.l HWIO_PMIC_ARB4_CHNL215_RDATA2_ADDR A:0x2abc020
y.create.l HWIO_PMIC_ARB4_CHNL216_RDATA2_ADDR A:0x2ac4020
y.create.l HWIO_PMIC_ARB4_CHNL217_RDATA2_ADDR A:0x2acc020
y.create.l HWIO_PMIC_ARB4_CHNL218_RDATA2_ADDR A:0x2ad4020
y.create.l HWIO_PMIC_ARB4_CHNL219_RDATA2_ADDR A:0x2adc020
y.create.l HWIO_PMIC_ARB4_CHNL220_RDATA2_ADDR A:0x2ae4020
y.create.l HWIO_PMIC_ARB4_CHNL221_RDATA2_ADDR A:0x2aec020
y.create.l HWIO_PMIC_ARB4_CHNL222_RDATA2_ADDR A:0x2af4020
y.create.l HWIO_PMIC_ARB4_CHNL223_RDATA2_ADDR A:0x2afc020
y.create.l HWIO_PMIC_ARB4_CHNL224_RDATA2_ADDR A:0x2b04020
y.create.l HWIO_PMIC_ARB4_CHNL225_RDATA2_ADDR A:0x2b0c020
y.create.l HWIO_PMIC_ARB4_CHNL226_RDATA2_ADDR A:0x2b14020
y.create.l HWIO_PMIC_ARB4_CHNL227_RDATA2_ADDR A:0x2b1c020
y.create.l HWIO_PMIC_ARB4_CHNL228_RDATA2_ADDR A:0x2b24020
y.create.l HWIO_PMIC_ARB4_CHNL229_RDATA2_ADDR A:0x2b2c020
y.create.l HWIO_PMIC_ARB4_CHNL230_RDATA2_ADDR A:0x2b34020
y.create.l HWIO_PMIC_ARB4_CHNL231_RDATA2_ADDR A:0x2b3c020
y.create.l HWIO_PMIC_ARB4_CHNL232_RDATA2_ADDR A:0x2b44020
y.create.l HWIO_PMIC_ARB4_CHNL233_RDATA2_ADDR A:0x2b4c020
y.create.l HWIO_PMIC_ARB4_CHNL234_RDATA2_ADDR A:0x2b54020
y.create.l HWIO_PMIC_ARB4_CHNL235_RDATA2_ADDR A:0x2b5c020
y.create.l HWIO_PMIC_ARB4_CHNL236_RDATA2_ADDR A:0x2b64020
y.create.l HWIO_PMIC_ARB4_CHNL237_RDATA2_ADDR A:0x2b6c020
y.create.l HWIO_PMIC_ARB4_CHNL238_RDATA2_ADDR A:0x2b74020
y.create.l HWIO_PMIC_ARB4_CHNL239_RDATA2_ADDR A:0x2b7c020
y.create.l HWIO_PMIC_ARB4_CHNL240_RDATA2_ADDR A:0x2b84020
y.create.l HWIO_PMIC_ARB4_CHNL241_RDATA2_ADDR A:0x2b8c020
y.create.l HWIO_PMIC_ARB4_CHNL242_RDATA2_ADDR A:0x2b94020
y.create.l HWIO_PMIC_ARB4_CHNL243_RDATA2_ADDR A:0x2b9c020
y.create.l HWIO_PMIC_ARB4_CHNL244_RDATA2_ADDR A:0x2ba4020
y.create.l HWIO_PMIC_ARB4_CHNL245_RDATA2_ADDR A:0x2bac020
y.create.l HWIO_PMIC_ARB4_CHNL246_RDATA2_ADDR A:0x2bb4020
y.create.l HWIO_PMIC_ARB4_CHNL247_RDATA2_ADDR A:0x2bbc020
y.create.l HWIO_PMIC_ARB4_CHNL248_RDATA2_ADDR A:0x2bc4020
y.create.l HWIO_PMIC_ARB4_CHNL249_RDATA2_ADDR A:0x2bcc020
y.create.l HWIO_PMIC_ARB4_CHNL250_RDATA2_ADDR A:0x2bd4020
y.create.l HWIO_PMIC_ARB4_CHNL251_RDATA2_ADDR A:0x2bdc020
y.create.l HWIO_PMIC_ARB4_CHNL252_RDATA2_ADDR A:0x2be4020
y.create.l HWIO_PMIC_ARB4_CHNL253_RDATA2_ADDR A:0x2bec020
y.create.l HWIO_PMIC_ARB4_CHNL254_RDATA2_ADDR A:0x2bf4020
y.create.l HWIO_PMIC_ARB4_CHNL255_RDATA2_ADDR A:0x2bfc020
y.create.l HWIO_PMIC_ARB5_CHNL0_RDATA2_ADDR A:0x2405020
y.create.l HWIO_PMIC_ARB5_CHNL1_RDATA2_ADDR A:0x240d020
y.create.l HWIO_PMIC_ARB5_CHNL2_RDATA2_ADDR A:0x2415020
y.create.l HWIO_PMIC_ARB5_CHNL3_RDATA2_ADDR A:0x241d020
y.create.l HWIO_PMIC_ARB5_CHNL4_RDATA2_ADDR A:0x2425020
y.create.l HWIO_PMIC_ARB5_CHNL5_RDATA2_ADDR A:0x242d020
y.create.l HWIO_PMIC_ARB5_CHNL6_RDATA2_ADDR A:0x2435020
y.create.l HWIO_PMIC_ARB5_CHNL7_RDATA2_ADDR A:0x243d020
y.create.l HWIO_PMIC_ARB5_CHNL8_RDATA2_ADDR A:0x2445020
y.create.l HWIO_PMIC_ARB5_CHNL9_RDATA2_ADDR A:0x244d020
y.create.l HWIO_PMIC_ARB5_CHNL10_RDATA2_ADDR A:0x2455020
y.create.l HWIO_PMIC_ARB5_CHNL11_RDATA2_ADDR A:0x245d020
y.create.l HWIO_PMIC_ARB5_CHNL12_RDATA2_ADDR A:0x2465020
y.create.l HWIO_PMIC_ARB5_CHNL13_RDATA2_ADDR A:0x246d020
y.create.l HWIO_PMIC_ARB5_CHNL14_RDATA2_ADDR A:0x2475020
y.create.l HWIO_PMIC_ARB5_CHNL15_RDATA2_ADDR A:0x247d020
y.create.l HWIO_PMIC_ARB5_CHNL16_RDATA2_ADDR A:0x2485020
y.create.l HWIO_PMIC_ARB5_CHNL17_RDATA2_ADDR A:0x248d020
y.create.l HWIO_PMIC_ARB5_CHNL18_RDATA2_ADDR A:0x2495020
y.create.l HWIO_PMIC_ARB5_CHNL19_RDATA2_ADDR A:0x249d020
y.create.l HWIO_PMIC_ARB5_CHNL20_RDATA2_ADDR A:0x24a5020
y.create.l HWIO_PMIC_ARB5_CHNL21_RDATA2_ADDR A:0x24ad020
y.create.l HWIO_PMIC_ARB5_CHNL22_RDATA2_ADDR A:0x24b5020
y.create.l HWIO_PMIC_ARB5_CHNL23_RDATA2_ADDR A:0x24bd020
y.create.l HWIO_PMIC_ARB5_CHNL24_RDATA2_ADDR A:0x24c5020
y.create.l HWIO_PMIC_ARB5_CHNL25_RDATA2_ADDR A:0x24cd020
y.create.l HWIO_PMIC_ARB5_CHNL26_RDATA2_ADDR A:0x24d5020
y.create.l HWIO_PMIC_ARB5_CHNL27_RDATA2_ADDR A:0x24dd020
y.create.l HWIO_PMIC_ARB5_CHNL28_RDATA2_ADDR A:0x24e5020
y.create.l HWIO_PMIC_ARB5_CHNL29_RDATA2_ADDR A:0x24ed020
y.create.l HWIO_PMIC_ARB5_CHNL30_RDATA2_ADDR A:0x24f5020
y.create.l HWIO_PMIC_ARB5_CHNL31_RDATA2_ADDR A:0x24fd020
y.create.l HWIO_PMIC_ARB5_CHNL32_RDATA2_ADDR A:0x2505020
y.create.l HWIO_PMIC_ARB5_CHNL33_RDATA2_ADDR A:0x250d020
y.create.l HWIO_PMIC_ARB5_CHNL34_RDATA2_ADDR A:0x2515020
y.create.l HWIO_PMIC_ARB5_CHNL35_RDATA2_ADDR A:0x251d020
y.create.l HWIO_PMIC_ARB5_CHNL36_RDATA2_ADDR A:0x2525020
y.create.l HWIO_PMIC_ARB5_CHNL37_RDATA2_ADDR A:0x252d020
y.create.l HWIO_PMIC_ARB5_CHNL38_RDATA2_ADDR A:0x2535020
y.create.l HWIO_PMIC_ARB5_CHNL39_RDATA2_ADDR A:0x253d020
y.create.l HWIO_PMIC_ARB5_CHNL40_RDATA2_ADDR A:0x2545020
y.create.l HWIO_PMIC_ARB5_CHNL41_RDATA2_ADDR A:0x254d020
y.create.l HWIO_PMIC_ARB5_CHNL42_RDATA2_ADDR A:0x2555020
y.create.l HWIO_PMIC_ARB5_CHNL43_RDATA2_ADDR A:0x255d020
y.create.l HWIO_PMIC_ARB5_CHNL44_RDATA2_ADDR A:0x2565020
y.create.l HWIO_PMIC_ARB5_CHNL45_RDATA2_ADDR A:0x256d020
y.create.l HWIO_PMIC_ARB5_CHNL46_RDATA2_ADDR A:0x2575020
y.create.l HWIO_PMIC_ARB5_CHNL47_RDATA2_ADDR A:0x257d020
y.create.l HWIO_PMIC_ARB5_CHNL48_RDATA2_ADDR A:0x2585020
y.create.l HWIO_PMIC_ARB5_CHNL49_RDATA2_ADDR A:0x258d020
y.create.l HWIO_PMIC_ARB5_CHNL50_RDATA2_ADDR A:0x2595020
y.create.l HWIO_PMIC_ARB5_CHNL51_RDATA2_ADDR A:0x259d020
y.create.l HWIO_PMIC_ARB5_CHNL52_RDATA2_ADDR A:0x25a5020
y.create.l HWIO_PMIC_ARB5_CHNL53_RDATA2_ADDR A:0x25ad020
y.create.l HWIO_PMIC_ARB5_CHNL54_RDATA2_ADDR A:0x25b5020
y.create.l HWIO_PMIC_ARB5_CHNL55_RDATA2_ADDR A:0x25bd020
y.create.l HWIO_PMIC_ARB5_CHNL56_RDATA2_ADDR A:0x25c5020
y.create.l HWIO_PMIC_ARB5_CHNL57_RDATA2_ADDR A:0x25cd020
y.create.l HWIO_PMIC_ARB5_CHNL58_RDATA2_ADDR A:0x25d5020
y.create.l HWIO_PMIC_ARB5_CHNL59_RDATA2_ADDR A:0x25dd020
y.create.l HWIO_PMIC_ARB5_CHNL60_RDATA2_ADDR A:0x25e5020
y.create.l HWIO_PMIC_ARB5_CHNL61_RDATA2_ADDR A:0x25ed020
y.create.l HWIO_PMIC_ARB5_CHNL62_RDATA2_ADDR A:0x25f5020
y.create.l HWIO_PMIC_ARB5_CHNL63_RDATA2_ADDR A:0x25fd020
y.create.l HWIO_PMIC_ARB5_CHNL64_RDATA2_ADDR A:0x2605020
y.create.l HWIO_PMIC_ARB5_CHNL65_RDATA2_ADDR A:0x260d020
y.create.l HWIO_PMIC_ARB5_CHNL66_RDATA2_ADDR A:0x2615020
y.create.l HWIO_PMIC_ARB5_CHNL67_RDATA2_ADDR A:0x261d020
y.create.l HWIO_PMIC_ARB5_CHNL68_RDATA2_ADDR A:0x2625020
y.create.l HWIO_PMIC_ARB5_CHNL69_RDATA2_ADDR A:0x262d020
y.create.l HWIO_PMIC_ARB5_CHNL70_RDATA2_ADDR A:0x2635020
y.create.l HWIO_PMIC_ARB5_CHNL71_RDATA2_ADDR A:0x263d020
y.create.l HWIO_PMIC_ARB5_CHNL72_RDATA2_ADDR A:0x2645020
y.create.l HWIO_PMIC_ARB5_CHNL73_RDATA2_ADDR A:0x264d020
y.create.l HWIO_PMIC_ARB5_CHNL74_RDATA2_ADDR A:0x2655020
y.create.l HWIO_PMIC_ARB5_CHNL75_RDATA2_ADDR A:0x265d020
y.create.l HWIO_PMIC_ARB5_CHNL76_RDATA2_ADDR A:0x2665020
y.create.l HWIO_PMIC_ARB5_CHNL77_RDATA2_ADDR A:0x266d020
y.create.l HWIO_PMIC_ARB5_CHNL78_RDATA2_ADDR A:0x2675020
y.create.l HWIO_PMIC_ARB5_CHNL79_RDATA2_ADDR A:0x267d020
y.create.l HWIO_PMIC_ARB5_CHNL80_RDATA2_ADDR A:0x2685020
y.create.l HWIO_PMIC_ARB5_CHNL81_RDATA2_ADDR A:0x268d020
y.create.l HWIO_PMIC_ARB5_CHNL82_RDATA2_ADDR A:0x2695020
y.create.l HWIO_PMIC_ARB5_CHNL83_RDATA2_ADDR A:0x269d020
y.create.l HWIO_PMIC_ARB5_CHNL84_RDATA2_ADDR A:0x26a5020
y.create.l HWIO_PMIC_ARB5_CHNL85_RDATA2_ADDR A:0x26ad020
y.create.l HWIO_PMIC_ARB5_CHNL86_RDATA2_ADDR A:0x26b5020
y.create.l HWIO_PMIC_ARB5_CHNL87_RDATA2_ADDR A:0x26bd020
y.create.l HWIO_PMIC_ARB5_CHNL88_RDATA2_ADDR A:0x26c5020
y.create.l HWIO_PMIC_ARB5_CHNL89_RDATA2_ADDR A:0x26cd020
y.create.l HWIO_PMIC_ARB5_CHNL90_RDATA2_ADDR A:0x26d5020
y.create.l HWIO_PMIC_ARB5_CHNL91_RDATA2_ADDR A:0x26dd020
y.create.l HWIO_PMIC_ARB5_CHNL92_RDATA2_ADDR A:0x26e5020
y.create.l HWIO_PMIC_ARB5_CHNL93_RDATA2_ADDR A:0x26ed020
y.create.l HWIO_PMIC_ARB5_CHNL94_RDATA2_ADDR A:0x26f5020
y.create.l HWIO_PMIC_ARB5_CHNL95_RDATA2_ADDR A:0x26fd020
y.create.l HWIO_PMIC_ARB5_CHNL96_RDATA2_ADDR A:0x2705020
y.create.l HWIO_PMIC_ARB5_CHNL97_RDATA2_ADDR A:0x270d020
y.create.l HWIO_PMIC_ARB5_CHNL98_RDATA2_ADDR A:0x2715020
y.create.l HWIO_PMIC_ARB5_CHNL99_RDATA2_ADDR A:0x271d020
y.create.l HWIO_PMIC_ARB5_CHNL100_RDATA2_ADDR A:0x2725020
y.create.l HWIO_PMIC_ARB5_CHNL101_RDATA2_ADDR A:0x272d020
y.create.l HWIO_PMIC_ARB5_CHNL102_RDATA2_ADDR A:0x2735020
y.create.l HWIO_PMIC_ARB5_CHNL103_RDATA2_ADDR A:0x273d020
y.create.l HWIO_PMIC_ARB5_CHNL104_RDATA2_ADDR A:0x2745020
y.create.l HWIO_PMIC_ARB5_CHNL105_RDATA2_ADDR A:0x274d020
y.create.l HWIO_PMIC_ARB5_CHNL106_RDATA2_ADDR A:0x2755020
y.create.l HWIO_PMIC_ARB5_CHNL107_RDATA2_ADDR A:0x275d020
y.create.l HWIO_PMIC_ARB5_CHNL108_RDATA2_ADDR A:0x2765020
y.create.l HWIO_PMIC_ARB5_CHNL109_RDATA2_ADDR A:0x276d020
y.create.l HWIO_PMIC_ARB5_CHNL110_RDATA2_ADDR A:0x2775020
y.create.l HWIO_PMIC_ARB5_CHNL111_RDATA2_ADDR A:0x277d020
y.create.l HWIO_PMIC_ARB5_CHNL112_RDATA2_ADDR A:0x2785020
y.create.l HWIO_PMIC_ARB5_CHNL113_RDATA2_ADDR A:0x278d020
y.create.l HWIO_PMIC_ARB5_CHNL114_RDATA2_ADDR A:0x2795020
y.create.l HWIO_PMIC_ARB5_CHNL115_RDATA2_ADDR A:0x279d020
y.create.l HWIO_PMIC_ARB5_CHNL116_RDATA2_ADDR A:0x27a5020
y.create.l HWIO_PMIC_ARB5_CHNL117_RDATA2_ADDR A:0x27ad020
y.create.l HWIO_PMIC_ARB5_CHNL118_RDATA2_ADDR A:0x27b5020
y.create.l HWIO_PMIC_ARB5_CHNL119_RDATA2_ADDR A:0x27bd020
y.create.l HWIO_PMIC_ARB5_CHNL120_RDATA2_ADDR A:0x27c5020
y.create.l HWIO_PMIC_ARB5_CHNL121_RDATA2_ADDR A:0x27cd020
y.create.l HWIO_PMIC_ARB5_CHNL122_RDATA2_ADDR A:0x27d5020
y.create.l HWIO_PMIC_ARB5_CHNL123_RDATA2_ADDR A:0x27dd020
y.create.l HWIO_PMIC_ARB5_CHNL124_RDATA2_ADDR A:0x27e5020
y.create.l HWIO_PMIC_ARB5_CHNL125_RDATA2_ADDR A:0x27ed020
y.create.l HWIO_PMIC_ARB5_CHNL126_RDATA2_ADDR A:0x27f5020
y.create.l HWIO_PMIC_ARB5_CHNL127_RDATA2_ADDR A:0x27fd020
y.create.l HWIO_PMIC_ARB5_CHNL128_RDATA2_ADDR A:0x2805020
y.create.l HWIO_PMIC_ARB5_CHNL129_RDATA2_ADDR A:0x280d020
y.create.l HWIO_PMIC_ARB5_CHNL130_RDATA2_ADDR A:0x2815020
y.create.l HWIO_PMIC_ARB5_CHNL131_RDATA2_ADDR A:0x281d020
y.create.l HWIO_PMIC_ARB5_CHNL132_RDATA2_ADDR A:0x2825020
y.create.l HWIO_PMIC_ARB5_CHNL133_RDATA2_ADDR A:0x282d020
y.create.l HWIO_PMIC_ARB5_CHNL134_RDATA2_ADDR A:0x2835020
y.create.l HWIO_PMIC_ARB5_CHNL135_RDATA2_ADDR A:0x283d020
y.create.l HWIO_PMIC_ARB5_CHNL136_RDATA2_ADDR A:0x2845020
y.create.l HWIO_PMIC_ARB5_CHNL137_RDATA2_ADDR A:0x284d020
y.create.l HWIO_PMIC_ARB5_CHNL138_RDATA2_ADDR A:0x2855020
y.create.l HWIO_PMIC_ARB5_CHNL139_RDATA2_ADDR A:0x285d020
y.create.l HWIO_PMIC_ARB5_CHNL140_RDATA2_ADDR A:0x2865020
y.create.l HWIO_PMIC_ARB5_CHNL141_RDATA2_ADDR A:0x286d020
y.create.l HWIO_PMIC_ARB5_CHNL142_RDATA2_ADDR A:0x2875020
y.create.l HWIO_PMIC_ARB5_CHNL143_RDATA2_ADDR A:0x287d020
y.create.l HWIO_PMIC_ARB5_CHNL144_RDATA2_ADDR A:0x2885020
y.create.l HWIO_PMIC_ARB5_CHNL145_RDATA2_ADDR A:0x288d020
y.create.l HWIO_PMIC_ARB5_CHNL146_RDATA2_ADDR A:0x2895020
y.create.l HWIO_PMIC_ARB5_CHNL147_RDATA2_ADDR A:0x289d020
y.create.l HWIO_PMIC_ARB5_CHNL148_RDATA2_ADDR A:0x28a5020
y.create.l HWIO_PMIC_ARB5_CHNL149_RDATA2_ADDR A:0x28ad020
y.create.l HWIO_PMIC_ARB5_CHNL150_RDATA2_ADDR A:0x28b5020
y.create.l HWIO_PMIC_ARB5_CHNL151_RDATA2_ADDR A:0x28bd020
y.create.l HWIO_PMIC_ARB5_CHNL152_RDATA2_ADDR A:0x28c5020
y.create.l HWIO_PMIC_ARB5_CHNL153_RDATA2_ADDR A:0x28cd020
y.create.l HWIO_PMIC_ARB5_CHNL154_RDATA2_ADDR A:0x28d5020
y.create.l HWIO_PMIC_ARB5_CHNL155_RDATA2_ADDR A:0x28dd020
y.create.l HWIO_PMIC_ARB5_CHNL156_RDATA2_ADDR A:0x28e5020
y.create.l HWIO_PMIC_ARB5_CHNL157_RDATA2_ADDR A:0x28ed020
y.create.l HWIO_PMIC_ARB5_CHNL158_RDATA2_ADDR A:0x28f5020
y.create.l HWIO_PMIC_ARB5_CHNL159_RDATA2_ADDR A:0x28fd020
y.create.l HWIO_PMIC_ARB5_CHNL160_RDATA2_ADDR A:0x2905020
y.create.l HWIO_PMIC_ARB5_CHNL161_RDATA2_ADDR A:0x290d020
y.create.l HWIO_PMIC_ARB5_CHNL162_RDATA2_ADDR A:0x2915020
y.create.l HWIO_PMIC_ARB5_CHNL163_RDATA2_ADDR A:0x291d020
y.create.l HWIO_PMIC_ARB5_CHNL164_RDATA2_ADDR A:0x2925020
y.create.l HWIO_PMIC_ARB5_CHNL165_RDATA2_ADDR A:0x292d020
y.create.l HWIO_PMIC_ARB5_CHNL166_RDATA2_ADDR A:0x2935020
y.create.l HWIO_PMIC_ARB5_CHNL167_RDATA2_ADDR A:0x293d020
y.create.l HWIO_PMIC_ARB5_CHNL168_RDATA2_ADDR A:0x2945020
y.create.l HWIO_PMIC_ARB5_CHNL169_RDATA2_ADDR A:0x294d020
y.create.l HWIO_PMIC_ARB5_CHNL170_RDATA2_ADDR A:0x2955020
y.create.l HWIO_PMIC_ARB5_CHNL171_RDATA2_ADDR A:0x295d020
y.create.l HWIO_PMIC_ARB5_CHNL172_RDATA2_ADDR A:0x2965020
y.create.l HWIO_PMIC_ARB5_CHNL173_RDATA2_ADDR A:0x296d020
y.create.l HWIO_PMIC_ARB5_CHNL174_RDATA2_ADDR A:0x2975020
y.create.l HWIO_PMIC_ARB5_CHNL175_RDATA2_ADDR A:0x297d020
y.create.l HWIO_PMIC_ARB5_CHNL176_RDATA2_ADDR A:0x2985020
y.create.l HWIO_PMIC_ARB5_CHNL177_RDATA2_ADDR A:0x298d020
y.create.l HWIO_PMIC_ARB5_CHNL178_RDATA2_ADDR A:0x2995020
y.create.l HWIO_PMIC_ARB5_CHNL179_RDATA2_ADDR A:0x299d020
y.create.l HWIO_PMIC_ARB5_CHNL180_RDATA2_ADDR A:0x29a5020
y.create.l HWIO_PMIC_ARB5_CHNL181_RDATA2_ADDR A:0x29ad020
y.create.l HWIO_PMIC_ARB5_CHNL182_RDATA2_ADDR A:0x29b5020
y.create.l HWIO_PMIC_ARB5_CHNL183_RDATA2_ADDR A:0x29bd020
y.create.l HWIO_PMIC_ARB5_CHNL184_RDATA2_ADDR A:0x29c5020
y.create.l HWIO_PMIC_ARB5_CHNL185_RDATA2_ADDR A:0x29cd020
y.create.l HWIO_PMIC_ARB5_CHNL186_RDATA2_ADDR A:0x29d5020
y.create.l HWIO_PMIC_ARB5_CHNL187_RDATA2_ADDR A:0x29dd020
y.create.l HWIO_PMIC_ARB5_CHNL188_RDATA2_ADDR A:0x29e5020
y.create.l HWIO_PMIC_ARB5_CHNL189_RDATA2_ADDR A:0x29ed020
y.create.l HWIO_PMIC_ARB5_CHNL190_RDATA2_ADDR A:0x29f5020
y.create.l HWIO_PMIC_ARB5_CHNL191_RDATA2_ADDR A:0x29fd020
y.create.l HWIO_PMIC_ARB5_CHNL192_RDATA2_ADDR A:0x2a05020
y.create.l HWIO_PMIC_ARB5_CHNL193_RDATA2_ADDR A:0x2a0d020
y.create.l HWIO_PMIC_ARB5_CHNL194_RDATA2_ADDR A:0x2a15020
y.create.l HWIO_PMIC_ARB5_CHNL195_RDATA2_ADDR A:0x2a1d020
y.create.l HWIO_PMIC_ARB5_CHNL196_RDATA2_ADDR A:0x2a25020
y.create.l HWIO_PMIC_ARB5_CHNL197_RDATA2_ADDR A:0x2a2d020
y.create.l HWIO_PMIC_ARB5_CHNL198_RDATA2_ADDR A:0x2a35020
y.create.l HWIO_PMIC_ARB5_CHNL199_RDATA2_ADDR A:0x2a3d020
y.create.l HWIO_PMIC_ARB5_CHNL200_RDATA2_ADDR A:0x2a45020
y.create.l HWIO_PMIC_ARB5_CHNL201_RDATA2_ADDR A:0x2a4d020
y.create.l HWIO_PMIC_ARB5_CHNL202_RDATA2_ADDR A:0x2a55020
y.create.l HWIO_PMIC_ARB5_CHNL203_RDATA2_ADDR A:0x2a5d020
y.create.l HWIO_PMIC_ARB5_CHNL204_RDATA2_ADDR A:0x2a65020
y.create.l HWIO_PMIC_ARB5_CHNL205_RDATA2_ADDR A:0x2a6d020
y.create.l HWIO_PMIC_ARB5_CHNL206_RDATA2_ADDR A:0x2a75020
y.create.l HWIO_PMIC_ARB5_CHNL207_RDATA2_ADDR A:0x2a7d020
y.create.l HWIO_PMIC_ARB5_CHNL208_RDATA2_ADDR A:0x2a85020
y.create.l HWIO_PMIC_ARB5_CHNL209_RDATA2_ADDR A:0x2a8d020
y.create.l HWIO_PMIC_ARB5_CHNL210_RDATA2_ADDR A:0x2a95020
y.create.l HWIO_PMIC_ARB5_CHNL211_RDATA2_ADDR A:0x2a9d020
y.create.l HWIO_PMIC_ARB5_CHNL212_RDATA2_ADDR A:0x2aa5020
y.create.l HWIO_PMIC_ARB5_CHNL213_RDATA2_ADDR A:0x2aad020
y.create.l HWIO_PMIC_ARB5_CHNL214_RDATA2_ADDR A:0x2ab5020
y.create.l HWIO_PMIC_ARB5_CHNL215_RDATA2_ADDR A:0x2abd020
y.create.l HWIO_PMIC_ARB5_CHNL216_RDATA2_ADDR A:0x2ac5020
y.create.l HWIO_PMIC_ARB5_CHNL217_RDATA2_ADDR A:0x2acd020
y.create.l HWIO_PMIC_ARB5_CHNL218_RDATA2_ADDR A:0x2ad5020
y.create.l HWIO_PMIC_ARB5_CHNL219_RDATA2_ADDR A:0x2add020
y.create.l HWIO_PMIC_ARB5_CHNL220_RDATA2_ADDR A:0x2ae5020
y.create.l HWIO_PMIC_ARB5_CHNL221_RDATA2_ADDR A:0x2aed020
y.create.l HWIO_PMIC_ARB5_CHNL222_RDATA2_ADDR A:0x2af5020
y.create.l HWIO_PMIC_ARB5_CHNL223_RDATA2_ADDR A:0x2afd020
y.create.l HWIO_PMIC_ARB5_CHNL224_RDATA2_ADDR A:0x2b05020
y.create.l HWIO_PMIC_ARB5_CHNL225_RDATA2_ADDR A:0x2b0d020
y.create.l HWIO_PMIC_ARB5_CHNL226_RDATA2_ADDR A:0x2b15020
y.create.l HWIO_PMIC_ARB5_CHNL227_RDATA2_ADDR A:0x2b1d020
y.create.l HWIO_PMIC_ARB5_CHNL228_RDATA2_ADDR A:0x2b25020
y.create.l HWIO_PMIC_ARB5_CHNL229_RDATA2_ADDR A:0x2b2d020
y.create.l HWIO_PMIC_ARB5_CHNL230_RDATA2_ADDR A:0x2b35020
y.create.l HWIO_PMIC_ARB5_CHNL231_RDATA2_ADDR A:0x2b3d020
y.create.l HWIO_PMIC_ARB5_CHNL232_RDATA2_ADDR A:0x2b45020
y.create.l HWIO_PMIC_ARB5_CHNL233_RDATA2_ADDR A:0x2b4d020
y.create.l HWIO_PMIC_ARB5_CHNL234_RDATA2_ADDR A:0x2b55020
y.create.l HWIO_PMIC_ARB5_CHNL235_RDATA2_ADDR A:0x2b5d020
y.create.l HWIO_PMIC_ARB5_CHNL236_RDATA2_ADDR A:0x2b65020
y.create.l HWIO_PMIC_ARB5_CHNL237_RDATA2_ADDR A:0x2b6d020
y.create.l HWIO_PMIC_ARB5_CHNL238_RDATA2_ADDR A:0x2b75020
y.create.l HWIO_PMIC_ARB5_CHNL239_RDATA2_ADDR A:0x2b7d020
y.create.l HWIO_PMIC_ARB5_CHNL240_RDATA2_ADDR A:0x2b85020
y.create.l HWIO_PMIC_ARB5_CHNL241_RDATA2_ADDR A:0x2b8d020
y.create.l HWIO_PMIC_ARB5_CHNL242_RDATA2_ADDR A:0x2b95020
y.create.l HWIO_PMIC_ARB5_CHNL243_RDATA2_ADDR A:0x2b9d020
y.create.l HWIO_PMIC_ARB5_CHNL244_RDATA2_ADDR A:0x2ba5020
y.create.l HWIO_PMIC_ARB5_CHNL245_RDATA2_ADDR A:0x2bad020
y.create.l HWIO_PMIC_ARB5_CHNL246_RDATA2_ADDR A:0x2bb5020
y.create.l HWIO_PMIC_ARB5_CHNL247_RDATA2_ADDR A:0x2bbd020
y.create.l HWIO_PMIC_ARB5_CHNL248_RDATA2_ADDR A:0x2bc5020
y.create.l HWIO_PMIC_ARB5_CHNL249_RDATA2_ADDR A:0x2bcd020
y.create.l HWIO_PMIC_ARB5_CHNL250_RDATA2_ADDR A:0x2bd5020
y.create.l HWIO_PMIC_ARB5_CHNL251_RDATA2_ADDR A:0x2bdd020
y.create.l HWIO_PMIC_ARB5_CHNL252_RDATA2_ADDR A:0x2be5020
y.create.l HWIO_PMIC_ARB5_CHNL253_RDATA2_ADDR A:0x2bed020
y.create.l HWIO_PMIC_ARB5_CHNL254_RDATA2_ADDR A:0x2bf5020
y.create.l HWIO_PMIC_ARB5_CHNL255_RDATA2_ADDR A:0x2bfd020
y.create.l HWIO_PMIC_ARB6_CHNL0_RDATA2_ADDR A:0x2406020
y.create.l HWIO_PMIC_ARB6_CHNL1_RDATA2_ADDR A:0x240e020
y.create.l HWIO_PMIC_ARB6_CHNL2_RDATA2_ADDR A:0x2416020
y.create.l HWIO_PMIC_ARB6_CHNL3_RDATA2_ADDR A:0x241e020
y.create.l HWIO_PMIC_ARB6_CHNL4_RDATA2_ADDR A:0x2426020
y.create.l HWIO_PMIC_ARB6_CHNL5_RDATA2_ADDR A:0x242e020
y.create.l HWIO_PMIC_ARB6_CHNL6_RDATA2_ADDR A:0x2436020
y.create.l HWIO_PMIC_ARB6_CHNL7_RDATA2_ADDR A:0x243e020
y.create.l HWIO_PMIC_ARB6_CHNL8_RDATA2_ADDR A:0x2446020
y.create.l HWIO_PMIC_ARB6_CHNL9_RDATA2_ADDR A:0x244e020
y.create.l HWIO_PMIC_ARB6_CHNL10_RDATA2_ADDR A:0x2456020
y.create.l HWIO_PMIC_ARB6_CHNL11_RDATA2_ADDR A:0x245e020
y.create.l HWIO_PMIC_ARB6_CHNL12_RDATA2_ADDR A:0x2466020
y.create.l HWIO_PMIC_ARB6_CHNL13_RDATA2_ADDR A:0x246e020
y.create.l HWIO_PMIC_ARB6_CHNL14_RDATA2_ADDR A:0x2476020
y.create.l HWIO_PMIC_ARB6_CHNL15_RDATA2_ADDR A:0x247e020
y.create.l HWIO_PMIC_ARB6_CHNL16_RDATA2_ADDR A:0x2486020
y.create.l HWIO_PMIC_ARB6_CHNL17_RDATA2_ADDR A:0x248e020
y.create.l HWIO_PMIC_ARB6_CHNL18_RDATA2_ADDR A:0x2496020
y.create.l HWIO_PMIC_ARB6_CHNL19_RDATA2_ADDR A:0x249e020
y.create.l HWIO_PMIC_ARB6_CHNL20_RDATA2_ADDR A:0x24a6020
y.create.l HWIO_PMIC_ARB6_CHNL21_RDATA2_ADDR A:0x24ae020
y.create.l HWIO_PMIC_ARB6_CHNL22_RDATA2_ADDR A:0x24b6020
y.create.l HWIO_PMIC_ARB6_CHNL23_RDATA2_ADDR A:0x24be020
y.create.l HWIO_PMIC_ARB6_CHNL24_RDATA2_ADDR A:0x24c6020
y.create.l HWIO_PMIC_ARB6_CHNL25_RDATA2_ADDR A:0x24ce020
y.create.l HWIO_PMIC_ARB6_CHNL26_RDATA2_ADDR A:0x24d6020
y.create.l HWIO_PMIC_ARB6_CHNL27_RDATA2_ADDR A:0x24de020
y.create.l HWIO_PMIC_ARB6_CHNL28_RDATA2_ADDR A:0x24e6020
y.create.l HWIO_PMIC_ARB6_CHNL29_RDATA2_ADDR A:0x24ee020
y.create.l HWIO_PMIC_ARB6_CHNL30_RDATA2_ADDR A:0x24f6020
y.create.l HWIO_PMIC_ARB6_CHNL31_RDATA2_ADDR A:0x24fe020
y.create.l HWIO_PMIC_ARB6_CHNL32_RDATA2_ADDR A:0x2506020
y.create.l HWIO_PMIC_ARB6_CHNL33_RDATA2_ADDR A:0x250e020
y.create.l HWIO_PMIC_ARB6_CHNL34_RDATA2_ADDR A:0x2516020
y.create.l HWIO_PMIC_ARB6_CHNL35_RDATA2_ADDR A:0x251e020
y.create.l HWIO_PMIC_ARB6_CHNL36_RDATA2_ADDR A:0x2526020
y.create.l HWIO_PMIC_ARB6_CHNL37_RDATA2_ADDR A:0x252e020
y.create.l HWIO_PMIC_ARB6_CHNL38_RDATA2_ADDR A:0x2536020
y.create.l HWIO_PMIC_ARB6_CHNL39_RDATA2_ADDR A:0x253e020
y.create.l HWIO_PMIC_ARB6_CHNL40_RDATA2_ADDR A:0x2546020
y.create.l HWIO_PMIC_ARB6_CHNL41_RDATA2_ADDR A:0x254e020
y.create.l HWIO_PMIC_ARB6_CHNL42_RDATA2_ADDR A:0x2556020
y.create.l HWIO_PMIC_ARB6_CHNL43_RDATA2_ADDR A:0x255e020
y.create.l HWIO_PMIC_ARB6_CHNL44_RDATA2_ADDR A:0x2566020
y.create.l HWIO_PMIC_ARB6_CHNL45_RDATA2_ADDR A:0x256e020
y.create.l HWIO_PMIC_ARB6_CHNL46_RDATA2_ADDR A:0x2576020
y.create.l HWIO_PMIC_ARB6_CHNL47_RDATA2_ADDR A:0x257e020
y.create.l HWIO_PMIC_ARB6_CHNL48_RDATA2_ADDR A:0x2586020
y.create.l HWIO_PMIC_ARB6_CHNL49_RDATA2_ADDR A:0x258e020
y.create.l HWIO_PMIC_ARB6_CHNL50_RDATA2_ADDR A:0x2596020
y.create.l HWIO_PMIC_ARB6_CHNL51_RDATA2_ADDR A:0x259e020
y.create.l HWIO_PMIC_ARB6_CHNL52_RDATA2_ADDR A:0x25a6020
y.create.l HWIO_PMIC_ARB6_CHNL53_RDATA2_ADDR A:0x25ae020
y.create.l HWIO_PMIC_ARB6_CHNL54_RDATA2_ADDR A:0x25b6020
y.create.l HWIO_PMIC_ARB6_CHNL55_RDATA2_ADDR A:0x25be020
y.create.l HWIO_PMIC_ARB6_CHNL56_RDATA2_ADDR A:0x25c6020
y.create.l HWIO_PMIC_ARB6_CHNL57_RDATA2_ADDR A:0x25ce020
y.create.l HWIO_PMIC_ARB6_CHNL58_RDATA2_ADDR A:0x25d6020
y.create.l HWIO_PMIC_ARB6_CHNL59_RDATA2_ADDR A:0x25de020
y.create.l HWIO_PMIC_ARB6_CHNL60_RDATA2_ADDR A:0x25e6020
y.create.l HWIO_PMIC_ARB6_CHNL61_RDATA2_ADDR A:0x25ee020
y.create.l HWIO_PMIC_ARB6_CHNL62_RDATA2_ADDR A:0x25f6020
y.create.l HWIO_PMIC_ARB6_CHNL63_RDATA2_ADDR A:0x25fe020
y.create.l HWIO_PMIC_ARB6_CHNL64_RDATA2_ADDR A:0x2606020
y.create.l HWIO_PMIC_ARB6_CHNL65_RDATA2_ADDR A:0x260e020
y.create.l HWIO_PMIC_ARB6_CHNL66_RDATA2_ADDR A:0x2616020
y.create.l HWIO_PMIC_ARB6_CHNL67_RDATA2_ADDR A:0x261e020
y.create.l HWIO_PMIC_ARB6_CHNL68_RDATA2_ADDR A:0x2626020
y.create.l HWIO_PMIC_ARB6_CHNL69_RDATA2_ADDR A:0x262e020
y.create.l HWIO_PMIC_ARB6_CHNL70_RDATA2_ADDR A:0x2636020
y.create.l HWIO_PMIC_ARB6_CHNL71_RDATA2_ADDR A:0x263e020
y.create.l HWIO_PMIC_ARB6_CHNL72_RDATA2_ADDR A:0x2646020
y.create.l HWIO_PMIC_ARB6_CHNL73_RDATA2_ADDR A:0x264e020
y.create.l HWIO_PMIC_ARB6_CHNL74_RDATA2_ADDR A:0x2656020
y.create.l HWIO_PMIC_ARB6_CHNL75_RDATA2_ADDR A:0x265e020
y.create.l HWIO_PMIC_ARB6_CHNL76_RDATA2_ADDR A:0x2666020
y.create.l HWIO_PMIC_ARB6_CHNL77_RDATA2_ADDR A:0x266e020
y.create.l HWIO_PMIC_ARB6_CHNL78_RDATA2_ADDR A:0x2676020
y.create.l HWIO_PMIC_ARB6_CHNL79_RDATA2_ADDR A:0x267e020
y.create.l HWIO_PMIC_ARB6_CHNL80_RDATA2_ADDR A:0x2686020
y.create.l HWIO_PMIC_ARB6_CHNL81_RDATA2_ADDR A:0x268e020
y.create.l HWIO_PMIC_ARB6_CHNL82_RDATA2_ADDR A:0x2696020
y.create.l HWIO_PMIC_ARB6_CHNL83_RDATA2_ADDR A:0x269e020
y.create.l HWIO_PMIC_ARB6_CHNL84_RDATA2_ADDR A:0x26a6020
y.create.l HWIO_PMIC_ARB6_CHNL85_RDATA2_ADDR A:0x26ae020
y.create.l HWIO_PMIC_ARB6_CHNL86_RDATA2_ADDR A:0x26b6020
y.create.l HWIO_PMIC_ARB6_CHNL87_RDATA2_ADDR A:0x26be020
y.create.l HWIO_PMIC_ARB6_CHNL88_RDATA2_ADDR A:0x26c6020
y.create.l HWIO_PMIC_ARB6_CHNL89_RDATA2_ADDR A:0x26ce020
y.create.l HWIO_PMIC_ARB6_CHNL90_RDATA2_ADDR A:0x26d6020
y.create.l HWIO_PMIC_ARB6_CHNL91_RDATA2_ADDR A:0x26de020
y.create.l HWIO_PMIC_ARB6_CHNL92_RDATA2_ADDR A:0x26e6020
y.create.l HWIO_PMIC_ARB6_CHNL93_RDATA2_ADDR A:0x26ee020
y.create.l HWIO_PMIC_ARB6_CHNL94_RDATA2_ADDR A:0x26f6020
y.create.l HWIO_PMIC_ARB6_CHNL95_RDATA2_ADDR A:0x26fe020
y.create.l HWIO_PMIC_ARB6_CHNL96_RDATA2_ADDR A:0x2706020
y.create.l HWIO_PMIC_ARB6_CHNL97_RDATA2_ADDR A:0x270e020
y.create.l HWIO_PMIC_ARB6_CHNL98_RDATA2_ADDR A:0x2716020
y.create.l HWIO_PMIC_ARB6_CHNL99_RDATA2_ADDR A:0x271e020
y.create.l HWIO_PMIC_ARB6_CHNL100_RDATA2_ADDR A:0x2726020
y.create.l HWIO_PMIC_ARB6_CHNL101_RDATA2_ADDR A:0x272e020
y.create.l HWIO_PMIC_ARB6_CHNL102_RDATA2_ADDR A:0x2736020
y.create.l HWIO_PMIC_ARB6_CHNL103_RDATA2_ADDR A:0x273e020
y.create.l HWIO_PMIC_ARB6_CHNL104_RDATA2_ADDR A:0x2746020
y.create.l HWIO_PMIC_ARB6_CHNL105_RDATA2_ADDR A:0x274e020
y.create.l HWIO_PMIC_ARB6_CHNL106_RDATA2_ADDR A:0x2756020
y.create.l HWIO_PMIC_ARB6_CHNL107_RDATA2_ADDR A:0x275e020
y.create.l HWIO_PMIC_ARB6_CHNL108_RDATA2_ADDR A:0x2766020
y.create.l HWIO_PMIC_ARB6_CHNL109_RDATA2_ADDR A:0x276e020
y.create.l HWIO_PMIC_ARB6_CHNL110_RDATA2_ADDR A:0x2776020
y.create.l HWIO_PMIC_ARB6_CHNL111_RDATA2_ADDR A:0x277e020
y.create.l HWIO_PMIC_ARB6_CHNL112_RDATA2_ADDR A:0x2786020
y.create.l HWIO_PMIC_ARB6_CHNL113_RDATA2_ADDR A:0x278e020
y.create.l HWIO_PMIC_ARB6_CHNL114_RDATA2_ADDR A:0x2796020
y.create.l HWIO_PMIC_ARB6_CHNL115_RDATA2_ADDR A:0x279e020
y.create.l HWIO_PMIC_ARB6_CHNL116_RDATA2_ADDR A:0x27a6020
y.create.l HWIO_PMIC_ARB6_CHNL117_RDATA2_ADDR A:0x27ae020
y.create.l HWIO_PMIC_ARB6_CHNL118_RDATA2_ADDR A:0x27b6020
y.create.l HWIO_PMIC_ARB6_CHNL119_RDATA2_ADDR A:0x27be020
y.create.l HWIO_PMIC_ARB6_CHNL120_RDATA2_ADDR A:0x27c6020
y.create.l HWIO_PMIC_ARB6_CHNL121_RDATA2_ADDR A:0x27ce020
y.create.l HWIO_PMIC_ARB6_CHNL122_RDATA2_ADDR A:0x27d6020
y.create.l HWIO_PMIC_ARB6_CHNL123_RDATA2_ADDR A:0x27de020
y.create.l HWIO_PMIC_ARB6_CHNL124_RDATA2_ADDR A:0x27e6020
y.create.l HWIO_PMIC_ARB6_CHNL125_RDATA2_ADDR A:0x27ee020
y.create.l HWIO_PMIC_ARB6_CHNL126_RDATA2_ADDR A:0x27f6020
y.create.l HWIO_PMIC_ARB6_CHNL127_RDATA2_ADDR A:0x27fe020
y.create.l HWIO_PMIC_ARB6_CHNL128_RDATA2_ADDR A:0x2806020
y.create.l HWIO_PMIC_ARB6_CHNL129_RDATA2_ADDR A:0x280e020
y.create.l HWIO_PMIC_ARB6_CHNL130_RDATA2_ADDR A:0x2816020
y.create.l HWIO_PMIC_ARB6_CHNL131_RDATA2_ADDR A:0x281e020
y.create.l HWIO_PMIC_ARB6_CHNL132_RDATA2_ADDR A:0x2826020
y.create.l HWIO_PMIC_ARB6_CHNL133_RDATA2_ADDR A:0x282e020
y.create.l HWIO_PMIC_ARB6_CHNL134_RDATA2_ADDR A:0x2836020
y.create.l HWIO_PMIC_ARB6_CHNL135_RDATA2_ADDR A:0x283e020
y.create.l HWIO_PMIC_ARB6_CHNL136_RDATA2_ADDR A:0x2846020
y.create.l HWIO_PMIC_ARB6_CHNL137_RDATA2_ADDR A:0x284e020
y.create.l HWIO_PMIC_ARB6_CHNL138_RDATA2_ADDR A:0x2856020
y.create.l HWIO_PMIC_ARB6_CHNL139_RDATA2_ADDR A:0x285e020
y.create.l HWIO_PMIC_ARB6_CHNL140_RDATA2_ADDR A:0x2866020
y.create.l HWIO_PMIC_ARB6_CHNL141_RDATA2_ADDR A:0x286e020
y.create.l HWIO_PMIC_ARB6_CHNL142_RDATA2_ADDR A:0x2876020
y.create.l HWIO_PMIC_ARB6_CHNL143_RDATA2_ADDR A:0x287e020
y.create.l HWIO_PMIC_ARB6_CHNL144_RDATA2_ADDR A:0x2886020
y.create.l HWIO_PMIC_ARB6_CHNL145_RDATA2_ADDR A:0x288e020
y.create.l HWIO_PMIC_ARB6_CHNL146_RDATA2_ADDR A:0x2896020
y.create.l HWIO_PMIC_ARB6_CHNL147_RDATA2_ADDR A:0x289e020
y.create.l HWIO_PMIC_ARB6_CHNL148_RDATA2_ADDR A:0x28a6020
y.create.l HWIO_PMIC_ARB6_CHNL149_RDATA2_ADDR A:0x28ae020
y.create.l HWIO_PMIC_ARB6_CHNL150_RDATA2_ADDR A:0x28b6020
y.create.l HWIO_PMIC_ARB6_CHNL151_RDATA2_ADDR A:0x28be020
y.create.l HWIO_PMIC_ARB6_CHNL152_RDATA2_ADDR A:0x28c6020
y.create.l HWIO_PMIC_ARB6_CHNL153_RDATA2_ADDR A:0x28ce020
y.create.l HWIO_PMIC_ARB6_CHNL154_RDATA2_ADDR A:0x28d6020
y.create.l HWIO_PMIC_ARB6_CHNL155_RDATA2_ADDR A:0x28de020
y.create.l HWIO_PMIC_ARB6_CHNL156_RDATA2_ADDR A:0x28e6020
y.create.l HWIO_PMIC_ARB6_CHNL157_RDATA2_ADDR A:0x28ee020
y.create.l HWIO_PMIC_ARB6_CHNL158_RDATA2_ADDR A:0x28f6020
y.create.l HWIO_PMIC_ARB6_CHNL159_RDATA2_ADDR A:0x28fe020
y.create.l HWIO_PMIC_ARB6_CHNL160_RDATA2_ADDR A:0x2906020
y.create.l HWIO_PMIC_ARB6_CHNL161_RDATA2_ADDR A:0x290e020
y.create.l HWIO_PMIC_ARB6_CHNL162_RDATA2_ADDR A:0x2916020
y.create.l HWIO_PMIC_ARB6_CHNL163_RDATA2_ADDR A:0x291e020
y.create.l HWIO_PMIC_ARB6_CHNL164_RDATA2_ADDR A:0x2926020
y.create.l HWIO_PMIC_ARB6_CHNL165_RDATA2_ADDR A:0x292e020
y.create.l HWIO_PMIC_ARB6_CHNL166_RDATA2_ADDR A:0x2936020
y.create.l HWIO_PMIC_ARB6_CHNL167_RDATA2_ADDR A:0x293e020
y.create.l HWIO_PMIC_ARB6_CHNL168_RDATA2_ADDR A:0x2946020
y.create.l HWIO_PMIC_ARB6_CHNL169_RDATA2_ADDR A:0x294e020
y.create.l HWIO_PMIC_ARB6_CHNL170_RDATA2_ADDR A:0x2956020
y.create.l HWIO_PMIC_ARB6_CHNL171_RDATA2_ADDR A:0x295e020
y.create.l HWIO_PMIC_ARB6_CHNL172_RDATA2_ADDR A:0x2966020
y.create.l HWIO_PMIC_ARB6_CHNL173_RDATA2_ADDR A:0x296e020
y.create.l HWIO_PMIC_ARB6_CHNL174_RDATA2_ADDR A:0x2976020
y.create.l HWIO_PMIC_ARB6_CHNL175_RDATA2_ADDR A:0x297e020
y.create.l HWIO_PMIC_ARB6_CHNL176_RDATA2_ADDR A:0x2986020
y.create.l HWIO_PMIC_ARB6_CHNL177_RDATA2_ADDR A:0x298e020
y.create.l HWIO_PMIC_ARB6_CHNL178_RDATA2_ADDR A:0x2996020
y.create.l HWIO_PMIC_ARB6_CHNL179_RDATA2_ADDR A:0x299e020
y.create.l HWIO_PMIC_ARB6_CHNL180_RDATA2_ADDR A:0x29a6020
y.create.l HWIO_PMIC_ARB6_CHNL181_RDATA2_ADDR A:0x29ae020
y.create.l HWIO_PMIC_ARB6_CHNL182_RDATA2_ADDR A:0x29b6020
y.create.l HWIO_PMIC_ARB6_CHNL183_RDATA2_ADDR A:0x29be020
y.create.l HWIO_PMIC_ARB6_CHNL184_RDATA2_ADDR A:0x29c6020
y.create.l HWIO_PMIC_ARB6_CHNL185_RDATA2_ADDR A:0x29ce020
y.create.l HWIO_PMIC_ARB6_CHNL186_RDATA2_ADDR A:0x29d6020
y.create.l HWIO_PMIC_ARB6_CHNL187_RDATA2_ADDR A:0x29de020
y.create.l HWIO_PMIC_ARB6_CHNL188_RDATA2_ADDR A:0x29e6020
y.create.l HWIO_PMIC_ARB6_CHNL189_RDATA2_ADDR A:0x29ee020
y.create.l HWIO_PMIC_ARB6_CHNL190_RDATA2_ADDR A:0x29f6020
y.create.l HWIO_PMIC_ARB6_CHNL191_RDATA2_ADDR A:0x29fe020
y.create.l HWIO_PMIC_ARB6_CHNL192_RDATA2_ADDR A:0x2a06020
y.create.l HWIO_PMIC_ARB6_CHNL193_RDATA2_ADDR A:0x2a0e020
y.create.l HWIO_PMIC_ARB6_CHNL194_RDATA2_ADDR A:0x2a16020
y.create.l HWIO_PMIC_ARB6_CHNL195_RDATA2_ADDR A:0x2a1e020
y.create.l HWIO_PMIC_ARB6_CHNL196_RDATA2_ADDR A:0x2a26020
y.create.l HWIO_PMIC_ARB6_CHNL197_RDATA2_ADDR A:0x2a2e020
y.create.l HWIO_PMIC_ARB6_CHNL198_RDATA2_ADDR A:0x2a36020
y.create.l HWIO_PMIC_ARB6_CHNL199_RDATA2_ADDR A:0x2a3e020
y.create.l HWIO_PMIC_ARB6_CHNL200_RDATA2_ADDR A:0x2a46020
y.create.l HWIO_PMIC_ARB6_CHNL201_RDATA2_ADDR A:0x2a4e020
y.create.l HWIO_PMIC_ARB6_CHNL202_RDATA2_ADDR A:0x2a56020
y.create.l HWIO_PMIC_ARB6_CHNL203_RDATA2_ADDR A:0x2a5e020
y.create.l HWIO_PMIC_ARB6_CHNL204_RDATA2_ADDR A:0x2a66020
y.create.l HWIO_PMIC_ARB6_CHNL205_RDATA2_ADDR A:0x2a6e020
y.create.l HWIO_PMIC_ARB6_CHNL206_RDATA2_ADDR A:0x2a76020
y.create.l HWIO_PMIC_ARB6_CHNL207_RDATA2_ADDR A:0x2a7e020
y.create.l HWIO_PMIC_ARB6_CHNL208_RDATA2_ADDR A:0x2a86020
y.create.l HWIO_PMIC_ARB6_CHNL209_RDATA2_ADDR A:0x2a8e020
y.create.l HWIO_PMIC_ARB6_CHNL210_RDATA2_ADDR A:0x2a96020
y.create.l HWIO_PMIC_ARB6_CHNL211_RDATA2_ADDR A:0x2a9e020
y.create.l HWIO_PMIC_ARB6_CHNL212_RDATA2_ADDR A:0x2aa6020
y.create.l HWIO_PMIC_ARB6_CHNL213_RDATA2_ADDR A:0x2aae020
y.create.l HWIO_PMIC_ARB6_CHNL214_RDATA2_ADDR A:0x2ab6020
y.create.l HWIO_PMIC_ARB6_CHNL215_RDATA2_ADDR A:0x2abe020
y.create.l HWIO_PMIC_ARB6_CHNL216_RDATA2_ADDR A:0x2ac6020
y.create.l HWIO_PMIC_ARB6_CHNL217_RDATA2_ADDR A:0x2ace020
y.create.l HWIO_PMIC_ARB6_CHNL218_RDATA2_ADDR A:0x2ad6020
y.create.l HWIO_PMIC_ARB6_CHNL219_RDATA2_ADDR A:0x2ade020
y.create.l HWIO_PMIC_ARB6_CHNL220_RDATA2_ADDR A:0x2ae6020
y.create.l HWIO_PMIC_ARB6_CHNL221_RDATA2_ADDR A:0x2aee020
y.create.l HWIO_PMIC_ARB6_CHNL222_RDATA2_ADDR A:0x2af6020
y.create.l HWIO_PMIC_ARB6_CHNL223_RDATA2_ADDR A:0x2afe020
y.create.l HWIO_PMIC_ARB6_CHNL224_RDATA2_ADDR A:0x2b06020
y.create.l HWIO_PMIC_ARB6_CHNL225_RDATA2_ADDR A:0x2b0e020
y.create.l HWIO_PMIC_ARB6_CHNL226_RDATA2_ADDR A:0x2b16020
y.create.l HWIO_PMIC_ARB6_CHNL227_RDATA2_ADDR A:0x2b1e020
y.create.l HWIO_PMIC_ARB6_CHNL228_RDATA2_ADDR A:0x2b26020
y.create.l HWIO_PMIC_ARB6_CHNL229_RDATA2_ADDR A:0x2b2e020
y.create.l HWIO_PMIC_ARB6_CHNL230_RDATA2_ADDR A:0x2b36020
y.create.l HWIO_PMIC_ARB6_CHNL231_RDATA2_ADDR A:0x2b3e020
y.create.l HWIO_PMIC_ARB6_CHNL232_RDATA2_ADDR A:0x2b46020
y.create.l HWIO_PMIC_ARB6_CHNL233_RDATA2_ADDR A:0x2b4e020
y.create.l HWIO_PMIC_ARB6_CHNL234_RDATA2_ADDR A:0x2b56020
y.create.l HWIO_PMIC_ARB6_CHNL235_RDATA2_ADDR A:0x2b5e020
y.create.l HWIO_PMIC_ARB6_CHNL236_RDATA2_ADDR A:0x2b66020
y.create.l HWIO_PMIC_ARB6_CHNL237_RDATA2_ADDR A:0x2b6e020
y.create.l HWIO_PMIC_ARB6_CHNL238_RDATA2_ADDR A:0x2b76020
y.create.l HWIO_PMIC_ARB6_CHNL239_RDATA2_ADDR A:0x2b7e020
y.create.l HWIO_PMIC_ARB6_CHNL240_RDATA2_ADDR A:0x2b86020
y.create.l HWIO_PMIC_ARB6_CHNL241_RDATA2_ADDR A:0x2b8e020
y.create.l HWIO_PMIC_ARB6_CHNL242_RDATA2_ADDR A:0x2b96020
y.create.l HWIO_PMIC_ARB6_CHNL243_RDATA2_ADDR A:0x2b9e020
y.create.l HWIO_PMIC_ARB6_CHNL244_RDATA2_ADDR A:0x2ba6020
y.create.l HWIO_PMIC_ARB6_CHNL245_RDATA2_ADDR A:0x2bae020
y.create.l HWIO_PMIC_ARB6_CHNL246_RDATA2_ADDR A:0x2bb6020
y.create.l HWIO_PMIC_ARB6_CHNL247_RDATA2_ADDR A:0x2bbe020
y.create.l HWIO_PMIC_ARB6_CHNL248_RDATA2_ADDR A:0x2bc6020
y.create.l HWIO_PMIC_ARB6_CHNL249_RDATA2_ADDR A:0x2bce020
y.create.l HWIO_PMIC_ARB6_CHNL250_RDATA2_ADDR A:0x2bd6020
y.create.l HWIO_PMIC_ARB6_CHNL251_RDATA2_ADDR A:0x2bde020
y.create.l HWIO_PMIC_ARB6_CHNL252_RDATA2_ADDR A:0x2be6020
y.create.l HWIO_PMIC_ARB6_CHNL253_RDATA2_ADDR A:0x2bee020
y.create.l HWIO_PMIC_ARB6_CHNL254_RDATA2_ADDR A:0x2bf6020
y.create.l HWIO_PMIC_ARB6_CHNL255_RDATA2_ADDR A:0x2bfe020
y.create.l HWIO_PMIC_ARB_OBS0_CHNL0_CMD_ADDR A:0x2c00000
y.create.l HWIO_PMIC_ARB_OBS0_CHNL1_CMD_ADDR A:0x2c08000
y.create.l HWIO_PMIC_ARB_OBS0_CHNL2_CMD_ADDR A:0x2c10000
y.create.l HWIO_PMIC_ARB_OBS0_CHNL3_CMD_ADDR A:0x2c18000
y.create.l HWIO_PMIC_ARB_OBS0_CHNL4_CMD_ADDR A:0x2c20000
y.create.l HWIO_PMIC_ARB_OBS0_CHNL5_CMD_ADDR A:0x2c28000
y.create.l HWIO_PMIC_ARB_OBS0_CHNL6_CMD_ADDR A:0x2c30000
y.create.l HWIO_PMIC_ARB_OBS0_CHNL7_CMD_ADDR A:0x2c38000
y.create.l HWIO_PMIC_ARB_OBS0_CHNL8_CMD_ADDR A:0x2c40000
y.create.l HWIO_PMIC_ARB_OBS0_CHNL9_CMD_ADDR A:0x2c48000
y.create.l HWIO_PMIC_ARB_OBS0_CHNL10_CMD_ADDR A:0x2c50000
y.create.l HWIO_PMIC_ARB_OBS0_CHNL11_CMD_ADDR A:0x2c58000
y.create.l HWIO_PMIC_ARB_OBS0_CHNL12_CMD_ADDR A:0x2c60000
y.create.l HWIO_PMIC_ARB_OBS0_CHNL13_CMD_ADDR A:0x2c68000
y.create.l HWIO_PMIC_ARB_OBS0_CHNL14_CMD_ADDR A:0x2c70000
y.create.l HWIO_PMIC_ARB_OBS0_CHNL15_CMD_ADDR A:0x2c78000
y.create.l HWIO_PMIC_ARB_OBS0_CHNL16_CMD_ADDR A:0x2c80000
y.create.l HWIO_PMIC_ARB_OBS0_CHNL17_CMD_ADDR A:0x2c88000
y.create.l HWIO_PMIC_ARB_OBS0_CHNL18_CMD_ADDR A:0x2c90000
y.create.l HWIO_PMIC_ARB_OBS0_CHNL19_CMD_ADDR A:0x2c98000
y.create.l HWIO_PMIC_ARB_OBS0_CHNL20_CMD_ADDR A:0x2ca0000
y.create.l HWIO_PMIC_ARB_OBS0_CHNL21_CMD_ADDR A:0x2ca8000
y.create.l HWIO_PMIC_ARB_OBS0_CHNL22_CMD_ADDR A:0x2cb0000
y.create.l HWIO_PMIC_ARB_OBS0_CHNL23_CMD_ADDR A:0x2cb8000
y.create.l HWIO_PMIC_ARB_OBS0_CHNL24_CMD_ADDR A:0x2cc0000
y.create.l HWIO_PMIC_ARB_OBS0_CHNL25_CMD_ADDR A:0x2cc8000
y.create.l HWIO_PMIC_ARB_OBS0_CHNL26_CMD_ADDR A:0x2cd0000
y.create.l HWIO_PMIC_ARB_OBS0_CHNL27_CMD_ADDR A:0x2cd8000
y.create.l HWIO_PMIC_ARB_OBS0_CHNL28_CMD_ADDR A:0x2ce0000
y.create.l HWIO_PMIC_ARB_OBS0_CHNL29_CMD_ADDR A:0x2ce8000
y.create.l HWIO_PMIC_ARB_OBS0_CHNL30_CMD_ADDR A:0x2cf0000
y.create.l HWIO_PMIC_ARB_OBS0_CHNL31_CMD_ADDR A:0x2cf8000
y.create.l HWIO_PMIC_ARB_OBS0_CHNL32_CMD_ADDR A:0x2d00000
y.create.l HWIO_PMIC_ARB_OBS0_CHNL33_CMD_ADDR A:0x2d08000
y.create.l HWIO_PMIC_ARB_OBS0_CHNL34_CMD_ADDR A:0x2d10000
y.create.l HWIO_PMIC_ARB_OBS0_CHNL35_CMD_ADDR A:0x2d18000
y.create.l HWIO_PMIC_ARB_OBS0_CHNL36_CMD_ADDR A:0x2d20000
y.create.l HWIO_PMIC_ARB_OBS0_CHNL37_CMD_ADDR A:0x2d28000
y.create.l HWIO_PMIC_ARB_OBS0_CHNL38_CMD_ADDR A:0x2d30000
y.create.l HWIO_PMIC_ARB_OBS0_CHNL39_CMD_ADDR A:0x2d38000
y.create.l HWIO_PMIC_ARB_OBS0_CHNL40_CMD_ADDR A:0x2d40000
y.create.l HWIO_PMIC_ARB_OBS0_CHNL41_CMD_ADDR A:0x2d48000
y.create.l HWIO_PMIC_ARB_OBS0_CHNL42_CMD_ADDR A:0x2d50000
y.create.l HWIO_PMIC_ARB_OBS0_CHNL43_CMD_ADDR A:0x2d58000
y.create.l HWIO_PMIC_ARB_OBS0_CHNL44_CMD_ADDR A:0x2d60000
y.create.l HWIO_PMIC_ARB_OBS0_CHNL45_CMD_ADDR A:0x2d68000
y.create.l HWIO_PMIC_ARB_OBS0_CHNL46_CMD_ADDR A:0x2d70000
y.create.l HWIO_PMIC_ARB_OBS0_CHNL47_CMD_ADDR A:0x2d78000
y.create.l HWIO_PMIC_ARB_OBS0_CHNL48_CMD_ADDR A:0x2d80000
y.create.l HWIO_PMIC_ARB_OBS0_CHNL49_CMD_ADDR A:0x2d88000
y.create.l HWIO_PMIC_ARB_OBS0_CHNL50_CMD_ADDR A:0x2d90000
y.create.l HWIO_PMIC_ARB_OBS0_CHNL51_CMD_ADDR A:0x2d98000
y.create.l HWIO_PMIC_ARB_OBS0_CHNL52_CMD_ADDR A:0x2da0000
y.create.l HWIO_PMIC_ARB_OBS0_CHNL53_CMD_ADDR A:0x2da8000
y.create.l HWIO_PMIC_ARB_OBS0_CHNL54_CMD_ADDR A:0x2db0000
y.create.l HWIO_PMIC_ARB_OBS0_CHNL55_CMD_ADDR A:0x2db8000
y.create.l HWIO_PMIC_ARB_OBS0_CHNL56_CMD_ADDR A:0x2dc0000
y.create.l HWIO_PMIC_ARB_OBS0_CHNL57_CMD_ADDR A:0x2dc8000
y.create.l HWIO_PMIC_ARB_OBS0_CHNL58_CMD_ADDR A:0x2dd0000
y.create.l HWIO_PMIC_ARB_OBS0_CHNL59_CMD_ADDR A:0x2dd8000
y.create.l HWIO_PMIC_ARB_OBS0_CHNL60_CMD_ADDR A:0x2de0000
y.create.l HWIO_PMIC_ARB_OBS0_CHNL61_CMD_ADDR A:0x2de8000
y.create.l HWIO_PMIC_ARB_OBS0_CHNL62_CMD_ADDR A:0x2df0000
y.create.l HWIO_PMIC_ARB_OBS0_CHNL63_CMD_ADDR A:0x2df8000
y.create.l HWIO_PMIC_ARB_OBS0_CHNL64_CMD_ADDR A:0x2e00000
y.create.l HWIO_PMIC_ARB_OBS0_CHNL65_CMD_ADDR A:0x2e08000
y.create.l HWIO_PMIC_ARB_OBS0_CHNL66_CMD_ADDR A:0x2e10000
y.create.l HWIO_PMIC_ARB_OBS0_CHNL67_CMD_ADDR A:0x2e18000
y.create.l HWIO_PMIC_ARB_OBS0_CHNL68_CMD_ADDR A:0x2e20000
y.create.l HWIO_PMIC_ARB_OBS0_CHNL69_CMD_ADDR A:0x2e28000
y.create.l HWIO_PMIC_ARB_OBS0_CHNL70_CMD_ADDR A:0x2e30000
y.create.l HWIO_PMIC_ARB_OBS0_CHNL71_CMD_ADDR A:0x2e38000
y.create.l HWIO_PMIC_ARB_OBS0_CHNL72_CMD_ADDR A:0x2e40000
y.create.l HWIO_PMIC_ARB_OBS0_CHNL73_CMD_ADDR A:0x2e48000
y.create.l HWIO_PMIC_ARB_OBS0_CHNL74_CMD_ADDR A:0x2e50000
y.create.l HWIO_PMIC_ARB_OBS0_CHNL75_CMD_ADDR A:0x2e58000
y.create.l HWIO_PMIC_ARB_OBS0_CHNL76_CMD_ADDR A:0x2e60000
y.create.l HWIO_PMIC_ARB_OBS0_CHNL77_CMD_ADDR A:0x2e68000
y.create.l HWIO_PMIC_ARB_OBS0_CHNL78_CMD_ADDR A:0x2e70000
y.create.l HWIO_PMIC_ARB_OBS0_CHNL79_CMD_ADDR A:0x2e78000
y.create.l HWIO_PMIC_ARB_OBS0_CHNL80_CMD_ADDR A:0x2e80000
y.create.l HWIO_PMIC_ARB_OBS0_CHNL81_CMD_ADDR A:0x2e88000
y.create.l HWIO_PMIC_ARB_OBS0_CHNL82_CMD_ADDR A:0x2e90000
y.create.l HWIO_PMIC_ARB_OBS0_CHNL83_CMD_ADDR A:0x2e98000
y.create.l HWIO_PMIC_ARB_OBS0_CHNL84_CMD_ADDR A:0x2ea0000
y.create.l HWIO_PMIC_ARB_OBS0_CHNL85_CMD_ADDR A:0x2ea8000
y.create.l HWIO_PMIC_ARB_OBS0_CHNL86_CMD_ADDR A:0x2eb0000
y.create.l HWIO_PMIC_ARB_OBS0_CHNL87_CMD_ADDR A:0x2eb8000
y.create.l HWIO_PMIC_ARB_OBS0_CHNL88_CMD_ADDR A:0x2ec0000
y.create.l HWIO_PMIC_ARB_OBS0_CHNL89_CMD_ADDR A:0x2ec8000
y.create.l HWIO_PMIC_ARB_OBS0_CHNL90_CMD_ADDR A:0x2ed0000
y.create.l HWIO_PMIC_ARB_OBS0_CHNL91_CMD_ADDR A:0x2ed8000
y.create.l HWIO_PMIC_ARB_OBS0_CHNL92_CMD_ADDR A:0x2ee0000
y.create.l HWIO_PMIC_ARB_OBS0_CHNL93_CMD_ADDR A:0x2ee8000
y.create.l HWIO_PMIC_ARB_OBS0_CHNL94_CMD_ADDR A:0x2ef0000
y.create.l HWIO_PMIC_ARB_OBS0_CHNL95_CMD_ADDR A:0x2ef8000
y.create.l HWIO_PMIC_ARB_OBS0_CHNL96_CMD_ADDR A:0x2f00000
y.create.l HWIO_PMIC_ARB_OBS0_CHNL97_CMD_ADDR A:0x2f08000
y.create.l HWIO_PMIC_ARB_OBS0_CHNL98_CMD_ADDR A:0x2f10000
y.create.l HWIO_PMIC_ARB_OBS0_CHNL99_CMD_ADDR A:0x2f18000
y.create.l HWIO_PMIC_ARB_OBS0_CHNL100_CMD_ADDR A:0x2f20000
y.create.l HWIO_PMIC_ARB_OBS0_CHNL101_CMD_ADDR A:0x2f28000
y.create.l HWIO_PMIC_ARB_OBS0_CHNL102_CMD_ADDR A:0x2f30000
y.create.l HWIO_PMIC_ARB_OBS0_CHNL103_CMD_ADDR A:0x2f38000
y.create.l HWIO_PMIC_ARB_OBS0_CHNL104_CMD_ADDR A:0x2f40000
y.create.l HWIO_PMIC_ARB_OBS0_CHNL105_CMD_ADDR A:0x2f48000
y.create.l HWIO_PMIC_ARB_OBS0_CHNL106_CMD_ADDR A:0x2f50000
y.create.l HWIO_PMIC_ARB_OBS0_CHNL107_CMD_ADDR A:0x2f58000
y.create.l HWIO_PMIC_ARB_OBS0_CHNL108_CMD_ADDR A:0x2f60000
y.create.l HWIO_PMIC_ARB_OBS0_CHNL109_CMD_ADDR A:0x2f68000
y.create.l HWIO_PMIC_ARB_OBS0_CHNL110_CMD_ADDR A:0x2f70000
y.create.l HWIO_PMIC_ARB_OBS0_CHNL111_CMD_ADDR A:0x2f78000
y.create.l HWIO_PMIC_ARB_OBS0_CHNL112_CMD_ADDR A:0x2f80000
y.create.l HWIO_PMIC_ARB_OBS0_CHNL113_CMD_ADDR A:0x2f88000
y.create.l HWIO_PMIC_ARB_OBS0_CHNL114_CMD_ADDR A:0x2f90000
y.create.l HWIO_PMIC_ARB_OBS0_CHNL115_CMD_ADDR A:0x2f98000
y.create.l HWIO_PMIC_ARB_OBS0_CHNL116_CMD_ADDR A:0x2fa0000
y.create.l HWIO_PMIC_ARB_OBS0_CHNL117_CMD_ADDR A:0x2fa8000
y.create.l HWIO_PMIC_ARB_OBS0_CHNL118_CMD_ADDR A:0x2fb0000
y.create.l HWIO_PMIC_ARB_OBS0_CHNL119_CMD_ADDR A:0x2fb8000
y.create.l HWIO_PMIC_ARB_OBS0_CHNL120_CMD_ADDR A:0x2fc0000
y.create.l HWIO_PMIC_ARB_OBS0_CHNL121_CMD_ADDR A:0x2fc8000
y.create.l HWIO_PMIC_ARB_OBS0_CHNL122_CMD_ADDR A:0x2fd0000
y.create.l HWIO_PMIC_ARB_OBS0_CHNL123_CMD_ADDR A:0x2fd8000
y.create.l HWIO_PMIC_ARB_OBS0_CHNL124_CMD_ADDR A:0x2fe0000
y.create.l HWIO_PMIC_ARB_OBS0_CHNL125_CMD_ADDR A:0x2fe8000
y.create.l HWIO_PMIC_ARB_OBS0_CHNL126_CMD_ADDR A:0x2ff0000
y.create.l HWIO_PMIC_ARB_OBS0_CHNL127_CMD_ADDR A:0x2ff8000
y.create.l HWIO_PMIC_ARB_OBS0_CHNL128_CMD_ADDR A:0x3000000
y.create.l HWIO_PMIC_ARB_OBS0_CHNL129_CMD_ADDR A:0x3008000
y.create.l HWIO_PMIC_ARB_OBS0_CHNL130_CMD_ADDR A:0x3010000
y.create.l HWIO_PMIC_ARB_OBS0_CHNL131_CMD_ADDR A:0x3018000
y.create.l HWIO_PMIC_ARB_OBS0_CHNL132_CMD_ADDR A:0x3020000
y.create.l HWIO_PMIC_ARB_OBS0_CHNL133_CMD_ADDR A:0x3028000
y.create.l HWIO_PMIC_ARB_OBS0_CHNL134_CMD_ADDR A:0x3030000
y.create.l HWIO_PMIC_ARB_OBS0_CHNL135_CMD_ADDR A:0x3038000
y.create.l HWIO_PMIC_ARB_OBS0_CHNL136_CMD_ADDR A:0x3040000
y.create.l HWIO_PMIC_ARB_OBS0_CHNL137_CMD_ADDR A:0x3048000
y.create.l HWIO_PMIC_ARB_OBS0_CHNL138_CMD_ADDR A:0x3050000
y.create.l HWIO_PMIC_ARB_OBS0_CHNL139_CMD_ADDR A:0x3058000
y.create.l HWIO_PMIC_ARB_OBS0_CHNL140_CMD_ADDR A:0x3060000
y.create.l HWIO_PMIC_ARB_OBS0_CHNL141_CMD_ADDR A:0x3068000
y.create.l HWIO_PMIC_ARB_OBS0_CHNL142_CMD_ADDR A:0x3070000
y.create.l HWIO_PMIC_ARB_OBS0_CHNL143_CMD_ADDR A:0x3078000
y.create.l HWIO_PMIC_ARB_OBS0_CHNL144_CMD_ADDR A:0x3080000
y.create.l HWIO_PMIC_ARB_OBS0_CHNL145_CMD_ADDR A:0x3088000
y.create.l HWIO_PMIC_ARB_OBS0_CHNL146_CMD_ADDR A:0x3090000
y.create.l HWIO_PMIC_ARB_OBS0_CHNL147_CMD_ADDR A:0x3098000
y.create.l HWIO_PMIC_ARB_OBS0_CHNL148_CMD_ADDR A:0x30a0000
y.create.l HWIO_PMIC_ARB_OBS0_CHNL149_CMD_ADDR A:0x30a8000
y.create.l HWIO_PMIC_ARB_OBS0_CHNL150_CMD_ADDR A:0x30b0000
y.create.l HWIO_PMIC_ARB_OBS0_CHNL151_CMD_ADDR A:0x30b8000
y.create.l HWIO_PMIC_ARB_OBS0_CHNL152_CMD_ADDR A:0x30c0000
y.create.l HWIO_PMIC_ARB_OBS0_CHNL153_CMD_ADDR A:0x30c8000
y.create.l HWIO_PMIC_ARB_OBS0_CHNL154_CMD_ADDR A:0x30d0000
y.create.l HWIO_PMIC_ARB_OBS0_CHNL155_CMD_ADDR A:0x30d8000
y.create.l HWIO_PMIC_ARB_OBS0_CHNL156_CMD_ADDR A:0x30e0000
y.create.l HWIO_PMIC_ARB_OBS0_CHNL157_CMD_ADDR A:0x30e8000
y.create.l HWIO_PMIC_ARB_OBS0_CHNL158_CMD_ADDR A:0x30f0000
y.create.l HWIO_PMIC_ARB_OBS0_CHNL159_CMD_ADDR A:0x30f8000
y.create.l HWIO_PMIC_ARB_OBS0_CHNL160_CMD_ADDR A:0x3100000
y.create.l HWIO_PMIC_ARB_OBS0_CHNL161_CMD_ADDR A:0x3108000
y.create.l HWIO_PMIC_ARB_OBS0_CHNL162_CMD_ADDR A:0x3110000
y.create.l HWIO_PMIC_ARB_OBS0_CHNL163_CMD_ADDR A:0x3118000
y.create.l HWIO_PMIC_ARB_OBS0_CHNL164_CMD_ADDR A:0x3120000
y.create.l HWIO_PMIC_ARB_OBS0_CHNL165_CMD_ADDR A:0x3128000
y.create.l HWIO_PMIC_ARB_OBS0_CHNL166_CMD_ADDR A:0x3130000
y.create.l HWIO_PMIC_ARB_OBS0_CHNL167_CMD_ADDR A:0x3138000
y.create.l HWIO_PMIC_ARB_OBS0_CHNL168_CMD_ADDR A:0x3140000
y.create.l HWIO_PMIC_ARB_OBS0_CHNL169_CMD_ADDR A:0x3148000
y.create.l HWIO_PMIC_ARB_OBS0_CHNL170_CMD_ADDR A:0x3150000
y.create.l HWIO_PMIC_ARB_OBS0_CHNL171_CMD_ADDR A:0x3158000
y.create.l HWIO_PMIC_ARB_OBS0_CHNL172_CMD_ADDR A:0x3160000
y.create.l HWIO_PMIC_ARB_OBS0_CHNL173_CMD_ADDR A:0x3168000
y.create.l HWIO_PMIC_ARB_OBS0_CHNL174_CMD_ADDR A:0x3170000
y.create.l HWIO_PMIC_ARB_OBS0_CHNL175_CMD_ADDR A:0x3178000
y.create.l HWIO_PMIC_ARB_OBS0_CHNL176_CMD_ADDR A:0x3180000
y.create.l HWIO_PMIC_ARB_OBS0_CHNL177_CMD_ADDR A:0x3188000
y.create.l HWIO_PMIC_ARB_OBS0_CHNL178_CMD_ADDR A:0x3190000
y.create.l HWIO_PMIC_ARB_OBS0_CHNL179_CMD_ADDR A:0x3198000
y.create.l HWIO_PMIC_ARB_OBS0_CHNL180_CMD_ADDR A:0x31a0000
y.create.l HWIO_PMIC_ARB_OBS0_CHNL181_CMD_ADDR A:0x31a8000
y.create.l HWIO_PMIC_ARB_OBS0_CHNL182_CMD_ADDR A:0x31b0000
y.create.l HWIO_PMIC_ARB_OBS0_CHNL183_CMD_ADDR A:0x31b8000
y.create.l HWIO_PMIC_ARB_OBS0_CHNL184_CMD_ADDR A:0x31c0000
y.create.l HWIO_PMIC_ARB_OBS0_CHNL185_CMD_ADDR A:0x31c8000
y.create.l HWIO_PMIC_ARB_OBS0_CHNL186_CMD_ADDR A:0x31d0000
y.create.l HWIO_PMIC_ARB_OBS0_CHNL187_CMD_ADDR A:0x31d8000
y.create.l HWIO_PMIC_ARB_OBS0_CHNL188_CMD_ADDR A:0x31e0000
y.create.l HWIO_PMIC_ARB_OBS0_CHNL189_CMD_ADDR A:0x31e8000
y.create.l HWIO_PMIC_ARB_OBS0_CHNL190_CMD_ADDR A:0x31f0000
y.create.l HWIO_PMIC_ARB_OBS0_CHNL191_CMD_ADDR A:0x31f8000
y.create.l HWIO_PMIC_ARB_OBS0_CHNL192_CMD_ADDR A:0x3200000
y.create.l HWIO_PMIC_ARB_OBS0_CHNL193_CMD_ADDR A:0x3208000
y.create.l HWIO_PMIC_ARB_OBS0_CHNL194_CMD_ADDR A:0x3210000
y.create.l HWIO_PMIC_ARB_OBS0_CHNL195_CMD_ADDR A:0x3218000
y.create.l HWIO_PMIC_ARB_OBS0_CHNL196_CMD_ADDR A:0x3220000
y.create.l HWIO_PMIC_ARB_OBS0_CHNL197_CMD_ADDR A:0x3228000
y.create.l HWIO_PMIC_ARB_OBS0_CHNL198_CMD_ADDR A:0x3230000
y.create.l HWIO_PMIC_ARB_OBS0_CHNL199_CMD_ADDR A:0x3238000
y.create.l HWIO_PMIC_ARB_OBS0_CHNL200_CMD_ADDR A:0x3240000
y.create.l HWIO_PMIC_ARB_OBS0_CHNL201_CMD_ADDR A:0x3248000
y.create.l HWIO_PMIC_ARB_OBS0_CHNL202_CMD_ADDR A:0x3250000
y.create.l HWIO_PMIC_ARB_OBS0_CHNL203_CMD_ADDR A:0x3258000
y.create.l HWIO_PMIC_ARB_OBS0_CHNL204_CMD_ADDR A:0x3260000
y.create.l HWIO_PMIC_ARB_OBS0_CHNL205_CMD_ADDR A:0x3268000
y.create.l HWIO_PMIC_ARB_OBS0_CHNL206_CMD_ADDR A:0x3270000
y.create.l HWIO_PMIC_ARB_OBS0_CHNL207_CMD_ADDR A:0x3278000
y.create.l HWIO_PMIC_ARB_OBS0_CHNL208_CMD_ADDR A:0x3280000
y.create.l HWIO_PMIC_ARB_OBS0_CHNL209_CMD_ADDR A:0x3288000
y.create.l HWIO_PMIC_ARB_OBS0_CHNL210_CMD_ADDR A:0x3290000
y.create.l HWIO_PMIC_ARB_OBS0_CHNL211_CMD_ADDR A:0x3298000
y.create.l HWIO_PMIC_ARB_OBS0_CHNL212_CMD_ADDR A:0x32a0000
y.create.l HWIO_PMIC_ARB_OBS0_CHNL213_CMD_ADDR A:0x32a8000
y.create.l HWIO_PMIC_ARB_OBS0_CHNL214_CMD_ADDR A:0x32b0000
y.create.l HWIO_PMIC_ARB_OBS0_CHNL215_CMD_ADDR A:0x32b8000
y.create.l HWIO_PMIC_ARB_OBS0_CHNL216_CMD_ADDR A:0x32c0000
y.create.l HWIO_PMIC_ARB_OBS0_CHNL217_CMD_ADDR A:0x32c8000
y.create.l HWIO_PMIC_ARB_OBS0_CHNL218_CMD_ADDR A:0x32d0000
y.create.l HWIO_PMIC_ARB_OBS0_CHNL219_CMD_ADDR A:0x32d8000
y.create.l HWIO_PMIC_ARB_OBS0_CHNL220_CMD_ADDR A:0x32e0000
y.create.l HWIO_PMIC_ARB_OBS0_CHNL221_CMD_ADDR A:0x32e8000
y.create.l HWIO_PMIC_ARB_OBS0_CHNL222_CMD_ADDR A:0x32f0000
y.create.l HWIO_PMIC_ARB_OBS0_CHNL223_CMD_ADDR A:0x32f8000
y.create.l HWIO_PMIC_ARB_OBS0_CHNL224_CMD_ADDR A:0x3300000
y.create.l HWIO_PMIC_ARB_OBS0_CHNL225_CMD_ADDR A:0x3308000
y.create.l HWIO_PMIC_ARB_OBS0_CHNL226_CMD_ADDR A:0x3310000
y.create.l HWIO_PMIC_ARB_OBS0_CHNL227_CMD_ADDR A:0x3318000
y.create.l HWIO_PMIC_ARB_OBS0_CHNL228_CMD_ADDR A:0x3320000
y.create.l HWIO_PMIC_ARB_OBS0_CHNL229_CMD_ADDR A:0x3328000
y.create.l HWIO_PMIC_ARB_OBS0_CHNL230_CMD_ADDR A:0x3330000
y.create.l HWIO_PMIC_ARB_OBS0_CHNL231_CMD_ADDR A:0x3338000
y.create.l HWIO_PMIC_ARB_OBS0_CHNL232_CMD_ADDR A:0x3340000
y.create.l HWIO_PMIC_ARB_OBS0_CHNL233_CMD_ADDR A:0x3348000
y.create.l HWIO_PMIC_ARB_OBS0_CHNL234_CMD_ADDR A:0x3350000
y.create.l HWIO_PMIC_ARB_OBS0_CHNL235_CMD_ADDR A:0x3358000
y.create.l HWIO_PMIC_ARB_OBS0_CHNL236_CMD_ADDR A:0x3360000
y.create.l HWIO_PMIC_ARB_OBS0_CHNL237_CMD_ADDR A:0x3368000
y.create.l HWIO_PMIC_ARB_OBS0_CHNL238_CMD_ADDR A:0x3370000
y.create.l HWIO_PMIC_ARB_OBS0_CHNL239_CMD_ADDR A:0x3378000
y.create.l HWIO_PMIC_ARB_OBS0_CHNL240_CMD_ADDR A:0x3380000
y.create.l HWIO_PMIC_ARB_OBS0_CHNL241_CMD_ADDR A:0x3388000
y.create.l HWIO_PMIC_ARB_OBS0_CHNL242_CMD_ADDR A:0x3390000
y.create.l HWIO_PMIC_ARB_OBS0_CHNL243_CMD_ADDR A:0x3398000
y.create.l HWIO_PMIC_ARB_OBS0_CHNL244_CMD_ADDR A:0x33a0000
y.create.l HWIO_PMIC_ARB_OBS0_CHNL245_CMD_ADDR A:0x33a8000
y.create.l HWIO_PMIC_ARB_OBS0_CHNL246_CMD_ADDR A:0x33b0000
y.create.l HWIO_PMIC_ARB_OBS0_CHNL247_CMD_ADDR A:0x33b8000
y.create.l HWIO_PMIC_ARB_OBS0_CHNL248_CMD_ADDR A:0x33c0000
y.create.l HWIO_PMIC_ARB_OBS0_CHNL249_CMD_ADDR A:0x33c8000
y.create.l HWIO_PMIC_ARB_OBS0_CHNL250_CMD_ADDR A:0x33d0000
y.create.l HWIO_PMIC_ARB_OBS0_CHNL251_CMD_ADDR A:0x33d8000
y.create.l HWIO_PMIC_ARB_OBS0_CHNL252_CMD_ADDR A:0x33e0000
y.create.l HWIO_PMIC_ARB_OBS0_CHNL253_CMD_ADDR A:0x33e8000
y.create.l HWIO_PMIC_ARB_OBS0_CHNL254_CMD_ADDR A:0x33f0000
y.create.l HWIO_PMIC_ARB_OBS0_CHNL255_CMD_ADDR A:0x33f8000
y.create.l HWIO_PMIC_ARB_OBS1_CHNL0_CMD_ADDR A:0x2c01000
y.create.l HWIO_PMIC_ARB_OBS1_CHNL1_CMD_ADDR A:0x2c09000
y.create.l HWIO_PMIC_ARB_OBS1_CHNL2_CMD_ADDR A:0x2c11000
y.create.l HWIO_PMIC_ARB_OBS1_CHNL3_CMD_ADDR A:0x2c19000
y.create.l HWIO_PMIC_ARB_OBS1_CHNL4_CMD_ADDR A:0x2c21000
y.create.l HWIO_PMIC_ARB_OBS1_CHNL5_CMD_ADDR A:0x2c29000
y.create.l HWIO_PMIC_ARB_OBS1_CHNL6_CMD_ADDR A:0x2c31000
y.create.l HWIO_PMIC_ARB_OBS1_CHNL7_CMD_ADDR A:0x2c39000
y.create.l HWIO_PMIC_ARB_OBS1_CHNL8_CMD_ADDR A:0x2c41000
y.create.l HWIO_PMIC_ARB_OBS1_CHNL9_CMD_ADDR A:0x2c49000
y.create.l HWIO_PMIC_ARB_OBS1_CHNL10_CMD_ADDR A:0x2c51000
y.create.l HWIO_PMIC_ARB_OBS1_CHNL11_CMD_ADDR A:0x2c59000
y.create.l HWIO_PMIC_ARB_OBS1_CHNL12_CMD_ADDR A:0x2c61000
y.create.l HWIO_PMIC_ARB_OBS1_CHNL13_CMD_ADDR A:0x2c69000
y.create.l HWIO_PMIC_ARB_OBS1_CHNL14_CMD_ADDR A:0x2c71000
y.create.l HWIO_PMIC_ARB_OBS1_CHNL15_CMD_ADDR A:0x2c79000
y.create.l HWIO_PMIC_ARB_OBS1_CHNL16_CMD_ADDR A:0x2c81000
y.create.l HWIO_PMIC_ARB_OBS1_CHNL17_CMD_ADDR A:0x2c89000
y.create.l HWIO_PMIC_ARB_OBS1_CHNL18_CMD_ADDR A:0x2c91000
y.create.l HWIO_PMIC_ARB_OBS1_CHNL19_CMD_ADDR A:0x2c99000
y.create.l HWIO_PMIC_ARB_OBS1_CHNL20_CMD_ADDR A:0x2ca1000
y.create.l HWIO_PMIC_ARB_OBS1_CHNL21_CMD_ADDR A:0x2ca9000
y.create.l HWIO_PMIC_ARB_OBS1_CHNL22_CMD_ADDR A:0x2cb1000
y.create.l HWIO_PMIC_ARB_OBS1_CHNL23_CMD_ADDR A:0x2cb9000
y.create.l HWIO_PMIC_ARB_OBS1_CHNL24_CMD_ADDR A:0x2cc1000
y.create.l HWIO_PMIC_ARB_OBS1_CHNL25_CMD_ADDR A:0x2cc9000
y.create.l HWIO_PMIC_ARB_OBS1_CHNL26_CMD_ADDR A:0x2cd1000
y.create.l HWIO_PMIC_ARB_OBS1_CHNL27_CMD_ADDR A:0x2cd9000
y.create.l HWIO_PMIC_ARB_OBS1_CHNL28_CMD_ADDR A:0x2ce1000
y.create.l HWIO_PMIC_ARB_OBS1_CHNL29_CMD_ADDR A:0x2ce9000
y.create.l HWIO_PMIC_ARB_OBS1_CHNL30_CMD_ADDR A:0x2cf1000
y.create.l HWIO_PMIC_ARB_OBS1_CHNL31_CMD_ADDR A:0x2cf9000
y.create.l HWIO_PMIC_ARB_OBS1_CHNL32_CMD_ADDR A:0x2d01000
y.create.l HWIO_PMIC_ARB_OBS1_CHNL33_CMD_ADDR A:0x2d09000
y.create.l HWIO_PMIC_ARB_OBS1_CHNL34_CMD_ADDR A:0x2d11000
y.create.l HWIO_PMIC_ARB_OBS1_CHNL35_CMD_ADDR A:0x2d19000
y.create.l HWIO_PMIC_ARB_OBS1_CHNL36_CMD_ADDR A:0x2d21000
y.create.l HWIO_PMIC_ARB_OBS1_CHNL37_CMD_ADDR A:0x2d29000
y.create.l HWIO_PMIC_ARB_OBS1_CHNL38_CMD_ADDR A:0x2d31000
y.create.l HWIO_PMIC_ARB_OBS1_CHNL39_CMD_ADDR A:0x2d39000
y.create.l HWIO_PMIC_ARB_OBS1_CHNL40_CMD_ADDR A:0x2d41000
y.create.l HWIO_PMIC_ARB_OBS1_CHNL41_CMD_ADDR A:0x2d49000
y.create.l HWIO_PMIC_ARB_OBS1_CHNL42_CMD_ADDR A:0x2d51000
y.create.l HWIO_PMIC_ARB_OBS1_CHNL43_CMD_ADDR A:0x2d59000
y.create.l HWIO_PMIC_ARB_OBS1_CHNL44_CMD_ADDR A:0x2d61000
y.create.l HWIO_PMIC_ARB_OBS1_CHNL45_CMD_ADDR A:0x2d69000
y.create.l HWIO_PMIC_ARB_OBS1_CHNL46_CMD_ADDR A:0x2d71000
y.create.l HWIO_PMIC_ARB_OBS1_CHNL47_CMD_ADDR A:0x2d79000
y.create.l HWIO_PMIC_ARB_OBS1_CHNL48_CMD_ADDR A:0x2d81000
y.create.l HWIO_PMIC_ARB_OBS1_CHNL49_CMD_ADDR A:0x2d89000
y.create.l HWIO_PMIC_ARB_OBS1_CHNL50_CMD_ADDR A:0x2d91000
y.create.l HWIO_PMIC_ARB_OBS1_CHNL51_CMD_ADDR A:0x2d99000
y.create.l HWIO_PMIC_ARB_OBS1_CHNL52_CMD_ADDR A:0x2da1000
y.create.l HWIO_PMIC_ARB_OBS1_CHNL53_CMD_ADDR A:0x2da9000
y.create.l HWIO_PMIC_ARB_OBS1_CHNL54_CMD_ADDR A:0x2db1000
y.create.l HWIO_PMIC_ARB_OBS1_CHNL55_CMD_ADDR A:0x2db9000
y.create.l HWIO_PMIC_ARB_OBS1_CHNL56_CMD_ADDR A:0x2dc1000
y.create.l HWIO_PMIC_ARB_OBS1_CHNL57_CMD_ADDR A:0x2dc9000
y.create.l HWIO_PMIC_ARB_OBS1_CHNL58_CMD_ADDR A:0x2dd1000
y.create.l HWIO_PMIC_ARB_OBS1_CHNL59_CMD_ADDR A:0x2dd9000
y.create.l HWIO_PMIC_ARB_OBS1_CHNL60_CMD_ADDR A:0x2de1000
y.create.l HWIO_PMIC_ARB_OBS1_CHNL61_CMD_ADDR A:0x2de9000
y.create.l HWIO_PMIC_ARB_OBS1_CHNL62_CMD_ADDR A:0x2df1000
y.create.l HWIO_PMIC_ARB_OBS1_CHNL63_CMD_ADDR A:0x2df9000
y.create.l HWIO_PMIC_ARB_OBS1_CHNL64_CMD_ADDR A:0x2e01000
y.create.l HWIO_PMIC_ARB_OBS1_CHNL65_CMD_ADDR A:0x2e09000
y.create.l HWIO_PMIC_ARB_OBS1_CHNL66_CMD_ADDR A:0x2e11000
y.create.l HWIO_PMIC_ARB_OBS1_CHNL67_CMD_ADDR A:0x2e19000
y.create.l HWIO_PMIC_ARB_OBS1_CHNL68_CMD_ADDR A:0x2e21000
y.create.l HWIO_PMIC_ARB_OBS1_CHNL69_CMD_ADDR A:0x2e29000
y.create.l HWIO_PMIC_ARB_OBS1_CHNL70_CMD_ADDR A:0x2e31000
y.create.l HWIO_PMIC_ARB_OBS1_CHNL71_CMD_ADDR A:0x2e39000
y.create.l HWIO_PMIC_ARB_OBS1_CHNL72_CMD_ADDR A:0x2e41000
y.create.l HWIO_PMIC_ARB_OBS1_CHNL73_CMD_ADDR A:0x2e49000
y.create.l HWIO_PMIC_ARB_OBS1_CHNL74_CMD_ADDR A:0x2e51000
y.create.l HWIO_PMIC_ARB_OBS1_CHNL75_CMD_ADDR A:0x2e59000
y.create.l HWIO_PMIC_ARB_OBS1_CHNL76_CMD_ADDR A:0x2e61000
y.create.l HWIO_PMIC_ARB_OBS1_CHNL77_CMD_ADDR A:0x2e69000
y.create.l HWIO_PMIC_ARB_OBS1_CHNL78_CMD_ADDR A:0x2e71000
y.create.l HWIO_PMIC_ARB_OBS1_CHNL79_CMD_ADDR A:0x2e79000
y.create.l HWIO_PMIC_ARB_OBS1_CHNL80_CMD_ADDR A:0x2e81000
y.create.l HWIO_PMIC_ARB_OBS1_CHNL81_CMD_ADDR A:0x2e89000
y.create.l HWIO_PMIC_ARB_OBS1_CHNL82_CMD_ADDR A:0x2e91000
y.create.l HWIO_PMIC_ARB_OBS1_CHNL83_CMD_ADDR A:0x2e99000
y.create.l HWIO_PMIC_ARB_OBS1_CHNL84_CMD_ADDR A:0x2ea1000
y.create.l HWIO_PMIC_ARB_OBS1_CHNL85_CMD_ADDR A:0x2ea9000
y.create.l HWIO_PMIC_ARB_OBS1_CHNL86_CMD_ADDR A:0x2eb1000
y.create.l HWIO_PMIC_ARB_OBS1_CHNL87_CMD_ADDR A:0x2eb9000
y.create.l HWIO_PMIC_ARB_OBS1_CHNL88_CMD_ADDR A:0x2ec1000
y.create.l HWIO_PMIC_ARB_OBS1_CHNL89_CMD_ADDR A:0x2ec9000
y.create.l HWIO_PMIC_ARB_OBS1_CHNL90_CMD_ADDR A:0x2ed1000
y.create.l HWIO_PMIC_ARB_OBS1_CHNL91_CMD_ADDR A:0x2ed9000
y.create.l HWIO_PMIC_ARB_OBS1_CHNL92_CMD_ADDR A:0x2ee1000
y.create.l HWIO_PMIC_ARB_OBS1_CHNL93_CMD_ADDR A:0x2ee9000
y.create.l HWIO_PMIC_ARB_OBS1_CHNL94_CMD_ADDR A:0x2ef1000
y.create.l HWIO_PMIC_ARB_OBS1_CHNL95_CMD_ADDR A:0x2ef9000
y.create.l HWIO_PMIC_ARB_OBS1_CHNL96_CMD_ADDR A:0x2f01000
y.create.l HWIO_PMIC_ARB_OBS1_CHNL97_CMD_ADDR A:0x2f09000
y.create.l HWIO_PMIC_ARB_OBS1_CHNL98_CMD_ADDR A:0x2f11000
y.create.l HWIO_PMIC_ARB_OBS1_CHNL99_CMD_ADDR A:0x2f19000
y.create.l HWIO_PMIC_ARB_OBS1_CHNL100_CMD_ADDR A:0x2f21000
y.create.l HWIO_PMIC_ARB_OBS1_CHNL101_CMD_ADDR A:0x2f29000
y.create.l HWIO_PMIC_ARB_OBS1_CHNL102_CMD_ADDR A:0x2f31000
y.create.l HWIO_PMIC_ARB_OBS1_CHNL103_CMD_ADDR A:0x2f39000
y.create.l HWIO_PMIC_ARB_OBS1_CHNL104_CMD_ADDR A:0x2f41000
y.create.l HWIO_PMIC_ARB_OBS1_CHNL105_CMD_ADDR A:0x2f49000
y.create.l HWIO_PMIC_ARB_OBS1_CHNL106_CMD_ADDR A:0x2f51000
y.create.l HWIO_PMIC_ARB_OBS1_CHNL107_CMD_ADDR A:0x2f59000
y.create.l HWIO_PMIC_ARB_OBS1_CHNL108_CMD_ADDR A:0x2f61000
y.create.l HWIO_PMIC_ARB_OBS1_CHNL109_CMD_ADDR A:0x2f69000
y.create.l HWIO_PMIC_ARB_OBS1_CHNL110_CMD_ADDR A:0x2f71000
y.create.l HWIO_PMIC_ARB_OBS1_CHNL111_CMD_ADDR A:0x2f79000
y.create.l HWIO_PMIC_ARB_OBS1_CHNL112_CMD_ADDR A:0x2f81000
y.create.l HWIO_PMIC_ARB_OBS1_CHNL113_CMD_ADDR A:0x2f89000
y.create.l HWIO_PMIC_ARB_OBS1_CHNL114_CMD_ADDR A:0x2f91000
y.create.l HWIO_PMIC_ARB_OBS1_CHNL115_CMD_ADDR A:0x2f99000
y.create.l HWIO_PMIC_ARB_OBS1_CHNL116_CMD_ADDR A:0x2fa1000
y.create.l HWIO_PMIC_ARB_OBS1_CHNL117_CMD_ADDR A:0x2fa9000
y.create.l HWIO_PMIC_ARB_OBS1_CHNL118_CMD_ADDR A:0x2fb1000
y.create.l HWIO_PMIC_ARB_OBS1_CHNL119_CMD_ADDR A:0x2fb9000
y.create.l HWIO_PMIC_ARB_OBS1_CHNL120_CMD_ADDR A:0x2fc1000
y.create.l HWIO_PMIC_ARB_OBS1_CHNL121_CMD_ADDR A:0x2fc9000
y.create.l HWIO_PMIC_ARB_OBS1_CHNL122_CMD_ADDR A:0x2fd1000
y.create.l HWIO_PMIC_ARB_OBS1_CHNL123_CMD_ADDR A:0x2fd9000
y.create.l HWIO_PMIC_ARB_OBS1_CHNL124_CMD_ADDR A:0x2fe1000
y.create.l HWIO_PMIC_ARB_OBS1_CHNL125_CMD_ADDR A:0x2fe9000
y.create.l HWIO_PMIC_ARB_OBS1_CHNL126_CMD_ADDR A:0x2ff1000
y.create.l HWIO_PMIC_ARB_OBS1_CHNL127_CMD_ADDR A:0x2ff9000
y.create.l HWIO_PMIC_ARB_OBS1_CHNL128_CMD_ADDR A:0x3001000
y.create.l HWIO_PMIC_ARB_OBS1_CHNL129_CMD_ADDR A:0x3009000
y.create.l HWIO_PMIC_ARB_OBS1_CHNL130_CMD_ADDR A:0x3011000
y.create.l HWIO_PMIC_ARB_OBS1_CHNL131_CMD_ADDR A:0x3019000
y.create.l HWIO_PMIC_ARB_OBS1_CHNL132_CMD_ADDR A:0x3021000
y.create.l HWIO_PMIC_ARB_OBS1_CHNL133_CMD_ADDR A:0x3029000
y.create.l HWIO_PMIC_ARB_OBS1_CHNL134_CMD_ADDR A:0x3031000
y.create.l HWIO_PMIC_ARB_OBS1_CHNL135_CMD_ADDR A:0x3039000
y.create.l HWIO_PMIC_ARB_OBS1_CHNL136_CMD_ADDR A:0x3041000
y.create.l HWIO_PMIC_ARB_OBS1_CHNL137_CMD_ADDR A:0x3049000
y.create.l HWIO_PMIC_ARB_OBS1_CHNL138_CMD_ADDR A:0x3051000
y.create.l HWIO_PMIC_ARB_OBS1_CHNL139_CMD_ADDR A:0x3059000
y.create.l HWIO_PMIC_ARB_OBS1_CHNL140_CMD_ADDR A:0x3061000
y.create.l HWIO_PMIC_ARB_OBS1_CHNL141_CMD_ADDR A:0x3069000
y.create.l HWIO_PMIC_ARB_OBS1_CHNL142_CMD_ADDR A:0x3071000
y.create.l HWIO_PMIC_ARB_OBS1_CHNL143_CMD_ADDR A:0x3079000
y.create.l HWIO_PMIC_ARB_OBS1_CHNL144_CMD_ADDR A:0x3081000
y.create.l HWIO_PMIC_ARB_OBS1_CHNL145_CMD_ADDR A:0x3089000
y.create.l HWIO_PMIC_ARB_OBS1_CHNL146_CMD_ADDR A:0x3091000
y.create.l HWIO_PMIC_ARB_OBS1_CHNL147_CMD_ADDR A:0x3099000
y.create.l HWIO_PMIC_ARB_OBS1_CHNL148_CMD_ADDR A:0x30a1000
y.create.l HWIO_PMIC_ARB_OBS1_CHNL149_CMD_ADDR A:0x30a9000
y.create.l HWIO_PMIC_ARB_OBS1_CHNL150_CMD_ADDR A:0x30b1000
y.create.l HWIO_PMIC_ARB_OBS1_CHNL151_CMD_ADDR A:0x30b9000
y.create.l HWIO_PMIC_ARB_OBS1_CHNL152_CMD_ADDR A:0x30c1000
y.create.l HWIO_PMIC_ARB_OBS1_CHNL153_CMD_ADDR A:0x30c9000
y.create.l HWIO_PMIC_ARB_OBS1_CHNL154_CMD_ADDR A:0x30d1000
y.create.l HWIO_PMIC_ARB_OBS1_CHNL155_CMD_ADDR A:0x30d9000
y.create.l HWIO_PMIC_ARB_OBS1_CHNL156_CMD_ADDR A:0x30e1000
y.create.l HWIO_PMIC_ARB_OBS1_CHNL157_CMD_ADDR A:0x30e9000
y.create.l HWIO_PMIC_ARB_OBS1_CHNL158_CMD_ADDR A:0x30f1000
y.create.l HWIO_PMIC_ARB_OBS1_CHNL159_CMD_ADDR A:0x30f9000
y.create.l HWIO_PMIC_ARB_OBS1_CHNL160_CMD_ADDR A:0x3101000
y.create.l HWIO_PMIC_ARB_OBS1_CHNL161_CMD_ADDR A:0x3109000
y.create.l HWIO_PMIC_ARB_OBS1_CHNL162_CMD_ADDR A:0x3111000
y.create.l HWIO_PMIC_ARB_OBS1_CHNL163_CMD_ADDR A:0x3119000
y.create.l HWIO_PMIC_ARB_OBS1_CHNL164_CMD_ADDR A:0x3121000
y.create.l HWIO_PMIC_ARB_OBS1_CHNL165_CMD_ADDR A:0x3129000
y.create.l HWIO_PMIC_ARB_OBS1_CHNL166_CMD_ADDR A:0x3131000
y.create.l HWIO_PMIC_ARB_OBS1_CHNL167_CMD_ADDR A:0x3139000
y.create.l HWIO_PMIC_ARB_OBS1_CHNL168_CMD_ADDR A:0x3141000
y.create.l HWIO_PMIC_ARB_OBS1_CHNL169_CMD_ADDR A:0x3149000
y.create.l HWIO_PMIC_ARB_OBS1_CHNL170_CMD_ADDR A:0x3151000
y.create.l HWIO_PMIC_ARB_OBS1_CHNL171_CMD_ADDR A:0x3159000
y.create.l HWIO_PMIC_ARB_OBS1_CHNL172_CMD_ADDR A:0x3161000
y.create.l HWIO_PMIC_ARB_OBS1_CHNL173_CMD_ADDR A:0x3169000
y.create.l HWIO_PMIC_ARB_OBS1_CHNL174_CMD_ADDR A:0x3171000
y.create.l HWIO_PMIC_ARB_OBS1_CHNL175_CMD_ADDR A:0x3179000
y.create.l HWIO_PMIC_ARB_OBS1_CHNL176_CMD_ADDR A:0x3181000
y.create.l HWIO_PMIC_ARB_OBS1_CHNL177_CMD_ADDR A:0x3189000
y.create.l HWIO_PMIC_ARB_OBS1_CHNL178_CMD_ADDR A:0x3191000
y.create.l HWIO_PMIC_ARB_OBS1_CHNL179_CMD_ADDR A:0x3199000
y.create.l HWIO_PMIC_ARB_OBS1_CHNL180_CMD_ADDR A:0x31a1000
y.create.l HWIO_PMIC_ARB_OBS1_CHNL181_CMD_ADDR A:0x31a9000
y.create.l HWIO_PMIC_ARB_OBS1_CHNL182_CMD_ADDR A:0x31b1000
y.create.l HWIO_PMIC_ARB_OBS1_CHNL183_CMD_ADDR A:0x31b9000
y.create.l HWIO_PMIC_ARB_OBS1_CHNL184_CMD_ADDR A:0x31c1000
y.create.l HWIO_PMIC_ARB_OBS1_CHNL185_CMD_ADDR A:0x31c9000
y.create.l HWIO_PMIC_ARB_OBS1_CHNL186_CMD_ADDR A:0x31d1000
y.create.l HWIO_PMIC_ARB_OBS1_CHNL187_CMD_ADDR A:0x31d9000
y.create.l HWIO_PMIC_ARB_OBS1_CHNL188_CMD_ADDR A:0x31e1000
y.create.l HWIO_PMIC_ARB_OBS1_CHNL189_CMD_ADDR A:0x31e9000
y.create.l HWIO_PMIC_ARB_OBS1_CHNL190_CMD_ADDR A:0x31f1000
y.create.l HWIO_PMIC_ARB_OBS1_CHNL191_CMD_ADDR A:0x31f9000
y.create.l HWIO_PMIC_ARB_OBS1_CHNL192_CMD_ADDR A:0x3201000
y.create.l HWIO_PMIC_ARB_OBS1_CHNL193_CMD_ADDR A:0x3209000
y.create.l HWIO_PMIC_ARB_OBS1_CHNL194_CMD_ADDR A:0x3211000
y.create.l HWIO_PMIC_ARB_OBS1_CHNL195_CMD_ADDR A:0x3219000
y.create.l HWIO_PMIC_ARB_OBS1_CHNL196_CMD_ADDR A:0x3221000
y.create.l HWIO_PMIC_ARB_OBS1_CHNL197_CMD_ADDR A:0x3229000
y.create.l HWIO_PMIC_ARB_OBS1_CHNL198_CMD_ADDR A:0x3231000
y.create.l HWIO_PMIC_ARB_OBS1_CHNL199_CMD_ADDR A:0x3239000
y.create.l HWIO_PMIC_ARB_OBS1_CHNL200_CMD_ADDR A:0x3241000
y.create.l HWIO_PMIC_ARB_OBS1_CHNL201_CMD_ADDR A:0x3249000
y.create.l HWIO_PMIC_ARB_OBS1_CHNL202_CMD_ADDR A:0x3251000
y.create.l HWIO_PMIC_ARB_OBS1_CHNL203_CMD_ADDR A:0x3259000
y.create.l HWIO_PMIC_ARB_OBS1_CHNL204_CMD_ADDR A:0x3261000
y.create.l HWIO_PMIC_ARB_OBS1_CHNL205_CMD_ADDR A:0x3269000
y.create.l HWIO_PMIC_ARB_OBS1_CHNL206_CMD_ADDR A:0x3271000
y.create.l HWIO_PMIC_ARB_OBS1_CHNL207_CMD_ADDR A:0x3279000
y.create.l HWIO_PMIC_ARB_OBS1_CHNL208_CMD_ADDR A:0x3281000
y.create.l HWIO_PMIC_ARB_OBS1_CHNL209_CMD_ADDR A:0x3289000
y.create.l HWIO_PMIC_ARB_OBS1_CHNL210_CMD_ADDR A:0x3291000
y.create.l HWIO_PMIC_ARB_OBS1_CHNL211_CMD_ADDR A:0x3299000
y.create.l HWIO_PMIC_ARB_OBS1_CHNL212_CMD_ADDR A:0x32a1000
y.create.l HWIO_PMIC_ARB_OBS1_CHNL213_CMD_ADDR A:0x32a9000
y.create.l HWIO_PMIC_ARB_OBS1_CHNL214_CMD_ADDR A:0x32b1000
y.create.l HWIO_PMIC_ARB_OBS1_CHNL215_CMD_ADDR A:0x32b9000
y.create.l HWIO_PMIC_ARB_OBS1_CHNL216_CMD_ADDR A:0x32c1000
y.create.l HWIO_PMIC_ARB_OBS1_CHNL217_CMD_ADDR A:0x32c9000
y.create.l HWIO_PMIC_ARB_OBS1_CHNL218_CMD_ADDR A:0x32d1000
y.create.l HWIO_PMIC_ARB_OBS1_CHNL219_CMD_ADDR A:0x32d9000
y.create.l HWIO_PMIC_ARB_OBS1_CHNL220_CMD_ADDR A:0x32e1000
y.create.l HWIO_PMIC_ARB_OBS1_CHNL221_CMD_ADDR A:0x32e9000
y.create.l HWIO_PMIC_ARB_OBS1_CHNL222_CMD_ADDR A:0x32f1000
y.create.l HWIO_PMIC_ARB_OBS1_CHNL223_CMD_ADDR A:0x32f9000
y.create.l HWIO_PMIC_ARB_OBS1_CHNL224_CMD_ADDR A:0x3301000
y.create.l HWIO_PMIC_ARB_OBS1_CHNL225_CMD_ADDR A:0x3309000
y.create.l HWIO_PMIC_ARB_OBS1_CHNL226_CMD_ADDR A:0x3311000
y.create.l HWIO_PMIC_ARB_OBS1_CHNL227_CMD_ADDR A:0x3319000
y.create.l HWIO_PMIC_ARB_OBS1_CHNL228_CMD_ADDR A:0x3321000
y.create.l HWIO_PMIC_ARB_OBS1_CHNL229_CMD_ADDR A:0x3329000
y.create.l HWIO_PMIC_ARB_OBS1_CHNL230_CMD_ADDR A:0x3331000
y.create.l HWIO_PMIC_ARB_OBS1_CHNL231_CMD_ADDR A:0x3339000
y.create.l HWIO_PMIC_ARB_OBS1_CHNL232_CMD_ADDR A:0x3341000
y.create.l HWIO_PMIC_ARB_OBS1_CHNL233_CMD_ADDR A:0x3349000
y.create.l HWIO_PMIC_ARB_OBS1_CHNL234_CMD_ADDR A:0x3351000
y.create.l HWIO_PMIC_ARB_OBS1_CHNL235_CMD_ADDR A:0x3359000
y.create.l HWIO_PMIC_ARB_OBS1_CHNL236_CMD_ADDR A:0x3361000
y.create.l HWIO_PMIC_ARB_OBS1_CHNL237_CMD_ADDR A:0x3369000
y.create.l HWIO_PMIC_ARB_OBS1_CHNL238_CMD_ADDR A:0x3371000
y.create.l HWIO_PMIC_ARB_OBS1_CHNL239_CMD_ADDR A:0x3379000
y.create.l HWIO_PMIC_ARB_OBS1_CHNL240_CMD_ADDR A:0x3381000
y.create.l HWIO_PMIC_ARB_OBS1_CHNL241_CMD_ADDR A:0x3389000
y.create.l HWIO_PMIC_ARB_OBS1_CHNL242_CMD_ADDR A:0x3391000
y.create.l HWIO_PMIC_ARB_OBS1_CHNL243_CMD_ADDR A:0x3399000
y.create.l HWIO_PMIC_ARB_OBS1_CHNL244_CMD_ADDR A:0x33a1000
y.create.l HWIO_PMIC_ARB_OBS1_CHNL245_CMD_ADDR A:0x33a9000
y.create.l HWIO_PMIC_ARB_OBS1_CHNL246_CMD_ADDR A:0x33b1000
y.create.l HWIO_PMIC_ARB_OBS1_CHNL247_CMD_ADDR A:0x33b9000
y.create.l HWIO_PMIC_ARB_OBS1_CHNL248_CMD_ADDR A:0x33c1000
y.create.l HWIO_PMIC_ARB_OBS1_CHNL249_CMD_ADDR A:0x33c9000
y.create.l HWIO_PMIC_ARB_OBS1_CHNL250_CMD_ADDR A:0x33d1000
y.create.l HWIO_PMIC_ARB_OBS1_CHNL251_CMD_ADDR A:0x33d9000
y.create.l HWIO_PMIC_ARB_OBS1_CHNL252_CMD_ADDR A:0x33e1000
y.create.l HWIO_PMIC_ARB_OBS1_CHNL253_CMD_ADDR A:0x33e9000
y.create.l HWIO_PMIC_ARB_OBS1_CHNL254_CMD_ADDR A:0x33f1000
y.create.l HWIO_PMIC_ARB_OBS1_CHNL255_CMD_ADDR A:0x33f9000
y.create.l HWIO_PMIC_ARB_OBS2_CHNL0_CMD_ADDR A:0x2c02000
y.create.l HWIO_PMIC_ARB_OBS2_CHNL1_CMD_ADDR A:0x2c0a000
y.create.l HWIO_PMIC_ARB_OBS2_CHNL2_CMD_ADDR A:0x2c12000
y.create.l HWIO_PMIC_ARB_OBS2_CHNL3_CMD_ADDR A:0x2c1a000
y.create.l HWIO_PMIC_ARB_OBS2_CHNL4_CMD_ADDR A:0x2c22000
y.create.l HWIO_PMIC_ARB_OBS2_CHNL5_CMD_ADDR A:0x2c2a000
y.create.l HWIO_PMIC_ARB_OBS2_CHNL6_CMD_ADDR A:0x2c32000
y.create.l HWIO_PMIC_ARB_OBS2_CHNL7_CMD_ADDR A:0x2c3a000
y.create.l HWIO_PMIC_ARB_OBS2_CHNL8_CMD_ADDR A:0x2c42000
y.create.l HWIO_PMIC_ARB_OBS2_CHNL9_CMD_ADDR A:0x2c4a000
y.create.l HWIO_PMIC_ARB_OBS2_CHNL10_CMD_ADDR A:0x2c52000
y.create.l HWIO_PMIC_ARB_OBS2_CHNL11_CMD_ADDR A:0x2c5a000
y.create.l HWIO_PMIC_ARB_OBS2_CHNL12_CMD_ADDR A:0x2c62000
y.create.l HWIO_PMIC_ARB_OBS2_CHNL13_CMD_ADDR A:0x2c6a000
y.create.l HWIO_PMIC_ARB_OBS2_CHNL14_CMD_ADDR A:0x2c72000
y.create.l HWIO_PMIC_ARB_OBS2_CHNL15_CMD_ADDR A:0x2c7a000
y.create.l HWIO_PMIC_ARB_OBS2_CHNL16_CMD_ADDR A:0x2c82000
y.create.l HWIO_PMIC_ARB_OBS2_CHNL17_CMD_ADDR A:0x2c8a000
y.create.l HWIO_PMIC_ARB_OBS2_CHNL18_CMD_ADDR A:0x2c92000
y.create.l HWIO_PMIC_ARB_OBS2_CHNL19_CMD_ADDR A:0x2c9a000
y.create.l HWIO_PMIC_ARB_OBS2_CHNL20_CMD_ADDR A:0x2ca2000
y.create.l HWIO_PMIC_ARB_OBS2_CHNL21_CMD_ADDR A:0x2caa000
y.create.l HWIO_PMIC_ARB_OBS2_CHNL22_CMD_ADDR A:0x2cb2000
y.create.l HWIO_PMIC_ARB_OBS2_CHNL23_CMD_ADDR A:0x2cba000
y.create.l HWIO_PMIC_ARB_OBS2_CHNL24_CMD_ADDR A:0x2cc2000
y.create.l HWIO_PMIC_ARB_OBS2_CHNL25_CMD_ADDR A:0x2cca000
y.create.l HWIO_PMIC_ARB_OBS2_CHNL26_CMD_ADDR A:0x2cd2000
y.create.l HWIO_PMIC_ARB_OBS2_CHNL27_CMD_ADDR A:0x2cda000
y.create.l HWIO_PMIC_ARB_OBS2_CHNL28_CMD_ADDR A:0x2ce2000
y.create.l HWIO_PMIC_ARB_OBS2_CHNL29_CMD_ADDR A:0x2cea000
y.create.l HWIO_PMIC_ARB_OBS2_CHNL30_CMD_ADDR A:0x2cf2000
y.create.l HWIO_PMIC_ARB_OBS2_CHNL31_CMD_ADDR A:0x2cfa000
y.create.l HWIO_PMIC_ARB_OBS2_CHNL32_CMD_ADDR A:0x2d02000
y.create.l HWIO_PMIC_ARB_OBS2_CHNL33_CMD_ADDR A:0x2d0a000
y.create.l HWIO_PMIC_ARB_OBS2_CHNL34_CMD_ADDR A:0x2d12000
y.create.l HWIO_PMIC_ARB_OBS2_CHNL35_CMD_ADDR A:0x2d1a000
y.create.l HWIO_PMIC_ARB_OBS2_CHNL36_CMD_ADDR A:0x2d22000
y.create.l HWIO_PMIC_ARB_OBS2_CHNL37_CMD_ADDR A:0x2d2a000
y.create.l HWIO_PMIC_ARB_OBS2_CHNL38_CMD_ADDR A:0x2d32000
y.create.l HWIO_PMIC_ARB_OBS2_CHNL39_CMD_ADDR A:0x2d3a000
y.create.l HWIO_PMIC_ARB_OBS2_CHNL40_CMD_ADDR A:0x2d42000
y.create.l HWIO_PMIC_ARB_OBS2_CHNL41_CMD_ADDR A:0x2d4a000
y.create.l HWIO_PMIC_ARB_OBS2_CHNL42_CMD_ADDR A:0x2d52000
y.create.l HWIO_PMIC_ARB_OBS2_CHNL43_CMD_ADDR A:0x2d5a000
y.create.l HWIO_PMIC_ARB_OBS2_CHNL44_CMD_ADDR A:0x2d62000
y.create.l HWIO_PMIC_ARB_OBS2_CHNL45_CMD_ADDR A:0x2d6a000
y.create.l HWIO_PMIC_ARB_OBS2_CHNL46_CMD_ADDR A:0x2d72000
y.create.l HWIO_PMIC_ARB_OBS2_CHNL47_CMD_ADDR A:0x2d7a000
y.create.l HWIO_PMIC_ARB_OBS2_CHNL48_CMD_ADDR A:0x2d82000
y.create.l HWIO_PMIC_ARB_OBS2_CHNL49_CMD_ADDR A:0x2d8a000
y.create.l HWIO_PMIC_ARB_OBS2_CHNL50_CMD_ADDR A:0x2d92000
y.create.l HWIO_PMIC_ARB_OBS2_CHNL51_CMD_ADDR A:0x2d9a000
y.create.l HWIO_PMIC_ARB_OBS2_CHNL52_CMD_ADDR A:0x2da2000
y.create.l HWIO_PMIC_ARB_OBS2_CHNL53_CMD_ADDR A:0x2daa000
y.create.l HWIO_PMIC_ARB_OBS2_CHNL54_CMD_ADDR A:0x2db2000
y.create.l HWIO_PMIC_ARB_OBS2_CHNL55_CMD_ADDR A:0x2dba000
y.create.l HWIO_PMIC_ARB_OBS2_CHNL56_CMD_ADDR A:0x2dc2000
y.create.l HWIO_PMIC_ARB_OBS2_CHNL57_CMD_ADDR A:0x2dca000
y.create.l HWIO_PMIC_ARB_OBS2_CHNL58_CMD_ADDR A:0x2dd2000
y.create.l HWIO_PMIC_ARB_OBS2_CHNL59_CMD_ADDR A:0x2dda000
y.create.l HWIO_PMIC_ARB_OBS2_CHNL60_CMD_ADDR A:0x2de2000
y.create.l HWIO_PMIC_ARB_OBS2_CHNL61_CMD_ADDR A:0x2dea000
y.create.l HWIO_PMIC_ARB_OBS2_CHNL62_CMD_ADDR A:0x2df2000
y.create.l HWIO_PMIC_ARB_OBS2_CHNL63_CMD_ADDR A:0x2dfa000
y.create.l HWIO_PMIC_ARB_OBS2_CHNL64_CMD_ADDR A:0x2e02000
y.create.l HWIO_PMIC_ARB_OBS2_CHNL65_CMD_ADDR A:0x2e0a000
y.create.l HWIO_PMIC_ARB_OBS2_CHNL66_CMD_ADDR A:0x2e12000
y.create.l HWIO_PMIC_ARB_OBS2_CHNL67_CMD_ADDR A:0x2e1a000
y.create.l HWIO_PMIC_ARB_OBS2_CHNL68_CMD_ADDR A:0x2e22000
y.create.l HWIO_PMIC_ARB_OBS2_CHNL69_CMD_ADDR A:0x2e2a000
y.create.l HWIO_PMIC_ARB_OBS2_CHNL70_CMD_ADDR A:0x2e32000
y.create.l HWIO_PMIC_ARB_OBS2_CHNL71_CMD_ADDR A:0x2e3a000
y.create.l HWIO_PMIC_ARB_OBS2_CHNL72_CMD_ADDR A:0x2e42000
y.create.l HWIO_PMIC_ARB_OBS2_CHNL73_CMD_ADDR A:0x2e4a000
y.create.l HWIO_PMIC_ARB_OBS2_CHNL74_CMD_ADDR A:0x2e52000
y.create.l HWIO_PMIC_ARB_OBS2_CHNL75_CMD_ADDR A:0x2e5a000
y.create.l HWIO_PMIC_ARB_OBS2_CHNL76_CMD_ADDR A:0x2e62000
y.create.l HWIO_PMIC_ARB_OBS2_CHNL77_CMD_ADDR A:0x2e6a000
y.create.l HWIO_PMIC_ARB_OBS2_CHNL78_CMD_ADDR A:0x2e72000
y.create.l HWIO_PMIC_ARB_OBS2_CHNL79_CMD_ADDR A:0x2e7a000
y.create.l HWIO_PMIC_ARB_OBS2_CHNL80_CMD_ADDR A:0x2e82000
y.create.l HWIO_PMIC_ARB_OBS2_CHNL81_CMD_ADDR A:0x2e8a000
y.create.l HWIO_PMIC_ARB_OBS2_CHNL82_CMD_ADDR A:0x2e92000
y.create.l HWIO_PMIC_ARB_OBS2_CHNL83_CMD_ADDR A:0x2e9a000
y.create.l HWIO_PMIC_ARB_OBS2_CHNL84_CMD_ADDR A:0x2ea2000
y.create.l HWIO_PMIC_ARB_OBS2_CHNL85_CMD_ADDR A:0x2eaa000
y.create.l HWIO_PMIC_ARB_OBS2_CHNL86_CMD_ADDR A:0x2eb2000
y.create.l HWIO_PMIC_ARB_OBS2_CHNL87_CMD_ADDR A:0x2eba000
y.create.l HWIO_PMIC_ARB_OBS2_CHNL88_CMD_ADDR A:0x2ec2000
y.create.l HWIO_PMIC_ARB_OBS2_CHNL89_CMD_ADDR A:0x2eca000
y.create.l HWIO_PMIC_ARB_OBS2_CHNL90_CMD_ADDR A:0x2ed2000
y.create.l HWIO_PMIC_ARB_OBS2_CHNL91_CMD_ADDR A:0x2eda000
y.create.l HWIO_PMIC_ARB_OBS2_CHNL92_CMD_ADDR A:0x2ee2000
y.create.l HWIO_PMIC_ARB_OBS2_CHNL93_CMD_ADDR A:0x2eea000
y.create.l HWIO_PMIC_ARB_OBS2_CHNL94_CMD_ADDR A:0x2ef2000
y.create.l HWIO_PMIC_ARB_OBS2_CHNL95_CMD_ADDR A:0x2efa000
y.create.l HWIO_PMIC_ARB_OBS2_CHNL96_CMD_ADDR A:0x2f02000
y.create.l HWIO_PMIC_ARB_OBS2_CHNL97_CMD_ADDR A:0x2f0a000
y.create.l HWIO_PMIC_ARB_OBS2_CHNL98_CMD_ADDR A:0x2f12000
y.create.l HWIO_PMIC_ARB_OBS2_CHNL99_CMD_ADDR A:0x2f1a000
y.create.l HWIO_PMIC_ARB_OBS2_CHNL100_CMD_ADDR A:0x2f22000
y.create.l HWIO_PMIC_ARB_OBS2_CHNL101_CMD_ADDR A:0x2f2a000
y.create.l HWIO_PMIC_ARB_OBS2_CHNL102_CMD_ADDR A:0x2f32000
y.create.l HWIO_PMIC_ARB_OBS2_CHNL103_CMD_ADDR A:0x2f3a000
y.create.l HWIO_PMIC_ARB_OBS2_CHNL104_CMD_ADDR A:0x2f42000
y.create.l HWIO_PMIC_ARB_OBS2_CHNL105_CMD_ADDR A:0x2f4a000
y.create.l HWIO_PMIC_ARB_OBS2_CHNL106_CMD_ADDR A:0x2f52000
y.create.l HWIO_PMIC_ARB_OBS2_CHNL107_CMD_ADDR A:0x2f5a000
y.create.l HWIO_PMIC_ARB_OBS2_CHNL108_CMD_ADDR A:0x2f62000
y.create.l HWIO_PMIC_ARB_OBS2_CHNL109_CMD_ADDR A:0x2f6a000
y.create.l HWIO_PMIC_ARB_OBS2_CHNL110_CMD_ADDR A:0x2f72000
y.create.l HWIO_PMIC_ARB_OBS2_CHNL111_CMD_ADDR A:0x2f7a000
y.create.l HWIO_PMIC_ARB_OBS2_CHNL112_CMD_ADDR A:0x2f82000
y.create.l HWIO_PMIC_ARB_OBS2_CHNL113_CMD_ADDR A:0x2f8a000
y.create.l HWIO_PMIC_ARB_OBS2_CHNL114_CMD_ADDR A:0x2f92000
y.create.l HWIO_PMIC_ARB_OBS2_CHNL115_CMD_ADDR A:0x2f9a000
y.create.l HWIO_PMIC_ARB_OBS2_CHNL116_CMD_ADDR A:0x2fa2000
y.create.l HWIO_PMIC_ARB_OBS2_CHNL117_CMD_ADDR A:0x2faa000
y.create.l HWIO_PMIC_ARB_OBS2_CHNL118_CMD_ADDR A:0x2fb2000
y.create.l HWIO_PMIC_ARB_OBS2_CHNL119_CMD_ADDR A:0x2fba000
y.create.l HWIO_PMIC_ARB_OBS2_CHNL120_CMD_ADDR A:0x2fc2000
y.create.l HWIO_PMIC_ARB_OBS2_CHNL121_CMD_ADDR A:0x2fca000
y.create.l HWIO_PMIC_ARB_OBS2_CHNL122_CMD_ADDR A:0x2fd2000
y.create.l HWIO_PMIC_ARB_OBS2_CHNL123_CMD_ADDR A:0x2fda000
y.create.l HWIO_PMIC_ARB_OBS2_CHNL124_CMD_ADDR A:0x2fe2000
y.create.l HWIO_PMIC_ARB_OBS2_CHNL125_CMD_ADDR A:0x2fea000
y.create.l HWIO_PMIC_ARB_OBS2_CHNL126_CMD_ADDR A:0x2ff2000
y.create.l HWIO_PMIC_ARB_OBS2_CHNL127_CMD_ADDR A:0x2ffa000
y.create.l HWIO_PMIC_ARB_OBS2_CHNL128_CMD_ADDR A:0x3002000
y.create.l HWIO_PMIC_ARB_OBS2_CHNL129_CMD_ADDR A:0x300a000
y.create.l HWIO_PMIC_ARB_OBS2_CHNL130_CMD_ADDR A:0x3012000
y.create.l HWIO_PMIC_ARB_OBS2_CHNL131_CMD_ADDR A:0x301a000
y.create.l HWIO_PMIC_ARB_OBS2_CHNL132_CMD_ADDR A:0x3022000
y.create.l HWIO_PMIC_ARB_OBS2_CHNL133_CMD_ADDR A:0x302a000
y.create.l HWIO_PMIC_ARB_OBS2_CHNL134_CMD_ADDR A:0x3032000
y.create.l HWIO_PMIC_ARB_OBS2_CHNL135_CMD_ADDR A:0x303a000
y.create.l HWIO_PMIC_ARB_OBS2_CHNL136_CMD_ADDR A:0x3042000
y.create.l HWIO_PMIC_ARB_OBS2_CHNL137_CMD_ADDR A:0x304a000
y.create.l HWIO_PMIC_ARB_OBS2_CHNL138_CMD_ADDR A:0x3052000
y.create.l HWIO_PMIC_ARB_OBS2_CHNL139_CMD_ADDR A:0x305a000
y.create.l HWIO_PMIC_ARB_OBS2_CHNL140_CMD_ADDR A:0x3062000
y.create.l HWIO_PMIC_ARB_OBS2_CHNL141_CMD_ADDR A:0x306a000
y.create.l HWIO_PMIC_ARB_OBS2_CHNL142_CMD_ADDR A:0x3072000
y.create.l HWIO_PMIC_ARB_OBS2_CHNL143_CMD_ADDR A:0x307a000
y.create.l HWIO_PMIC_ARB_OBS2_CHNL144_CMD_ADDR A:0x3082000
y.create.l HWIO_PMIC_ARB_OBS2_CHNL145_CMD_ADDR A:0x308a000
y.create.l HWIO_PMIC_ARB_OBS2_CHNL146_CMD_ADDR A:0x3092000
y.create.l HWIO_PMIC_ARB_OBS2_CHNL147_CMD_ADDR A:0x309a000
y.create.l HWIO_PMIC_ARB_OBS2_CHNL148_CMD_ADDR A:0x30a2000
y.create.l HWIO_PMIC_ARB_OBS2_CHNL149_CMD_ADDR A:0x30aa000
y.create.l HWIO_PMIC_ARB_OBS2_CHNL150_CMD_ADDR A:0x30b2000
y.create.l HWIO_PMIC_ARB_OBS2_CHNL151_CMD_ADDR A:0x30ba000
y.create.l HWIO_PMIC_ARB_OBS2_CHNL152_CMD_ADDR A:0x30c2000
y.create.l HWIO_PMIC_ARB_OBS2_CHNL153_CMD_ADDR A:0x30ca000
y.create.l HWIO_PMIC_ARB_OBS2_CHNL154_CMD_ADDR A:0x30d2000
y.create.l HWIO_PMIC_ARB_OBS2_CHNL155_CMD_ADDR A:0x30da000
y.create.l HWIO_PMIC_ARB_OBS2_CHNL156_CMD_ADDR A:0x30e2000
y.create.l HWIO_PMIC_ARB_OBS2_CHNL157_CMD_ADDR A:0x30ea000
y.create.l HWIO_PMIC_ARB_OBS2_CHNL158_CMD_ADDR A:0x30f2000
y.create.l HWIO_PMIC_ARB_OBS2_CHNL159_CMD_ADDR A:0x30fa000
y.create.l HWIO_PMIC_ARB_OBS2_CHNL160_CMD_ADDR A:0x3102000
y.create.l HWIO_PMIC_ARB_OBS2_CHNL161_CMD_ADDR A:0x310a000
y.create.l HWIO_PMIC_ARB_OBS2_CHNL162_CMD_ADDR A:0x3112000
y.create.l HWIO_PMIC_ARB_OBS2_CHNL163_CMD_ADDR A:0x311a000
y.create.l HWIO_PMIC_ARB_OBS2_CHNL164_CMD_ADDR A:0x3122000
y.create.l HWIO_PMIC_ARB_OBS2_CHNL165_CMD_ADDR A:0x312a000
y.create.l HWIO_PMIC_ARB_OBS2_CHNL166_CMD_ADDR A:0x3132000
y.create.l HWIO_PMIC_ARB_OBS2_CHNL167_CMD_ADDR A:0x313a000
y.create.l HWIO_PMIC_ARB_OBS2_CHNL168_CMD_ADDR A:0x3142000
y.create.l HWIO_PMIC_ARB_OBS2_CHNL169_CMD_ADDR A:0x314a000
y.create.l HWIO_PMIC_ARB_OBS2_CHNL170_CMD_ADDR A:0x3152000
y.create.l HWIO_PMIC_ARB_OBS2_CHNL171_CMD_ADDR A:0x315a000
y.create.l HWIO_PMIC_ARB_OBS2_CHNL172_CMD_ADDR A:0x3162000
y.create.l HWIO_PMIC_ARB_OBS2_CHNL173_CMD_ADDR A:0x316a000
y.create.l HWIO_PMIC_ARB_OBS2_CHNL174_CMD_ADDR A:0x3172000
y.create.l HWIO_PMIC_ARB_OBS2_CHNL175_CMD_ADDR A:0x317a000
y.create.l HWIO_PMIC_ARB_OBS2_CHNL176_CMD_ADDR A:0x3182000
y.create.l HWIO_PMIC_ARB_OBS2_CHNL177_CMD_ADDR A:0x318a000
y.create.l HWIO_PMIC_ARB_OBS2_CHNL178_CMD_ADDR A:0x3192000
y.create.l HWIO_PMIC_ARB_OBS2_CHNL179_CMD_ADDR A:0x319a000
y.create.l HWIO_PMIC_ARB_OBS2_CHNL180_CMD_ADDR A:0x31a2000
y.create.l HWIO_PMIC_ARB_OBS2_CHNL181_CMD_ADDR A:0x31aa000
y.create.l HWIO_PMIC_ARB_OBS2_CHNL182_CMD_ADDR A:0x31b2000
y.create.l HWIO_PMIC_ARB_OBS2_CHNL183_CMD_ADDR A:0x31ba000
y.create.l HWIO_PMIC_ARB_OBS2_CHNL184_CMD_ADDR A:0x31c2000
y.create.l HWIO_PMIC_ARB_OBS2_CHNL185_CMD_ADDR A:0x31ca000
y.create.l HWIO_PMIC_ARB_OBS2_CHNL186_CMD_ADDR A:0x31d2000
y.create.l HWIO_PMIC_ARB_OBS2_CHNL187_CMD_ADDR A:0x31da000
y.create.l HWIO_PMIC_ARB_OBS2_CHNL188_CMD_ADDR A:0x31e2000
y.create.l HWIO_PMIC_ARB_OBS2_CHNL189_CMD_ADDR A:0x31ea000
y.create.l HWIO_PMIC_ARB_OBS2_CHNL190_CMD_ADDR A:0x31f2000
y.create.l HWIO_PMIC_ARB_OBS2_CHNL191_CMD_ADDR A:0x31fa000
y.create.l HWIO_PMIC_ARB_OBS2_CHNL192_CMD_ADDR A:0x3202000
y.create.l HWIO_PMIC_ARB_OBS2_CHNL193_CMD_ADDR A:0x320a000
y.create.l HWIO_PMIC_ARB_OBS2_CHNL194_CMD_ADDR A:0x3212000
y.create.l HWIO_PMIC_ARB_OBS2_CHNL195_CMD_ADDR A:0x321a000
y.create.l HWIO_PMIC_ARB_OBS2_CHNL196_CMD_ADDR A:0x3222000
y.create.l HWIO_PMIC_ARB_OBS2_CHNL197_CMD_ADDR A:0x322a000
y.create.l HWIO_PMIC_ARB_OBS2_CHNL198_CMD_ADDR A:0x3232000
y.create.l HWIO_PMIC_ARB_OBS2_CHNL199_CMD_ADDR A:0x323a000
y.create.l HWIO_PMIC_ARB_OBS2_CHNL200_CMD_ADDR A:0x3242000
y.create.l HWIO_PMIC_ARB_OBS2_CHNL201_CMD_ADDR A:0x324a000
y.create.l HWIO_PMIC_ARB_OBS2_CHNL202_CMD_ADDR A:0x3252000
y.create.l HWIO_PMIC_ARB_OBS2_CHNL203_CMD_ADDR A:0x325a000
y.create.l HWIO_PMIC_ARB_OBS2_CHNL204_CMD_ADDR A:0x3262000
y.create.l HWIO_PMIC_ARB_OBS2_CHNL205_CMD_ADDR A:0x326a000
y.create.l HWIO_PMIC_ARB_OBS2_CHNL206_CMD_ADDR A:0x3272000
y.create.l HWIO_PMIC_ARB_OBS2_CHNL207_CMD_ADDR A:0x327a000
y.create.l HWIO_PMIC_ARB_OBS2_CHNL208_CMD_ADDR A:0x3282000
y.create.l HWIO_PMIC_ARB_OBS2_CHNL209_CMD_ADDR A:0x328a000
y.create.l HWIO_PMIC_ARB_OBS2_CHNL210_CMD_ADDR A:0x3292000
y.create.l HWIO_PMIC_ARB_OBS2_CHNL211_CMD_ADDR A:0x329a000
y.create.l HWIO_PMIC_ARB_OBS2_CHNL212_CMD_ADDR A:0x32a2000
y.create.l HWIO_PMIC_ARB_OBS2_CHNL213_CMD_ADDR A:0x32aa000
y.create.l HWIO_PMIC_ARB_OBS2_CHNL214_CMD_ADDR A:0x32b2000
y.create.l HWIO_PMIC_ARB_OBS2_CHNL215_CMD_ADDR A:0x32ba000
y.create.l HWIO_PMIC_ARB_OBS2_CHNL216_CMD_ADDR A:0x32c2000
y.create.l HWIO_PMIC_ARB_OBS2_CHNL217_CMD_ADDR A:0x32ca000
y.create.l HWIO_PMIC_ARB_OBS2_CHNL218_CMD_ADDR A:0x32d2000
y.create.l HWIO_PMIC_ARB_OBS2_CHNL219_CMD_ADDR A:0x32da000
y.create.l HWIO_PMIC_ARB_OBS2_CHNL220_CMD_ADDR A:0x32e2000
y.create.l HWIO_PMIC_ARB_OBS2_CHNL221_CMD_ADDR A:0x32ea000
y.create.l HWIO_PMIC_ARB_OBS2_CHNL222_CMD_ADDR A:0x32f2000
y.create.l HWIO_PMIC_ARB_OBS2_CHNL223_CMD_ADDR A:0x32fa000
y.create.l HWIO_PMIC_ARB_OBS2_CHNL224_CMD_ADDR A:0x3302000
y.create.l HWIO_PMIC_ARB_OBS2_CHNL225_CMD_ADDR A:0x330a000
y.create.l HWIO_PMIC_ARB_OBS2_CHNL226_CMD_ADDR A:0x3312000
y.create.l HWIO_PMIC_ARB_OBS2_CHNL227_CMD_ADDR A:0x331a000
y.create.l HWIO_PMIC_ARB_OBS2_CHNL228_CMD_ADDR A:0x3322000
y.create.l HWIO_PMIC_ARB_OBS2_CHNL229_CMD_ADDR A:0x332a000
y.create.l HWIO_PMIC_ARB_OBS2_CHNL230_CMD_ADDR A:0x3332000
y.create.l HWIO_PMIC_ARB_OBS2_CHNL231_CMD_ADDR A:0x333a000
y.create.l HWIO_PMIC_ARB_OBS2_CHNL232_CMD_ADDR A:0x3342000
y.create.l HWIO_PMIC_ARB_OBS2_CHNL233_CMD_ADDR A:0x334a000
y.create.l HWIO_PMIC_ARB_OBS2_CHNL234_CMD_ADDR A:0x3352000
y.create.l HWIO_PMIC_ARB_OBS2_CHNL235_CMD_ADDR A:0x335a000
y.create.l HWIO_PMIC_ARB_OBS2_CHNL236_CMD_ADDR A:0x3362000
y.create.l HWIO_PMIC_ARB_OBS2_CHNL237_CMD_ADDR A:0x336a000
y.create.l HWIO_PMIC_ARB_OBS2_CHNL238_CMD_ADDR A:0x3372000
y.create.l HWIO_PMIC_ARB_OBS2_CHNL239_CMD_ADDR A:0x337a000
y.create.l HWIO_PMIC_ARB_OBS2_CHNL240_CMD_ADDR A:0x3382000
y.create.l HWIO_PMIC_ARB_OBS2_CHNL241_CMD_ADDR A:0x338a000
y.create.l HWIO_PMIC_ARB_OBS2_CHNL242_CMD_ADDR A:0x3392000
y.create.l HWIO_PMIC_ARB_OBS2_CHNL243_CMD_ADDR A:0x339a000
y.create.l HWIO_PMIC_ARB_OBS2_CHNL244_CMD_ADDR A:0x33a2000
y.create.l HWIO_PMIC_ARB_OBS2_CHNL245_CMD_ADDR A:0x33aa000
y.create.l HWIO_PMIC_ARB_OBS2_CHNL246_CMD_ADDR A:0x33b2000
y.create.l HWIO_PMIC_ARB_OBS2_CHNL247_CMD_ADDR A:0x33ba000
y.create.l HWIO_PMIC_ARB_OBS2_CHNL248_CMD_ADDR A:0x33c2000
y.create.l HWIO_PMIC_ARB_OBS2_CHNL249_CMD_ADDR A:0x33ca000
y.create.l HWIO_PMIC_ARB_OBS2_CHNL250_CMD_ADDR A:0x33d2000
y.create.l HWIO_PMIC_ARB_OBS2_CHNL251_CMD_ADDR A:0x33da000
y.create.l HWIO_PMIC_ARB_OBS2_CHNL252_CMD_ADDR A:0x33e2000
y.create.l HWIO_PMIC_ARB_OBS2_CHNL253_CMD_ADDR A:0x33ea000
y.create.l HWIO_PMIC_ARB_OBS2_CHNL254_CMD_ADDR A:0x33f2000
y.create.l HWIO_PMIC_ARB_OBS2_CHNL255_CMD_ADDR A:0x33fa000
y.create.l HWIO_PMIC_ARB_OBS3_CHNL0_CMD_ADDR A:0x2c03000
y.create.l HWIO_PMIC_ARB_OBS3_CHNL1_CMD_ADDR A:0x2c0b000
y.create.l HWIO_PMIC_ARB_OBS3_CHNL2_CMD_ADDR A:0x2c13000
y.create.l HWIO_PMIC_ARB_OBS3_CHNL3_CMD_ADDR A:0x2c1b000
y.create.l HWIO_PMIC_ARB_OBS3_CHNL4_CMD_ADDR A:0x2c23000
y.create.l HWIO_PMIC_ARB_OBS3_CHNL5_CMD_ADDR A:0x2c2b000
y.create.l HWIO_PMIC_ARB_OBS3_CHNL6_CMD_ADDR A:0x2c33000
y.create.l HWIO_PMIC_ARB_OBS3_CHNL7_CMD_ADDR A:0x2c3b000
y.create.l HWIO_PMIC_ARB_OBS3_CHNL8_CMD_ADDR A:0x2c43000
y.create.l HWIO_PMIC_ARB_OBS3_CHNL9_CMD_ADDR A:0x2c4b000
y.create.l HWIO_PMIC_ARB_OBS3_CHNL10_CMD_ADDR A:0x2c53000
y.create.l HWIO_PMIC_ARB_OBS3_CHNL11_CMD_ADDR A:0x2c5b000
y.create.l HWIO_PMIC_ARB_OBS3_CHNL12_CMD_ADDR A:0x2c63000
y.create.l HWIO_PMIC_ARB_OBS3_CHNL13_CMD_ADDR A:0x2c6b000
y.create.l HWIO_PMIC_ARB_OBS3_CHNL14_CMD_ADDR A:0x2c73000
y.create.l HWIO_PMIC_ARB_OBS3_CHNL15_CMD_ADDR A:0x2c7b000
y.create.l HWIO_PMIC_ARB_OBS3_CHNL16_CMD_ADDR A:0x2c83000
y.create.l HWIO_PMIC_ARB_OBS3_CHNL17_CMD_ADDR A:0x2c8b000
y.create.l HWIO_PMIC_ARB_OBS3_CHNL18_CMD_ADDR A:0x2c93000
y.create.l HWIO_PMIC_ARB_OBS3_CHNL19_CMD_ADDR A:0x2c9b000
y.create.l HWIO_PMIC_ARB_OBS3_CHNL20_CMD_ADDR A:0x2ca3000
y.create.l HWIO_PMIC_ARB_OBS3_CHNL21_CMD_ADDR A:0x2cab000
y.create.l HWIO_PMIC_ARB_OBS3_CHNL22_CMD_ADDR A:0x2cb3000
y.create.l HWIO_PMIC_ARB_OBS3_CHNL23_CMD_ADDR A:0x2cbb000
y.create.l HWIO_PMIC_ARB_OBS3_CHNL24_CMD_ADDR A:0x2cc3000
y.create.l HWIO_PMIC_ARB_OBS3_CHNL25_CMD_ADDR A:0x2ccb000
y.create.l HWIO_PMIC_ARB_OBS3_CHNL26_CMD_ADDR A:0x2cd3000
y.create.l HWIO_PMIC_ARB_OBS3_CHNL27_CMD_ADDR A:0x2cdb000
y.create.l HWIO_PMIC_ARB_OBS3_CHNL28_CMD_ADDR A:0x2ce3000
y.create.l HWIO_PMIC_ARB_OBS3_CHNL29_CMD_ADDR A:0x2ceb000
y.create.l HWIO_PMIC_ARB_OBS3_CHNL30_CMD_ADDR A:0x2cf3000
y.create.l HWIO_PMIC_ARB_OBS3_CHNL31_CMD_ADDR A:0x2cfb000
y.create.l HWIO_PMIC_ARB_OBS3_CHNL32_CMD_ADDR A:0x2d03000
y.create.l HWIO_PMIC_ARB_OBS3_CHNL33_CMD_ADDR A:0x2d0b000
y.create.l HWIO_PMIC_ARB_OBS3_CHNL34_CMD_ADDR A:0x2d13000
y.create.l HWIO_PMIC_ARB_OBS3_CHNL35_CMD_ADDR A:0x2d1b000
y.create.l HWIO_PMIC_ARB_OBS3_CHNL36_CMD_ADDR A:0x2d23000
y.create.l HWIO_PMIC_ARB_OBS3_CHNL37_CMD_ADDR A:0x2d2b000
y.create.l HWIO_PMIC_ARB_OBS3_CHNL38_CMD_ADDR A:0x2d33000
y.create.l HWIO_PMIC_ARB_OBS3_CHNL39_CMD_ADDR A:0x2d3b000
y.create.l HWIO_PMIC_ARB_OBS3_CHNL40_CMD_ADDR A:0x2d43000
y.create.l HWIO_PMIC_ARB_OBS3_CHNL41_CMD_ADDR A:0x2d4b000
y.create.l HWIO_PMIC_ARB_OBS3_CHNL42_CMD_ADDR A:0x2d53000
y.create.l HWIO_PMIC_ARB_OBS3_CHNL43_CMD_ADDR A:0x2d5b000
y.create.l HWIO_PMIC_ARB_OBS3_CHNL44_CMD_ADDR A:0x2d63000
y.create.l HWIO_PMIC_ARB_OBS3_CHNL45_CMD_ADDR A:0x2d6b000
y.create.l HWIO_PMIC_ARB_OBS3_CHNL46_CMD_ADDR A:0x2d73000
y.create.l HWIO_PMIC_ARB_OBS3_CHNL47_CMD_ADDR A:0x2d7b000
y.create.l HWIO_PMIC_ARB_OBS3_CHNL48_CMD_ADDR A:0x2d83000
y.create.l HWIO_PMIC_ARB_OBS3_CHNL49_CMD_ADDR A:0x2d8b000
y.create.l HWIO_PMIC_ARB_OBS3_CHNL50_CMD_ADDR A:0x2d93000
y.create.l HWIO_PMIC_ARB_OBS3_CHNL51_CMD_ADDR A:0x2d9b000
y.create.l HWIO_PMIC_ARB_OBS3_CHNL52_CMD_ADDR A:0x2da3000
y.create.l HWIO_PMIC_ARB_OBS3_CHNL53_CMD_ADDR A:0x2dab000
y.create.l HWIO_PMIC_ARB_OBS3_CHNL54_CMD_ADDR A:0x2db3000
y.create.l HWIO_PMIC_ARB_OBS3_CHNL55_CMD_ADDR A:0x2dbb000
y.create.l HWIO_PMIC_ARB_OBS3_CHNL56_CMD_ADDR A:0x2dc3000
y.create.l HWIO_PMIC_ARB_OBS3_CHNL57_CMD_ADDR A:0x2dcb000
y.create.l HWIO_PMIC_ARB_OBS3_CHNL58_CMD_ADDR A:0x2dd3000
y.create.l HWIO_PMIC_ARB_OBS3_CHNL59_CMD_ADDR A:0x2ddb000
y.create.l HWIO_PMIC_ARB_OBS3_CHNL60_CMD_ADDR A:0x2de3000
y.create.l HWIO_PMIC_ARB_OBS3_CHNL61_CMD_ADDR A:0x2deb000
y.create.l HWIO_PMIC_ARB_OBS3_CHNL62_CMD_ADDR A:0x2df3000
y.create.l HWIO_PMIC_ARB_OBS3_CHNL63_CMD_ADDR A:0x2dfb000
y.create.l HWIO_PMIC_ARB_OBS3_CHNL64_CMD_ADDR A:0x2e03000
y.create.l HWIO_PMIC_ARB_OBS3_CHNL65_CMD_ADDR A:0x2e0b000
y.create.l HWIO_PMIC_ARB_OBS3_CHNL66_CMD_ADDR A:0x2e13000
y.create.l HWIO_PMIC_ARB_OBS3_CHNL67_CMD_ADDR A:0x2e1b000
y.create.l HWIO_PMIC_ARB_OBS3_CHNL68_CMD_ADDR A:0x2e23000
y.create.l HWIO_PMIC_ARB_OBS3_CHNL69_CMD_ADDR A:0x2e2b000
y.create.l HWIO_PMIC_ARB_OBS3_CHNL70_CMD_ADDR A:0x2e33000
y.create.l HWIO_PMIC_ARB_OBS3_CHNL71_CMD_ADDR A:0x2e3b000
y.create.l HWIO_PMIC_ARB_OBS3_CHNL72_CMD_ADDR A:0x2e43000
y.create.l HWIO_PMIC_ARB_OBS3_CHNL73_CMD_ADDR A:0x2e4b000
y.create.l HWIO_PMIC_ARB_OBS3_CHNL74_CMD_ADDR A:0x2e53000
y.create.l HWIO_PMIC_ARB_OBS3_CHNL75_CMD_ADDR A:0x2e5b000
y.create.l HWIO_PMIC_ARB_OBS3_CHNL76_CMD_ADDR A:0x2e63000
y.create.l HWIO_PMIC_ARB_OBS3_CHNL77_CMD_ADDR A:0x2e6b000
y.create.l HWIO_PMIC_ARB_OBS3_CHNL78_CMD_ADDR A:0x2e73000
y.create.l HWIO_PMIC_ARB_OBS3_CHNL79_CMD_ADDR A:0x2e7b000
y.create.l HWIO_PMIC_ARB_OBS3_CHNL80_CMD_ADDR A:0x2e83000
y.create.l HWIO_PMIC_ARB_OBS3_CHNL81_CMD_ADDR A:0x2e8b000
y.create.l HWIO_PMIC_ARB_OBS3_CHNL82_CMD_ADDR A:0x2e93000
y.create.l HWIO_PMIC_ARB_OBS3_CHNL83_CMD_ADDR A:0x2e9b000
y.create.l HWIO_PMIC_ARB_OBS3_CHNL84_CMD_ADDR A:0x2ea3000
y.create.l HWIO_PMIC_ARB_OBS3_CHNL85_CMD_ADDR A:0x2eab000
y.create.l HWIO_PMIC_ARB_OBS3_CHNL86_CMD_ADDR A:0x2eb3000
y.create.l HWIO_PMIC_ARB_OBS3_CHNL87_CMD_ADDR A:0x2ebb000
y.create.l HWIO_PMIC_ARB_OBS3_CHNL88_CMD_ADDR A:0x2ec3000
y.create.l HWIO_PMIC_ARB_OBS3_CHNL89_CMD_ADDR A:0x2ecb000
y.create.l HWIO_PMIC_ARB_OBS3_CHNL90_CMD_ADDR A:0x2ed3000
y.create.l HWIO_PMIC_ARB_OBS3_CHNL91_CMD_ADDR A:0x2edb000
y.create.l HWIO_PMIC_ARB_OBS3_CHNL92_CMD_ADDR A:0x2ee3000
y.create.l HWIO_PMIC_ARB_OBS3_CHNL93_CMD_ADDR A:0x2eeb000
y.create.l HWIO_PMIC_ARB_OBS3_CHNL94_CMD_ADDR A:0x2ef3000
y.create.l HWIO_PMIC_ARB_OBS3_CHNL95_CMD_ADDR A:0x2efb000
y.create.l HWIO_PMIC_ARB_OBS3_CHNL96_CMD_ADDR A:0x2f03000
y.create.l HWIO_PMIC_ARB_OBS3_CHNL97_CMD_ADDR A:0x2f0b000
y.create.l HWIO_PMIC_ARB_OBS3_CHNL98_CMD_ADDR A:0x2f13000
y.create.l HWIO_PMIC_ARB_OBS3_CHNL99_CMD_ADDR A:0x2f1b000
y.create.l HWIO_PMIC_ARB_OBS3_CHNL100_CMD_ADDR A:0x2f23000
y.create.l HWIO_PMIC_ARB_OBS3_CHNL101_CMD_ADDR A:0x2f2b000
y.create.l HWIO_PMIC_ARB_OBS3_CHNL102_CMD_ADDR A:0x2f33000
y.create.l HWIO_PMIC_ARB_OBS3_CHNL103_CMD_ADDR A:0x2f3b000
y.create.l HWIO_PMIC_ARB_OBS3_CHNL104_CMD_ADDR A:0x2f43000
y.create.l HWIO_PMIC_ARB_OBS3_CHNL105_CMD_ADDR A:0x2f4b000
y.create.l HWIO_PMIC_ARB_OBS3_CHNL106_CMD_ADDR A:0x2f53000
y.create.l HWIO_PMIC_ARB_OBS3_CHNL107_CMD_ADDR A:0x2f5b000
y.create.l HWIO_PMIC_ARB_OBS3_CHNL108_CMD_ADDR A:0x2f63000
y.create.l HWIO_PMIC_ARB_OBS3_CHNL109_CMD_ADDR A:0x2f6b000
y.create.l HWIO_PMIC_ARB_OBS3_CHNL110_CMD_ADDR A:0x2f73000
y.create.l HWIO_PMIC_ARB_OBS3_CHNL111_CMD_ADDR A:0x2f7b000
y.create.l HWIO_PMIC_ARB_OBS3_CHNL112_CMD_ADDR A:0x2f83000
y.create.l HWIO_PMIC_ARB_OBS3_CHNL113_CMD_ADDR A:0x2f8b000
y.create.l HWIO_PMIC_ARB_OBS3_CHNL114_CMD_ADDR A:0x2f93000
y.create.l HWIO_PMIC_ARB_OBS3_CHNL115_CMD_ADDR A:0x2f9b000
y.create.l HWIO_PMIC_ARB_OBS3_CHNL116_CMD_ADDR A:0x2fa3000
y.create.l HWIO_PMIC_ARB_OBS3_CHNL117_CMD_ADDR A:0x2fab000
y.create.l HWIO_PMIC_ARB_OBS3_CHNL118_CMD_ADDR A:0x2fb3000
y.create.l HWIO_PMIC_ARB_OBS3_CHNL119_CMD_ADDR A:0x2fbb000
y.create.l HWIO_PMIC_ARB_OBS3_CHNL120_CMD_ADDR A:0x2fc3000
y.create.l HWIO_PMIC_ARB_OBS3_CHNL121_CMD_ADDR A:0x2fcb000
y.create.l HWIO_PMIC_ARB_OBS3_CHNL122_CMD_ADDR A:0x2fd3000
y.create.l HWIO_PMIC_ARB_OBS3_CHNL123_CMD_ADDR A:0x2fdb000
y.create.l HWIO_PMIC_ARB_OBS3_CHNL124_CMD_ADDR A:0x2fe3000
y.create.l HWIO_PMIC_ARB_OBS3_CHNL125_CMD_ADDR A:0x2feb000
y.create.l HWIO_PMIC_ARB_OBS3_CHNL126_CMD_ADDR A:0x2ff3000
y.create.l HWIO_PMIC_ARB_OBS3_CHNL127_CMD_ADDR A:0x2ffb000
y.create.l HWIO_PMIC_ARB_OBS3_CHNL128_CMD_ADDR A:0x3003000
y.create.l HWIO_PMIC_ARB_OBS3_CHNL129_CMD_ADDR A:0x300b000
y.create.l HWIO_PMIC_ARB_OBS3_CHNL130_CMD_ADDR A:0x3013000
y.create.l HWIO_PMIC_ARB_OBS3_CHNL131_CMD_ADDR A:0x301b000
y.create.l HWIO_PMIC_ARB_OBS3_CHNL132_CMD_ADDR A:0x3023000
y.create.l HWIO_PMIC_ARB_OBS3_CHNL133_CMD_ADDR A:0x302b000
y.create.l HWIO_PMIC_ARB_OBS3_CHNL134_CMD_ADDR A:0x3033000
y.create.l HWIO_PMIC_ARB_OBS3_CHNL135_CMD_ADDR A:0x303b000
y.create.l HWIO_PMIC_ARB_OBS3_CHNL136_CMD_ADDR A:0x3043000
y.create.l HWIO_PMIC_ARB_OBS3_CHNL137_CMD_ADDR A:0x304b000
y.create.l HWIO_PMIC_ARB_OBS3_CHNL138_CMD_ADDR A:0x3053000
y.create.l HWIO_PMIC_ARB_OBS3_CHNL139_CMD_ADDR A:0x305b000
y.create.l HWIO_PMIC_ARB_OBS3_CHNL140_CMD_ADDR A:0x3063000
y.create.l HWIO_PMIC_ARB_OBS3_CHNL141_CMD_ADDR A:0x306b000
y.create.l HWIO_PMIC_ARB_OBS3_CHNL142_CMD_ADDR A:0x3073000
y.create.l HWIO_PMIC_ARB_OBS3_CHNL143_CMD_ADDR A:0x307b000
y.create.l HWIO_PMIC_ARB_OBS3_CHNL144_CMD_ADDR A:0x3083000
y.create.l HWIO_PMIC_ARB_OBS3_CHNL145_CMD_ADDR A:0x308b000
y.create.l HWIO_PMIC_ARB_OBS3_CHNL146_CMD_ADDR A:0x3093000
y.create.l HWIO_PMIC_ARB_OBS3_CHNL147_CMD_ADDR A:0x309b000
y.create.l HWIO_PMIC_ARB_OBS3_CHNL148_CMD_ADDR A:0x30a3000
y.create.l HWIO_PMIC_ARB_OBS3_CHNL149_CMD_ADDR A:0x30ab000
y.create.l HWIO_PMIC_ARB_OBS3_CHNL150_CMD_ADDR A:0x30b3000
y.create.l HWIO_PMIC_ARB_OBS3_CHNL151_CMD_ADDR A:0x30bb000
y.create.l HWIO_PMIC_ARB_OBS3_CHNL152_CMD_ADDR A:0x30c3000
y.create.l HWIO_PMIC_ARB_OBS3_CHNL153_CMD_ADDR A:0x30cb000
y.create.l HWIO_PMIC_ARB_OBS3_CHNL154_CMD_ADDR A:0x30d3000
y.create.l HWIO_PMIC_ARB_OBS3_CHNL155_CMD_ADDR A:0x30db000
y.create.l HWIO_PMIC_ARB_OBS3_CHNL156_CMD_ADDR A:0x30e3000
y.create.l HWIO_PMIC_ARB_OBS3_CHNL157_CMD_ADDR A:0x30eb000
y.create.l HWIO_PMIC_ARB_OBS3_CHNL158_CMD_ADDR A:0x30f3000
y.create.l HWIO_PMIC_ARB_OBS3_CHNL159_CMD_ADDR A:0x30fb000
y.create.l HWIO_PMIC_ARB_OBS3_CHNL160_CMD_ADDR A:0x3103000
y.create.l HWIO_PMIC_ARB_OBS3_CHNL161_CMD_ADDR A:0x310b000
y.create.l HWIO_PMIC_ARB_OBS3_CHNL162_CMD_ADDR A:0x3113000
y.create.l HWIO_PMIC_ARB_OBS3_CHNL163_CMD_ADDR A:0x311b000
y.create.l HWIO_PMIC_ARB_OBS3_CHNL164_CMD_ADDR A:0x3123000
y.create.l HWIO_PMIC_ARB_OBS3_CHNL165_CMD_ADDR A:0x312b000
y.create.l HWIO_PMIC_ARB_OBS3_CHNL166_CMD_ADDR A:0x3133000
y.create.l HWIO_PMIC_ARB_OBS3_CHNL167_CMD_ADDR A:0x313b000
y.create.l HWIO_PMIC_ARB_OBS3_CHNL168_CMD_ADDR A:0x3143000
y.create.l HWIO_PMIC_ARB_OBS3_CHNL169_CMD_ADDR A:0x314b000
y.create.l HWIO_PMIC_ARB_OBS3_CHNL170_CMD_ADDR A:0x3153000
y.create.l HWIO_PMIC_ARB_OBS3_CHNL171_CMD_ADDR A:0x315b000
y.create.l HWIO_PMIC_ARB_OBS3_CHNL172_CMD_ADDR A:0x3163000
y.create.l HWIO_PMIC_ARB_OBS3_CHNL173_CMD_ADDR A:0x316b000
y.create.l HWIO_PMIC_ARB_OBS3_CHNL174_CMD_ADDR A:0x3173000
y.create.l HWIO_PMIC_ARB_OBS3_CHNL175_CMD_ADDR A:0x317b000
y.create.l HWIO_PMIC_ARB_OBS3_CHNL176_CMD_ADDR A:0x3183000
y.create.l HWIO_PMIC_ARB_OBS3_CHNL177_CMD_ADDR A:0x318b000
y.create.l HWIO_PMIC_ARB_OBS3_CHNL178_CMD_ADDR A:0x3193000
y.create.l HWIO_PMIC_ARB_OBS3_CHNL179_CMD_ADDR A:0x319b000
y.create.l HWIO_PMIC_ARB_OBS3_CHNL180_CMD_ADDR A:0x31a3000
y.create.l HWIO_PMIC_ARB_OBS3_CHNL181_CMD_ADDR A:0x31ab000
y.create.l HWIO_PMIC_ARB_OBS3_CHNL182_CMD_ADDR A:0x31b3000
y.create.l HWIO_PMIC_ARB_OBS3_CHNL183_CMD_ADDR A:0x31bb000
y.create.l HWIO_PMIC_ARB_OBS3_CHNL184_CMD_ADDR A:0x31c3000
y.create.l HWIO_PMIC_ARB_OBS3_CHNL185_CMD_ADDR A:0x31cb000
y.create.l HWIO_PMIC_ARB_OBS3_CHNL186_CMD_ADDR A:0x31d3000
y.create.l HWIO_PMIC_ARB_OBS3_CHNL187_CMD_ADDR A:0x31db000
y.create.l HWIO_PMIC_ARB_OBS3_CHNL188_CMD_ADDR A:0x31e3000
y.create.l HWIO_PMIC_ARB_OBS3_CHNL189_CMD_ADDR A:0x31eb000
y.create.l HWIO_PMIC_ARB_OBS3_CHNL190_CMD_ADDR A:0x31f3000
y.create.l HWIO_PMIC_ARB_OBS3_CHNL191_CMD_ADDR A:0x31fb000
y.create.l HWIO_PMIC_ARB_OBS3_CHNL192_CMD_ADDR A:0x3203000
y.create.l HWIO_PMIC_ARB_OBS3_CHNL193_CMD_ADDR A:0x320b000
y.create.l HWIO_PMIC_ARB_OBS3_CHNL194_CMD_ADDR A:0x3213000
y.create.l HWIO_PMIC_ARB_OBS3_CHNL195_CMD_ADDR A:0x321b000
y.create.l HWIO_PMIC_ARB_OBS3_CHNL196_CMD_ADDR A:0x3223000
y.create.l HWIO_PMIC_ARB_OBS3_CHNL197_CMD_ADDR A:0x322b000
y.create.l HWIO_PMIC_ARB_OBS3_CHNL198_CMD_ADDR A:0x3233000
y.create.l HWIO_PMIC_ARB_OBS3_CHNL199_CMD_ADDR A:0x323b000
y.create.l HWIO_PMIC_ARB_OBS3_CHNL200_CMD_ADDR A:0x3243000
y.create.l HWIO_PMIC_ARB_OBS3_CHNL201_CMD_ADDR A:0x324b000
y.create.l HWIO_PMIC_ARB_OBS3_CHNL202_CMD_ADDR A:0x3253000
y.create.l HWIO_PMIC_ARB_OBS3_CHNL203_CMD_ADDR A:0x325b000
y.create.l HWIO_PMIC_ARB_OBS3_CHNL204_CMD_ADDR A:0x3263000
y.create.l HWIO_PMIC_ARB_OBS3_CHNL205_CMD_ADDR A:0x326b000
y.create.l HWIO_PMIC_ARB_OBS3_CHNL206_CMD_ADDR A:0x3273000
y.create.l HWIO_PMIC_ARB_OBS3_CHNL207_CMD_ADDR A:0x327b000
y.create.l HWIO_PMIC_ARB_OBS3_CHNL208_CMD_ADDR A:0x3283000
y.create.l HWIO_PMIC_ARB_OBS3_CHNL209_CMD_ADDR A:0x328b000
y.create.l HWIO_PMIC_ARB_OBS3_CHNL210_CMD_ADDR A:0x3293000
y.create.l HWIO_PMIC_ARB_OBS3_CHNL211_CMD_ADDR A:0x329b000
y.create.l HWIO_PMIC_ARB_OBS3_CHNL212_CMD_ADDR A:0x32a3000
y.create.l HWIO_PMIC_ARB_OBS3_CHNL213_CMD_ADDR A:0x32ab000
y.create.l HWIO_PMIC_ARB_OBS3_CHNL214_CMD_ADDR A:0x32b3000
y.create.l HWIO_PMIC_ARB_OBS3_CHNL215_CMD_ADDR A:0x32bb000
y.create.l HWIO_PMIC_ARB_OBS3_CHNL216_CMD_ADDR A:0x32c3000
y.create.l HWIO_PMIC_ARB_OBS3_CHNL217_CMD_ADDR A:0x32cb000
y.create.l HWIO_PMIC_ARB_OBS3_CHNL218_CMD_ADDR A:0x32d3000
y.create.l HWIO_PMIC_ARB_OBS3_CHNL219_CMD_ADDR A:0x32db000
y.create.l HWIO_PMIC_ARB_OBS3_CHNL220_CMD_ADDR A:0x32e3000
y.create.l HWIO_PMIC_ARB_OBS3_CHNL221_CMD_ADDR A:0x32eb000
y.create.l HWIO_PMIC_ARB_OBS3_CHNL222_CMD_ADDR A:0x32f3000
y.create.l HWIO_PMIC_ARB_OBS3_CHNL223_CMD_ADDR A:0x32fb000
y.create.l HWIO_PMIC_ARB_OBS3_CHNL224_CMD_ADDR A:0x3303000
y.create.l HWIO_PMIC_ARB_OBS3_CHNL225_CMD_ADDR A:0x330b000
y.create.l HWIO_PMIC_ARB_OBS3_CHNL226_CMD_ADDR A:0x3313000
y.create.l HWIO_PMIC_ARB_OBS3_CHNL227_CMD_ADDR A:0x331b000
y.create.l HWIO_PMIC_ARB_OBS3_CHNL228_CMD_ADDR A:0x3323000
y.create.l HWIO_PMIC_ARB_OBS3_CHNL229_CMD_ADDR A:0x332b000
y.create.l HWIO_PMIC_ARB_OBS3_CHNL230_CMD_ADDR A:0x3333000
y.create.l HWIO_PMIC_ARB_OBS3_CHNL231_CMD_ADDR A:0x333b000
y.create.l HWIO_PMIC_ARB_OBS3_CHNL232_CMD_ADDR A:0x3343000
y.create.l HWIO_PMIC_ARB_OBS3_CHNL233_CMD_ADDR A:0x334b000
y.create.l HWIO_PMIC_ARB_OBS3_CHNL234_CMD_ADDR A:0x3353000
y.create.l HWIO_PMIC_ARB_OBS3_CHNL235_CMD_ADDR A:0x335b000
y.create.l HWIO_PMIC_ARB_OBS3_CHNL236_CMD_ADDR A:0x3363000
y.create.l HWIO_PMIC_ARB_OBS3_CHNL237_CMD_ADDR A:0x336b000
y.create.l HWIO_PMIC_ARB_OBS3_CHNL238_CMD_ADDR A:0x3373000
y.create.l HWIO_PMIC_ARB_OBS3_CHNL239_CMD_ADDR A:0x337b000
y.create.l HWIO_PMIC_ARB_OBS3_CHNL240_CMD_ADDR A:0x3383000
y.create.l HWIO_PMIC_ARB_OBS3_CHNL241_CMD_ADDR A:0x338b000
y.create.l HWIO_PMIC_ARB_OBS3_CHNL242_CMD_ADDR A:0x3393000
y.create.l HWIO_PMIC_ARB_OBS3_CHNL243_CMD_ADDR A:0x339b000
y.create.l HWIO_PMIC_ARB_OBS3_CHNL244_CMD_ADDR A:0x33a3000
y.create.l HWIO_PMIC_ARB_OBS3_CHNL245_CMD_ADDR A:0x33ab000
y.create.l HWIO_PMIC_ARB_OBS3_CHNL246_CMD_ADDR A:0x33b3000
y.create.l HWIO_PMIC_ARB_OBS3_CHNL247_CMD_ADDR A:0x33bb000
y.create.l HWIO_PMIC_ARB_OBS3_CHNL248_CMD_ADDR A:0x33c3000
y.create.l HWIO_PMIC_ARB_OBS3_CHNL249_CMD_ADDR A:0x33cb000
y.create.l HWIO_PMIC_ARB_OBS3_CHNL250_CMD_ADDR A:0x33d3000
y.create.l HWIO_PMIC_ARB_OBS3_CHNL251_CMD_ADDR A:0x33db000
y.create.l HWIO_PMIC_ARB_OBS3_CHNL252_CMD_ADDR A:0x33e3000
y.create.l HWIO_PMIC_ARB_OBS3_CHNL253_CMD_ADDR A:0x33eb000
y.create.l HWIO_PMIC_ARB_OBS3_CHNL254_CMD_ADDR A:0x33f3000
y.create.l HWIO_PMIC_ARB_OBS3_CHNL255_CMD_ADDR A:0x33fb000
y.create.l HWIO_PMIC_ARB_OBS4_CHNL0_CMD_ADDR A:0x2c04000
y.create.l HWIO_PMIC_ARB_OBS4_CHNL1_CMD_ADDR A:0x2c0c000
y.create.l HWIO_PMIC_ARB_OBS4_CHNL2_CMD_ADDR A:0x2c14000
y.create.l HWIO_PMIC_ARB_OBS4_CHNL3_CMD_ADDR A:0x2c1c000
y.create.l HWIO_PMIC_ARB_OBS4_CHNL4_CMD_ADDR A:0x2c24000
y.create.l HWIO_PMIC_ARB_OBS4_CHNL5_CMD_ADDR A:0x2c2c000
y.create.l HWIO_PMIC_ARB_OBS4_CHNL6_CMD_ADDR A:0x2c34000
y.create.l HWIO_PMIC_ARB_OBS4_CHNL7_CMD_ADDR A:0x2c3c000
y.create.l HWIO_PMIC_ARB_OBS4_CHNL8_CMD_ADDR A:0x2c44000
y.create.l HWIO_PMIC_ARB_OBS4_CHNL9_CMD_ADDR A:0x2c4c000
y.create.l HWIO_PMIC_ARB_OBS4_CHNL10_CMD_ADDR A:0x2c54000
y.create.l HWIO_PMIC_ARB_OBS4_CHNL11_CMD_ADDR A:0x2c5c000
y.create.l HWIO_PMIC_ARB_OBS4_CHNL12_CMD_ADDR A:0x2c64000
y.create.l HWIO_PMIC_ARB_OBS4_CHNL13_CMD_ADDR A:0x2c6c000
y.create.l HWIO_PMIC_ARB_OBS4_CHNL14_CMD_ADDR A:0x2c74000
y.create.l HWIO_PMIC_ARB_OBS4_CHNL15_CMD_ADDR A:0x2c7c000
y.create.l HWIO_PMIC_ARB_OBS4_CHNL16_CMD_ADDR A:0x2c84000
y.create.l HWIO_PMIC_ARB_OBS4_CHNL17_CMD_ADDR A:0x2c8c000
y.create.l HWIO_PMIC_ARB_OBS4_CHNL18_CMD_ADDR A:0x2c94000
y.create.l HWIO_PMIC_ARB_OBS4_CHNL19_CMD_ADDR A:0x2c9c000
y.create.l HWIO_PMIC_ARB_OBS4_CHNL20_CMD_ADDR A:0x2ca4000
y.create.l HWIO_PMIC_ARB_OBS4_CHNL21_CMD_ADDR A:0x2cac000
y.create.l HWIO_PMIC_ARB_OBS4_CHNL22_CMD_ADDR A:0x2cb4000
y.create.l HWIO_PMIC_ARB_OBS4_CHNL23_CMD_ADDR A:0x2cbc000
y.create.l HWIO_PMIC_ARB_OBS4_CHNL24_CMD_ADDR A:0x2cc4000
y.create.l HWIO_PMIC_ARB_OBS4_CHNL25_CMD_ADDR A:0x2ccc000
y.create.l HWIO_PMIC_ARB_OBS4_CHNL26_CMD_ADDR A:0x2cd4000
y.create.l HWIO_PMIC_ARB_OBS4_CHNL27_CMD_ADDR A:0x2cdc000
y.create.l HWIO_PMIC_ARB_OBS4_CHNL28_CMD_ADDR A:0x2ce4000
y.create.l HWIO_PMIC_ARB_OBS4_CHNL29_CMD_ADDR A:0x2cec000
y.create.l HWIO_PMIC_ARB_OBS4_CHNL30_CMD_ADDR A:0x2cf4000
y.create.l HWIO_PMIC_ARB_OBS4_CHNL31_CMD_ADDR A:0x2cfc000
y.create.l HWIO_PMIC_ARB_OBS4_CHNL32_CMD_ADDR A:0x2d04000
y.create.l HWIO_PMIC_ARB_OBS4_CHNL33_CMD_ADDR A:0x2d0c000
y.create.l HWIO_PMIC_ARB_OBS4_CHNL34_CMD_ADDR A:0x2d14000
y.create.l HWIO_PMIC_ARB_OBS4_CHNL35_CMD_ADDR A:0x2d1c000
y.create.l HWIO_PMIC_ARB_OBS4_CHNL36_CMD_ADDR A:0x2d24000
y.create.l HWIO_PMIC_ARB_OBS4_CHNL37_CMD_ADDR A:0x2d2c000
y.create.l HWIO_PMIC_ARB_OBS4_CHNL38_CMD_ADDR A:0x2d34000
y.create.l HWIO_PMIC_ARB_OBS4_CHNL39_CMD_ADDR A:0x2d3c000
y.create.l HWIO_PMIC_ARB_OBS4_CHNL40_CMD_ADDR A:0x2d44000
y.create.l HWIO_PMIC_ARB_OBS4_CHNL41_CMD_ADDR A:0x2d4c000
y.create.l HWIO_PMIC_ARB_OBS4_CHNL42_CMD_ADDR A:0x2d54000
y.create.l HWIO_PMIC_ARB_OBS4_CHNL43_CMD_ADDR A:0x2d5c000
y.create.l HWIO_PMIC_ARB_OBS4_CHNL44_CMD_ADDR A:0x2d64000
y.create.l HWIO_PMIC_ARB_OBS4_CHNL45_CMD_ADDR A:0x2d6c000
y.create.l HWIO_PMIC_ARB_OBS4_CHNL46_CMD_ADDR A:0x2d74000
y.create.l HWIO_PMIC_ARB_OBS4_CHNL47_CMD_ADDR A:0x2d7c000
y.create.l HWIO_PMIC_ARB_OBS4_CHNL48_CMD_ADDR A:0x2d84000
y.create.l HWIO_PMIC_ARB_OBS4_CHNL49_CMD_ADDR A:0x2d8c000
y.create.l HWIO_PMIC_ARB_OBS4_CHNL50_CMD_ADDR A:0x2d94000
y.create.l HWIO_PMIC_ARB_OBS4_CHNL51_CMD_ADDR A:0x2d9c000
y.create.l HWIO_PMIC_ARB_OBS4_CHNL52_CMD_ADDR A:0x2da4000
y.create.l HWIO_PMIC_ARB_OBS4_CHNL53_CMD_ADDR A:0x2dac000
y.create.l HWIO_PMIC_ARB_OBS4_CHNL54_CMD_ADDR A:0x2db4000
y.create.l HWIO_PMIC_ARB_OBS4_CHNL55_CMD_ADDR A:0x2dbc000
y.create.l HWIO_PMIC_ARB_OBS4_CHNL56_CMD_ADDR A:0x2dc4000
y.create.l HWIO_PMIC_ARB_OBS4_CHNL57_CMD_ADDR A:0x2dcc000
y.create.l HWIO_PMIC_ARB_OBS4_CHNL58_CMD_ADDR A:0x2dd4000
y.create.l HWIO_PMIC_ARB_OBS4_CHNL59_CMD_ADDR A:0x2ddc000
y.create.l HWIO_PMIC_ARB_OBS4_CHNL60_CMD_ADDR A:0x2de4000
y.create.l HWIO_PMIC_ARB_OBS4_CHNL61_CMD_ADDR A:0x2dec000
y.create.l HWIO_PMIC_ARB_OBS4_CHNL62_CMD_ADDR A:0x2df4000
y.create.l HWIO_PMIC_ARB_OBS4_CHNL63_CMD_ADDR A:0x2dfc000
y.create.l HWIO_PMIC_ARB_OBS4_CHNL64_CMD_ADDR A:0x2e04000
y.create.l HWIO_PMIC_ARB_OBS4_CHNL65_CMD_ADDR A:0x2e0c000
y.create.l HWIO_PMIC_ARB_OBS4_CHNL66_CMD_ADDR A:0x2e14000
y.create.l HWIO_PMIC_ARB_OBS4_CHNL67_CMD_ADDR A:0x2e1c000
y.create.l HWIO_PMIC_ARB_OBS4_CHNL68_CMD_ADDR A:0x2e24000
y.create.l HWIO_PMIC_ARB_OBS4_CHNL69_CMD_ADDR A:0x2e2c000
y.create.l HWIO_PMIC_ARB_OBS4_CHNL70_CMD_ADDR A:0x2e34000
y.create.l HWIO_PMIC_ARB_OBS4_CHNL71_CMD_ADDR A:0x2e3c000
y.create.l HWIO_PMIC_ARB_OBS4_CHNL72_CMD_ADDR A:0x2e44000
y.create.l HWIO_PMIC_ARB_OBS4_CHNL73_CMD_ADDR A:0x2e4c000
y.create.l HWIO_PMIC_ARB_OBS4_CHNL74_CMD_ADDR A:0x2e54000
y.create.l HWIO_PMIC_ARB_OBS4_CHNL75_CMD_ADDR A:0x2e5c000
y.create.l HWIO_PMIC_ARB_OBS4_CHNL76_CMD_ADDR A:0x2e64000
y.create.l HWIO_PMIC_ARB_OBS4_CHNL77_CMD_ADDR A:0x2e6c000
y.create.l HWIO_PMIC_ARB_OBS4_CHNL78_CMD_ADDR A:0x2e74000
y.create.l HWIO_PMIC_ARB_OBS4_CHNL79_CMD_ADDR A:0x2e7c000
y.create.l HWIO_PMIC_ARB_OBS4_CHNL80_CMD_ADDR A:0x2e84000
y.create.l HWIO_PMIC_ARB_OBS4_CHNL81_CMD_ADDR A:0x2e8c000
y.create.l HWIO_PMIC_ARB_OBS4_CHNL82_CMD_ADDR A:0x2e94000
y.create.l HWIO_PMIC_ARB_OBS4_CHNL83_CMD_ADDR A:0x2e9c000
y.create.l HWIO_PMIC_ARB_OBS4_CHNL84_CMD_ADDR A:0x2ea4000
y.create.l HWIO_PMIC_ARB_OBS4_CHNL85_CMD_ADDR A:0x2eac000
y.create.l HWIO_PMIC_ARB_OBS4_CHNL86_CMD_ADDR A:0x2eb4000
y.create.l HWIO_PMIC_ARB_OBS4_CHNL87_CMD_ADDR A:0x2ebc000
y.create.l HWIO_PMIC_ARB_OBS4_CHNL88_CMD_ADDR A:0x2ec4000
y.create.l HWIO_PMIC_ARB_OBS4_CHNL89_CMD_ADDR A:0x2ecc000
y.create.l HWIO_PMIC_ARB_OBS4_CHNL90_CMD_ADDR A:0x2ed4000
y.create.l HWIO_PMIC_ARB_OBS4_CHNL91_CMD_ADDR A:0x2edc000
y.create.l HWIO_PMIC_ARB_OBS4_CHNL92_CMD_ADDR A:0x2ee4000
y.create.l HWIO_PMIC_ARB_OBS4_CHNL93_CMD_ADDR A:0x2eec000
y.create.l HWIO_PMIC_ARB_OBS4_CHNL94_CMD_ADDR A:0x2ef4000
y.create.l HWIO_PMIC_ARB_OBS4_CHNL95_CMD_ADDR A:0x2efc000
y.create.l HWIO_PMIC_ARB_OBS4_CHNL96_CMD_ADDR A:0x2f04000
y.create.l HWIO_PMIC_ARB_OBS4_CHNL97_CMD_ADDR A:0x2f0c000
y.create.l HWIO_PMIC_ARB_OBS4_CHNL98_CMD_ADDR A:0x2f14000
y.create.l HWIO_PMIC_ARB_OBS4_CHNL99_CMD_ADDR A:0x2f1c000
y.create.l HWIO_PMIC_ARB_OBS4_CHNL100_CMD_ADDR A:0x2f24000
y.create.l HWIO_PMIC_ARB_OBS4_CHNL101_CMD_ADDR A:0x2f2c000
y.create.l HWIO_PMIC_ARB_OBS4_CHNL102_CMD_ADDR A:0x2f34000
y.create.l HWIO_PMIC_ARB_OBS4_CHNL103_CMD_ADDR A:0x2f3c000
y.create.l HWIO_PMIC_ARB_OBS4_CHNL104_CMD_ADDR A:0x2f44000
y.create.l HWIO_PMIC_ARB_OBS4_CHNL105_CMD_ADDR A:0x2f4c000
y.create.l HWIO_PMIC_ARB_OBS4_CHNL106_CMD_ADDR A:0x2f54000
y.create.l HWIO_PMIC_ARB_OBS4_CHNL107_CMD_ADDR A:0x2f5c000
y.create.l HWIO_PMIC_ARB_OBS4_CHNL108_CMD_ADDR A:0x2f64000
y.create.l HWIO_PMIC_ARB_OBS4_CHNL109_CMD_ADDR A:0x2f6c000
y.create.l HWIO_PMIC_ARB_OBS4_CHNL110_CMD_ADDR A:0x2f74000
y.create.l HWIO_PMIC_ARB_OBS4_CHNL111_CMD_ADDR A:0x2f7c000
y.create.l HWIO_PMIC_ARB_OBS4_CHNL112_CMD_ADDR A:0x2f84000
y.create.l HWIO_PMIC_ARB_OBS4_CHNL113_CMD_ADDR A:0x2f8c000
y.create.l HWIO_PMIC_ARB_OBS4_CHNL114_CMD_ADDR A:0x2f94000
y.create.l HWIO_PMIC_ARB_OBS4_CHNL115_CMD_ADDR A:0x2f9c000
y.create.l HWIO_PMIC_ARB_OBS4_CHNL116_CMD_ADDR A:0x2fa4000
y.create.l HWIO_PMIC_ARB_OBS4_CHNL117_CMD_ADDR A:0x2fac000
y.create.l HWIO_PMIC_ARB_OBS4_CHNL118_CMD_ADDR A:0x2fb4000
y.create.l HWIO_PMIC_ARB_OBS4_CHNL119_CMD_ADDR A:0x2fbc000
y.create.l HWIO_PMIC_ARB_OBS4_CHNL120_CMD_ADDR A:0x2fc4000
y.create.l HWIO_PMIC_ARB_OBS4_CHNL121_CMD_ADDR A:0x2fcc000
y.create.l HWIO_PMIC_ARB_OBS4_CHNL122_CMD_ADDR A:0x2fd4000
y.create.l HWIO_PMIC_ARB_OBS4_CHNL123_CMD_ADDR A:0x2fdc000
y.create.l HWIO_PMIC_ARB_OBS4_CHNL124_CMD_ADDR A:0x2fe4000
y.create.l HWIO_PMIC_ARB_OBS4_CHNL125_CMD_ADDR A:0x2fec000
y.create.l HWIO_PMIC_ARB_OBS4_CHNL126_CMD_ADDR A:0x2ff4000
y.create.l HWIO_PMIC_ARB_OBS4_CHNL127_CMD_ADDR A:0x2ffc000
y.create.l HWIO_PMIC_ARB_OBS4_CHNL128_CMD_ADDR A:0x3004000
y.create.l HWIO_PMIC_ARB_OBS4_CHNL129_CMD_ADDR A:0x300c000
y.create.l HWIO_PMIC_ARB_OBS4_CHNL130_CMD_ADDR A:0x3014000
y.create.l HWIO_PMIC_ARB_OBS4_CHNL131_CMD_ADDR A:0x301c000
y.create.l HWIO_PMIC_ARB_OBS4_CHNL132_CMD_ADDR A:0x3024000
y.create.l HWIO_PMIC_ARB_OBS4_CHNL133_CMD_ADDR A:0x302c000
y.create.l HWIO_PMIC_ARB_OBS4_CHNL134_CMD_ADDR A:0x3034000
y.create.l HWIO_PMIC_ARB_OBS4_CHNL135_CMD_ADDR A:0x303c000
y.create.l HWIO_PMIC_ARB_OBS4_CHNL136_CMD_ADDR A:0x3044000
y.create.l HWIO_PMIC_ARB_OBS4_CHNL137_CMD_ADDR A:0x304c000
y.create.l HWIO_PMIC_ARB_OBS4_CHNL138_CMD_ADDR A:0x3054000
y.create.l HWIO_PMIC_ARB_OBS4_CHNL139_CMD_ADDR A:0x305c000
y.create.l HWIO_PMIC_ARB_OBS4_CHNL140_CMD_ADDR A:0x3064000
y.create.l HWIO_PMIC_ARB_OBS4_CHNL141_CMD_ADDR A:0x306c000
y.create.l HWIO_PMIC_ARB_OBS4_CHNL142_CMD_ADDR A:0x3074000
y.create.l HWIO_PMIC_ARB_OBS4_CHNL143_CMD_ADDR A:0x307c000
y.create.l HWIO_PMIC_ARB_OBS4_CHNL144_CMD_ADDR A:0x3084000
y.create.l HWIO_PMIC_ARB_OBS4_CHNL145_CMD_ADDR A:0x308c000
y.create.l HWIO_PMIC_ARB_OBS4_CHNL146_CMD_ADDR A:0x3094000
y.create.l HWIO_PMIC_ARB_OBS4_CHNL147_CMD_ADDR A:0x309c000
y.create.l HWIO_PMIC_ARB_OBS4_CHNL148_CMD_ADDR A:0x30a4000
y.create.l HWIO_PMIC_ARB_OBS4_CHNL149_CMD_ADDR A:0x30ac000
y.create.l HWIO_PMIC_ARB_OBS4_CHNL150_CMD_ADDR A:0x30b4000
y.create.l HWIO_PMIC_ARB_OBS4_CHNL151_CMD_ADDR A:0x30bc000
y.create.l HWIO_PMIC_ARB_OBS4_CHNL152_CMD_ADDR A:0x30c4000
y.create.l HWIO_PMIC_ARB_OBS4_CHNL153_CMD_ADDR A:0x30cc000
y.create.l HWIO_PMIC_ARB_OBS4_CHNL154_CMD_ADDR A:0x30d4000
y.create.l HWIO_PMIC_ARB_OBS4_CHNL155_CMD_ADDR A:0x30dc000
y.create.l HWIO_PMIC_ARB_OBS4_CHNL156_CMD_ADDR A:0x30e4000
y.create.l HWIO_PMIC_ARB_OBS4_CHNL157_CMD_ADDR A:0x30ec000
y.create.l HWIO_PMIC_ARB_OBS4_CHNL158_CMD_ADDR A:0x30f4000
y.create.l HWIO_PMIC_ARB_OBS4_CHNL159_CMD_ADDR A:0x30fc000
y.create.l HWIO_PMIC_ARB_OBS4_CHNL160_CMD_ADDR A:0x3104000
y.create.l HWIO_PMIC_ARB_OBS4_CHNL161_CMD_ADDR A:0x310c000
y.create.l HWIO_PMIC_ARB_OBS4_CHNL162_CMD_ADDR A:0x3114000
y.create.l HWIO_PMIC_ARB_OBS4_CHNL163_CMD_ADDR A:0x311c000
y.create.l HWIO_PMIC_ARB_OBS4_CHNL164_CMD_ADDR A:0x3124000
y.create.l HWIO_PMIC_ARB_OBS4_CHNL165_CMD_ADDR A:0x312c000
y.create.l HWIO_PMIC_ARB_OBS4_CHNL166_CMD_ADDR A:0x3134000
y.create.l HWIO_PMIC_ARB_OBS4_CHNL167_CMD_ADDR A:0x313c000
y.create.l HWIO_PMIC_ARB_OBS4_CHNL168_CMD_ADDR A:0x3144000
y.create.l HWIO_PMIC_ARB_OBS4_CHNL169_CMD_ADDR A:0x314c000
y.create.l HWIO_PMIC_ARB_OBS4_CHNL170_CMD_ADDR A:0x3154000
y.create.l HWIO_PMIC_ARB_OBS4_CHNL171_CMD_ADDR A:0x315c000
y.create.l HWIO_PMIC_ARB_OBS4_CHNL172_CMD_ADDR A:0x3164000
y.create.l HWIO_PMIC_ARB_OBS4_CHNL173_CMD_ADDR A:0x316c000
y.create.l HWIO_PMIC_ARB_OBS4_CHNL174_CMD_ADDR A:0x3174000
y.create.l HWIO_PMIC_ARB_OBS4_CHNL175_CMD_ADDR A:0x317c000
y.create.l HWIO_PMIC_ARB_OBS4_CHNL176_CMD_ADDR A:0x3184000
y.create.l HWIO_PMIC_ARB_OBS4_CHNL177_CMD_ADDR A:0x318c000
y.create.l HWIO_PMIC_ARB_OBS4_CHNL178_CMD_ADDR A:0x3194000
y.create.l HWIO_PMIC_ARB_OBS4_CHNL179_CMD_ADDR A:0x319c000
y.create.l HWIO_PMIC_ARB_OBS4_CHNL180_CMD_ADDR A:0x31a4000
y.create.l HWIO_PMIC_ARB_OBS4_CHNL181_CMD_ADDR A:0x31ac000
y.create.l HWIO_PMIC_ARB_OBS4_CHNL182_CMD_ADDR A:0x31b4000
y.create.l HWIO_PMIC_ARB_OBS4_CHNL183_CMD_ADDR A:0x31bc000
y.create.l HWIO_PMIC_ARB_OBS4_CHNL184_CMD_ADDR A:0x31c4000
y.create.l HWIO_PMIC_ARB_OBS4_CHNL185_CMD_ADDR A:0x31cc000
y.create.l HWIO_PMIC_ARB_OBS4_CHNL186_CMD_ADDR A:0x31d4000
y.create.l HWIO_PMIC_ARB_OBS4_CHNL187_CMD_ADDR A:0x31dc000
y.create.l HWIO_PMIC_ARB_OBS4_CHNL188_CMD_ADDR A:0x31e4000
y.create.l HWIO_PMIC_ARB_OBS4_CHNL189_CMD_ADDR A:0x31ec000
y.create.l HWIO_PMIC_ARB_OBS4_CHNL190_CMD_ADDR A:0x31f4000
y.create.l HWIO_PMIC_ARB_OBS4_CHNL191_CMD_ADDR A:0x31fc000
y.create.l HWIO_PMIC_ARB_OBS4_CHNL192_CMD_ADDR A:0x3204000
y.create.l HWIO_PMIC_ARB_OBS4_CHNL193_CMD_ADDR A:0x320c000
y.create.l HWIO_PMIC_ARB_OBS4_CHNL194_CMD_ADDR A:0x3214000
y.create.l HWIO_PMIC_ARB_OBS4_CHNL195_CMD_ADDR A:0x321c000
y.create.l HWIO_PMIC_ARB_OBS4_CHNL196_CMD_ADDR A:0x3224000
y.create.l HWIO_PMIC_ARB_OBS4_CHNL197_CMD_ADDR A:0x322c000
y.create.l HWIO_PMIC_ARB_OBS4_CHNL198_CMD_ADDR A:0x3234000
y.create.l HWIO_PMIC_ARB_OBS4_CHNL199_CMD_ADDR A:0x323c000
y.create.l HWIO_PMIC_ARB_OBS4_CHNL200_CMD_ADDR A:0x3244000
y.create.l HWIO_PMIC_ARB_OBS4_CHNL201_CMD_ADDR A:0x324c000
y.create.l HWIO_PMIC_ARB_OBS4_CHNL202_CMD_ADDR A:0x3254000
y.create.l HWIO_PMIC_ARB_OBS4_CHNL203_CMD_ADDR A:0x325c000
y.create.l HWIO_PMIC_ARB_OBS4_CHNL204_CMD_ADDR A:0x3264000
y.create.l HWIO_PMIC_ARB_OBS4_CHNL205_CMD_ADDR A:0x326c000
y.create.l HWIO_PMIC_ARB_OBS4_CHNL206_CMD_ADDR A:0x3274000
y.create.l HWIO_PMIC_ARB_OBS4_CHNL207_CMD_ADDR A:0x327c000
y.create.l HWIO_PMIC_ARB_OBS4_CHNL208_CMD_ADDR A:0x3284000
y.create.l HWIO_PMIC_ARB_OBS4_CHNL209_CMD_ADDR A:0x328c000
y.create.l HWIO_PMIC_ARB_OBS4_CHNL210_CMD_ADDR A:0x3294000
y.create.l HWIO_PMIC_ARB_OBS4_CHNL211_CMD_ADDR A:0x329c000
y.create.l HWIO_PMIC_ARB_OBS4_CHNL212_CMD_ADDR A:0x32a4000
y.create.l HWIO_PMIC_ARB_OBS4_CHNL213_CMD_ADDR A:0x32ac000
y.create.l HWIO_PMIC_ARB_OBS4_CHNL214_CMD_ADDR A:0x32b4000
y.create.l HWIO_PMIC_ARB_OBS4_CHNL215_CMD_ADDR A:0x32bc000
y.create.l HWIO_PMIC_ARB_OBS4_CHNL216_CMD_ADDR A:0x32c4000
y.create.l HWIO_PMIC_ARB_OBS4_CHNL217_CMD_ADDR A:0x32cc000
y.create.l HWIO_PMIC_ARB_OBS4_CHNL218_CMD_ADDR A:0x32d4000
y.create.l HWIO_PMIC_ARB_OBS4_CHNL219_CMD_ADDR A:0x32dc000
y.create.l HWIO_PMIC_ARB_OBS4_CHNL220_CMD_ADDR A:0x32e4000
y.create.l HWIO_PMIC_ARB_OBS4_CHNL221_CMD_ADDR A:0x32ec000
y.create.l HWIO_PMIC_ARB_OBS4_CHNL222_CMD_ADDR A:0x32f4000
y.create.l HWIO_PMIC_ARB_OBS4_CHNL223_CMD_ADDR A:0x32fc000
y.create.l HWIO_PMIC_ARB_OBS4_CHNL224_CMD_ADDR A:0x3304000
y.create.l HWIO_PMIC_ARB_OBS4_CHNL225_CMD_ADDR A:0x330c000
y.create.l HWIO_PMIC_ARB_OBS4_CHNL226_CMD_ADDR A:0x3314000
y.create.l HWIO_PMIC_ARB_OBS4_CHNL227_CMD_ADDR A:0x331c000
y.create.l HWIO_PMIC_ARB_OBS4_CHNL228_CMD_ADDR A:0x3324000
y.create.l HWIO_PMIC_ARB_OBS4_CHNL229_CMD_ADDR A:0x332c000
y.create.l HWIO_PMIC_ARB_OBS4_CHNL230_CMD_ADDR A:0x3334000
y.create.l HWIO_PMIC_ARB_OBS4_CHNL231_CMD_ADDR A:0x333c000
y.create.l HWIO_PMIC_ARB_OBS4_CHNL232_CMD_ADDR A:0x3344000
y.create.l HWIO_PMIC_ARB_OBS4_CHNL233_CMD_ADDR A:0x334c000
y.create.l HWIO_PMIC_ARB_OBS4_CHNL234_CMD_ADDR A:0x3354000
y.create.l HWIO_PMIC_ARB_OBS4_CHNL235_CMD_ADDR A:0x335c000
y.create.l HWIO_PMIC_ARB_OBS4_CHNL236_CMD_ADDR A:0x3364000
y.create.l HWIO_PMIC_ARB_OBS4_CHNL237_CMD_ADDR A:0x336c000
y.create.l HWIO_PMIC_ARB_OBS4_CHNL238_CMD_ADDR A:0x3374000
y.create.l HWIO_PMIC_ARB_OBS4_CHNL239_CMD_ADDR A:0x337c000
y.create.l HWIO_PMIC_ARB_OBS4_CHNL240_CMD_ADDR A:0x3384000
y.create.l HWIO_PMIC_ARB_OBS4_CHNL241_CMD_ADDR A:0x338c000
y.create.l HWIO_PMIC_ARB_OBS4_CHNL242_CMD_ADDR A:0x3394000
y.create.l HWIO_PMIC_ARB_OBS4_CHNL243_CMD_ADDR A:0x339c000
y.create.l HWIO_PMIC_ARB_OBS4_CHNL244_CMD_ADDR A:0x33a4000
y.create.l HWIO_PMIC_ARB_OBS4_CHNL245_CMD_ADDR A:0x33ac000
y.create.l HWIO_PMIC_ARB_OBS4_CHNL246_CMD_ADDR A:0x33b4000
y.create.l HWIO_PMIC_ARB_OBS4_CHNL247_CMD_ADDR A:0x33bc000
y.create.l HWIO_PMIC_ARB_OBS4_CHNL248_CMD_ADDR A:0x33c4000
y.create.l HWIO_PMIC_ARB_OBS4_CHNL249_CMD_ADDR A:0x33cc000
y.create.l HWIO_PMIC_ARB_OBS4_CHNL250_CMD_ADDR A:0x33d4000
y.create.l HWIO_PMIC_ARB_OBS4_CHNL251_CMD_ADDR A:0x33dc000
y.create.l HWIO_PMIC_ARB_OBS4_CHNL252_CMD_ADDR A:0x33e4000
y.create.l HWIO_PMIC_ARB_OBS4_CHNL253_CMD_ADDR A:0x33ec000
y.create.l HWIO_PMIC_ARB_OBS4_CHNL254_CMD_ADDR A:0x33f4000
y.create.l HWIO_PMIC_ARB_OBS4_CHNL255_CMD_ADDR A:0x33fc000
y.create.l HWIO_PMIC_ARB_OBS5_CHNL0_CMD_ADDR A:0x2c05000
y.create.l HWIO_PMIC_ARB_OBS5_CHNL1_CMD_ADDR A:0x2c0d000
y.create.l HWIO_PMIC_ARB_OBS5_CHNL2_CMD_ADDR A:0x2c15000
y.create.l HWIO_PMIC_ARB_OBS5_CHNL3_CMD_ADDR A:0x2c1d000
y.create.l HWIO_PMIC_ARB_OBS5_CHNL4_CMD_ADDR A:0x2c25000
y.create.l HWIO_PMIC_ARB_OBS5_CHNL5_CMD_ADDR A:0x2c2d000
y.create.l HWIO_PMIC_ARB_OBS5_CHNL6_CMD_ADDR A:0x2c35000
y.create.l HWIO_PMIC_ARB_OBS5_CHNL7_CMD_ADDR A:0x2c3d000
y.create.l HWIO_PMIC_ARB_OBS5_CHNL8_CMD_ADDR A:0x2c45000
y.create.l HWIO_PMIC_ARB_OBS5_CHNL9_CMD_ADDR A:0x2c4d000
y.create.l HWIO_PMIC_ARB_OBS5_CHNL10_CMD_ADDR A:0x2c55000
y.create.l HWIO_PMIC_ARB_OBS5_CHNL11_CMD_ADDR A:0x2c5d000
y.create.l HWIO_PMIC_ARB_OBS5_CHNL12_CMD_ADDR A:0x2c65000
y.create.l HWIO_PMIC_ARB_OBS5_CHNL13_CMD_ADDR A:0x2c6d000
y.create.l HWIO_PMIC_ARB_OBS5_CHNL14_CMD_ADDR A:0x2c75000
y.create.l HWIO_PMIC_ARB_OBS5_CHNL15_CMD_ADDR A:0x2c7d000
y.create.l HWIO_PMIC_ARB_OBS5_CHNL16_CMD_ADDR A:0x2c85000
y.create.l HWIO_PMIC_ARB_OBS5_CHNL17_CMD_ADDR A:0x2c8d000
y.create.l HWIO_PMIC_ARB_OBS5_CHNL18_CMD_ADDR A:0x2c95000
y.create.l HWIO_PMIC_ARB_OBS5_CHNL19_CMD_ADDR A:0x2c9d000
y.create.l HWIO_PMIC_ARB_OBS5_CHNL20_CMD_ADDR A:0x2ca5000
y.create.l HWIO_PMIC_ARB_OBS5_CHNL21_CMD_ADDR A:0x2cad000
y.create.l HWIO_PMIC_ARB_OBS5_CHNL22_CMD_ADDR A:0x2cb5000
y.create.l HWIO_PMIC_ARB_OBS5_CHNL23_CMD_ADDR A:0x2cbd000
y.create.l HWIO_PMIC_ARB_OBS5_CHNL24_CMD_ADDR A:0x2cc5000
y.create.l HWIO_PMIC_ARB_OBS5_CHNL25_CMD_ADDR A:0x2ccd000
y.create.l HWIO_PMIC_ARB_OBS5_CHNL26_CMD_ADDR A:0x2cd5000
y.create.l HWIO_PMIC_ARB_OBS5_CHNL27_CMD_ADDR A:0x2cdd000
y.create.l HWIO_PMIC_ARB_OBS5_CHNL28_CMD_ADDR A:0x2ce5000
y.create.l HWIO_PMIC_ARB_OBS5_CHNL29_CMD_ADDR A:0x2ced000
y.create.l HWIO_PMIC_ARB_OBS5_CHNL30_CMD_ADDR A:0x2cf5000
y.create.l HWIO_PMIC_ARB_OBS5_CHNL31_CMD_ADDR A:0x2cfd000
y.create.l HWIO_PMIC_ARB_OBS5_CHNL32_CMD_ADDR A:0x2d05000
y.create.l HWIO_PMIC_ARB_OBS5_CHNL33_CMD_ADDR A:0x2d0d000
y.create.l HWIO_PMIC_ARB_OBS5_CHNL34_CMD_ADDR A:0x2d15000
y.create.l HWIO_PMIC_ARB_OBS5_CHNL35_CMD_ADDR A:0x2d1d000
y.create.l HWIO_PMIC_ARB_OBS5_CHNL36_CMD_ADDR A:0x2d25000
y.create.l HWIO_PMIC_ARB_OBS5_CHNL37_CMD_ADDR A:0x2d2d000
y.create.l HWIO_PMIC_ARB_OBS5_CHNL38_CMD_ADDR A:0x2d35000
y.create.l HWIO_PMIC_ARB_OBS5_CHNL39_CMD_ADDR A:0x2d3d000
y.create.l HWIO_PMIC_ARB_OBS5_CHNL40_CMD_ADDR A:0x2d45000
y.create.l HWIO_PMIC_ARB_OBS5_CHNL41_CMD_ADDR A:0x2d4d000
y.create.l HWIO_PMIC_ARB_OBS5_CHNL42_CMD_ADDR A:0x2d55000
y.create.l HWIO_PMIC_ARB_OBS5_CHNL43_CMD_ADDR A:0x2d5d000
y.create.l HWIO_PMIC_ARB_OBS5_CHNL44_CMD_ADDR A:0x2d65000
y.create.l HWIO_PMIC_ARB_OBS5_CHNL45_CMD_ADDR A:0x2d6d000
y.create.l HWIO_PMIC_ARB_OBS5_CHNL46_CMD_ADDR A:0x2d75000
y.create.l HWIO_PMIC_ARB_OBS5_CHNL47_CMD_ADDR A:0x2d7d000
y.create.l HWIO_PMIC_ARB_OBS5_CHNL48_CMD_ADDR A:0x2d85000
y.create.l HWIO_PMIC_ARB_OBS5_CHNL49_CMD_ADDR A:0x2d8d000
y.create.l HWIO_PMIC_ARB_OBS5_CHNL50_CMD_ADDR A:0x2d95000
y.create.l HWIO_PMIC_ARB_OBS5_CHNL51_CMD_ADDR A:0x2d9d000
y.create.l HWIO_PMIC_ARB_OBS5_CHNL52_CMD_ADDR A:0x2da5000
y.create.l HWIO_PMIC_ARB_OBS5_CHNL53_CMD_ADDR A:0x2dad000
y.create.l HWIO_PMIC_ARB_OBS5_CHNL54_CMD_ADDR A:0x2db5000
y.create.l HWIO_PMIC_ARB_OBS5_CHNL55_CMD_ADDR A:0x2dbd000
y.create.l HWIO_PMIC_ARB_OBS5_CHNL56_CMD_ADDR A:0x2dc5000
y.create.l HWIO_PMIC_ARB_OBS5_CHNL57_CMD_ADDR A:0x2dcd000
y.create.l HWIO_PMIC_ARB_OBS5_CHNL58_CMD_ADDR A:0x2dd5000
y.create.l HWIO_PMIC_ARB_OBS5_CHNL59_CMD_ADDR A:0x2ddd000
y.create.l HWIO_PMIC_ARB_OBS5_CHNL60_CMD_ADDR A:0x2de5000
y.create.l HWIO_PMIC_ARB_OBS5_CHNL61_CMD_ADDR A:0x2ded000
y.create.l HWIO_PMIC_ARB_OBS5_CHNL62_CMD_ADDR A:0x2df5000
y.create.l HWIO_PMIC_ARB_OBS5_CHNL63_CMD_ADDR A:0x2dfd000
y.create.l HWIO_PMIC_ARB_OBS5_CHNL64_CMD_ADDR A:0x2e05000
y.create.l HWIO_PMIC_ARB_OBS5_CHNL65_CMD_ADDR A:0x2e0d000
y.create.l HWIO_PMIC_ARB_OBS5_CHNL66_CMD_ADDR A:0x2e15000
y.create.l HWIO_PMIC_ARB_OBS5_CHNL67_CMD_ADDR A:0x2e1d000
y.create.l HWIO_PMIC_ARB_OBS5_CHNL68_CMD_ADDR A:0x2e25000
y.create.l HWIO_PMIC_ARB_OBS5_CHNL69_CMD_ADDR A:0x2e2d000
y.create.l HWIO_PMIC_ARB_OBS5_CHNL70_CMD_ADDR A:0x2e35000
y.create.l HWIO_PMIC_ARB_OBS5_CHNL71_CMD_ADDR A:0x2e3d000
y.create.l HWIO_PMIC_ARB_OBS5_CHNL72_CMD_ADDR A:0x2e45000
y.create.l HWIO_PMIC_ARB_OBS5_CHNL73_CMD_ADDR A:0x2e4d000
y.create.l HWIO_PMIC_ARB_OBS5_CHNL74_CMD_ADDR A:0x2e55000
y.create.l HWIO_PMIC_ARB_OBS5_CHNL75_CMD_ADDR A:0x2e5d000
y.create.l HWIO_PMIC_ARB_OBS5_CHNL76_CMD_ADDR A:0x2e65000
y.create.l HWIO_PMIC_ARB_OBS5_CHNL77_CMD_ADDR A:0x2e6d000
y.create.l HWIO_PMIC_ARB_OBS5_CHNL78_CMD_ADDR A:0x2e75000
y.create.l HWIO_PMIC_ARB_OBS5_CHNL79_CMD_ADDR A:0x2e7d000
y.create.l HWIO_PMIC_ARB_OBS5_CHNL80_CMD_ADDR A:0x2e85000
y.create.l HWIO_PMIC_ARB_OBS5_CHNL81_CMD_ADDR A:0x2e8d000
y.create.l HWIO_PMIC_ARB_OBS5_CHNL82_CMD_ADDR A:0x2e95000
y.create.l HWIO_PMIC_ARB_OBS5_CHNL83_CMD_ADDR A:0x2e9d000
y.create.l HWIO_PMIC_ARB_OBS5_CHNL84_CMD_ADDR A:0x2ea5000
y.create.l HWIO_PMIC_ARB_OBS5_CHNL85_CMD_ADDR A:0x2ead000
y.create.l HWIO_PMIC_ARB_OBS5_CHNL86_CMD_ADDR A:0x2eb5000
y.create.l HWIO_PMIC_ARB_OBS5_CHNL87_CMD_ADDR A:0x2ebd000
y.create.l HWIO_PMIC_ARB_OBS5_CHNL88_CMD_ADDR A:0x2ec5000
y.create.l HWIO_PMIC_ARB_OBS5_CHNL89_CMD_ADDR A:0x2ecd000
y.create.l HWIO_PMIC_ARB_OBS5_CHNL90_CMD_ADDR A:0x2ed5000
y.create.l HWIO_PMIC_ARB_OBS5_CHNL91_CMD_ADDR A:0x2edd000
y.create.l HWIO_PMIC_ARB_OBS5_CHNL92_CMD_ADDR A:0x2ee5000
y.create.l HWIO_PMIC_ARB_OBS5_CHNL93_CMD_ADDR A:0x2eed000
y.create.l HWIO_PMIC_ARB_OBS5_CHNL94_CMD_ADDR A:0x2ef5000
y.create.l HWIO_PMIC_ARB_OBS5_CHNL95_CMD_ADDR A:0x2efd000
y.create.l HWIO_PMIC_ARB_OBS5_CHNL96_CMD_ADDR A:0x2f05000
y.create.l HWIO_PMIC_ARB_OBS5_CHNL97_CMD_ADDR A:0x2f0d000
y.create.l HWIO_PMIC_ARB_OBS5_CHNL98_CMD_ADDR A:0x2f15000
y.create.l HWIO_PMIC_ARB_OBS5_CHNL99_CMD_ADDR A:0x2f1d000
y.create.l HWIO_PMIC_ARB_OBS5_CHNL100_CMD_ADDR A:0x2f25000
y.create.l HWIO_PMIC_ARB_OBS5_CHNL101_CMD_ADDR A:0x2f2d000
y.create.l HWIO_PMIC_ARB_OBS5_CHNL102_CMD_ADDR A:0x2f35000
y.create.l HWIO_PMIC_ARB_OBS5_CHNL103_CMD_ADDR A:0x2f3d000
y.create.l HWIO_PMIC_ARB_OBS5_CHNL104_CMD_ADDR A:0x2f45000
y.create.l HWIO_PMIC_ARB_OBS5_CHNL105_CMD_ADDR A:0x2f4d000
y.create.l HWIO_PMIC_ARB_OBS5_CHNL106_CMD_ADDR A:0x2f55000
y.create.l HWIO_PMIC_ARB_OBS5_CHNL107_CMD_ADDR A:0x2f5d000
y.create.l HWIO_PMIC_ARB_OBS5_CHNL108_CMD_ADDR A:0x2f65000
y.create.l HWIO_PMIC_ARB_OBS5_CHNL109_CMD_ADDR A:0x2f6d000
y.create.l HWIO_PMIC_ARB_OBS5_CHNL110_CMD_ADDR A:0x2f75000
y.create.l HWIO_PMIC_ARB_OBS5_CHNL111_CMD_ADDR A:0x2f7d000
y.create.l HWIO_PMIC_ARB_OBS5_CHNL112_CMD_ADDR A:0x2f85000
y.create.l HWIO_PMIC_ARB_OBS5_CHNL113_CMD_ADDR A:0x2f8d000
y.create.l HWIO_PMIC_ARB_OBS5_CHNL114_CMD_ADDR A:0x2f95000
y.create.l HWIO_PMIC_ARB_OBS5_CHNL115_CMD_ADDR A:0x2f9d000
y.create.l HWIO_PMIC_ARB_OBS5_CHNL116_CMD_ADDR A:0x2fa5000
y.create.l HWIO_PMIC_ARB_OBS5_CHNL117_CMD_ADDR A:0x2fad000
y.create.l HWIO_PMIC_ARB_OBS5_CHNL118_CMD_ADDR A:0x2fb5000
y.create.l HWIO_PMIC_ARB_OBS5_CHNL119_CMD_ADDR A:0x2fbd000
y.create.l HWIO_PMIC_ARB_OBS5_CHNL120_CMD_ADDR A:0x2fc5000
y.create.l HWIO_PMIC_ARB_OBS5_CHNL121_CMD_ADDR A:0x2fcd000
y.create.l HWIO_PMIC_ARB_OBS5_CHNL122_CMD_ADDR A:0x2fd5000
y.create.l HWIO_PMIC_ARB_OBS5_CHNL123_CMD_ADDR A:0x2fdd000
y.create.l HWIO_PMIC_ARB_OBS5_CHNL124_CMD_ADDR A:0x2fe5000
y.create.l HWIO_PMIC_ARB_OBS5_CHNL125_CMD_ADDR A:0x2fed000
y.create.l HWIO_PMIC_ARB_OBS5_CHNL126_CMD_ADDR A:0x2ff5000
y.create.l HWIO_PMIC_ARB_OBS5_CHNL127_CMD_ADDR A:0x2ffd000
y.create.l HWIO_PMIC_ARB_OBS5_CHNL128_CMD_ADDR A:0x3005000
y.create.l HWIO_PMIC_ARB_OBS5_CHNL129_CMD_ADDR A:0x300d000
y.create.l HWIO_PMIC_ARB_OBS5_CHNL130_CMD_ADDR A:0x3015000
y.create.l HWIO_PMIC_ARB_OBS5_CHNL131_CMD_ADDR A:0x301d000
y.create.l HWIO_PMIC_ARB_OBS5_CHNL132_CMD_ADDR A:0x3025000
y.create.l HWIO_PMIC_ARB_OBS5_CHNL133_CMD_ADDR A:0x302d000
y.create.l HWIO_PMIC_ARB_OBS5_CHNL134_CMD_ADDR A:0x3035000
y.create.l HWIO_PMIC_ARB_OBS5_CHNL135_CMD_ADDR A:0x303d000
y.create.l HWIO_PMIC_ARB_OBS5_CHNL136_CMD_ADDR A:0x3045000
y.create.l HWIO_PMIC_ARB_OBS5_CHNL137_CMD_ADDR A:0x304d000
y.create.l HWIO_PMIC_ARB_OBS5_CHNL138_CMD_ADDR A:0x3055000
y.create.l HWIO_PMIC_ARB_OBS5_CHNL139_CMD_ADDR A:0x305d000
y.create.l HWIO_PMIC_ARB_OBS5_CHNL140_CMD_ADDR A:0x3065000
y.create.l HWIO_PMIC_ARB_OBS5_CHNL141_CMD_ADDR A:0x306d000
y.create.l HWIO_PMIC_ARB_OBS5_CHNL142_CMD_ADDR A:0x3075000
y.create.l HWIO_PMIC_ARB_OBS5_CHNL143_CMD_ADDR A:0x307d000
y.create.l HWIO_PMIC_ARB_OBS5_CHNL144_CMD_ADDR A:0x3085000
y.create.l HWIO_PMIC_ARB_OBS5_CHNL145_CMD_ADDR A:0x308d000
y.create.l HWIO_PMIC_ARB_OBS5_CHNL146_CMD_ADDR A:0x3095000
y.create.l HWIO_PMIC_ARB_OBS5_CHNL147_CMD_ADDR A:0x309d000
y.create.l HWIO_PMIC_ARB_OBS5_CHNL148_CMD_ADDR A:0x30a5000
y.create.l HWIO_PMIC_ARB_OBS5_CHNL149_CMD_ADDR A:0x30ad000
y.create.l HWIO_PMIC_ARB_OBS5_CHNL150_CMD_ADDR A:0x30b5000
y.create.l HWIO_PMIC_ARB_OBS5_CHNL151_CMD_ADDR A:0x30bd000
y.create.l HWIO_PMIC_ARB_OBS5_CHNL152_CMD_ADDR A:0x30c5000
y.create.l HWIO_PMIC_ARB_OBS5_CHNL153_CMD_ADDR A:0x30cd000
y.create.l HWIO_PMIC_ARB_OBS5_CHNL154_CMD_ADDR A:0x30d5000
y.create.l HWIO_PMIC_ARB_OBS5_CHNL155_CMD_ADDR A:0x30dd000
y.create.l HWIO_PMIC_ARB_OBS5_CHNL156_CMD_ADDR A:0x30e5000
y.create.l HWIO_PMIC_ARB_OBS5_CHNL157_CMD_ADDR A:0x30ed000
y.create.l HWIO_PMIC_ARB_OBS5_CHNL158_CMD_ADDR A:0x30f5000
y.create.l HWIO_PMIC_ARB_OBS5_CHNL159_CMD_ADDR A:0x30fd000
y.create.l HWIO_PMIC_ARB_OBS5_CHNL160_CMD_ADDR A:0x3105000
y.create.l HWIO_PMIC_ARB_OBS5_CHNL161_CMD_ADDR A:0x310d000
y.create.l HWIO_PMIC_ARB_OBS5_CHNL162_CMD_ADDR A:0x3115000
y.create.l HWIO_PMIC_ARB_OBS5_CHNL163_CMD_ADDR A:0x311d000
y.create.l HWIO_PMIC_ARB_OBS5_CHNL164_CMD_ADDR A:0x3125000
y.create.l HWIO_PMIC_ARB_OBS5_CHNL165_CMD_ADDR A:0x312d000
y.create.l HWIO_PMIC_ARB_OBS5_CHNL166_CMD_ADDR A:0x3135000
y.create.l HWIO_PMIC_ARB_OBS5_CHNL167_CMD_ADDR A:0x313d000
y.create.l HWIO_PMIC_ARB_OBS5_CHNL168_CMD_ADDR A:0x3145000
y.create.l HWIO_PMIC_ARB_OBS5_CHNL169_CMD_ADDR A:0x314d000
y.create.l HWIO_PMIC_ARB_OBS5_CHNL170_CMD_ADDR A:0x3155000
y.create.l HWIO_PMIC_ARB_OBS5_CHNL171_CMD_ADDR A:0x315d000
y.create.l HWIO_PMIC_ARB_OBS5_CHNL172_CMD_ADDR A:0x3165000
y.create.l HWIO_PMIC_ARB_OBS5_CHNL173_CMD_ADDR A:0x316d000
y.create.l HWIO_PMIC_ARB_OBS5_CHNL174_CMD_ADDR A:0x3175000
y.create.l HWIO_PMIC_ARB_OBS5_CHNL175_CMD_ADDR A:0x317d000
y.create.l HWIO_PMIC_ARB_OBS5_CHNL176_CMD_ADDR A:0x3185000
y.create.l HWIO_PMIC_ARB_OBS5_CHNL177_CMD_ADDR A:0x318d000
y.create.l HWIO_PMIC_ARB_OBS5_CHNL178_CMD_ADDR A:0x3195000
y.create.l HWIO_PMIC_ARB_OBS5_CHNL179_CMD_ADDR A:0x319d000
y.create.l HWIO_PMIC_ARB_OBS5_CHNL180_CMD_ADDR A:0x31a5000
y.create.l HWIO_PMIC_ARB_OBS5_CHNL181_CMD_ADDR A:0x31ad000
y.create.l HWIO_PMIC_ARB_OBS5_CHNL182_CMD_ADDR A:0x31b5000
y.create.l HWIO_PMIC_ARB_OBS5_CHNL183_CMD_ADDR A:0x31bd000
y.create.l HWIO_PMIC_ARB_OBS5_CHNL184_CMD_ADDR A:0x31c5000
y.create.l HWIO_PMIC_ARB_OBS5_CHNL185_CMD_ADDR A:0x31cd000
y.create.l HWIO_PMIC_ARB_OBS5_CHNL186_CMD_ADDR A:0x31d5000
y.create.l HWIO_PMIC_ARB_OBS5_CHNL187_CMD_ADDR A:0x31dd000
y.create.l HWIO_PMIC_ARB_OBS5_CHNL188_CMD_ADDR A:0x31e5000
y.create.l HWIO_PMIC_ARB_OBS5_CHNL189_CMD_ADDR A:0x31ed000
y.create.l HWIO_PMIC_ARB_OBS5_CHNL190_CMD_ADDR A:0x31f5000
y.create.l HWIO_PMIC_ARB_OBS5_CHNL191_CMD_ADDR A:0x31fd000
y.create.l HWIO_PMIC_ARB_OBS5_CHNL192_CMD_ADDR A:0x3205000
y.create.l HWIO_PMIC_ARB_OBS5_CHNL193_CMD_ADDR A:0x320d000
y.create.l HWIO_PMIC_ARB_OBS5_CHNL194_CMD_ADDR A:0x3215000
y.create.l HWIO_PMIC_ARB_OBS5_CHNL195_CMD_ADDR A:0x321d000
y.create.l HWIO_PMIC_ARB_OBS5_CHNL196_CMD_ADDR A:0x3225000
y.create.l HWIO_PMIC_ARB_OBS5_CHNL197_CMD_ADDR A:0x322d000
y.create.l HWIO_PMIC_ARB_OBS5_CHNL198_CMD_ADDR A:0x3235000
y.create.l HWIO_PMIC_ARB_OBS5_CHNL199_CMD_ADDR A:0x323d000
y.create.l HWIO_PMIC_ARB_OBS5_CHNL200_CMD_ADDR A:0x3245000
y.create.l HWIO_PMIC_ARB_OBS5_CHNL201_CMD_ADDR A:0x324d000
y.create.l HWIO_PMIC_ARB_OBS5_CHNL202_CMD_ADDR A:0x3255000
y.create.l HWIO_PMIC_ARB_OBS5_CHNL203_CMD_ADDR A:0x325d000
y.create.l HWIO_PMIC_ARB_OBS5_CHNL204_CMD_ADDR A:0x3265000
y.create.l HWIO_PMIC_ARB_OBS5_CHNL205_CMD_ADDR A:0x326d000
y.create.l HWIO_PMIC_ARB_OBS5_CHNL206_CMD_ADDR A:0x3275000
y.create.l HWIO_PMIC_ARB_OBS5_CHNL207_CMD_ADDR A:0x327d000
y.create.l HWIO_PMIC_ARB_OBS5_CHNL208_CMD_ADDR A:0x3285000
y.create.l HWIO_PMIC_ARB_OBS5_CHNL209_CMD_ADDR A:0x328d000
y.create.l HWIO_PMIC_ARB_OBS5_CHNL210_CMD_ADDR A:0x3295000
y.create.l HWIO_PMIC_ARB_OBS5_CHNL211_CMD_ADDR A:0x329d000
y.create.l HWIO_PMIC_ARB_OBS5_CHNL212_CMD_ADDR A:0x32a5000
y.create.l HWIO_PMIC_ARB_OBS5_CHNL213_CMD_ADDR A:0x32ad000
y.create.l HWIO_PMIC_ARB_OBS5_CHNL214_CMD_ADDR A:0x32b5000
y.create.l HWIO_PMIC_ARB_OBS5_CHNL215_CMD_ADDR A:0x32bd000
y.create.l HWIO_PMIC_ARB_OBS5_CHNL216_CMD_ADDR A:0x32c5000
y.create.l HWIO_PMIC_ARB_OBS5_CHNL217_CMD_ADDR A:0x32cd000
y.create.l HWIO_PMIC_ARB_OBS5_CHNL218_CMD_ADDR A:0x32d5000
y.create.l HWIO_PMIC_ARB_OBS5_CHNL219_CMD_ADDR A:0x32dd000
y.create.l HWIO_PMIC_ARB_OBS5_CHNL220_CMD_ADDR A:0x32e5000
y.create.l HWIO_PMIC_ARB_OBS5_CHNL221_CMD_ADDR A:0x32ed000
y.create.l HWIO_PMIC_ARB_OBS5_CHNL222_CMD_ADDR A:0x32f5000
y.create.l HWIO_PMIC_ARB_OBS5_CHNL223_CMD_ADDR A:0x32fd000
y.create.l HWIO_PMIC_ARB_OBS5_CHNL224_CMD_ADDR A:0x3305000
y.create.l HWIO_PMIC_ARB_OBS5_CHNL225_CMD_ADDR A:0x330d000
y.create.l HWIO_PMIC_ARB_OBS5_CHNL226_CMD_ADDR A:0x3315000
y.create.l HWIO_PMIC_ARB_OBS5_CHNL227_CMD_ADDR A:0x331d000
y.create.l HWIO_PMIC_ARB_OBS5_CHNL228_CMD_ADDR A:0x3325000
y.create.l HWIO_PMIC_ARB_OBS5_CHNL229_CMD_ADDR A:0x332d000
y.create.l HWIO_PMIC_ARB_OBS5_CHNL230_CMD_ADDR A:0x3335000
y.create.l HWIO_PMIC_ARB_OBS5_CHNL231_CMD_ADDR A:0x333d000
y.create.l HWIO_PMIC_ARB_OBS5_CHNL232_CMD_ADDR A:0x3345000
y.create.l HWIO_PMIC_ARB_OBS5_CHNL233_CMD_ADDR A:0x334d000
y.create.l HWIO_PMIC_ARB_OBS5_CHNL234_CMD_ADDR A:0x3355000
y.create.l HWIO_PMIC_ARB_OBS5_CHNL235_CMD_ADDR A:0x335d000
y.create.l HWIO_PMIC_ARB_OBS5_CHNL236_CMD_ADDR A:0x3365000
y.create.l HWIO_PMIC_ARB_OBS5_CHNL237_CMD_ADDR A:0x336d000
y.create.l HWIO_PMIC_ARB_OBS5_CHNL238_CMD_ADDR A:0x3375000
y.create.l HWIO_PMIC_ARB_OBS5_CHNL239_CMD_ADDR A:0x337d000
y.create.l HWIO_PMIC_ARB_OBS5_CHNL240_CMD_ADDR A:0x3385000
y.create.l HWIO_PMIC_ARB_OBS5_CHNL241_CMD_ADDR A:0x338d000
y.create.l HWIO_PMIC_ARB_OBS5_CHNL242_CMD_ADDR A:0x3395000
y.create.l HWIO_PMIC_ARB_OBS5_CHNL243_CMD_ADDR A:0x339d000
y.create.l HWIO_PMIC_ARB_OBS5_CHNL244_CMD_ADDR A:0x33a5000
y.create.l HWIO_PMIC_ARB_OBS5_CHNL245_CMD_ADDR A:0x33ad000
y.create.l HWIO_PMIC_ARB_OBS5_CHNL246_CMD_ADDR A:0x33b5000
y.create.l HWIO_PMIC_ARB_OBS5_CHNL247_CMD_ADDR A:0x33bd000
y.create.l HWIO_PMIC_ARB_OBS5_CHNL248_CMD_ADDR A:0x33c5000
y.create.l HWIO_PMIC_ARB_OBS5_CHNL249_CMD_ADDR A:0x33cd000
y.create.l HWIO_PMIC_ARB_OBS5_CHNL250_CMD_ADDR A:0x33d5000
y.create.l HWIO_PMIC_ARB_OBS5_CHNL251_CMD_ADDR A:0x33dd000
y.create.l HWIO_PMIC_ARB_OBS5_CHNL252_CMD_ADDR A:0x33e5000
y.create.l HWIO_PMIC_ARB_OBS5_CHNL253_CMD_ADDR A:0x33ed000
y.create.l HWIO_PMIC_ARB_OBS5_CHNL254_CMD_ADDR A:0x33f5000
y.create.l HWIO_PMIC_ARB_OBS5_CHNL255_CMD_ADDR A:0x33fd000
y.create.l HWIO_PMIC_ARB_OBS6_CHNL0_CMD_ADDR A:0x2c06000
y.create.l HWIO_PMIC_ARB_OBS6_CHNL1_CMD_ADDR A:0x2c0e000
y.create.l HWIO_PMIC_ARB_OBS6_CHNL2_CMD_ADDR A:0x2c16000
y.create.l HWIO_PMIC_ARB_OBS6_CHNL3_CMD_ADDR A:0x2c1e000
y.create.l HWIO_PMIC_ARB_OBS6_CHNL4_CMD_ADDR A:0x2c26000
y.create.l HWIO_PMIC_ARB_OBS6_CHNL5_CMD_ADDR A:0x2c2e000
y.create.l HWIO_PMIC_ARB_OBS6_CHNL6_CMD_ADDR A:0x2c36000
y.create.l HWIO_PMIC_ARB_OBS6_CHNL7_CMD_ADDR A:0x2c3e000
y.create.l HWIO_PMIC_ARB_OBS6_CHNL8_CMD_ADDR A:0x2c46000
y.create.l HWIO_PMIC_ARB_OBS6_CHNL9_CMD_ADDR A:0x2c4e000
y.create.l HWIO_PMIC_ARB_OBS6_CHNL10_CMD_ADDR A:0x2c56000
y.create.l HWIO_PMIC_ARB_OBS6_CHNL11_CMD_ADDR A:0x2c5e000
y.create.l HWIO_PMIC_ARB_OBS6_CHNL12_CMD_ADDR A:0x2c66000
y.create.l HWIO_PMIC_ARB_OBS6_CHNL13_CMD_ADDR A:0x2c6e000
y.create.l HWIO_PMIC_ARB_OBS6_CHNL14_CMD_ADDR A:0x2c76000
y.create.l HWIO_PMIC_ARB_OBS6_CHNL15_CMD_ADDR A:0x2c7e000
y.create.l HWIO_PMIC_ARB_OBS6_CHNL16_CMD_ADDR A:0x2c86000
y.create.l HWIO_PMIC_ARB_OBS6_CHNL17_CMD_ADDR A:0x2c8e000
y.create.l HWIO_PMIC_ARB_OBS6_CHNL18_CMD_ADDR A:0x2c96000
y.create.l HWIO_PMIC_ARB_OBS6_CHNL19_CMD_ADDR A:0x2c9e000
y.create.l HWIO_PMIC_ARB_OBS6_CHNL20_CMD_ADDR A:0x2ca6000
y.create.l HWIO_PMIC_ARB_OBS6_CHNL21_CMD_ADDR A:0x2cae000
y.create.l HWIO_PMIC_ARB_OBS6_CHNL22_CMD_ADDR A:0x2cb6000
y.create.l HWIO_PMIC_ARB_OBS6_CHNL23_CMD_ADDR A:0x2cbe000
y.create.l HWIO_PMIC_ARB_OBS6_CHNL24_CMD_ADDR A:0x2cc6000
y.create.l HWIO_PMIC_ARB_OBS6_CHNL25_CMD_ADDR A:0x2cce000
y.create.l HWIO_PMIC_ARB_OBS6_CHNL26_CMD_ADDR A:0x2cd6000
y.create.l HWIO_PMIC_ARB_OBS6_CHNL27_CMD_ADDR A:0x2cde000
y.create.l HWIO_PMIC_ARB_OBS6_CHNL28_CMD_ADDR A:0x2ce6000
y.create.l HWIO_PMIC_ARB_OBS6_CHNL29_CMD_ADDR A:0x2cee000
y.create.l HWIO_PMIC_ARB_OBS6_CHNL30_CMD_ADDR A:0x2cf6000
y.create.l HWIO_PMIC_ARB_OBS6_CHNL31_CMD_ADDR A:0x2cfe000
y.create.l HWIO_PMIC_ARB_OBS6_CHNL32_CMD_ADDR A:0x2d06000
y.create.l HWIO_PMIC_ARB_OBS6_CHNL33_CMD_ADDR A:0x2d0e000
y.create.l HWIO_PMIC_ARB_OBS6_CHNL34_CMD_ADDR A:0x2d16000
y.create.l HWIO_PMIC_ARB_OBS6_CHNL35_CMD_ADDR A:0x2d1e000
y.create.l HWIO_PMIC_ARB_OBS6_CHNL36_CMD_ADDR A:0x2d26000
y.create.l HWIO_PMIC_ARB_OBS6_CHNL37_CMD_ADDR A:0x2d2e000
y.create.l HWIO_PMIC_ARB_OBS6_CHNL38_CMD_ADDR A:0x2d36000
y.create.l HWIO_PMIC_ARB_OBS6_CHNL39_CMD_ADDR A:0x2d3e000
y.create.l HWIO_PMIC_ARB_OBS6_CHNL40_CMD_ADDR A:0x2d46000
y.create.l HWIO_PMIC_ARB_OBS6_CHNL41_CMD_ADDR A:0x2d4e000
y.create.l HWIO_PMIC_ARB_OBS6_CHNL42_CMD_ADDR A:0x2d56000
y.create.l HWIO_PMIC_ARB_OBS6_CHNL43_CMD_ADDR A:0x2d5e000
y.create.l HWIO_PMIC_ARB_OBS6_CHNL44_CMD_ADDR A:0x2d66000
y.create.l HWIO_PMIC_ARB_OBS6_CHNL45_CMD_ADDR A:0x2d6e000
y.create.l HWIO_PMIC_ARB_OBS6_CHNL46_CMD_ADDR A:0x2d76000
y.create.l HWIO_PMIC_ARB_OBS6_CHNL47_CMD_ADDR A:0x2d7e000
y.create.l HWIO_PMIC_ARB_OBS6_CHNL48_CMD_ADDR A:0x2d86000
y.create.l HWIO_PMIC_ARB_OBS6_CHNL49_CMD_ADDR A:0x2d8e000
y.create.l HWIO_PMIC_ARB_OBS6_CHNL50_CMD_ADDR A:0x2d96000
y.create.l HWIO_PMIC_ARB_OBS6_CHNL51_CMD_ADDR A:0x2d9e000
y.create.l HWIO_PMIC_ARB_OBS6_CHNL52_CMD_ADDR A:0x2da6000
y.create.l HWIO_PMIC_ARB_OBS6_CHNL53_CMD_ADDR A:0x2dae000
y.create.l HWIO_PMIC_ARB_OBS6_CHNL54_CMD_ADDR A:0x2db6000
y.create.l HWIO_PMIC_ARB_OBS6_CHNL55_CMD_ADDR A:0x2dbe000
y.create.l HWIO_PMIC_ARB_OBS6_CHNL56_CMD_ADDR A:0x2dc6000
y.create.l HWIO_PMIC_ARB_OBS6_CHNL57_CMD_ADDR A:0x2dce000
y.create.l HWIO_PMIC_ARB_OBS6_CHNL58_CMD_ADDR A:0x2dd6000
y.create.l HWIO_PMIC_ARB_OBS6_CHNL59_CMD_ADDR A:0x2dde000
y.create.l HWIO_PMIC_ARB_OBS6_CHNL60_CMD_ADDR A:0x2de6000
y.create.l HWIO_PMIC_ARB_OBS6_CHNL61_CMD_ADDR A:0x2dee000
y.create.l HWIO_PMIC_ARB_OBS6_CHNL62_CMD_ADDR A:0x2df6000
y.create.l HWIO_PMIC_ARB_OBS6_CHNL63_CMD_ADDR A:0x2dfe000
y.create.l HWIO_PMIC_ARB_OBS6_CHNL64_CMD_ADDR A:0x2e06000
y.create.l HWIO_PMIC_ARB_OBS6_CHNL65_CMD_ADDR A:0x2e0e000
y.create.l HWIO_PMIC_ARB_OBS6_CHNL66_CMD_ADDR A:0x2e16000
y.create.l HWIO_PMIC_ARB_OBS6_CHNL67_CMD_ADDR A:0x2e1e000
y.create.l HWIO_PMIC_ARB_OBS6_CHNL68_CMD_ADDR A:0x2e26000
y.create.l HWIO_PMIC_ARB_OBS6_CHNL69_CMD_ADDR A:0x2e2e000
y.create.l HWIO_PMIC_ARB_OBS6_CHNL70_CMD_ADDR A:0x2e36000
y.create.l HWIO_PMIC_ARB_OBS6_CHNL71_CMD_ADDR A:0x2e3e000
y.create.l HWIO_PMIC_ARB_OBS6_CHNL72_CMD_ADDR A:0x2e46000
y.create.l HWIO_PMIC_ARB_OBS6_CHNL73_CMD_ADDR A:0x2e4e000
y.create.l HWIO_PMIC_ARB_OBS6_CHNL74_CMD_ADDR A:0x2e56000
y.create.l HWIO_PMIC_ARB_OBS6_CHNL75_CMD_ADDR A:0x2e5e000
y.create.l HWIO_PMIC_ARB_OBS6_CHNL76_CMD_ADDR A:0x2e66000
y.create.l HWIO_PMIC_ARB_OBS6_CHNL77_CMD_ADDR A:0x2e6e000
y.create.l HWIO_PMIC_ARB_OBS6_CHNL78_CMD_ADDR A:0x2e76000
y.create.l HWIO_PMIC_ARB_OBS6_CHNL79_CMD_ADDR A:0x2e7e000
y.create.l HWIO_PMIC_ARB_OBS6_CHNL80_CMD_ADDR A:0x2e86000
y.create.l HWIO_PMIC_ARB_OBS6_CHNL81_CMD_ADDR A:0x2e8e000
y.create.l HWIO_PMIC_ARB_OBS6_CHNL82_CMD_ADDR A:0x2e96000
y.create.l HWIO_PMIC_ARB_OBS6_CHNL83_CMD_ADDR A:0x2e9e000
y.create.l HWIO_PMIC_ARB_OBS6_CHNL84_CMD_ADDR A:0x2ea6000
y.create.l HWIO_PMIC_ARB_OBS6_CHNL85_CMD_ADDR A:0x2eae000
y.create.l HWIO_PMIC_ARB_OBS6_CHNL86_CMD_ADDR A:0x2eb6000
y.create.l HWIO_PMIC_ARB_OBS6_CHNL87_CMD_ADDR A:0x2ebe000
y.create.l HWIO_PMIC_ARB_OBS6_CHNL88_CMD_ADDR A:0x2ec6000
y.create.l HWIO_PMIC_ARB_OBS6_CHNL89_CMD_ADDR A:0x2ece000
y.create.l HWIO_PMIC_ARB_OBS6_CHNL90_CMD_ADDR A:0x2ed6000
y.create.l HWIO_PMIC_ARB_OBS6_CHNL91_CMD_ADDR A:0x2ede000
y.create.l HWIO_PMIC_ARB_OBS6_CHNL92_CMD_ADDR A:0x2ee6000
y.create.l HWIO_PMIC_ARB_OBS6_CHNL93_CMD_ADDR A:0x2eee000
y.create.l HWIO_PMIC_ARB_OBS6_CHNL94_CMD_ADDR A:0x2ef6000
y.create.l HWIO_PMIC_ARB_OBS6_CHNL95_CMD_ADDR A:0x2efe000
y.create.l HWIO_PMIC_ARB_OBS6_CHNL96_CMD_ADDR A:0x2f06000
y.create.l HWIO_PMIC_ARB_OBS6_CHNL97_CMD_ADDR A:0x2f0e000
y.create.l HWIO_PMIC_ARB_OBS6_CHNL98_CMD_ADDR A:0x2f16000
y.create.l HWIO_PMIC_ARB_OBS6_CHNL99_CMD_ADDR A:0x2f1e000
y.create.l HWIO_PMIC_ARB_OBS6_CHNL100_CMD_ADDR A:0x2f26000
y.create.l HWIO_PMIC_ARB_OBS6_CHNL101_CMD_ADDR A:0x2f2e000
y.create.l HWIO_PMIC_ARB_OBS6_CHNL102_CMD_ADDR A:0x2f36000
y.create.l HWIO_PMIC_ARB_OBS6_CHNL103_CMD_ADDR A:0x2f3e000
y.create.l HWIO_PMIC_ARB_OBS6_CHNL104_CMD_ADDR A:0x2f46000
y.create.l HWIO_PMIC_ARB_OBS6_CHNL105_CMD_ADDR A:0x2f4e000
y.create.l HWIO_PMIC_ARB_OBS6_CHNL106_CMD_ADDR A:0x2f56000
y.create.l HWIO_PMIC_ARB_OBS6_CHNL107_CMD_ADDR A:0x2f5e000
y.create.l HWIO_PMIC_ARB_OBS6_CHNL108_CMD_ADDR A:0x2f66000
y.create.l HWIO_PMIC_ARB_OBS6_CHNL109_CMD_ADDR A:0x2f6e000
y.create.l HWIO_PMIC_ARB_OBS6_CHNL110_CMD_ADDR A:0x2f76000
y.create.l HWIO_PMIC_ARB_OBS6_CHNL111_CMD_ADDR A:0x2f7e000
y.create.l HWIO_PMIC_ARB_OBS6_CHNL112_CMD_ADDR A:0x2f86000
y.create.l HWIO_PMIC_ARB_OBS6_CHNL113_CMD_ADDR A:0x2f8e000
y.create.l HWIO_PMIC_ARB_OBS6_CHNL114_CMD_ADDR A:0x2f96000
y.create.l HWIO_PMIC_ARB_OBS6_CHNL115_CMD_ADDR A:0x2f9e000
y.create.l HWIO_PMIC_ARB_OBS6_CHNL116_CMD_ADDR A:0x2fa6000
y.create.l HWIO_PMIC_ARB_OBS6_CHNL117_CMD_ADDR A:0x2fae000
y.create.l HWIO_PMIC_ARB_OBS6_CHNL118_CMD_ADDR A:0x2fb6000
y.create.l HWIO_PMIC_ARB_OBS6_CHNL119_CMD_ADDR A:0x2fbe000
y.create.l HWIO_PMIC_ARB_OBS6_CHNL120_CMD_ADDR A:0x2fc6000
y.create.l HWIO_PMIC_ARB_OBS6_CHNL121_CMD_ADDR A:0x2fce000
y.create.l HWIO_PMIC_ARB_OBS6_CHNL122_CMD_ADDR A:0x2fd6000
y.create.l HWIO_PMIC_ARB_OBS6_CHNL123_CMD_ADDR A:0x2fde000
y.create.l HWIO_PMIC_ARB_OBS6_CHNL124_CMD_ADDR A:0x2fe6000
y.create.l HWIO_PMIC_ARB_OBS6_CHNL125_CMD_ADDR A:0x2fee000
y.create.l HWIO_PMIC_ARB_OBS6_CHNL126_CMD_ADDR A:0x2ff6000
y.create.l HWIO_PMIC_ARB_OBS6_CHNL127_CMD_ADDR A:0x2ffe000
y.create.l HWIO_PMIC_ARB_OBS6_CHNL128_CMD_ADDR A:0x3006000
y.create.l HWIO_PMIC_ARB_OBS6_CHNL129_CMD_ADDR A:0x300e000
y.create.l HWIO_PMIC_ARB_OBS6_CHNL130_CMD_ADDR A:0x3016000
y.create.l HWIO_PMIC_ARB_OBS6_CHNL131_CMD_ADDR A:0x301e000
y.create.l HWIO_PMIC_ARB_OBS6_CHNL132_CMD_ADDR A:0x3026000
y.create.l HWIO_PMIC_ARB_OBS6_CHNL133_CMD_ADDR A:0x302e000
y.create.l HWIO_PMIC_ARB_OBS6_CHNL134_CMD_ADDR A:0x3036000
y.create.l HWIO_PMIC_ARB_OBS6_CHNL135_CMD_ADDR A:0x303e000
y.create.l HWIO_PMIC_ARB_OBS6_CHNL136_CMD_ADDR A:0x3046000
y.create.l HWIO_PMIC_ARB_OBS6_CHNL137_CMD_ADDR A:0x304e000
y.create.l HWIO_PMIC_ARB_OBS6_CHNL138_CMD_ADDR A:0x3056000
y.create.l HWIO_PMIC_ARB_OBS6_CHNL139_CMD_ADDR A:0x305e000
y.create.l HWIO_PMIC_ARB_OBS6_CHNL140_CMD_ADDR A:0x3066000
y.create.l HWIO_PMIC_ARB_OBS6_CHNL141_CMD_ADDR A:0x306e000
y.create.l HWIO_PMIC_ARB_OBS6_CHNL142_CMD_ADDR A:0x3076000
y.create.l HWIO_PMIC_ARB_OBS6_CHNL143_CMD_ADDR A:0x307e000
y.create.l HWIO_PMIC_ARB_OBS6_CHNL144_CMD_ADDR A:0x3086000
y.create.l HWIO_PMIC_ARB_OBS6_CHNL145_CMD_ADDR A:0x308e000
y.create.l HWIO_PMIC_ARB_OBS6_CHNL146_CMD_ADDR A:0x3096000
y.create.l HWIO_PMIC_ARB_OBS6_CHNL147_CMD_ADDR A:0x309e000
y.create.l HWIO_PMIC_ARB_OBS6_CHNL148_CMD_ADDR A:0x30a6000
y.create.l HWIO_PMIC_ARB_OBS6_CHNL149_CMD_ADDR A:0x30ae000
y.create.l HWIO_PMIC_ARB_OBS6_CHNL150_CMD_ADDR A:0x30b6000
y.create.l HWIO_PMIC_ARB_OBS6_CHNL151_CMD_ADDR A:0x30be000
y.create.l HWIO_PMIC_ARB_OBS6_CHNL152_CMD_ADDR A:0x30c6000
y.create.l HWIO_PMIC_ARB_OBS6_CHNL153_CMD_ADDR A:0x30ce000
y.create.l HWIO_PMIC_ARB_OBS6_CHNL154_CMD_ADDR A:0x30d6000
y.create.l HWIO_PMIC_ARB_OBS6_CHNL155_CMD_ADDR A:0x30de000
y.create.l HWIO_PMIC_ARB_OBS6_CHNL156_CMD_ADDR A:0x30e6000
y.create.l HWIO_PMIC_ARB_OBS6_CHNL157_CMD_ADDR A:0x30ee000
y.create.l HWIO_PMIC_ARB_OBS6_CHNL158_CMD_ADDR A:0x30f6000
y.create.l HWIO_PMIC_ARB_OBS6_CHNL159_CMD_ADDR A:0x30fe000
y.create.l HWIO_PMIC_ARB_OBS6_CHNL160_CMD_ADDR A:0x3106000
y.create.l HWIO_PMIC_ARB_OBS6_CHNL161_CMD_ADDR A:0x310e000
y.create.l HWIO_PMIC_ARB_OBS6_CHNL162_CMD_ADDR A:0x3116000
y.create.l HWIO_PMIC_ARB_OBS6_CHNL163_CMD_ADDR A:0x311e000
y.create.l HWIO_PMIC_ARB_OBS6_CHNL164_CMD_ADDR A:0x3126000
y.create.l HWIO_PMIC_ARB_OBS6_CHNL165_CMD_ADDR A:0x312e000
y.create.l HWIO_PMIC_ARB_OBS6_CHNL166_CMD_ADDR A:0x3136000
y.create.l HWIO_PMIC_ARB_OBS6_CHNL167_CMD_ADDR A:0x313e000
y.create.l HWIO_PMIC_ARB_OBS6_CHNL168_CMD_ADDR A:0x3146000
y.create.l HWIO_PMIC_ARB_OBS6_CHNL169_CMD_ADDR A:0x314e000
y.create.l HWIO_PMIC_ARB_OBS6_CHNL170_CMD_ADDR A:0x3156000
y.create.l HWIO_PMIC_ARB_OBS6_CHNL171_CMD_ADDR A:0x315e000
y.create.l HWIO_PMIC_ARB_OBS6_CHNL172_CMD_ADDR A:0x3166000
y.create.l HWIO_PMIC_ARB_OBS6_CHNL173_CMD_ADDR A:0x316e000
y.create.l HWIO_PMIC_ARB_OBS6_CHNL174_CMD_ADDR A:0x3176000
y.create.l HWIO_PMIC_ARB_OBS6_CHNL175_CMD_ADDR A:0x317e000
y.create.l HWIO_PMIC_ARB_OBS6_CHNL176_CMD_ADDR A:0x3186000
y.create.l HWIO_PMIC_ARB_OBS6_CHNL177_CMD_ADDR A:0x318e000
y.create.l HWIO_PMIC_ARB_OBS6_CHNL178_CMD_ADDR A:0x3196000
y.create.l HWIO_PMIC_ARB_OBS6_CHNL179_CMD_ADDR A:0x319e000
y.create.l HWIO_PMIC_ARB_OBS6_CHNL180_CMD_ADDR A:0x31a6000
y.create.l HWIO_PMIC_ARB_OBS6_CHNL181_CMD_ADDR A:0x31ae000
y.create.l HWIO_PMIC_ARB_OBS6_CHNL182_CMD_ADDR A:0x31b6000
y.create.l HWIO_PMIC_ARB_OBS6_CHNL183_CMD_ADDR A:0x31be000
y.create.l HWIO_PMIC_ARB_OBS6_CHNL184_CMD_ADDR A:0x31c6000
y.create.l HWIO_PMIC_ARB_OBS6_CHNL185_CMD_ADDR A:0x31ce000
y.create.l HWIO_PMIC_ARB_OBS6_CHNL186_CMD_ADDR A:0x31d6000
y.create.l HWIO_PMIC_ARB_OBS6_CHNL187_CMD_ADDR A:0x31de000
y.create.l HWIO_PMIC_ARB_OBS6_CHNL188_CMD_ADDR A:0x31e6000
y.create.l HWIO_PMIC_ARB_OBS6_CHNL189_CMD_ADDR A:0x31ee000
y.create.l HWIO_PMIC_ARB_OBS6_CHNL190_CMD_ADDR A:0x31f6000
y.create.l HWIO_PMIC_ARB_OBS6_CHNL191_CMD_ADDR A:0x31fe000
y.create.l HWIO_PMIC_ARB_OBS6_CHNL192_CMD_ADDR A:0x3206000
y.create.l HWIO_PMIC_ARB_OBS6_CHNL193_CMD_ADDR A:0x320e000
y.create.l HWIO_PMIC_ARB_OBS6_CHNL194_CMD_ADDR A:0x3216000
y.create.l HWIO_PMIC_ARB_OBS6_CHNL195_CMD_ADDR A:0x321e000
y.create.l HWIO_PMIC_ARB_OBS6_CHNL196_CMD_ADDR A:0x3226000
y.create.l HWIO_PMIC_ARB_OBS6_CHNL197_CMD_ADDR A:0x322e000
y.create.l HWIO_PMIC_ARB_OBS6_CHNL198_CMD_ADDR A:0x3236000
y.create.l HWIO_PMIC_ARB_OBS6_CHNL199_CMD_ADDR A:0x323e000
y.create.l HWIO_PMIC_ARB_OBS6_CHNL200_CMD_ADDR A:0x3246000
y.create.l HWIO_PMIC_ARB_OBS6_CHNL201_CMD_ADDR A:0x324e000
y.create.l HWIO_PMIC_ARB_OBS6_CHNL202_CMD_ADDR A:0x3256000
y.create.l HWIO_PMIC_ARB_OBS6_CHNL203_CMD_ADDR A:0x325e000
y.create.l HWIO_PMIC_ARB_OBS6_CHNL204_CMD_ADDR A:0x3266000
y.create.l HWIO_PMIC_ARB_OBS6_CHNL205_CMD_ADDR A:0x326e000
y.create.l HWIO_PMIC_ARB_OBS6_CHNL206_CMD_ADDR A:0x3276000
y.create.l HWIO_PMIC_ARB_OBS6_CHNL207_CMD_ADDR A:0x327e000
y.create.l HWIO_PMIC_ARB_OBS6_CHNL208_CMD_ADDR A:0x3286000
y.create.l HWIO_PMIC_ARB_OBS6_CHNL209_CMD_ADDR A:0x328e000
y.create.l HWIO_PMIC_ARB_OBS6_CHNL210_CMD_ADDR A:0x3296000
y.create.l HWIO_PMIC_ARB_OBS6_CHNL211_CMD_ADDR A:0x329e000
y.create.l HWIO_PMIC_ARB_OBS6_CHNL212_CMD_ADDR A:0x32a6000
y.create.l HWIO_PMIC_ARB_OBS6_CHNL213_CMD_ADDR A:0x32ae000
y.create.l HWIO_PMIC_ARB_OBS6_CHNL214_CMD_ADDR A:0x32b6000
y.create.l HWIO_PMIC_ARB_OBS6_CHNL215_CMD_ADDR A:0x32be000
y.create.l HWIO_PMIC_ARB_OBS6_CHNL216_CMD_ADDR A:0x32c6000
y.create.l HWIO_PMIC_ARB_OBS6_CHNL217_CMD_ADDR A:0x32ce000
y.create.l HWIO_PMIC_ARB_OBS6_CHNL218_CMD_ADDR A:0x32d6000
y.create.l HWIO_PMIC_ARB_OBS6_CHNL219_CMD_ADDR A:0x32de000
y.create.l HWIO_PMIC_ARB_OBS6_CHNL220_CMD_ADDR A:0x32e6000
y.create.l HWIO_PMIC_ARB_OBS6_CHNL221_CMD_ADDR A:0x32ee000
y.create.l HWIO_PMIC_ARB_OBS6_CHNL222_CMD_ADDR A:0x32f6000
y.create.l HWIO_PMIC_ARB_OBS6_CHNL223_CMD_ADDR A:0x32fe000
y.create.l HWIO_PMIC_ARB_OBS6_CHNL224_CMD_ADDR A:0x3306000
y.create.l HWIO_PMIC_ARB_OBS6_CHNL225_CMD_ADDR A:0x330e000
y.create.l HWIO_PMIC_ARB_OBS6_CHNL226_CMD_ADDR A:0x3316000
y.create.l HWIO_PMIC_ARB_OBS6_CHNL227_CMD_ADDR A:0x331e000
y.create.l HWIO_PMIC_ARB_OBS6_CHNL228_CMD_ADDR A:0x3326000
y.create.l HWIO_PMIC_ARB_OBS6_CHNL229_CMD_ADDR A:0x332e000
y.create.l HWIO_PMIC_ARB_OBS6_CHNL230_CMD_ADDR A:0x3336000
y.create.l HWIO_PMIC_ARB_OBS6_CHNL231_CMD_ADDR A:0x333e000
y.create.l HWIO_PMIC_ARB_OBS6_CHNL232_CMD_ADDR A:0x3346000
y.create.l HWIO_PMIC_ARB_OBS6_CHNL233_CMD_ADDR A:0x334e000
y.create.l HWIO_PMIC_ARB_OBS6_CHNL234_CMD_ADDR A:0x3356000
y.create.l HWIO_PMIC_ARB_OBS6_CHNL235_CMD_ADDR A:0x335e000
y.create.l HWIO_PMIC_ARB_OBS6_CHNL236_CMD_ADDR A:0x3366000
y.create.l HWIO_PMIC_ARB_OBS6_CHNL237_CMD_ADDR A:0x336e000
y.create.l HWIO_PMIC_ARB_OBS6_CHNL238_CMD_ADDR A:0x3376000
y.create.l HWIO_PMIC_ARB_OBS6_CHNL239_CMD_ADDR A:0x337e000
y.create.l HWIO_PMIC_ARB_OBS6_CHNL240_CMD_ADDR A:0x3386000
y.create.l HWIO_PMIC_ARB_OBS6_CHNL241_CMD_ADDR A:0x338e000
y.create.l HWIO_PMIC_ARB_OBS6_CHNL242_CMD_ADDR A:0x3396000
y.create.l HWIO_PMIC_ARB_OBS6_CHNL243_CMD_ADDR A:0x339e000
y.create.l HWIO_PMIC_ARB_OBS6_CHNL244_CMD_ADDR A:0x33a6000
y.create.l HWIO_PMIC_ARB_OBS6_CHNL245_CMD_ADDR A:0x33ae000
y.create.l HWIO_PMIC_ARB_OBS6_CHNL246_CMD_ADDR A:0x33b6000
y.create.l HWIO_PMIC_ARB_OBS6_CHNL247_CMD_ADDR A:0x33be000
y.create.l HWIO_PMIC_ARB_OBS6_CHNL248_CMD_ADDR A:0x33c6000
y.create.l HWIO_PMIC_ARB_OBS6_CHNL249_CMD_ADDR A:0x33ce000
y.create.l HWIO_PMIC_ARB_OBS6_CHNL250_CMD_ADDR A:0x33d6000
y.create.l HWIO_PMIC_ARB_OBS6_CHNL251_CMD_ADDR A:0x33de000
y.create.l HWIO_PMIC_ARB_OBS6_CHNL252_CMD_ADDR A:0x33e6000
y.create.l HWIO_PMIC_ARB_OBS6_CHNL253_CMD_ADDR A:0x33ee000
y.create.l HWIO_PMIC_ARB_OBS6_CHNL254_CMD_ADDR A:0x33f6000
y.create.l HWIO_PMIC_ARB_OBS6_CHNL255_CMD_ADDR A:0x33fe000
y.create.l HWIO_PMIC_ARB_OBS0_CHNL0_CONFIG_ADDR A:0x2c00004
y.create.l HWIO_PMIC_ARB_OBS0_CHNL1_CONFIG_ADDR A:0x2c08004
y.create.l HWIO_PMIC_ARB_OBS0_CHNL2_CONFIG_ADDR A:0x2c10004
y.create.l HWIO_PMIC_ARB_OBS0_CHNL3_CONFIG_ADDR A:0x2c18004
y.create.l HWIO_PMIC_ARB_OBS0_CHNL4_CONFIG_ADDR A:0x2c20004
y.create.l HWIO_PMIC_ARB_OBS0_CHNL5_CONFIG_ADDR A:0x2c28004
y.create.l HWIO_PMIC_ARB_OBS0_CHNL6_CONFIG_ADDR A:0x2c30004
y.create.l HWIO_PMIC_ARB_OBS0_CHNL7_CONFIG_ADDR A:0x2c38004
y.create.l HWIO_PMIC_ARB_OBS0_CHNL8_CONFIG_ADDR A:0x2c40004
y.create.l HWIO_PMIC_ARB_OBS0_CHNL9_CONFIG_ADDR A:0x2c48004
y.create.l HWIO_PMIC_ARB_OBS0_CHNL10_CONFIG_ADDR A:0x2c50004
y.create.l HWIO_PMIC_ARB_OBS0_CHNL11_CONFIG_ADDR A:0x2c58004
y.create.l HWIO_PMIC_ARB_OBS0_CHNL12_CONFIG_ADDR A:0x2c60004
y.create.l HWIO_PMIC_ARB_OBS0_CHNL13_CONFIG_ADDR A:0x2c68004
y.create.l HWIO_PMIC_ARB_OBS0_CHNL14_CONFIG_ADDR A:0x2c70004
y.create.l HWIO_PMIC_ARB_OBS0_CHNL15_CONFIG_ADDR A:0x2c78004
y.create.l HWIO_PMIC_ARB_OBS0_CHNL16_CONFIG_ADDR A:0x2c80004
y.create.l HWIO_PMIC_ARB_OBS0_CHNL17_CONFIG_ADDR A:0x2c88004
y.create.l HWIO_PMIC_ARB_OBS0_CHNL18_CONFIG_ADDR A:0x2c90004
y.create.l HWIO_PMIC_ARB_OBS0_CHNL19_CONFIG_ADDR A:0x2c98004
y.create.l HWIO_PMIC_ARB_OBS0_CHNL20_CONFIG_ADDR A:0x2ca0004
y.create.l HWIO_PMIC_ARB_OBS0_CHNL21_CONFIG_ADDR A:0x2ca8004
y.create.l HWIO_PMIC_ARB_OBS0_CHNL22_CONFIG_ADDR A:0x2cb0004
y.create.l HWIO_PMIC_ARB_OBS0_CHNL23_CONFIG_ADDR A:0x2cb8004
y.create.l HWIO_PMIC_ARB_OBS0_CHNL24_CONFIG_ADDR A:0x2cc0004
y.create.l HWIO_PMIC_ARB_OBS0_CHNL25_CONFIG_ADDR A:0x2cc8004
y.create.l HWIO_PMIC_ARB_OBS0_CHNL26_CONFIG_ADDR A:0x2cd0004
y.create.l HWIO_PMIC_ARB_OBS0_CHNL27_CONFIG_ADDR A:0x2cd8004
y.create.l HWIO_PMIC_ARB_OBS0_CHNL28_CONFIG_ADDR A:0x2ce0004
y.create.l HWIO_PMIC_ARB_OBS0_CHNL29_CONFIG_ADDR A:0x2ce8004
y.create.l HWIO_PMIC_ARB_OBS0_CHNL30_CONFIG_ADDR A:0x2cf0004
y.create.l HWIO_PMIC_ARB_OBS0_CHNL31_CONFIG_ADDR A:0x2cf8004
y.create.l HWIO_PMIC_ARB_OBS0_CHNL32_CONFIG_ADDR A:0x2d00004
y.create.l HWIO_PMIC_ARB_OBS0_CHNL33_CONFIG_ADDR A:0x2d08004
y.create.l HWIO_PMIC_ARB_OBS0_CHNL34_CONFIG_ADDR A:0x2d10004
y.create.l HWIO_PMIC_ARB_OBS0_CHNL35_CONFIG_ADDR A:0x2d18004
y.create.l HWIO_PMIC_ARB_OBS0_CHNL36_CONFIG_ADDR A:0x2d20004
y.create.l HWIO_PMIC_ARB_OBS0_CHNL37_CONFIG_ADDR A:0x2d28004
y.create.l HWIO_PMIC_ARB_OBS0_CHNL38_CONFIG_ADDR A:0x2d30004
y.create.l HWIO_PMIC_ARB_OBS0_CHNL39_CONFIG_ADDR A:0x2d38004
y.create.l HWIO_PMIC_ARB_OBS0_CHNL40_CONFIG_ADDR A:0x2d40004
y.create.l HWIO_PMIC_ARB_OBS0_CHNL41_CONFIG_ADDR A:0x2d48004
y.create.l HWIO_PMIC_ARB_OBS0_CHNL42_CONFIG_ADDR A:0x2d50004
y.create.l HWIO_PMIC_ARB_OBS0_CHNL43_CONFIG_ADDR A:0x2d58004
y.create.l HWIO_PMIC_ARB_OBS0_CHNL44_CONFIG_ADDR A:0x2d60004
y.create.l HWIO_PMIC_ARB_OBS0_CHNL45_CONFIG_ADDR A:0x2d68004
y.create.l HWIO_PMIC_ARB_OBS0_CHNL46_CONFIG_ADDR A:0x2d70004
y.create.l HWIO_PMIC_ARB_OBS0_CHNL47_CONFIG_ADDR A:0x2d78004
y.create.l HWIO_PMIC_ARB_OBS0_CHNL48_CONFIG_ADDR A:0x2d80004
y.create.l HWIO_PMIC_ARB_OBS0_CHNL49_CONFIG_ADDR A:0x2d88004
y.create.l HWIO_PMIC_ARB_OBS0_CHNL50_CONFIG_ADDR A:0x2d90004
y.create.l HWIO_PMIC_ARB_OBS0_CHNL51_CONFIG_ADDR A:0x2d98004
y.create.l HWIO_PMIC_ARB_OBS0_CHNL52_CONFIG_ADDR A:0x2da0004
y.create.l HWIO_PMIC_ARB_OBS0_CHNL53_CONFIG_ADDR A:0x2da8004
y.create.l HWIO_PMIC_ARB_OBS0_CHNL54_CONFIG_ADDR A:0x2db0004
y.create.l HWIO_PMIC_ARB_OBS0_CHNL55_CONFIG_ADDR A:0x2db8004
y.create.l HWIO_PMIC_ARB_OBS0_CHNL56_CONFIG_ADDR A:0x2dc0004
y.create.l HWIO_PMIC_ARB_OBS0_CHNL57_CONFIG_ADDR A:0x2dc8004
y.create.l HWIO_PMIC_ARB_OBS0_CHNL58_CONFIG_ADDR A:0x2dd0004
y.create.l HWIO_PMIC_ARB_OBS0_CHNL59_CONFIG_ADDR A:0x2dd8004
y.create.l HWIO_PMIC_ARB_OBS0_CHNL60_CONFIG_ADDR A:0x2de0004
y.create.l HWIO_PMIC_ARB_OBS0_CHNL61_CONFIG_ADDR A:0x2de8004
y.create.l HWIO_PMIC_ARB_OBS0_CHNL62_CONFIG_ADDR A:0x2df0004
y.create.l HWIO_PMIC_ARB_OBS0_CHNL63_CONFIG_ADDR A:0x2df8004
y.create.l HWIO_PMIC_ARB_OBS0_CHNL64_CONFIG_ADDR A:0x2e00004
y.create.l HWIO_PMIC_ARB_OBS0_CHNL65_CONFIG_ADDR A:0x2e08004
y.create.l HWIO_PMIC_ARB_OBS0_CHNL66_CONFIG_ADDR A:0x2e10004
y.create.l HWIO_PMIC_ARB_OBS0_CHNL67_CONFIG_ADDR A:0x2e18004
y.create.l HWIO_PMIC_ARB_OBS0_CHNL68_CONFIG_ADDR A:0x2e20004
y.create.l HWIO_PMIC_ARB_OBS0_CHNL69_CONFIG_ADDR A:0x2e28004
y.create.l HWIO_PMIC_ARB_OBS0_CHNL70_CONFIG_ADDR A:0x2e30004
y.create.l HWIO_PMIC_ARB_OBS0_CHNL71_CONFIG_ADDR A:0x2e38004
y.create.l HWIO_PMIC_ARB_OBS0_CHNL72_CONFIG_ADDR A:0x2e40004
y.create.l HWIO_PMIC_ARB_OBS0_CHNL73_CONFIG_ADDR A:0x2e48004
y.create.l HWIO_PMIC_ARB_OBS0_CHNL74_CONFIG_ADDR A:0x2e50004
y.create.l HWIO_PMIC_ARB_OBS0_CHNL75_CONFIG_ADDR A:0x2e58004
y.create.l HWIO_PMIC_ARB_OBS0_CHNL76_CONFIG_ADDR A:0x2e60004
y.create.l HWIO_PMIC_ARB_OBS0_CHNL77_CONFIG_ADDR A:0x2e68004
y.create.l HWIO_PMIC_ARB_OBS0_CHNL78_CONFIG_ADDR A:0x2e70004
y.create.l HWIO_PMIC_ARB_OBS0_CHNL79_CONFIG_ADDR A:0x2e78004
y.create.l HWIO_PMIC_ARB_OBS0_CHNL80_CONFIG_ADDR A:0x2e80004
y.create.l HWIO_PMIC_ARB_OBS0_CHNL81_CONFIG_ADDR A:0x2e88004
y.create.l HWIO_PMIC_ARB_OBS0_CHNL82_CONFIG_ADDR A:0x2e90004
y.create.l HWIO_PMIC_ARB_OBS0_CHNL83_CONFIG_ADDR A:0x2e98004
y.create.l HWIO_PMIC_ARB_OBS0_CHNL84_CONFIG_ADDR A:0x2ea0004
y.create.l HWIO_PMIC_ARB_OBS0_CHNL85_CONFIG_ADDR A:0x2ea8004
y.create.l HWIO_PMIC_ARB_OBS0_CHNL86_CONFIG_ADDR A:0x2eb0004
y.create.l HWIO_PMIC_ARB_OBS0_CHNL87_CONFIG_ADDR A:0x2eb8004
y.create.l HWIO_PMIC_ARB_OBS0_CHNL88_CONFIG_ADDR A:0x2ec0004
y.create.l HWIO_PMIC_ARB_OBS0_CHNL89_CONFIG_ADDR A:0x2ec8004
y.create.l HWIO_PMIC_ARB_OBS0_CHNL90_CONFIG_ADDR A:0x2ed0004
y.create.l HWIO_PMIC_ARB_OBS0_CHNL91_CONFIG_ADDR A:0x2ed8004
y.create.l HWIO_PMIC_ARB_OBS0_CHNL92_CONFIG_ADDR A:0x2ee0004
y.create.l HWIO_PMIC_ARB_OBS0_CHNL93_CONFIG_ADDR A:0x2ee8004
y.create.l HWIO_PMIC_ARB_OBS0_CHNL94_CONFIG_ADDR A:0x2ef0004
y.create.l HWIO_PMIC_ARB_OBS0_CHNL95_CONFIG_ADDR A:0x2ef8004
y.create.l HWIO_PMIC_ARB_OBS0_CHNL96_CONFIG_ADDR A:0x2f00004
y.create.l HWIO_PMIC_ARB_OBS0_CHNL97_CONFIG_ADDR A:0x2f08004
y.create.l HWIO_PMIC_ARB_OBS0_CHNL98_CONFIG_ADDR A:0x2f10004
y.create.l HWIO_PMIC_ARB_OBS0_CHNL99_CONFIG_ADDR A:0x2f18004
y.create.l HWIO_PMIC_ARB_OBS0_CHNL100_CONFIG_ADDR A:0x2f20004
y.create.l HWIO_PMIC_ARB_OBS0_CHNL101_CONFIG_ADDR A:0x2f28004
y.create.l HWIO_PMIC_ARB_OBS0_CHNL102_CONFIG_ADDR A:0x2f30004
y.create.l HWIO_PMIC_ARB_OBS0_CHNL103_CONFIG_ADDR A:0x2f38004
y.create.l HWIO_PMIC_ARB_OBS0_CHNL104_CONFIG_ADDR A:0x2f40004
y.create.l HWIO_PMIC_ARB_OBS0_CHNL105_CONFIG_ADDR A:0x2f48004
y.create.l HWIO_PMIC_ARB_OBS0_CHNL106_CONFIG_ADDR A:0x2f50004
y.create.l HWIO_PMIC_ARB_OBS0_CHNL107_CONFIG_ADDR A:0x2f58004
y.create.l HWIO_PMIC_ARB_OBS0_CHNL108_CONFIG_ADDR A:0x2f60004
y.create.l HWIO_PMIC_ARB_OBS0_CHNL109_CONFIG_ADDR A:0x2f68004
y.create.l HWIO_PMIC_ARB_OBS0_CHNL110_CONFIG_ADDR A:0x2f70004
y.create.l HWIO_PMIC_ARB_OBS0_CHNL111_CONFIG_ADDR A:0x2f78004
y.create.l HWIO_PMIC_ARB_OBS0_CHNL112_CONFIG_ADDR A:0x2f80004
y.create.l HWIO_PMIC_ARB_OBS0_CHNL113_CONFIG_ADDR A:0x2f88004
y.create.l HWIO_PMIC_ARB_OBS0_CHNL114_CONFIG_ADDR A:0x2f90004
y.create.l HWIO_PMIC_ARB_OBS0_CHNL115_CONFIG_ADDR A:0x2f98004
y.create.l HWIO_PMIC_ARB_OBS0_CHNL116_CONFIG_ADDR A:0x2fa0004
y.create.l HWIO_PMIC_ARB_OBS0_CHNL117_CONFIG_ADDR A:0x2fa8004
y.create.l HWIO_PMIC_ARB_OBS0_CHNL118_CONFIG_ADDR A:0x2fb0004
y.create.l HWIO_PMIC_ARB_OBS0_CHNL119_CONFIG_ADDR A:0x2fb8004
y.create.l HWIO_PMIC_ARB_OBS0_CHNL120_CONFIG_ADDR A:0x2fc0004
y.create.l HWIO_PMIC_ARB_OBS0_CHNL121_CONFIG_ADDR A:0x2fc8004
y.create.l HWIO_PMIC_ARB_OBS0_CHNL122_CONFIG_ADDR A:0x2fd0004
y.create.l HWIO_PMIC_ARB_OBS0_CHNL123_CONFIG_ADDR A:0x2fd8004
y.create.l HWIO_PMIC_ARB_OBS0_CHNL124_CONFIG_ADDR A:0x2fe0004
y.create.l HWIO_PMIC_ARB_OBS0_CHNL125_CONFIG_ADDR A:0x2fe8004
y.create.l HWIO_PMIC_ARB_OBS0_CHNL126_CONFIG_ADDR A:0x2ff0004
y.create.l HWIO_PMIC_ARB_OBS0_CHNL127_CONFIG_ADDR A:0x2ff8004
y.create.l HWIO_PMIC_ARB_OBS0_CHNL128_CONFIG_ADDR A:0x3000004
y.create.l HWIO_PMIC_ARB_OBS0_CHNL129_CONFIG_ADDR A:0x3008004
y.create.l HWIO_PMIC_ARB_OBS0_CHNL130_CONFIG_ADDR A:0x3010004
y.create.l HWIO_PMIC_ARB_OBS0_CHNL131_CONFIG_ADDR A:0x3018004
y.create.l HWIO_PMIC_ARB_OBS0_CHNL132_CONFIG_ADDR A:0x3020004
y.create.l HWIO_PMIC_ARB_OBS0_CHNL133_CONFIG_ADDR A:0x3028004
y.create.l HWIO_PMIC_ARB_OBS0_CHNL134_CONFIG_ADDR A:0x3030004
y.create.l HWIO_PMIC_ARB_OBS0_CHNL135_CONFIG_ADDR A:0x3038004
y.create.l HWIO_PMIC_ARB_OBS0_CHNL136_CONFIG_ADDR A:0x3040004
y.create.l HWIO_PMIC_ARB_OBS0_CHNL137_CONFIG_ADDR A:0x3048004
y.create.l HWIO_PMIC_ARB_OBS0_CHNL138_CONFIG_ADDR A:0x3050004
y.create.l HWIO_PMIC_ARB_OBS0_CHNL139_CONFIG_ADDR A:0x3058004
y.create.l HWIO_PMIC_ARB_OBS0_CHNL140_CONFIG_ADDR A:0x3060004
y.create.l HWIO_PMIC_ARB_OBS0_CHNL141_CONFIG_ADDR A:0x3068004
y.create.l HWIO_PMIC_ARB_OBS0_CHNL142_CONFIG_ADDR A:0x3070004
y.create.l HWIO_PMIC_ARB_OBS0_CHNL143_CONFIG_ADDR A:0x3078004
y.create.l HWIO_PMIC_ARB_OBS0_CHNL144_CONFIG_ADDR A:0x3080004
y.create.l HWIO_PMIC_ARB_OBS0_CHNL145_CONFIG_ADDR A:0x3088004
y.create.l HWIO_PMIC_ARB_OBS0_CHNL146_CONFIG_ADDR A:0x3090004
y.create.l HWIO_PMIC_ARB_OBS0_CHNL147_CONFIG_ADDR A:0x3098004
y.create.l HWIO_PMIC_ARB_OBS0_CHNL148_CONFIG_ADDR A:0x30a0004
y.create.l HWIO_PMIC_ARB_OBS0_CHNL149_CONFIG_ADDR A:0x30a8004
y.create.l HWIO_PMIC_ARB_OBS0_CHNL150_CONFIG_ADDR A:0x30b0004
y.create.l HWIO_PMIC_ARB_OBS0_CHNL151_CONFIG_ADDR A:0x30b8004
y.create.l HWIO_PMIC_ARB_OBS0_CHNL152_CONFIG_ADDR A:0x30c0004
y.create.l HWIO_PMIC_ARB_OBS0_CHNL153_CONFIG_ADDR A:0x30c8004
y.create.l HWIO_PMIC_ARB_OBS0_CHNL154_CONFIG_ADDR A:0x30d0004
y.create.l HWIO_PMIC_ARB_OBS0_CHNL155_CONFIG_ADDR A:0x30d8004
y.create.l HWIO_PMIC_ARB_OBS0_CHNL156_CONFIG_ADDR A:0x30e0004
y.create.l HWIO_PMIC_ARB_OBS0_CHNL157_CONFIG_ADDR A:0x30e8004
y.create.l HWIO_PMIC_ARB_OBS0_CHNL158_CONFIG_ADDR A:0x30f0004
y.create.l HWIO_PMIC_ARB_OBS0_CHNL159_CONFIG_ADDR A:0x30f8004
y.create.l HWIO_PMIC_ARB_OBS0_CHNL160_CONFIG_ADDR A:0x3100004
y.create.l HWIO_PMIC_ARB_OBS0_CHNL161_CONFIG_ADDR A:0x3108004
y.create.l HWIO_PMIC_ARB_OBS0_CHNL162_CONFIG_ADDR A:0x3110004
y.create.l HWIO_PMIC_ARB_OBS0_CHNL163_CONFIG_ADDR A:0x3118004
y.create.l HWIO_PMIC_ARB_OBS0_CHNL164_CONFIG_ADDR A:0x3120004
y.create.l HWIO_PMIC_ARB_OBS0_CHNL165_CONFIG_ADDR A:0x3128004
y.create.l HWIO_PMIC_ARB_OBS0_CHNL166_CONFIG_ADDR A:0x3130004
y.create.l HWIO_PMIC_ARB_OBS0_CHNL167_CONFIG_ADDR A:0x3138004
y.create.l HWIO_PMIC_ARB_OBS0_CHNL168_CONFIG_ADDR A:0x3140004
y.create.l HWIO_PMIC_ARB_OBS0_CHNL169_CONFIG_ADDR A:0x3148004
y.create.l HWIO_PMIC_ARB_OBS0_CHNL170_CONFIG_ADDR A:0x3150004
y.create.l HWIO_PMIC_ARB_OBS0_CHNL171_CONFIG_ADDR A:0x3158004
y.create.l HWIO_PMIC_ARB_OBS0_CHNL172_CONFIG_ADDR A:0x3160004
y.create.l HWIO_PMIC_ARB_OBS0_CHNL173_CONFIG_ADDR A:0x3168004
y.create.l HWIO_PMIC_ARB_OBS0_CHNL174_CONFIG_ADDR A:0x3170004
y.create.l HWIO_PMIC_ARB_OBS0_CHNL175_CONFIG_ADDR A:0x3178004
y.create.l HWIO_PMIC_ARB_OBS0_CHNL176_CONFIG_ADDR A:0x3180004
y.create.l HWIO_PMIC_ARB_OBS0_CHNL177_CONFIG_ADDR A:0x3188004
y.create.l HWIO_PMIC_ARB_OBS0_CHNL178_CONFIG_ADDR A:0x3190004
y.create.l HWIO_PMIC_ARB_OBS0_CHNL179_CONFIG_ADDR A:0x3198004
y.create.l HWIO_PMIC_ARB_OBS0_CHNL180_CONFIG_ADDR A:0x31a0004
y.create.l HWIO_PMIC_ARB_OBS0_CHNL181_CONFIG_ADDR A:0x31a8004
y.create.l HWIO_PMIC_ARB_OBS0_CHNL182_CONFIG_ADDR A:0x31b0004
y.create.l HWIO_PMIC_ARB_OBS0_CHNL183_CONFIG_ADDR A:0x31b8004
y.create.l HWIO_PMIC_ARB_OBS0_CHNL184_CONFIG_ADDR A:0x31c0004
y.create.l HWIO_PMIC_ARB_OBS0_CHNL185_CONFIG_ADDR A:0x31c8004
y.create.l HWIO_PMIC_ARB_OBS0_CHNL186_CONFIG_ADDR A:0x31d0004
y.create.l HWIO_PMIC_ARB_OBS0_CHNL187_CONFIG_ADDR A:0x31d8004
y.create.l HWIO_PMIC_ARB_OBS0_CHNL188_CONFIG_ADDR A:0x31e0004
y.create.l HWIO_PMIC_ARB_OBS0_CHNL189_CONFIG_ADDR A:0x31e8004
y.create.l HWIO_PMIC_ARB_OBS0_CHNL190_CONFIG_ADDR A:0x31f0004
y.create.l HWIO_PMIC_ARB_OBS0_CHNL191_CONFIG_ADDR A:0x31f8004
y.create.l HWIO_PMIC_ARB_OBS0_CHNL192_CONFIG_ADDR A:0x3200004
y.create.l HWIO_PMIC_ARB_OBS0_CHNL193_CONFIG_ADDR A:0x3208004
y.create.l HWIO_PMIC_ARB_OBS0_CHNL194_CONFIG_ADDR A:0x3210004
y.create.l HWIO_PMIC_ARB_OBS0_CHNL195_CONFIG_ADDR A:0x3218004
y.create.l HWIO_PMIC_ARB_OBS0_CHNL196_CONFIG_ADDR A:0x3220004
y.create.l HWIO_PMIC_ARB_OBS0_CHNL197_CONFIG_ADDR A:0x3228004
y.create.l HWIO_PMIC_ARB_OBS0_CHNL198_CONFIG_ADDR A:0x3230004
y.create.l HWIO_PMIC_ARB_OBS0_CHNL199_CONFIG_ADDR A:0x3238004
y.create.l HWIO_PMIC_ARB_OBS0_CHNL200_CONFIG_ADDR A:0x3240004
y.create.l HWIO_PMIC_ARB_OBS0_CHNL201_CONFIG_ADDR A:0x3248004
y.create.l HWIO_PMIC_ARB_OBS0_CHNL202_CONFIG_ADDR A:0x3250004
y.create.l HWIO_PMIC_ARB_OBS0_CHNL203_CONFIG_ADDR A:0x3258004
y.create.l HWIO_PMIC_ARB_OBS0_CHNL204_CONFIG_ADDR A:0x3260004
y.create.l HWIO_PMIC_ARB_OBS0_CHNL205_CONFIG_ADDR A:0x3268004
y.create.l HWIO_PMIC_ARB_OBS0_CHNL206_CONFIG_ADDR A:0x3270004
y.create.l HWIO_PMIC_ARB_OBS0_CHNL207_CONFIG_ADDR A:0x3278004
y.create.l HWIO_PMIC_ARB_OBS0_CHNL208_CONFIG_ADDR A:0x3280004
y.create.l HWIO_PMIC_ARB_OBS0_CHNL209_CONFIG_ADDR A:0x3288004
y.create.l HWIO_PMIC_ARB_OBS0_CHNL210_CONFIG_ADDR A:0x3290004
y.create.l HWIO_PMIC_ARB_OBS0_CHNL211_CONFIG_ADDR A:0x3298004
y.create.l HWIO_PMIC_ARB_OBS0_CHNL212_CONFIG_ADDR A:0x32a0004
y.create.l HWIO_PMIC_ARB_OBS0_CHNL213_CONFIG_ADDR A:0x32a8004
y.create.l HWIO_PMIC_ARB_OBS0_CHNL214_CONFIG_ADDR A:0x32b0004
y.create.l HWIO_PMIC_ARB_OBS0_CHNL215_CONFIG_ADDR A:0x32b8004
y.create.l HWIO_PMIC_ARB_OBS0_CHNL216_CONFIG_ADDR A:0x32c0004
y.create.l HWIO_PMIC_ARB_OBS0_CHNL217_CONFIG_ADDR A:0x32c8004
y.create.l HWIO_PMIC_ARB_OBS0_CHNL218_CONFIG_ADDR A:0x32d0004
y.create.l HWIO_PMIC_ARB_OBS0_CHNL219_CONFIG_ADDR A:0x32d8004
y.create.l HWIO_PMIC_ARB_OBS0_CHNL220_CONFIG_ADDR A:0x32e0004
y.create.l HWIO_PMIC_ARB_OBS0_CHNL221_CONFIG_ADDR A:0x32e8004
y.create.l HWIO_PMIC_ARB_OBS0_CHNL222_CONFIG_ADDR A:0x32f0004
y.create.l HWIO_PMIC_ARB_OBS0_CHNL223_CONFIG_ADDR A:0x32f8004
y.create.l HWIO_PMIC_ARB_OBS0_CHNL224_CONFIG_ADDR A:0x3300004
y.create.l HWIO_PMIC_ARB_OBS0_CHNL225_CONFIG_ADDR A:0x3308004
y.create.l HWIO_PMIC_ARB_OBS0_CHNL226_CONFIG_ADDR A:0x3310004
y.create.l HWIO_PMIC_ARB_OBS0_CHNL227_CONFIG_ADDR A:0x3318004
y.create.l HWIO_PMIC_ARB_OBS0_CHNL228_CONFIG_ADDR A:0x3320004
y.create.l HWIO_PMIC_ARB_OBS0_CHNL229_CONFIG_ADDR A:0x3328004
y.create.l HWIO_PMIC_ARB_OBS0_CHNL230_CONFIG_ADDR A:0x3330004
y.create.l HWIO_PMIC_ARB_OBS0_CHNL231_CONFIG_ADDR A:0x3338004
y.create.l HWIO_PMIC_ARB_OBS0_CHNL232_CONFIG_ADDR A:0x3340004
y.create.l HWIO_PMIC_ARB_OBS0_CHNL233_CONFIG_ADDR A:0x3348004
y.create.l HWIO_PMIC_ARB_OBS0_CHNL234_CONFIG_ADDR A:0x3350004
y.create.l HWIO_PMIC_ARB_OBS0_CHNL235_CONFIG_ADDR A:0x3358004
y.create.l HWIO_PMIC_ARB_OBS0_CHNL236_CONFIG_ADDR A:0x3360004
y.create.l HWIO_PMIC_ARB_OBS0_CHNL237_CONFIG_ADDR A:0x3368004
y.create.l HWIO_PMIC_ARB_OBS0_CHNL238_CONFIG_ADDR A:0x3370004
y.create.l HWIO_PMIC_ARB_OBS0_CHNL239_CONFIG_ADDR A:0x3378004
y.create.l HWIO_PMIC_ARB_OBS0_CHNL240_CONFIG_ADDR A:0x3380004
y.create.l HWIO_PMIC_ARB_OBS0_CHNL241_CONFIG_ADDR A:0x3388004
y.create.l HWIO_PMIC_ARB_OBS0_CHNL242_CONFIG_ADDR A:0x3390004
y.create.l HWIO_PMIC_ARB_OBS0_CHNL243_CONFIG_ADDR A:0x3398004
y.create.l HWIO_PMIC_ARB_OBS0_CHNL244_CONFIG_ADDR A:0x33a0004
y.create.l HWIO_PMIC_ARB_OBS0_CHNL245_CONFIG_ADDR A:0x33a8004
y.create.l HWIO_PMIC_ARB_OBS0_CHNL246_CONFIG_ADDR A:0x33b0004
y.create.l HWIO_PMIC_ARB_OBS0_CHNL247_CONFIG_ADDR A:0x33b8004
y.create.l HWIO_PMIC_ARB_OBS0_CHNL248_CONFIG_ADDR A:0x33c0004
y.create.l HWIO_PMIC_ARB_OBS0_CHNL249_CONFIG_ADDR A:0x33c8004
y.create.l HWIO_PMIC_ARB_OBS0_CHNL250_CONFIG_ADDR A:0x33d0004
y.create.l HWIO_PMIC_ARB_OBS0_CHNL251_CONFIG_ADDR A:0x33d8004
y.create.l HWIO_PMIC_ARB_OBS0_CHNL252_CONFIG_ADDR A:0x33e0004
y.create.l HWIO_PMIC_ARB_OBS0_CHNL253_CONFIG_ADDR A:0x33e8004
y.create.l HWIO_PMIC_ARB_OBS0_CHNL254_CONFIG_ADDR A:0x33f0004
y.create.l HWIO_PMIC_ARB_OBS0_CHNL255_CONFIG_ADDR A:0x33f8004
y.create.l HWIO_PMIC_ARB_OBS1_CHNL0_CONFIG_ADDR A:0x2c01004
y.create.l HWIO_PMIC_ARB_OBS1_CHNL1_CONFIG_ADDR A:0x2c09004
y.create.l HWIO_PMIC_ARB_OBS1_CHNL2_CONFIG_ADDR A:0x2c11004
y.create.l HWIO_PMIC_ARB_OBS1_CHNL3_CONFIG_ADDR A:0x2c19004
y.create.l HWIO_PMIC_ARB_OBS1_CHNL4_CONFIG_ADDR A:0x2c21004
y.create.l HWIO_PMIC_ARB_OBS1_CHNL5_CONFIG_ADDR A:0x2c29004
y.create.l HWIO_PMIC_ARB_OBS1_CHNL6_CONFIG_ADDR A:0x2c31004
y.create.l HWIO_PMIC_ARB_OBS1_CHNL7_CONFIG_ADDR A:0x2c39004
y.create.l HWIO_PMIC_ARB_OBS1_CHNL8_CONFIG_ADDR A:0x2c41004
y.create.l HWIO_PMIC_ARB_OBS1_CHNL9_CONFIG_ADDR A:0x2c49004
y.create.l HWIO_PMIC_ARB_OBS1_CHNL10_CONFIG_ADDR A:0x2c51004
y.create.l HWIO_PMIC_ARB_OBS1_CHNL11_CONFIG_ADDR A:0x2c59004
y.create.l HWIO_PMIC_ARB_OBS1_CHNL12_CONFIG_ADDR A:0x2c61004
y.create.l HWIO_PMIC_ARB_OBS1_CHNL13_CONFIG_ADDR A:0x2c69004
y.create.l HWIO_PMIC_ARB_OBS1_CHNL14_CONFIG_ADDR A:0x2c71004
y.create.l HWIO_PMIC_ARB_OBS1_CHNL15_CONFIG_ADDR A:0x2c79004
y.create.l HWIO_PMIC_ARB_OBS1_CHNL16_CONFIG_ADDR A:0x2c81004
y.create.l HWIO_PMIC_ARB_OBS1_CHNL17_CONFIG_ADDR A:0x2c89004
y.create.l HWIO_PMIC_ARB_OBS1_CHNL18_CONFIG_ADDR A:0x2c91004
y.create.l HWIO_PMIC_ARB_OBS1_CHNL19_CONFIG_ADDR A:0x2c99004
y.create.l HWIO_PMIC_ARB_OBS1_CHNL20_CONFIG_ADDR A:0x2ca1004
y.create.l HWIO_PMIC_ARB_OBS1_CHNL21_CONFIG_ADDR A:0x2ca9004
y.create.l HWIO_PMIC_ARB_OBS1_CHNL22_CONFIG_ADDR A:0x2cb1004
y.create.l HWIO_PMIC_ARB_OBS1_CHNL23_CONFIG_ADDR A:0x2cb9004
y.create.l HWIO_PMIC_ARB_OBS1_CHNL24_CONFIG_ADDR A:0x2cc1004
y.create.l HWIO_PMIC_ARB_OBS1_CHNL25_CONFIG_ADDR A:0x2cc9004
y.create.l HWIO_PMIC_ARB_OBS1_CHNL26_CONFIG_ADDR A:0x2cd1004
y.create.l HWIO_PMIC_ARB_OBS1_CHNL27_CONFIG_ADDR A:0x2cd9004
y.create.l HWIO_PMIC_ARB_OBS1_CHNL28_CONFIG_ADDR A:0x2ce1004
y.create.l HWIO_PMIC_ARB_OBS1_CHNL29_CONFIG_ADDR A:0x2ce9004
y.create.l HWIO_PMIC_ARB_OBS1_CHNL30_CONFIG_ADDR A:0x2cf1004
y.create.l HWIO_PMIC_ARB_OBS1_CHNL31_CONFIG_ADDR A:0x2cf9004
y.create.l HWIO_PMIC_ARB_OBS1_CHNL32_CONFIG_ADDR A:0x2d01004
y.create.l HWIO_PMIC_ARB_OBS1_CHNL33_CONFIG_ADDR A:0x2d09004
y.create.l HWIO_PMIC_ARB_OBS1_CHNL34_CONFIG_ADDR A:0x2d11004
y.create.l HWIO_PMIC_ARB_OBS1_CHNL35_CONFIG_ADDR A:0x2d19004
y.create.l HWIO_PMIC_ARB_OBS1_CHNL36_CONFIG_ADDR A:0x2d21004
y.create.l HWIO_PMIC_ARB_OBS1_CHNL37_CONFIG_ADDR A:0x2d29004
y.create.l HWIO_PMIC_ARB_OBS1_CHNL38_CONFIG_ADDR A:0x2d31004
y.create.l HWIO_PMIC_ARB_OBS1_CHNL39_CONFIG_ADDR A:0x2d39004
y.create.l HWIO_PMIC_ARB_OBS1_CHNL40_CONFIG_ADDR A:0x2d41004
y.create.l HWIO_PMIC_ARB_OBS1_CHNL41_CONFIG_ADDR A:0x2d49004
y.create.l HWIO_PMIC_ARB_OBS1_CHNL42_CONFIG_ADDR A:0x2d51004
y.create.l HWIO_PMIC_ARB_OBS1_CHNL43_CONFIG_ADDR A:0x2d59004
y.create.l HWIO_PMIC_ARB_OBS1_CHNL44_CONFIG_ADDR A:0x2d61004
y.create.l HWIO_PMIC_ARB_OBS1_CHNL45_CONFIG_ADDR A:0x2d69004
y.create.l HWIO_PMIC_ARB_OBS1_CHNL46_CONFIG_ADDR A:0x2d71004
y.create.l HWIO_PMIC_ARB_OBS1_CHNL47_CONFIG_ADDR A:0x2d79004
y.create.l HWIO_PMIC_ARB_OBS1_CHNL48_CONFIG_ADDR A:0x2d81004
y.create.l HWIO_PMIC_ARB_OBS1_CHNL49_CONFIG_ADDR A:0x2d89004
y.create.l HWIO_PMIC_ARB_OBS1_CHNL50_CONFIG_ADDR A:0x2d91004
y.create.l HWIO_PMIC_ARB_OBS1_CHNL51_CONFIG_ADDR A:0x2d99004
y.create.l HWIO_PMIC_ARB_OBS1_CHNL52_CONFIG_ADDR A:0x2da1004
y.create.l HWIO_PMIC_ARB_OBS1_CHNL53_CONFIG_ADDR A:0x2da9004
y.create.l HWIO_PMIC_ARB_OBS1_CHNL54_CONFIG_ADDR A:0x2db1004
y.create.l HWIO_PMIC_ARB_OBS1_CHNL55_CONFIG_ADDR A:0x2db9004
y.create.l HWIO_PMIC_ARB_OBS1_CHNL56_CONFIG_ADDR A:0x2dc1004
y.create.l HWIO_PMIC_ARB_OBS1_CHNL57_CONFIG_ADDR A:0x2dc9004
y.create.l HWIO_PMIC_ARB_OBS1_CHNL58_CONFIG_ADDR A:0x2dd1004
y.create.l HWIO_PMIC_ARB_OBS1_CHNL59_CONFIG_ADDR A:0x2dd9004
y.create.l HWIO_PMIC_ARB_OBS1_CHNL60_CONFIG_ADDR A:0x2de1004
y.create.l HWIO_PMIC_ARB_OBS1_CHNL61_CONFIG_ADDR A:0x2de9004
y.create.l HWIO_PMIC_ARB_OBS1_CHNL62_CONFIG_ADDR A:0x2df1004
y.create.l HWIO_PMIC_ARB_OBS1_CHNL63_CONFIG_ADDR A:0x2df9004
y.create.l HWIO_PMIC_ARB_OBS1_CHNL64_CONFIG_ADDR A:0x2e01004
y.create.l HWIO_PMIC_ARB_OBS1_CHNL65_CONFIG_ADDR A:0x2e09004
y.create.l HWIO_PMIC_ARB_OBS1_CHNL66_CONFIG_ADDR A:0x2e11004
y.create.l HWIO_PMIC_ARB_OBS1_CHNL67_CONFIG_ADDR A:0x2e19004
y.create.l HWIO_PMIC_ARB_OBS1_CHNL68_CONFIG_ADDR A:0x2e21004
y.create.l HWIO_PMIC_ARB_OBS1_CHNL69_CONFIG_ADDR A:0x2e29004
y.create.l HWIO_PMIC_ARB_OBS1_CHNL70_CONFIG_ADDR A:0x2e31004
y.create.l HWIO_PMIC_ARB_OBS1_CHNL71_CONFIG_ADDR A:0x2e39004
y.create.l HWIO_PMIC_ARB_OBS1_CHNL72_CONFIG_ADDR A:0x2e41004
y.create.l HWIO_PMIC_ARB_OBS1_CHNL73_CONFIG_ADDR A:0x2e49004
y.create.l HWIO_PMIC_ARB_OBS1_CHNL74_CONFIG_ADDR A:0x2e51004
y.create.l HWIO_PMIC_ARB_OBS1_CHNL75_CONFIG_ADDR A:0x2e59004
y.create.l HWIO_PMIC_ARB_OBS1_CHNL76_CONFIG_ADDR A:0x2e61004
y.create.l HWIO_PMIC_ARB_OBS1_CHNL77_CONFIG_ADDR A:0x2e69004
y.create.l HWIO_PMIC_ARB_OBS1_CHNL78_CONFIG_ADDR A:0x2e71004
y.create.l HWIO_PMIC_ARB_OBS1_CHNL79_CONFIG_ADDR A:0x2e79004
y.create.l HWIO_PMIC_ARB_OBS1_CHNL80_CONFIG_ADDR A:0x2e81004
y.create.l HWIO_PMIC_ARB_OBS1_CHNL81_CONFIG_ADDR A:0x2e89004
y.create.l HWIO_PMIC_ARB_OBS1_CHNL82_CONFIG_ADDR A:0x2e91004
y.create.l HWIO_PMIC_ARB_OBS1_CHNL83_CONFIG_ADDR A:0x2e99004
y.create.l HWIO_PMIC_ARB_OBS1_CHNL84_CONFIG_ADDR A:0x2ea1004
y.create.l HWIO_PMIC_ARB_OBS1_CHNL85_CONFIG_ADDR A:0x2ea9004
y.create.l HWIO_PMIC_ARB_OBS1_CHNL86_CONFIG_ADDR A:0x2eb1004
y.create.l HWIO_PMIC_ARB_OBS1_CHNL87_CONFIG_ADDR A:0x2eb9004
y.create.l HWIO_PMIC_ARB_OBS1_CHNL88_CONFIG_ADDR A:0x2ec1004
y.create.l HWIO_PMIC_ARB_OBS1_CHNL89_CONFIG_ADDR A:0x2ec9004
y.create.l HWIO_PMIC_ARB_OBS1_CHNL90_CONFIG_ADDR A:0x2ed1004
y.create.l HWIO_PMIC_ARB_OBS1_CHNL91_CONFIG_ADDR A:0x2ed9004
y.create.l HWIO_PMIC_ARB_OBS1_CHNL92_CONFIG_ADDR A:0x2ee1004
y.create.l HWIO_PMIC_ARB_OBS1_CHNL93_CONFIG_ADDR A:0x2ee9004
y.create.l HWIO_PMIC_ARB_OBS1_CHNL94_CONFIG_ADDR A:0x2ef1004
y.create.l HWIO_PMIC_ARB_OBS1_CHNL95_CONFIG_ADDR A:0x2ef9004
y.create.l HWIO_PMIC_ARB_OBS1_CHNL96_CONFIG_ADDR A:0x2f01004
y.create.l HWIO_PMIC_ARB_OBS1_CHNL97_CONFIG_ADDR A:0x2f09004
y.create.l HWIO_PMIC_ARB_OBS1_CHNL98_CONFIG_ADDR A:0x2f11004
y.create.l HWIO_PMIC_ARB_OBS1_CHNL99_CONFIG_ADDR A:0x2f19004
y.create.l HWIO_PMIC_ARB_OBS1_CHNL100_CONFIG_ADDR A:0x2f21004
y.create.l HWIO_PMIC_ARB_OBS1_CHNL101_CONFIG_ADDR A:0x2f29004
y.create.l HWIO_PMIC_ARB_OBS1_CHNL102_CONFIG_ADDR A:0x2f31004
y.create.l HWIO_PMIC_ARB_OBS1_CHNL103_CONFIG_ADDR A:0x2f39004
y.create.l HWIO_PMIC_ARB_OBS1_CHNL104_CONFIG_ADDR A:0x2f41004
y.create.l HWIO_PMIC_ARB_OBS1_CHNL105_CONFIG_ADDR A:0x2f49004
y.create.l HWIO_PMIC_ARB_OBS1_CHNL106_CONFIG_ADDR A:0x2f51004
y.create.l HWIO_PMIC_ARB_OBS1_CHNL107_CONFIG_ADDR A:0x2f59004
y.create.l HWIO_PMIC_ARB_OBS1_CHNL108_CONFIG_ADDR A:0x2f61004
y.create.l HWIO_PMIC_ARB_OBS1_CHNL109_CONFIG_ADDR A:0x2f69004
y.create.l HWIO_PMIC_ARB_OBS1_CHNL110_CONFIG_ADDR A:0x2f71004
y.create.l HWIO_PMIC_ARB_OBS1_CHNL111_CONFIG_ADDR A:0x2f79004
y.create.l HWIO_PMIC_ARB_OBS1_CHNL112_CONFIG_ADDR A:0x2f81004
y.create.l HWIO_PMIC_ARB_OBS1_CHNL113_CONFIG_ADDR A:0x2f89004
y.create.l HWIO_PMIC_ARB_OBS1_CHNL114_CONFIG_ADDR A:0x2f91004
y.create.l HWIO_PMIC_ARB_OBS1_CHNL115_CONFIG_ADDR A:0x2f99004
y.create.l HWIO_PMIC_ARB_OBS1_CHNL116_CONFIG_ADDR A:0x2fa1004
y.create.l HWIO_PMIC_ARB_OBS1_CHNL117_CONFIG_ADDR A:0x2fa9004
y.create.l HWIO_PMIC_ARB_OBS1_CHNL118_CONFIG_ADDR A:0x2fb1004
y.create.l HWIO_PMIC_ARB_OBS1_CHNL119_CONFIG_ADDR A:0x2fb9004
y.create.l HWIO_PMIC_ARB_OBS1_CHNL120_CONFIG_ADDR A:0x2fc1004
y.create.l HWIO_PMIC_ARB_OBS1_CHNL121_CONFIG_ADDR A:0x2fc9004
y.create.l HWIO_PMIC_ARB_OBS1_CHNL122_CONFIG_ADDR A:0x2fd1004
y.create.l HWIO_PMIC_ARB_OBS1_CHNL123_CONFIG_ADDR A:0x2fd9004
y.create.l HWIO_PMIC_ARB_OBS1_CHNL124_CONFIG_ADDR A:0x2fe1004
y.create.l HWIO_PMIC_ARB_OBS1_CHNL125_CONFIG_ADDR A:0x2fe9004
y.create.l HWIO_PMIC_ARB_OBS1_CHNL126_CONFIG_ADDR A:0x2ff1004
y.create.l HWIO_PMIC_ARB_OBS1_CHNL127_CONFIG_ADDR A:0x2ff9004
y.create.l HWIO_PMIC_ARB_OBS1_CHNL128_CONFIG_ADDR A:0x3001004
y.create.l HWIO_PMIC_ARB_OBS1_CHNL129_CONFIG_ADDR A:0x3009004
y.create.l HWIO_PMIC_ARB_OBS1_CHNL130_CONFIG_ADDR A:0x3011004
y.create.l HWIO_PMIC_ARB_OBS1_CHNL131_CONFIG_ADDR A:0x3019004
y.create.l HWIO_PMIC_ARB_OBS1_CHNL132_CONFIG_ADDR A:0x3021004
y.create.l HWIO_PMIC_ARB_OBS1_CHNL133_CONFIG_ADDR A:0x3029004
y.create.l HWIO_PMIC_ARB_OBS1_CHNL134_CONFIG_ADDR A:0x3031004
y.create.l HWIO_PMIC_ARB_OBS1_CHNL135_CONFIG_ADDR A:0x3039004
y.create.l HWIO_PMIC_ARB_OBS1_CHNL136_CONFIG_ADDR A:0x3041004
y.create.l HWIO_PMIC_ARB_OBS1_CHNL137_CONFIG_ADDR A:0x3049004
y.create.l HWIO_PMIC_ARB_OBS1_CHNL138_CONFIG_ADDR A:0x3051004
y.create.l HWIO_PMIC_ARB_OBS1_CHNL139_CONFIG_ADDR A:0x3059004
y.create.l HWIO_PMIC_ARB_OBS1_CHNL140_CONFIG_ADDR A:0x3061004
y.create.l HWIO_PMIC_ARB_OBS1_CHNL141_CONFIG_ADDR A:0x3069004
y.create.l HWIO_PMIC_ARB_OBS1_CHNL142_CONFIG_ADDR A:0x3071004
y.create.l HWIO_PMIC_ARB_OBS1_CHNL143_CONFIG_ADDR A:0x3079004
y.create.l HWIO_PMIC_ARB_OBS1_CHNL144_CONFIG_ADDR A:0x3081004
y.create.l HWIO_PMIC_ARB_OBS1_CHNL145_CONFIG_ADDR A:0x3089004
y.create.l HWIO_PMIC_ARB_OBS1_CHNL146_CONFIG_ADDR A:0x3091004
y.create.l HWIO_PMIC_ARB_OBS1_CHNL147_CONFIG_ADDR A:0x3099004
y.create.l HWIO_PMIC_ARB_OBS1_CHNL148_CONFIG_ADDR A:0x30a1004
y.create.l HWIO_PMIC_ARB_OBS1_CHNL149_CONFIG_ADDR A:0x30a9004
y.create.l HWIO_PMIC_ARB_OBS1_CHNL150_CONFIG_ADDR A:0x30b1004
y.create.l HWIO_PMIC_ARB_OBS1_CHNL151_CONFIG_ADDR A:0x30b9004
y.create.l HWIO_PMIC_ARB_OBS1_CHNL152_CONFIG_ADDR A:0x30c1004
y.create.l HWIO_PMIC_ARB_OBS1_CHNL153_CONFIG_ADDR A:0x30c9004
y.create.l HWIO_PMIC_ARB_OBS1_CHNL154_CONFIG_ADDR A:0x30d1004
y.create.l HWIO_PMIC_ARB_OBS1_CHNL155_CONFIG_ADDR A:0x30d9004
y.create.l HWIO_PMIC_ARB_OBS1_CHNL156_CONFIG_ADDR A:0x30e1004
y.create.l HWIO_PMIC_ARB_OBS1_CHNL157_CONFIG_ADDR A:0x30e9004
y.create.l HWIO_PMIC_ARB_OBS1_CHNL158_CONFIG_ADDR A:0x30f1004
y.create.l HWIO_PMIC_ARB_OBS1_CHNL159_CONFIG_ADDR A:0x30f9004
y.create.l HWIO_PMIC_ARB_OBS1_CHNL160_CONFIG_ADDR A:0x3101004
y.create.l HWIO_PMIC_ARB_OBS1_CHNL161_CONFIG_ADDR A:0x3109004
y.create.l HWIO_PMIC_ARB_OBS1_CHNL162_CONFIG_ADDR A:0x3111004
y.create.l HWIO_PMIC_ARB_OBS1_CHNL163_CONFIG_ADDR A:0x3119004
y.create.l HWIO_PMIC_ARB_OBS1_CHNL164_CONFIG_ADDR A:0x3121004
y.create.l HWIO_PMIC_ARB_OBS1_CHNL165_CONFIG_ADDR A:0x3129004
y.create.l HWIO_PMIC_ARB_OBS1_CHNL166_CONFIG_ADDR A:0x3131004
y.create.l HWIO_PMIC_ARB_OBS1_CHNL167_CONFIG_ADDR A:0x3139004
y.create.l HWIO_PMIC_ARB_OBS1_CHNL168_CONFIG_ADDR A:0x3141004
y.create.l HWIO_PMIC_ARB_OBS1_CHNL169_CONFIG_ADDR A:0x3149004
y.create.l HWIO_PMIC_ARB_OBS1_CHNL170_CONFIG_ADDR A:0x3151004
y.create.l HWIO_PMIC_ARB_OBS1_CHNL171_CONFIG_ADDR A:0x3159004
y.create.l HWIO_PMIC_ARB_OBS1_CHNL172_CONFIG_ADDR A:0x3161004
y.create.l HWIO_PMIC_ARB_OBS1_CHNL173_CONFIG_ADDR A:0x3169004
y.create.l HWIO_PMIC_ARB_OBS1_CHNL174_CONFIG_ADDR A:0x3171004
y.create.l HWIO_PMIC_ARB_OBS1_CHNL175_CONFIG_ADDR A:0x3179004
y.create.l HWIO_PMIC_ARB_OBS1_CHNL176_CONFIG_ADDR A:0x3181004
y.create.l HWIO_PMIC_ARB_OBS1_CHNL177_CONFIG_ADDR A:0x3189004
y.create.l HWIO_PMIC_ARB_OBS1_CHNL178_CONFIG_ADDR A:0x3191004
y.create.l HWIO_PMIC_ARB_OBS1_CHNL179_CONFIG_ADDR A:0x3199004
y.create.l HWIO_PMIC_ARB_OBS1_CHNL180_CONFIG_ADDR A:0x31a1004
y.create.l HWIO_PMIC_ARB_OBS1_CHNL181_CONFIG_ADDR A:0x31a9004
y.create.l HWIO_PMIC_ARB_OBS1_CHNL182_CONFIG_ADDR A:0x31b1004
y.create.l HWIO_PMIC_ARB_OBS1_CHNL183_CONFIG_ADDR A:0x31b9004
y.create.l HWIO_PMIC_ARB_OBS1_CHNL184_CONFIG_ADDR A:0x31c1004
y.create.l HWIO_PMIC_ARB_OBS1_CHNL185_CONFIG_ADDR A:0x31c9004
y.create.l HWIO_PMIC_ARB_OBS1_CHNL186_CONFIG_ADDR A:0x31d1004
y.create.l HWIO_PMIC_ARB_OBS1_CHNL187_CONFIG_ADDR A:0x31d9004
y.create.l HWIO_PMIC_ARB_OBS1_CHNL188_CONFIG_ADDR A:0x31e1004
y.create.l HWIO_PMIC_ARB_OBS1_CHNL189_CONFIG_ADDR A:0x31e9004
y.create.l HWIO_PMIC_ARB_OBS1_CHNL190_CONFIG_ADDR A:0x31f1004
y.create.l HWIO_PMIC_ARB_OBS1_CHNL191_CONFIG_ADDR A:0x31f9004
y.create.l HWIO_PMIC_ARB_OBS1_CHNL192_CONFIG_ADDR A:0x3201004
y.create.l HWIO_PMIC_ARB_OBS1_CHNL193_CONFIG_ADDR A:0x3209004
y.create.l HWIO_PMIC_ARB_OBS1_CHNL194_CONFIG_ADDR A:0x3211004
y.create.l HWIO_PMIC_ARB_OBS1_CHNL195_CONFIG_ADDR A:0x3219004
y.create.l HWIO_PMIC_ARB_OBS1_CHNL196_CONFIG_ADDR A:0x3221004
y.create.l HWIO_PMIC_ARB_OBS1_CHNL197_CONFIG_ADDR A:0x3229004
y.create.l HWIO_PMIC_ARB_OBS1_CHNL198_CONFIG_ADDR A:0x3231004
y.create.l HWIO_PMIC_ARB_OBS1_CHNL199_CONFIG_ADDR A:0x3239004
y.create.l HWIO_PMIC_ARB_OBS1_CHNL200_CONFIG_ADDR A:0x3241004
y.create.l HWIO_PMIC_ARB_OBS1_CHNL201_CONFIG_ADDR A:0x3249004
y.create.l HWIO_PMIC_ARB_OBS1_CHNL202_CONFIG_ADDR A:0x3251004
y.create.l HWIO_PMIC_ARB_OBS1_CHNL203_CONFIG_ADDR A:0x3259004
y.create.l HWIO_PMIC_ARB_OBS1_CHNL204_CONFIG_ADDR A:0x3261004
y.create.l HWIO_PMIC_ARB_OBS1_CHNL205_CONFIG_ADDR A:0x3269004
y.create.l HWIO_PMIC_ARB_OBS1_CHNL206_CONFIG_ADDR A:0x3271004
y.create.l HWIO_PMIC_ARB_OBS1_CHNL207_CONFIG_ADDR A:0x3279004
y.create.l HWIO_PMIC_ARB_OBS1_CHNL208_CONFIG_ADDR A:0x3281004
y.create.l HWIO_PMIC_ARB_OBS1_CHNL209_CONFIG_ADDR A:0x3289004
y.create.l HWIO_PMIC_ARB_OBS1_CHNL210_CONFIG_ADDR A:0x3291004
y.create.l HWIO_PMIC_ARB_OBS1_CHNL211_CONFIG_ADDR A:0x3299004
y.create.l HWIO_PMIC_ARB_OBS1_CHNL212_CONFIG_ADDR A:0x32a1004
y.create.l HWIO_PMIC_ARB_OBS1_CHNL213_CONFIG_ADDR A:0x32a9004
y.create.l HWIO_PMIC_ARB_OBS1_CHNL214_CONFIG_ADDR A:0x32b1004
y.create.l HWIO_PMIC_ARB_OBS1_CHNL215_CONFIG_ADDR A:0x32b9004
y.create.l HWIO_PMIC_ARB_OBS1_CHNL216_CONFIG_ADDR A:0x32c1004
y.create.l HWIO_PMIC_ARB_OBS1_CHNL217_CONFIG_ADDR A:0x32c9004
y.create.l HWIO_PMIC_ARB_OBS1_CHNL218_CONFIG_ADDR A:0x32d1004
y.create.l HWIO_PMIC_ARB_OBS1_CHNL219_CONFIG_ADDR A:0x32d9004
y.create.l HWIO_PMIC_ARB_OBS1_CHNL220_CONFIG_ADDR A:0x32e1004
y.create.l HWIO_PMIC_ARB_OBS1_CHNL221_CONFIG_ADDR A:0x32e9004
y.create.l HWIO_PMIC_ARB_OBS1_CHNL222_CONFIG_ADDR A:0x32f1004
y.create.l HWIO_PMIC_ARB_OBS1_CHNL223_CONFIG_ADDR A:0x32f9004
y.create.l HWIO_PMIC_ARB_OBS1_CHNL224_CONFIG_ADDR A:0x3301004
y.create.l HWIO_PMIC_ARB_OBS1_CHNL225_CONFIG_ADDR A:0x3309004
y.create.l HWIO_PMIC_ARB_OBS1_CHNL226_CONFIG_ADDR A:0x3311004
y.create.l HWIO_PMIC_ARB_OBS1_CHNL227_CONFIG_ADDR A:0x3319004
y.create.l HWIO_PMIC_ARB_OBS1_CHNL228_CONFIG_ADDR A:0x3321004
y.create.l HWIO_PMIC_ARB_OBS1_CHNL229_CONFIG_ADDR A:0x3329004
y.create.l HWIO_PMIC_ARB_OBS1_CHNL230_CONFIG_ADDR A:0x3331004
y.create.l HWIO_PMIC_ARB_OBS1_CHNL231_CONFIG_ADDR A:0x3339004
y.create.l HWIO_PMIC_ARB_OBS1_CHNL232_CONFIG_ADDR A:0x3341004
y.create.l HWIO_PMIC_ARB_OBS1_CHNL233_CONFIG_ADDR A:0x3349004
y.create.l HWIO_PMIC_ARB_OBS1_CHNL234_CONFIG_ADDR A:0x3351004
y.create.l HWIO_PMIC_ARB_OBS1_CHNL235_CONFIG_ADDR A:0x3359004
y.create.l HWIO_PMIC_ARB_OBS1_CHNL236_CONFIG_ADDR A:0x3361004
y.create.l HWIO_PMIC_ARB_OBS1_CHNL237_CONFIG_ADDR A:0x3369004
y.create.l HWIO_PMIC_ARB_OBS1_CHNL238_CONFIG_ADDR A:0x3371004
y.create.l HWIO_PMIC_ARB_OBS1_CHNL239_CONFIG_ADDR A:0x3379004
y.create.l HWIO_PMIC_ARB_OBS1_CHNL240_CONFIG_ADDR A:0x3381004
y.create.l HWIO_PMIC_ARB_OBS1_CHNL241_CONFIG_ADDR A:0x3389004
y.create.l HWIO_PMIC_ARB_OBS1_CHNL242_CONFIG_ADDR A:0x3391004
y.create.l HWIO_PMIC_ARB_OBS1_CHNL243_CONFIG_ADDR A:0x3399004
y.create.l HWIO_PMIC_ARB_OBS1_CHNL244_CONFIG_ADDR A:0x33a1004
y.create.l HWIO_PMIC_ARB_OBS1_CHNL245_CONFIG_ADDR A:0x33a9004
y.create.l HWIO_PMIC_ARB_OBS1_CHNL246_CONFIG_ADDR A:0x33b1004
y.create.l HWIO_PMIC_ARB_OBS1_CHNL247_CONFIG_ADDR A:0x33b9004
y.create.l HWIO_PMIC_ARB_OBS1_CHNL248_CONFIG_ADDR A:0x33c1004
y.create.l HWIO_PMIC_ARB_OBS1_CHNL249_CONFIG_ADDR A:0x33c9004
y.create.l HWIO_PMIC_ARB_OBS1_CHNL250_CONFIG_ADDR A:0x33d1004
y.create.l HWIO_PMIC_ARB_OBS1_CHNL251_CONFIG_ADDR A:0x33d9004
y.create.l HWIO_PMIC_ARB_OBS1_CHNL252_CONFIG_ADDR A:0x33e1004
y.create.l HWIO_PMIC_ARB_OBS1_CHNL253_CONFIG_ADDR A:0x33e9004
y.create.l HWIO_PMIC_ARB_OBS1_CHNL254_CONFIG_ADDR A:0x33f1004
y.create.l HWIO_PMIC_ARB_OBS1_CHNL255_CONFIG_ADDR A:0x33f9004
y.create.l HWIO_PMIC_ARB_OBS2_CHNL0_CONFIG_ADDR A:0x2c02004
y.create.l HWIO_PMIC_ARB_OBS2_CHNL1_CONFIG_ADDR A:0x2c0a004
y.create.l HWIO_PMIC_ARB_OBS2_CHNL2_CONFIG_ADDR A:0x2c12004
y.create.l HWIO_PMIC_ARB_OBS2_CHNL3_CONFIG_ADDR A:0x2c1a004
y.create.l HWIO_PMIC_ARB_OBS2_CHNL4_CONFIG_ADDR A:0x2c22004
y.create.l HWIO_PMIC_ARB_OBS2_CHNL5_CONFIG_ADDR A:0x2c2a004
y.create.l HWIO_PMIC_ARB_OBS2_CHNL6_CONFIG_ADDR A:0x2c32004
y.create.l HWIO_PMIC_ARB_OBS2_CHNL7_CONFIG_ADDR A:0x2c3a004
y.create.l HWIO_PMIC_ARB_OBS2_CHNL8_CONFIG_ADDR A:0x2c42004
y.create.l HWIO_PMIC_ARB_OBS2_CHNL9_CONFIG_ADDR A:0x2c4a004
y.create.l HWIO_PMIC_ARB_OBS2_CHNL10_CONFIG_ADDR A:0x2c52004
y.create.l HWIO_PMIC_ARB_OBS2_CHNL11_CONFIG_ADDR A:0x2c5a004
y.create.l HWIO_PMIC_ARB_OBS2_CHNL12_CONFIG_ADDR A:0x2c62004
y.create.l HWIO_PMIC_ARB_OBS2_CHNL13_CONFIG_ADDR A:0x2c6a004
y.create.l HWIO_PMIC_ARB_OBS2_CHNL14_CONFIG_ADDR A:0x2c72004
y.create.l HWIO_PMIC_ARB_OBS2_CHNL15_CONFIG_ADDR A:0x2c7a004
y.create.l HWIO_PMIC_ARB_OBS2_CHNL16_CONFIG_ADDR A:0x2c82004
y.create.l HWIO_PMIC_ARB_OBS2_CHNL17_CONFIG_ADDR A:0x2c8a004
y.create.l HWIO_PMIC_ARB_OBS2_CHNL18_CONFIG_ADDR A:0x2c92004
y.create.l HWIO_PMIC_ARB_OBS2_CHNL19_CONFIG_ADDR A:0x2c9a004
y.create.l HWIO_PMIC_ARB_OBS2_CHNL20_CONFIG_ADDR A:0x2ca2004
y.create.l HWIO_PMIC_ARB_OBS2_CHNL21_CONFIG_ADDR A:0x2caa004
y.create.l HWIO_PMIC_ARB_OBS2_CHNL22_CONFIG_ADDR A:0x2cb2004
y.create.l HWIO_PMIC_ARB_OBS2_CHNL23_CONFIG_ADDR A:0x2cba004
y.create.l HWIO_PMIC_ARB_OBS2_CHNL24_CONFIG_ADDR A:0x2cc2004
y.create.l HWIO_PMIC_ARB_OBS2_CHNL25_CONFIG_ADDR A:0x2cca004
y.create.l HWIO_PMIC_ARB_OBS2_CHNL26_CONFIG_ADDR A:0x2cd2004
y.create.l HWIO_PMIC_ARB_OBS2_CHNL27_CONFIG_ADDR A:0x2cda004
y.create.l HWIO_PMIC_ARB_OBS2_CHNL28_CONFIG_ADDR A:0x2ce2004
y.create.l HWIO_PMIC_ARB_OBS2_CHNL29_CONFIG_ADDR A:0x2cea004
y.create.l HWIO_PMIC_ARB_OBS2_CHNL30_CONFIG_ADDR A:0x2cf2004
y.create.l HWIO_PMIC_ARB_OBS2_CHNL31_CONFIG_ADDR A:0x2cfa004
y.create.l HWIO_PMIC_ARB_OBS2_CHNL32_CONFIG_ADDR A:0x2d02004
y.create.l HWIO_PMIC_ARB_OBS2_CHNL33_CONFIG_ADDR A:0x2d0a004
y.create.l HWIO_PMIC_ARB_OBS2_CHNL34_CONFIG_ADDR A:0x2d12004
y.create.l HWIO_PMIC_ARB_OBS2_CHNL35_CONFIG_ADDR A:0x2d1a004
y.create.l HWIO_PMIC_ARB_OBS2_CHNL36_CONFIG_ADDR A:0x2d22004
y.create.l HWIO_PMIC_ARB_OBS2_CHNL37_CONFIG_ADDR A:0x2d2a004
y.create.l HWIO_PMIC_ARB_OBS2_CHNL38_CONFIG_ADDR A:0x2d32004
y.create.l HWIO_PMIC_ARB_OBS2_CHNL39_CONFIG_ADDR A:0x2d3a004
y.create.l HWIO_PMIC_ARB_OBS2_CHNL40_CONFIG_ADDR A:0x2d42004
y.create.l HWIO_PMIC_ARB_OBS2_CHNL41_CONFIG_ADDR A:0x2d4a004
y.create.l HWIO_PMIC_ARB_OBS2_CHNL42_CONFIG_ADDR A:0x2d52004
y.create.l HWIO_PMIC_ARB_OBS2_CHNL43_CONFIG_ADDR A:0x2d5a004
y.create.l HWIO_PMIC_ARB_OBS2_CHNL44_CONFIG_ADDR A:0x2d62004
y.create.l HWIO_PMIC_ARB_OBS2_CHNL45_CONFIG_ADDR A:0x2d6a004
y.create.l HWIO_PMIC_ARB_OBS2_CHNL46_CONFIG_ADDR A:0x2d72004
y.create.l HWIO_PMIC_ARB_OBS2_CHNL47_CONFIG_ADDR A:0x2d7a004
y.create.l HWIO_PMIC_ARB_OBS2_CHNL48_CONFIG_ADDR A:0x2d82004
y.create.l HWIO_PMIC_ARB_OBS2_CHNL49_CONFIG_ADDR A:0x2d8a004
y.create.l HWIO_PMIC_ARB_OBS2_CHNL50_CONFIG_ADDR A:0x2d92004
y.create.l HWIO_PMIC_ARB_OBS2_CHNL51_CONFIG_ADDR A:0x2d9a004
y.create.l HWIO_PMIC_ARB_OBS2_CHNL52_CONFIG_ADDR A:0x2da2004
y.create.l HWIO_PMIC_ARB_OBS2_CHNL53_CONFIG_ADDR A:0x2daa004
y.create.l HWIO_PMIC_ARB_OBS2_CHNL54_CONFIG_ADDR A:0x2db2004
y.create.l HWIO_PMIC_ARB_OBS2_CHNL55_CONFIG_ADDR A:0x2dba004
y.create.l HWIO_PMIC_ARB_OBS2_CHNL56_CONFIG_ADDR A:0x2dc2004
y.create.l HWIO_PMIC_ARB_OBS2_CHNL57_CONFIG_ADDR A:0x2dca004
y.create.l HWIO_PMIC_ARB_OBS2_CHNL58_CONFIG_ADDR A:0x2dd2004
y.create.l HWIO_PMIC_ARB_OBS2_CHNL59_CONFIG_ADDR A:0x2dda004
y.create.l HWIO_PMIC_ARB_OBS2_CHNL60_CONFIG_ADDR A:0x2de2004
y.create.l HWIO_PMIC_ARB_OBS2_CHNL61_CONFIG_ADDR A:0x2dea004
y.create.l HWIO_PMIC_ARB_OBS2_CHNL62_CONFIG_ADDR A:0x2df2004
y.create.l HWIO_PMIC_ARB_OBS2_CHNL63_CONFIG_ADDR A:0x2dfa004
y.create.l HWIO_PMIC_ARB_OBS2_CHNL64_CONFIG_ADDR A:0x2e02004
y.create.l HWIO_PMIC_ARB_OBS2_CHNL65_CONFIG_ADDR A:0x2e0a004
y.create.l HWIO_PMIC_ARB_OBS2_CHNL66_CONFIG_ADDR A:0x2e12004
y.create.l HWIO_PMIC_ARB_OBS2_CHNL67_CONFIG_ADDR A:0x2e1a004
y.create.l HWIO_PMIC_ARB_OBS2_CHNL68_CONFIG_ADDR A:0x2e22004
y.create.l HWIO_PMIC_ARB_OBS2_CHNL69_CONFIG_ADDR A:0x2e2a004
y.create.l HWIO_PMIC_ARB_OBS2_CHNL70_CONFIG_ADDR A:0x2e32004
y.create.l HWIO_PMIC_ARB_OBS2_CHNL71_CONFIG_ADDR A:0x2e3a004
y.create.l HWIO_PMIC_ARB_OBS2_CHNL72_CONFIG_ADDR A:0x2e42004
y.create.l HWIO_PMIC_ARB_OBS2_CHNL73_CONFIG_ADDR A:0x2e4a004
y.create.l HWIO_PMIC_ARB_OBS2_CHNL74_CONFIG_ADDR A:0x2e52004
y.create.l HWIO_PMIC_ARB_OBS2_CHNL75_CONFIG_ADDR A:0x2e5a004
y.create.l HWIO_PMIC_ARB_OBS2_CHNL76_CONFIG_ADDR A:0x2e62004
y.create.l HWIO_PMIC_ARB_OBS2_CHNL77_CONFIG_ADDR A:0x2e6a004
y.create.l HWIO_PMIC_ARB_OBS2_CHNL78_CONFIG_ADDR A:0x2e72004
y.create.l HWIO_PMIC_ARB_OBS2_CHNL79_CONFIG_ADDR A:0x2e7a004
y.create.l HWIO_PMIC_ARB_OBS2_CHNL80_CONFIG_ADDR A:0x2e82004
y.create.l HWIO_PMIC_ARB_OBS2_CHNL81_CONFIG_ADDR A:0x2e8a004
y.create.l HWIO_PMIC_ARB_OBS2_CHNL82_CONFIG_ADDR A:0x2e92004
y.create.l HWIO_PMIC_ARB_OBS2_CHNL83_CONFIG_ADDR A:0x2e9a004
y.create.l HWIO_PMIC_ARB_OBS2_CHNL84_CONFIG_ADDR A:0x2ea2004
y.create.l HWIO_PMIC_ARB_OBS2_CHNL85_CONFIG_ADDR A:0x2eaa004
y.create.l HWIO_PMIC_ARB_OBS2_CHNL86_CONFIG_ADDR A:0x2eb2004
y.create.l HWIO_PMIC_ARB_OBS2_CHNL87_CONFIG_ADDR A:0x2eba004
y.create.l HWIO_PMIC_ARB_OBS2_CHNL88_CONFIG_ADDR A:0x2ec2004
y.create.l HWIO_PMIC_ARB_OBS2_CHNL89_CONFIG_ADDR A:0x2eca004
y.create.l HWIO_PMIC_ARB_OBS2_CHNL90_CONFIG_ADDR A:0x2ed2004
y.create.l HWIO_PMIC_ARB_OBS2_CHNL91_CONFIG_ADDR A:0x2eda004
y.create.l HWIO_PMIC_ARB_OBS2_CHNL92_CONFIG_ADDR A:0x2ee2004
y.create.l HWIO_PMIC_ARB_OBS2_CHNL93_CONFIG_ADDR A:0x2eea004
y.create.l HWIO_PMIC_ARB_OBS2_CHNL94_CONFIG_ADDR A:0x2ef2004
y.create.l HWIO_PMIC_ARB_OBS2_CHNL95_CONFIG_ADDR A:0x2efa004
y.create.l HWIO_PMIC_ARB_OBS2_CHNL96_CONFIG_ADDR A:0x2f02004
y.create.l HWIO_PMIC_ARB_OBS2_CHNL97_CONFIG_ADDR A:0x2f0a004
y.create.l HWIO_PMIC_ARB_OBS2_CHNL98_CONFIG_ADDR A:0x2f12004
y.create.l HWIO_PMIC_ARB_OBS2_CHNL99_CONFIG_ADDR A:0x2f1a004
y.create.l HWIO_PMIC_ARB_OBS2_CHNL100_CONFIG_ADDR A:0x2f22004
y.create.l HWIO_PMIC_ARB_OBS2_CHNL101_CONFIG_ADDR A:0x2f2a004
y.create.l HWIO_PMIC_ARB_OBS2_CHNL102_CONFIG_ADDR A:0x2f32004
y.create.l HWIO_PMIC_ARB_OBS2_CHNL103_CONFIG_ADDR A:0x2f3a004
y.create.l HWIO_PMIC_ARB_OBS2_CHNL104_CONFIG_ADDR A:0x2f42004
y.create.l HWIO_PMIC_ARB_OBS2_CHNL105_CONFIG_ADDR A:0x2f4a004
y.create.l HWIO_PMIC_ARB_OBS2_CHNL106_CONFIG_ADDR A:0x2f52004
y.create.l HWIO_PMIC_ARB_OBS2_CHNL107_CONFIG_ADDR A:0x2f5a004
y.create.l HWIO_PMIC_ARB_OBS2_CHNL108_CONFIG_ADDR A:0x2f62004
y.create.l HWIO_PMIC_ARB_OBS2_CHNL109_CONFIG_ADDR A:0x2f6a004
y.create.l HWIO_PMIC_ARB_OBS2_CHNL110_CONFIG_ADDR A:0x2f72004
y.create.l HWIO_PMIC_ARB_OBS2_CHNL111_CONFIG_ADDR A:0x2f7a004
y.create.l HWIO_PMIC_ARB_OBS2_CHNL112_CONFIG_ADDR A:0x2f82004
y.create.l HWIO_PMIC_ARB_OBS2_CHNL113_CONFIG_ADDR A:0x2f8a004
y.create.l HWIO_PMIC_ARB_OBS2_CHNL114_CONFIG_ADDR A:0x2f92004
y.create.l HWIO_PMIC_ARB_OBS2_CHNL115_CONFIG_ADDR A:0x2f9a004
y.create.l HWIO_PMIC_ARB_OBS2_CHNL116_CONFIG_ADDR A:0x2fa2004
y.create.l HWIO_PMIC_ARB_OBS2_CHNL117_CONFIG_ADDR A:0x2faa004
y.create.l HWIO_PMIC_ARB_OBS2_CHNL118_CONFIG_ADDR A:0x2fb2004
y.create.l HWIO_PMIC_ARB_OBS2_CHNL119_CONFIG_ADDR A:0x2fba004
y.create.l HWIO_PMIC_ARB_OBS2_CHNL120_CONFIG_ADDR A:0x2fc2004
y.create.l HWIO_PMIC_ARB_OBS2_CHNL121_CONFIG_ADDR A:0x2fca004
y.create.l HWIO_PMIC_ARB_OBS2_CHNL122_CONFIG_ADDR A:0x2fd2004
y.create.l HWIO_PMIC_ARB_OBS2_CHNL123_CONFIG_ADDR A:0x2fda004
y.create.l HWIO_PMIC_ARB_OBS2_CHNL124_CONFIG_ADDR A:0x2fe2004
y.create.l HWIO_PMIC_ARB_OBS2_CHNL125_CONFIG_ADDR A:0x2fea004
y.create.l HWIO_PMIC_ARB_OBS2_CHNL126_CONFIG_ADDR A:0x2ff2004
y.create.l HWIO_PMIC_ARB_OBS2_CHNL127_CONFIG_ADDR A:0x2ffa004
y.create.l HWIO_PMIC_ARB_OBS2_CHNL128_CONFIG_ADDR A:0x3002004
y.create.l HWIO_PMIC_ARB_OBS2_CHNL129_CONFIG_ADDR A:0x300a004
y.create.l HWIO_PMIC_ARB_OBS2_CHNL130_CONFIG_ADDR A:0x3012004
y.create.l HWIO_PMIC_ARB_OBS2_CHNL131_CONFIG_ADDR A:0x301a004
y.create.l HWIO_PMIC_ARB_OBS2_CHNL132_CONFIG_ADDR A:0x3022004
y.create.l HWIO_PMIC_ARB_OBS2_CHNL133_CONFIG_ADDR A:0x302a004
y.create.l HWIO_PMIC_ARB_OBS2_CHNL134_CONFIG_ADDR A:0x3032004
y.create.l HWIO_PMIC_ARB_OBS2_CHNL135_CONFIG_ADDR A:0x303a004
y.create.l HWIO_PMIC_ARB_OBS2_CHNL136_CONFIG_ADDR A:0x3042004
y.create.l HWIO_PMIC_ARB_OBS2_CHNL137_CONFIG_ADDR A:0x304a004
y.create.l HWIO_PMIC_ARB_OBS2_CHNL138_CONFIG_ADDR A:0x3052004
y.create.l HWIO_PMIC_ARB_OBS2_CHNL139_CONFIG_ADDR A:0x305a004
y.create.l HWIO_PMIC_ARB_OBS2_CHNL140_CONFIG_ADDR A:0x3062004
y.create.l HWIO_PMIC_ARB_OBS2_CHNL141_CONFIG_ADDR A:0x306a004
y.create.l HWIO_PMIC_ARB_OBS2_CHNL142_CONFIG_ADDR A:0x3072004
y.create.l HWIO_PMIC_ARB_OBS2_CHNL143_CONFIG_ADDR A:0x307a004
y.create.l HWIO_PMIC_ARB_OBS2_CHNL144_CONFIG_ADDR A:0x3082004
y.create.l HWIO_PMIC_ARB_OBS2_CHNL145_CONFIG_ADDR A:0x308a004
y.create.l HWIO_PMIC_ARB_OBS2_CHNL146_CONFIG_ADDR A:0x3092004
y.create.l HWIO_PMIC_ARB_OBS2_CHNL147_CONFIG_ADDR A:0x309a004
y.create.l HWIO_PMIC_ARB_OBS2_CHNL148_CONFIG_ADDR A:0x30a2004
y.create.l HWIO_PMIC_ARB_OBS2_CHNL149_CONFIG_ADDR A:0x30aa004
y.create.l HWIO_PMIC_ARB_OBS2_CHNL150_CONFIG_ADDR A:0x30b2004
y.create.l HWIO_PMIC_ARB_OBS2_CHNL151_CONFIG_ADDR A:0x30ba004
y.create.l HWIO_PMIC_ARB_OBS2_CHNL152_CONFIG_ADDR A:0x30c2004
y.create.l HWIO_PMIC_ARB_OBS2_CHNL153_CONFIG_ADDR A:0x30ca004
y.create.l HWIO_PMIC_ARB_OBS2_CHNL154_CONFIG_ADDR A:0x30d2004
y.create.l HWIO_PMIC_ARB_OBS2_CHNL155_CONFIG_ADDR A:0x30da004
y.create.l HWIO_PMIC_ARB_OBS2_CHNL156_CONFIG_ADDR A:0x30e2004
y.create.l HWIO_PMIC_ARB_OBS2_CHNL157_CONFIG_ADDR A:0x30ea004
y.create.l HWIO_PMIC_ARB_OBS2_CHNL158_CONFIG_ADDR A:0x30f2004
y.create.l HWIO_PMIC_ARB_OBS2_CHNL159_CONFIG_ADDR A:0x30fa004
y.create.l HWIO_PMIC_ARB_OBS2_CHNL160_CONFIG_ADDR A:0x3102004
y.create.l HWIO_PMIC_ARB_OBS2_CHNL161_CONFIG_ADDR A:0x310a004
y.create.l HWIO_PMIC_ARB_OBS2_CHNL162_CONFIG_ADDR A:0x3112004
y.create.l HWIO_PMIC_ARB_OBS2_CHNL163_CONFIG_ADDR A:0x311a004
y.create.l HWIO_PMIC_ARB_OBS2_CHNL164_CONFIG_ADDR A:0x3122004
y.create.l HWIO_PMIC_ARB_OBS2_CHNL165_CONFIG_ADDR A:0x312a004
y.create.l HWIO_PMIC_ARB_OBS2_CHNL166_CONFIG_ADDR A:0x3132004
y.create.l HWIO_PMIC_ARB_OBS2_CHNL167_CONFIG_ADDR A:0x313a004
y.create.l HWIO_PMIC_ARB_OBS2_CHNL168_CONFIG_ADDR A:0x3142004
y.create.l HWIO_PMIC_ARB_OBS2_CHNL169_CONFIG_ADDR A:0x314a004
y.create.l HWIO_PMIC_ARB_OBS2_CHNL170_CONFIG_ADDR A:0x3152004
y.create.l HWIO_PMIC_ARB_OBS2_CHNL171_CONFIG_ADDR A:0x315a004
y.create.l HWIO_PMIC_ARB_OBS2_CHNL172_CONFIG_ADDR A:0x3162004
y.create.l HWIO_PMIC_ARB_OBS2_CHNL173_CONFIG_ADDR A:0x316a004
y.create.l HWIO_PMIC_ARB_OBS2_CHNL174_CONFIG_ADDR A:0x3172004
y.create.l HWIO_PMIC_ARB_OBS2_CHNL175_CONFIG_ADDR A:0x317a004
y.create.l HWIO_PMIC_ARB_OBS2_CHNL176_CONFIG_ADDR A:0x3182004
y.create.l HWIO_PMIC_ARB_OBS2_CHNL177_CONFIG_ADDR A:0x318a004
y.create.l HWIO_PMIC_ARB_OBS2_CHNL178_CONFIG_ADDR A:0x3192004
y.create.l HWIO_PMIC_ARB_OBS2_CHNL179_CONFIG_ADDR A:0x319a004
y.create.l HWIO_PMIC_ARB_OBS2_CHNL180_CONFIG_ADDR A:0x31a2004
y.create.l HWIO_PMIC_ARB_OBS2_CHNL181_CONFIG_ADDR A:0x31aa004
y.create.l HWIO_PMIC_ARB_OBS2_CHNL182_CONFIG_ADDR A:0x31b2004
y.create.l HWIO_PMIC_ARB_OBS2_CHNL183_CONFIG_ADDR A:0x31ba004
y.create.l HWIO_PMIC_ARB_OBS2_CHNL184_CONFIG_ADDR A:0x31c2004
y.create.l HWIO_PMIC_ARB_OBS2_CHNL185_CONFIG_ADDR A:0x31ca004
y.create.l HWIO_PMIC_ARB_OBS2_CHNL186_CONFIG_ADDR A:0x31d2004
y.create.l HWIO_PMIC_ARB_OBS2_CHNL187_CONFIG_ADDR A:0x31da004
y.create.l HWIO_PMIC_ARB_OBS2_CHNL188_CONFIG_ADDR A:0x31e2004
y.create.l HWIO_PMIC_ARB_OBS2_CHNL189_CONFIG_ADDR A:0x31ea004
y.create.l HWIO_PMIC_ARB_OBS2_CHNL190_CONFIG_ADDR A:0x31f2004
y.create.l HWIO_PMIC_ARB_OBS2_CHNL191_CONFIG_ADDR A:0x31fa004
y.create.l HWIO_PMIC_ARB_OBS2_CHNL192_CONFIG_ADDR A:0x3202004
y.create.l HWIO_PMIC_ARB_OBS2_CHNL193_CONFIG_ADDR A:0x320a004
y.create.l HWIO_PMIC_ARB_OBS2_CHNL194_CONFIG_ADDR A:0x3212004
y.create.l HWIO_PMIC_ARB_OBS2_CHNL195_CONFIG_ADDR A:0x321a004
y.create.l HWIO_PMIC_ARB_OBS2_CHNL196_CONFIG_ADDR A:0x3222004
y.create.l HWIO_PMIC_ARB_OBS2_CHNL197_CONFIG_ADDR A:0x322a004
y.create.l HWIO_PMIC_ARB_OBS2_CHNL198_CONFIG_ADDR A:0x3232004
y.create.l HWIO_PMIC_ARB_OBS2_CHNL199_CONFIG_ADDR A:0x323a004
y.create.l HWIO_PMIC_ARB_OBS2_CHNL200_CONFIG_ADDR A:0x3242004
y.create.l HWIO_PMIC_ARB_OBS2_CHNL201_CONFIG_ADDR A:0x324a004
y.create.l HWIO_PMIC_ARB_OBS2_CHNL202_CONFIG_ADDR A:0x3252004
y.create.l HWIO_PMIC_ARB_OBS2_CHNL203_CONFIG_ADDR A:0x325a004
y.create.l HWIO_PMIC_ARB_OBS2_CHNL204_CONFIG_ADDR A:0x3262004
y.create.l HWIO_PMIC_ARB_OBS2_CHNL205_CONFIG_ADDR A:0x326a004
y.create.l HWIO_PMIC_ARB_OBS2_CHNL206_CONFIG_ADDR A:0x3272004
y.create.l HWIO_PMIC_ARB_OBS2_CHNL207_CONFIG_ADDR A:0x327a004
y.create.l HWIO_PMIC_ARB_OBS2_CHNL208_CONFIG_ADDR A:0x3282004
y.create.l HWIO_PMIC_ARB_OBS2_CHNL209_CONFIG_ADDR A:0x328a004
y.create.l HWIO_PMIC_ARB_OBS2_CHNL210_CONFIG_ADDR A:0x3292004
y.create.l HWIO_PMIC_ARB_OBS2_CHNL211_CONFIG_ADDR A:0x329a004
y.create.l HWIO_PMIC_ARB_OBS2_CHNL212_CONFIG_ADDR A:0x32a2004
y.create.l HWIO_PMIC_ARB_OBS2_CHNL213_CONFIG_ADDR A:0x32aa004
y.create.l HWIO_PMIC_ARB_OBS2_CHNL214_CONFIG_ADDR A:0x32b2004
y.create.l HWIO_PMIC_ARB_OBS2_CHNL215_CONFIG_ADDR A:0x32ba004
y.create.l HWIO_PMIC_ARB_OBS2_CHNL216_CONFIG_ADDR A:0x32c2004
y.create.l HWIO_PMIC_ARB_OBS2_CHNL217_CONFIG_ADDR A:0x32ca004
y.create.l HWIO_PMIC_ARB_OBS2_CHNL218_CONFIG_ADDR A:0x32d2004
y.create.l HWIO_PMIC_ARB_OBS2_CHNL219_CONFIG_ADDR A:0x32da004
y.create.l HWIO_PMIC_ARB_OBS2_CHNL220_CONFIG_ADDR A:0x32e2004
y.create.l HWIO_PMIC_ARB_OBS2_CHNL221_CONFIG_ADDR A:0x32ea004
y.create.l HWIO_PMIC_ARB_OBS2_CHNL222_CONFIG_ADDR A:0x32f2004
y.create.l HWIO_PMIC_ARB_OBS2_CHNL223_CONFIG_ADDR A:0x32fa004
y.create.l HWIO_PMIC_ARB_OBS2_CHNL224_CONFIG_ADDR A:0x3302004
y.create.l HWIO_PMIC_ARB_OBS2_CHNL225_CONFIG_ADDR A:0x330a004
y.create.l HWIO_PMIC_ARB_OBS2_CHNL226_CONFIG_ADDR A:0x3312004
y.create.l HWIO_PMIC_ARB_OBS2_CHNL227_CONFIG_ADDR A:0x331a004
y.create.l HWIO_PMIC_ARB_OBS2_CHNL228_CONFIG_ADDR A:0x3322004
y.create.l HWIO_PMIC_ARB_OBS2_CHNL229_CONFIG_ADDR A:0x332a004
y.create.l HWIO_PMIC_ARB_OBS2_CHNL230_CONFIG_ADDR A:0x3332004
y.create.l HWIO_PMIC_ARB_OBS2_CHNL231_CONFIG_ADDR A:0x333a004
y.create.l HWIO_PMIC_ARB_OBS2_CHNL232_CONFIG_ADDR A:0x3342004
y.create.l HWIO_PMIC_ARB_OBS2_CHNL233_CONFIG_ADDR A:0x334a004
y.create.l HWIO_PMIC_ARB_OBS2_CHNL234_CONFIG_ADDR A:0x3352004
y.create.l HWIO_PMIC_ARB_OBS2_CHNL235_CONFIG_ADDR A:0x335a004
y.create.l HWIO_PMIC_ARB_OBS2_CHNL236_CONFIG_ADDR A:0x3362004
y.create.l HWIO_PMIC_ARB_OBS2_CHNL237_CONFIG_ADDR A:0x336a004
y.create.l HWIO_PMIC_ARB_OBS2_CHNL238_CONFIG_ADDR A:0x3372004
y.create.l HWIO_PMIC_ARB_OBS2_CHNL239_CONFIG_ADDR A:0x337a004
y.create.l HWIO_PMIC_ARB_OBS2_CHNL240_CONFIG_ADDR A:0x3382004
y.create.l HWIO_PMIC_ARB_OBS2_CHNL241_CONFIG_ADDR A:0x338a004
y.create.l HWIO_PMIC_ARB_OBS2_CHNL242_CONFIG_ADDR A:0x3392004
y.create.l HWIO_PMIC_ARB_OBS2_CHNL243_CONFIG_ADDR A:0x339a004
y.create.l HWIO_PMIC_ARB_OBS2_CHNL244_CONFIG_ADDR A:0x33a2004
y.create.l HWIO_PMIC_ARB_OBS2_CHNL245_CONFIG_ADDR A:0x33aa004
y.create.l HWIO_PMIC_ARB_OBS2_CHNL246_CONFIG_ADDR A:0x33b2004
y.create.l HWIO_PMIC_ARB_OBS2_CHNL247_CONFIG_ADDR A:0x33ba004
y.create.l HWIO_PMIC_ARB_OBS2_CHNL248_CONFIG_ADDR A:0x33c2004
y.create.l HWIO_PMIC_ARB_OBS2_CHNL249_CONFIG_ADDR A:0x33ca004
y.create.l HWIO_PMIC_ARB_OBS2_CHNL250_CONFIG_ADDR A:0x33d2004
y.create.l HWIO_PMIC_ARB_OBS2_CHNL251_CONFIG_ADDR A:0x33da004
y.create.l HWIO_PMIC_ARB_OBS2_CHNL252_CONFIG_ADDR A:0x33e2004
y.create.l HWIO_PMIC_ARB_OBS2_CHNL253_CONFIG_ADDR A:0x33ea004
y.create.l HWIO_PMIC_ARB_OBS2_CHNL254_CONFIG_ADDR A:0x33f2004
y.create.l HWIO_PMIC_ARB_OBS2_CHNL255_CONFIG_ADDR A:0x33fa004
y.create.l HWIO_PMIC_ARB_OBS3_CHNL0_CONFIG_ADDR A:0x2c03004
y.create.l HWIO_PMIC_ARB_OBS3_CHNL1_CONFIG_ADDR A:0x2c0b004
y.create.l HWIO_PMIC_ARB_OBS3_CHNL2_CONFIG_ADDR A:0x2c13004
y.create.l HWIO_PMIC_ARB_OBS3_CHNL3_CONFIG_ADDR A:0x2c1b004
y.create.l HWIO_PMIC_ARB_OBS3_CHNL4_CONFIG_ADDR A:0x2c23004
y.create.l HWIO_PMIC_ARB_OBS3_CHNL5_CONFIG_ADDR A:0x2c2b004
y.create.l HWIO_PMIC_ARB_OBS3_CHNL6_CONFIG_ADDR A:0x2c33004
y.create.l HWIO_PMIC_ARB_OBS3_CHNL7_CONFIG_ADDR A:0x2c3b004
y.create.l HWIO_PMIC_ARB_OBS3_CHNL8_CONFIG_ADDR A:0x2c43004
y.create.l HWIO_PMIC_ARB_OBS3_CHNL9_CONFIG_ADDR A:0x2c4b004
y.create.l HWIO_PMIC_ARB_OBS3_CHNL10_CONFIG_ADDR A:0x2c53004
y.create.l HWIO_PMIC_ARB_OBS3_CHNL11_CONFIG_ADDR A:0x2c5b004
y.create.l HWIO_PMIC_ARB_OBS3_CHNL12_CONFIG_ADDR A:0x2c63004
y.create.l HWIO_PMIC_ARB_OBS3_CHNL13_CONFIG_ADDR A:0x2c6b004
y.create.l HWIO_PMIC_ARB_OBS3_CHNL14_CONFIG_ADDR A:0x2c73004
y.create.l HWIO_PMIC_ARB_OBS3_CHNL15_CONFIG_ADDR A:0x2c7b004
y.create.l HWIO_PMIC_ARB_OBS3_CHNL16_CONFIG_ADDR A:0x2c83004
y.create.l HWIO_PMIC_ARB_OBS3_CHNL17_CONFIG_ADDR A:0x2c8b004
y.create.l HWIO_PMIC_ARB_OBS3_CHNL18_CONFIG_ADDR A:0x2c93004
y.create.l HWIO_PMIC_ARB_OBS3_CHNL19_CONFIG_ADDR A:0x2c9b004
y.create.l HWIO_PMIC_ARB_OBS3_CHNL20_CONFIG_ADDR A:0x2ca3004
y.create.l HWIO_PMIC_ARB_OBS3_CHNL21_CONFIG_ADDR A:0x2cab004
y.create.l HWIO_PMIC_ARB_OBS3_CHNL22_CONFIG_ADDR A:0x2cb3004
y.create.l HWIO_PMIC_ARB_OBS3_CHNL23_CONFIG_ADDR A:0x2cbb004
y.create.l HWIO_PMIC_ARB_OBS3_CHNL24_CONFIG_ADDR A:0x2cc3004
y.create.l HWIO_PMIC_ARB_OBS3_CHNL25_CONFIG_ADDR A:0x2ccb004
y.create.l HWIO_PMIC_ARB_OBS3_CHNL26_CONFIG_ADDR A:0x2cd3004
y.create.l HWIO_PMIC_ARB_OBS3_CHNL27_CONFIG_ADDR A:0x2cdb004
y.create.l HWIO_PMIC_ARB_OBS3_CHNL28_CONFIG_ADDR A:0x2ce3004
y.create.l HWIO_PMIC_ARB_OBS3_CHNL29_CONFIG_ADDR A:0x2ceb004
y.create.l HWIO_PMIC_ARB_OBS3_CHNL30_CONFIG_ADDR A:0x2cf3004
y.create.l HWIO_PMIC_ARB_OBS3_CHNL31_CONFIG_ADDR A:0x2cfb004
y.create.l HWIO_PMIC_ARB_OBS3_CHNL32_CONFIG_ADDR A:0x2d03004
y.create.l HWIO_PMIC_ARB_OBS3_CHNL33_CONFIG_ADDR A:0x2d0b004
y.create.l HWIO_PMIC_ARB_OBS3_CHNL34_CONFIG_ADDR A:0x2d13004
y.create.l HWIO_PMIC_ARB_OBS3_CHNL35_CONFIG_ADDR A:0x2d1b004
y.create.l HWIO_PMIC_ARB_OBS3_CHNL36_CONFIG_ADDR A:0x2d23004
y.create.l HWIO_PMIC_ARB_OBS3_CHNL37_CONFIG_ADDR A:0x2d2b004
y.create.l HWIO_PMIC_ARB_OBS3_CHNL38_CONFIG_ADDR A:0x2d33004
y.create.l HWIO_PMIC_ARB_OBS3_CHNL39_CONFIG_ADDR A:0x2d3b004
y.create.l HWIO_PMIC_ARB_OBS3_CHNL40_CONFIG_ADDR A:0x2d43004
y.create.l HWIO_PMIC_ARB_OBS3_CHNL41_CONFIG_ADDR A:0x2d4b004
y.create.l HWIO_PMIC_ARB_OBS3_CHNL42_CONFIG_ADDR A:0x2d53004
y.create.l HWIO_PMIC_ARB_OBS3_CHNL43_CONFIG_ADDR A:0x2d5b004
y.create.l HWIO_PMIC_ARB_OBS3_CHNL44_CONFIG_ADDR A:0x2d63004
y.create.l HWIO_PMIC_ARB_OBS3_CHNL45_CONFIG_ADDR A:0x2d6b004
y.create.l HWIO_PMIC_ARB_OBS3_CHNL46_CONFIG_ADDR A:0x2d73004
y.create.l HWIO_PMIC_ARB_OBS3_CHNL47_CONFIG_ADDR A:0x2d7b004
y.create.l HWIO_PMIC_ARB_OBS3_CHNL48_CONFIG_ADDR A:0x2d83004
y.create.l HWIO_PMIC_ARB_OBS3_CHNL49_CONFIG_ADDR A:0x2d8b004
y.create.l HWIO_PMIC_ARB_OBS3_CHNL50_CONFIG_ADDR A:0x2d93004
y.create.l HWIO_PMIC_ARB_OBS3_CHNL51_CONFIG_ADDR A:0x2d9b004
y.create.l HWIO_PMIC_ARB_OBS3_CHNL52_CONFIG_ADDR A:0x2da3004
y.create.l HWIO_PMIC_ARB_OBS3_CHNL53_CONFIG_ADDR A:0x2dab004
y.create.l HWIO_PMIC_ARB_OBS3_CHNL54_CONFIG_ADDR A:0x2db3004
y.create.l HWIO_PMIC_ARB_OBS3_CHNL55_CONFIG_ADDR A:0x2dbb004
y.create.l HWIO_PMIC_ARB_OBS3_CHNL56_CONFIG_ADDR A:0x2dc3004
y.create.l HWIO_PMIC_ARB_OBS3_CHNL57_CONFIG_ADDR A:0x2dcb004
y.create.l HWIO_PMIC_ARB_OBS3_CHNL58_CONFIG_ADDR A:0x2dd3004
y.create.l HWIO_PMIC_ARB_OBS3_CHNL59_CONFIG_ADDR A:0x2ddb004
y.create.l HWIO_PMIC_ARB_OBS3_CHNL60_CONFIG_ADDR A:0x2de3004
y.create.l HWIO_PMIC_ARB_OBS3_CHNL61_CONFIG_ADDR A:0x2deb004
y.create.l HWIO_PMIC_ARB_OBS3_CHNL62_CONFIG_ADDR A:0x2df3004
y.create.l HWIO_PMIC_ARB_OBS3_CHNL63_CONFIG_ADDR A:0x2dfb004
y.create.l HWIO_PMIC_ARB_OBS3_CHNL64_CONFIG_ADDR A:0x2e03004
y.create.l HWIO_PMIC_ARB_OBS3_CHNL65_CONFIG_ADDR A:0x2e0b004
y.create.l HWIO_PMIC_ARB_OBS3_CHNL66_CONFIG_ADDR A:0x2e13004
y.create.l HWIO_PMIC_ARB_OBS3_CHNL67_CONFIG_ADDR A:0x2e1b004
y.create.l HWIO_PMIC_ARB_OBS3_CHNL68_CONFIG_ADDR A:0x2e23004
y.create.l HWIO_PMIC_ARB_OBS3_CHNL69_CONFIG_ADDR A:0x2e2b004
y.create.l HWIO_PMIC_ARB_OBS3_CHNL70_CONFIG_ADDR A:0x2e33004
y.create.l HWIO_PMIC_ARB_OBS3_CHNL71_CONFIG_ADDR A:0x2e3b004
y.create.l HWIO_PMIC_ARB_OBS3_CHNL72_CONFIG_ADDR A:0x2e43004
y.create.l HWIO_PMIC_ARB_OBS3_CHNL73_CONFIG_ADDR A:0x2e4b004
y.create.l HWIO_PMIC_ARB_OBS3_CHNL74_CONFIG_ADDR A:0x2e53004
y.create.l HWIO_PMIC_ARB_OBS3_CHNL75_CONFIG_ADDR A:0x2e5b004
y.create.l HWIO_PMIC_ARB_OBS3_CHNL76_CONFIG_ADDR A:0x2e63004
y.create.l HWIO_PMIC_ARB_OBS3_CHNL77_CONFIG_ADDR A:0x2e6b004
y.create.l HWIO_PMIC_ARB_OBS3_CHNL78_CONFIG_ADDR A:0x2e73004
y.create.l HWIO_PMIC_ARB_OBS3_CHNL79_CONFIG_ADDR A:0x2e7b004
y.create.l HWIO_PMIC_ARB_OBS3_CHNL80_CONFIG_ADDR A:0x2e83004
y.create.l HWIO_PMIC_ARB_OBS3_CHNL81_CONFIG_ADDR A:0x2e8b004
y.create.l HWIO_PMIC_ARB_OBS3_CHNL82_CONFIG_ADDR A:0x2e93004
y.create.l HWIO_PMIC_ARB_OBS3_CHNL83_CONFIG_ADDR A:0x2e9b004
y.create.l HWIO_PMIC_ARB_OBS3_CHNL84_CONFIG_ADDR A:0x2ea3004
y.create.l HWIO_PMIC_ARB_OBS3_CHNL85_CONFIG_ADDR A:0x2eab004
y.create.l HWIO_PMIC_ARB_OBS3_CHNL86_CONFIG_ADDR A:0x2eb3004
y.create.l HWIO_PMIC_ARB_OBS3_CHNL87_CONFIG_ADDR A:0x2ebb004
y.create.l HWIO_PMIC_ARB_OBS3_CHNL88_CONFIG_ADDR A:0x2ec3004
y.create.l HWIO_PMIC_ARB_OBS3_CHNL89_CONFIG_ADDR A:0x2ecb004
y.create.l HWIO_PMIC_ARB_OBS3_CHNL90_CONFIG_ADDR A:0x2ed3004
y.create.l HWIO_PMIC_ARB_OBS3_CHNL91_CONFIG_ADDR A:0x2edb004
y.create.l HWIO_PMIC_ARB_OBS3_CHNL92_CONFIG_ADDR A:0x2ee3004
y.create.l HWIO_PMIC_ARB_OBS3_CHNL93_CONFIG_ADDR A:0x2eeb004
y.create.l HWIO_PMIC_ARB_OBS3_CHNL94_CONFIG_ADDR A:0x2ef3004
y.create.l HWIO_PMIC_ARB_OBS3_CHNL95_CONFIG_ADDR A:0x2efb004
y.create.l HWIO_PMIC_ARB_OBS3_CHNL96_CONFIG_ADDR A:0x2f03004
y.create.l HWIO_PMIC_ARB_OBS3_CHNL97_CONFIG_ADDR A:0x2f0b004
y.create.l HWIO_PMIC_ARB_OBS3_CHNL98_CONFIG_ADDR A:0x2f13004
y.create.l HWIO_PMIC_ARB_OBS3_CHNL99_CONFIG_ADDR A:0x2f1b004
y.create.l HWIO_PMIC_ARB_OBS3_CHNL100_CONFIG_ADDR A:0x2f23004
y.create.l HWIO_PMIC_ARB_OBS3_CHNL101_CONFIG_ADDR A:0x2f2b004
y.create.l HWIO_PMIC_ARB_OBS3_CHNL102_CONFIG_ADDR A:0x2f33004
y.create.l HWIO_PMIC_ARB_OBS3_CHNL103_CONFIG_ADDR A:0x2f3b004
y.create.l HWIO_PMIC_ARB_OBS3_CHNL104_CONFIG_ADDR A:0x2f43004
y.create.l HWIO_PMIC_ARB_OBS3_CHNL105_CONFIG_ADDR A:0x2f4b004
y.create.l HWIO_PMIC_ARB_OBS3_CHNL106_CONFIG_ADDR A:0x2f53004
y.create.l HWIO_PMIC_ARB_OBS3_CHNL107_CONFIG_ADDR A:0x2f5b004
y.create.l HWIO_PMIC_ARB_OBS3_CHNL108_CONFIG_ADDR A:0x2f63004
y.create.l HWIO_PMIC_ARB_OBS3_CHNL109_CONFIG_ADDR A:0x2f6b004
y.create.l HWIO_PMIC_ARB_OBS3_CHNL110_CONFIG_ADDR A:0x2f73004
y.create.l HWIO_PMIC_ARB_OBS3_CHNL111_CONFIG_ADDR A:0x2f7b004
y.create.l HWIO_PMIC_ARB_OBS3_CHNL112_CONFIG_ADDR A:0x2f83004
y.create.l HWIO_PMIC_ARB_OBS3_CHNL113_CONFIG_ADDR A:0x2f8b004
y.create.l HWIO_PMIC_ARB_OBS3_CHNL114_CONFIG_ADDR A:0x2f93004
y.create.l HWIO_PMIC_ARB_OBS3_CHNL115_CONFIG_ADDR A:0x2f9b004
y.create.l HWIO_PMIC_ARB_OBS3_CHNL116_CONFIG_ADDR A:0x2fa3004
y.create.l HWIO_PMIC_ARB_OBS3_CHNL117_CONFIG_ADDR A:0x2fab004
y.create.l HWIO_PMIC_ARB_OBS3_CHNL118_CONFIG_ADDR A:0x2fb3004
y.create.l HWIO_PMIC_ARB_OBS3_CHNL119_CONFIG_ADDR A:0x2fbb004
y.create.l HWIO_PMIC_ARB_OBS3_CHNL120_CONFIG_ADDR A:0x2fc3004
y.create.l HWIO_PMIC_ARB_OBS3_CHNL121_CONFIG_ADDR A:0x2fcb004
y.create.l HWIO_PMIC_ARB_OBS3_CHNL122_CONFIG_ADDR A:0x2fd3004
y.create.l HWIO_PMIC_ARB_OBS3_CHNL123_CONFIG_ADDR A:0x2fdb004
y.create.l HWIO_PMIC_ARB_OBS3_CHNL124_CONFIG_ADDR A:0x2fe3004
y.create.l HWIO_PMIC_ARB_OBS3_CHNL125_CONFIG_ADDR A:0x2feb004
y.create.l HWIO_PMIC_ARB_OBS3_CHNL126_CONFIG_ADDR A:0x2ff3004
y.create.l HWIO_PMIC_ARB_OBS3_CHNL127_CONFIG_ADDR A:0x2ffb004
y.create.l HWIO_PMIC_ARB_OBS3_CHNL128_CONFIG_ADDR A:0x3003004
y.create.l HWIO_PMIC_ARB_OBS3_CHNL129_CONFIG_ADDR A:0x300b004
y.create.l HWIO_PMIC_ARB_OBS3_CHNL130_CONFIG_ADDR A:0x3013004
y.create.l HWIO_PMIC_ARB_OBS3_CHNL131_CONFIG_ADDR A:0x301b004
y.create.l HWIO_PMIC_ARB_OBS3_CHNL132_CONFIG_ADDR A:0x3023004
y.create.l HWIO_PMIC_ARB_OBS3_CHNL133_CONFIG_ADDR A:0x302b004
y.create.l HWIO_PMIC_ARB_OBS3_CHNL134_CONFIG_ADDR A:0x3033004
y.create.l HWIO_PMIC_ARB_OBS3_CHNL135_CONFIG_ADDR A:0x303b004
y.create.l HWIO_PMIC_ARB_OBS3_CHNL136_CONFIG_ADDR A:0x3043004
y.create.l HWIO_PMIC_ARB_OBS3_CHNL137_CONFIG_ADDR A:0x304b004
y.create.l HWIO_PMIC_ARB_OBS3_CHNL138_CONFIG_ADDR A:0x3053004
y.create.l HWIO_PMIC_ARB_OBS3_CHNL139_CONFIG_ADDR A:0x305b004
y.create.l HWIO_PMIC_ARB_OBS3_CHNL140_CONFIG_ADDR A:0x3063004
y.create.l HWIO_PMIC_ARB_OBS3_CHNL141_CONFIG_ADDR A:0x306b004
y.create.l HWIO_PMIC_ARB_OBS3_CHNL142_CONFIG_ADDR A:0x3073004
y.create.l HWIO_PMIC_ARB_OBS3_CHNL143_CONFIG_ADDR A:0x307b004
y.create.l HWIO_PMIC_ARB_OBS3_CHNL144_CONFIG_ADDR A:0x3083004
y.create.l HWIO_PMIC_ARB_OBS3_CHNL145_CONFIG_ADDR A:0x308b004
y.create.l HWIO_PMIC_ARB_OBS3_CHNL146_CONFIG_ADDR A:0x3093004
y.create.l HWIO_PMIC_ARB_OBS3_CHNL147_CONFIG_ADDR A:0x309b004
y.create.l HWIO_PMIC_ARB_OBS3_CHNL148_CONFIG_ADDR A:0x30a3004
y.create.l HWIO_PMIC_ARB_OBS3_CHNL149_CONFIG_ADDR A:0x30ab004
y.create.l HWIO_PMIC_ARB_OBS3_CHNL150_CONFIG_ADDR A:0x30b3004
y.create.l HWIO_PMIC_ARB_OBS3_CHNL151_CONFIG_ADDR A:0x30bb004
y.create.l HWIO_PMIC_ARB_OBS3_CHNL152_CONFIG_ADDR A:0x30c3004
y.create.l HWIO_PMIC_ARB_OBS3_CHNL153_CONFIG_ADDR A:0x30cb004
y.create.l HWIO_PMIC_ARB_OBS3_CHNL154_CONFIG_ADDR A:0x30d3004
y.create.l HWIO_PMIC_ARB_OBS3_CHNL155_CONFIG_ADDR A:0x30db004
y.create.l HWIO_PMIC_ARB_OBS3_CHNL156_CONFIG_ADDR A:0x30e3004
y.create.l HWIO_PMIC_ARB_OBS3_CHNL157_CONFIG_ADDR A:0x30eb004
y.create.l HWIO_PMIC_ARB_OBS3_CHNL158_CONFIG_ADDR A:0x30f3004
y.create.l HWIO_PMIC_ARB_OBS3_CHNL159_CONFIG_ADDR A:0x30fb004
y.create.l HWIO_PMIC_ARB_OBS3_CHNL160_CONFIG_ADDR A:0x3103004
y.create.l HWIO_PMIC_ARB_OBS3_CHNL161_CONFIG_ADDR A:0x310b004
y.create.l HWIO_PMIC_ARB_OBS3_CHNL162_CONFIG_ADDR A:0x3113004
y.create.l HWIO_PMIC_ARB_OBS3_CHNL163_CONFIG_ADDR A:0x311b004
y.create.l HWIO_PMIC_ARB_OBS3_CHNL164_CONFIG_ADDR A:0x3123004
y.create.l HWIO_PMIC_ARB_OBS3_CHNL165_CONFIG_ADDR A:0x312b004
y.create.l HWIO_PMIC_ARB_OBS3_CHNL166_CONFIG_ADDR A:0x3133004
y.create.l HWIO_PMIC_ARB_OBS3_CHNL167_CONFIG_ADDR A:0x313b004
y.create.l HWIO_PMIC_ARB_OBS3_CHNL168_CONFIG_ADDR A:0x3143004
y.create.l HWIO_PMIC_ARB_OBS3_CHNL169_CONFIG_ADDR A:0x314b004
y.create.l HWIO_PMIC_ARB_OBS3_CHNL170_CONFIG_ADDR A:0x3153004
y.create.l HWIO_PMIC_ARB_OBS3_CHNL171_CONFIG_ADDR A:0x315b004
y.create.l HWIO_PMIC_ARB_OBS3_CHNL172_CONFIG_ADDR A:0x3163004
y.create.l HWIO_PMIC_ARB_OBS3_CHNL173_CONFIG_ADDR A:0x316b004
y.create.l HWIO_PMIC_ARB_OBS3_CHNL174_CONFIG_ADDR A:0x3173004
y.create.l HWIO_PMIC_ARB_OBS3_CHNL175_CONFIG_ADDR A:0x317b004
y.create.l HWIO_PMIC_ARB_OBS3_CHNL176_CONFIG_ADDR A:0x3183004
y.create.l HWIO_PMIC_ARB_OBS3_CHNL177_CONFIG_ADDR A:0x318b004
y.create.l HWIO_PMIC_ARB_OBS3_CHNL178_CONFIG_ADDR A:0x3193004
y.create.l HWIO_PMIC_ARB_OBS3_CHNL179_CONFIG_ADDR A:0x319b004
y.create.l HWIO_PMIC_ARB_OBS3_CHNL180_CONFIG_ADDR A:0x31a3004
y.create.l HWIO_PMIC_ARB_OBS3_CHNL181_CONFIG_ADDR A:0x31ab004
y.create.l HWIO_PMIC_ARB_OBS3_CHNL182_CONFIG_ADDR A:0x31b3004
y.create.l HWIO_PMIC_ARB_OBS3_CHNL183_CONFIG_ADDR A:0x31bb004
y.create.l HWIO_PMIC_ARB_OBS3_CHNL184_CONFIG_ADDR A:0x31c3004
y.create.l HWIO_PMIC_ARB_OBS3_CHNL185_CONFIG_ADDR A:0x31cb004
y.create.l HWIO_PMIC_ARB_OBS3_CHNL186_CONFIG_ADDR A:0x31d3004
y.create.l HWIO_PMIC_ARB_OBS3_CHNL187_CONFIG_ADDR A:0x31db004
y.create.l HWIO_PMIC_ARB_OBS3_CHNL188_CONFIG_ADDR A:0x31e3004
y.create.l HWIO_PMIC_ARB_OBS3_CHNL189_CONFIG_ADDR A:0x31eb004
y.create.l HWIO_PMIC_ARB_OBS3_CHNL190_CONFIG_ADDR A:0x31f3004
y.create.l HWIO_PMIC_ARB_OBS3_CHNL191_CONFIG_ADDR A:0x31fb004
y.create.l HWIO_PMIC_ARB_OBS3_CHNL192_CONFIG_ADDR A:0x3203004
y.create.l HWIO_PMIC_ARB_OBS3_CHNL193_CONFIG_ADDR A:0x320b004
y.create.l HWIO_PMIC_ARB_OBS3_CHNL194_CONFIG_ADDR A:0x3213004
y.create.l HWIO_PMIC_ARB_OBS3_CHNL195_CONFIG_ADDR A:0x321b004
y.create.l HWIO_PMIC_ARB_OBS3_CHNL196_CONFIG_ADDR A:0x3223004
y.create.l HWIO_PMIC_ARB_OBS3_CHNL197_CONFIG_ADDR A:0x322b004
y.create.l HWIO_PMIC_ARB_OBS3_CHNL198_CONFIG_ADDR A:0x3233004
y.create.l HWIO_PMIC_ARB_OBS3_CHNL199_CONFIG_ADDR A:0x323b004
y.create.l HWIO_PMIC_ARB_OBS3_CHNL200_CONFIG_ADDR A:0x3243004
y.create.l HWIO_PMIC_ARB_OBS3_CHNL201_CONFIG_ADDR A:0x324b004
y.create.l HWIO_PMIC_ARB_OBS3_CHNL202_CONFIG_ADDR A:0x3253004
y.create.l HWIO_PMIC_ARB_OBS3_CHNL203_CONFIG_ADDR A:0x325b004
y.create.l HWIO_PMIC_ARB_OBS3_CHNL204_CONFIG_ADDR A:0x3263004
y.create.l HWIO_PMIC_ARB_OBS3_CHNL205_CONFIG_ADDR A:0x326b004
y.create.l HWIO_PMIC_ARB_OBS3_CHNL206_CONFIG_ADDR A:0x3273004
y.create.l HWIO_PMIC_ARB_OBS3_CHNL207_CONFIG_ADDR A:0x327b004
y.create.l HWIO_PMIC_ARB_OBS3_CHNL208_CONFIG_ADDR A:0x3283004
y.create.l HWIO_PMIC_ARB_OBS3_CHNL209_CONFIG_ADDR A:0x328b004
y.create.l HWIO_PMIC_ARB_OBS3_CHNL210_CONFIG_ADDR A:0x3293004
y.create.l HWIO_PMIC_ARB_OBS3_CHNL211_CONFIG_ADDR A:0x329b004
y.create.l HWIO_PMIC_ARB_OBS3_CHNL212_CONFIG_ADDR A:0x32a3004
y.create.l HWIO_PMIC_ARB_OBS3_CHNL213_CONFIG_ADDR A:0x32ab004
y.create.l HWIO_PMIC_ARB_OBS3_CHNL214_CONFIG_ADDR A:0x32b3004
y.create.l HWIO_PMIC_ARB_OBS3_CHNL215_CONFIG_ADDR A:0x32bb004
y.create.l HWIO_PMIC_ARB_OBS3_CHNL216_CONFIG_ADDR A:0x32c3004
y.create.l HWIO_PMIC_ARB_OBS3_CHNL217_CONFIG_ADDR A:0x32cb004
y.create.l HWIO_PMIC_ARB_OBS3_CHNL218_CONFIG_ADDR A:0x32d3004
y.create.l HWIO_PMIC_ARB_OBS3_CHNL219_CONFIG_ADDR A:0x32db004
y.create.l HWIO_PMIC_ARB_OBS3_CHNL220_CONFIG_ADDR A:0x32e3004
y.create.l HWIO_PMIC_ARB_OBS3_CHNL221_CONFIG_ADDR A:0x32eb004
y.create.l HWIO_PMIC_ARB_OBS3_CHNL222_CONFIG_ADDR A:0x32f3004
y.create.l HWIO_PMIC_ARB_OBS3_CHNL223_CONFIG_ADDR A:0x32fb004
y.create.l HWIO_PMIC_ARB_OBS3_CHNL224_CONFIG_ADDR A:0x3303004
y.create.l HWIO_PMIC_ARB_OBS3_CHNL225_CONFIG_ADDR A:0x330b004
y.create.l HWIO_PMIC_ARB_OBS3_CHNL226_CONFIG_ADDR A:0x3313004
y.create.l HWIO_PMIC_ARB_OBS3_CHNL227_CONFIG_ADDR A:0x331b004
y.create.l HWIO_PMIC_ARB_OBS3_CHNL228_CONFIG_ADDR A:0x3323004
y.create.l HWIO_PMIC_ARB_OBS3_CHNL229_CONFIG_ADDR A:0x332b004
y.create.l HWIO_PMIC_ARB_OBS3_CHNL230_CONFIG_ADDR A:0x3333004
y.create.l HWIO_PMIC_ARB_OBS3_CHNL231_CONFIG_ADDR A:0x333b004
y.create.l HWIO_PMIC_ARB_OBS3_CHNL232_CONFIG_ADDR A:0x3343004
y.create.l HWIO_PMIC_ARB_OBS3_CHNL233_CONFIG_ADDR A:0x334b004
y.create.l HWIO_PMIC_ARB_OBS3_CHNL234_CONFIG_ADDR A:0x3353004
y.create.l HWIO_PMIC_ARB_OBS3_CHNL235_CONFIG_ADDR A:0x335b004
y.create.l HWIO_PMIC_ARB_OBS3_CHNL236_CONFIG_ADDR A:0x3363004
y.create.l HWIO_PMIC_ARB_OBS3_CHNL237_CONFIG_ADDR A:0x336b004
y.create.l HWIO_PMIC_ARB_OBS3_CHNL238_CONFIG_ADDR A:0x3373004
y.create.l HWIO_PMIC_ARB_OBS3_CHNL239_CONFIG_ADDR A:0x337b004
y.create.l HWIO_PMIC_ARB_OBS3_CHNL240_CONFIG_ADDR A:0x3383004
y.create.l HWIO_PMIC_ARB_OBS3_CHNL241_CONFIG_ADDR A:0x338b004
y.create.l HWIO_PMIC_ARB_OBS3_CHNL242_CONFIG_ADDR A:0x3393004
y.create.l HWIO_PMIC_ARB_OBS3_CHNL243_CONFIG_ADDR A:0x339b004
y.create.l HWIO_PMIC_ARB_OBS3_CHNL244_CONFIG_ADDR A:0x33a3004
y.create.l HWIO_PMIC_ARB_OBS3_CHNL245_CONFIG_ADDR A:0x33ab004
y.create.l HWIO_PMIC_ARB_OBS3_CHNL246_CONFIG_ADDR A:0x33b3004
y.create.l HWIO_PMIC_ARB_OBS3_CHNL247_CONFIG_ADDR A:0x33bb004
y.create.l HWIO_PMIC_ARB_OBS3_CHNL248_CONFIG_ADDR A:0x33c3004
y.create.l HWIO_PMIC_ARB_OBS3_CHNL249_CONFIG_ADDR A:0x33cb004
y.create.l HWIO_PMIC_ARB_OBS3_CHNL250_CONFIG_ADDR A:0x33d3004
y.create.l HWIO_PMIC_ARB_OBS3_CHNL251_CONFIG_ADDR A:0x33db004
y.create.l HWIO_PMIC_ARB_OBS3_CHNL252_CONFIG_ADDR A:0x33e3004
y.create.l HWIO_PMIC_ARB_OBS3_CHNL253_CONFIG_ADDR A:0x33eb004
y.create.l HWIO_PMIC_ARB_OBS3_CHNL254_CONFIG_ADDR A:0x33f3004
y.create.l HWIO_PMIC_ARB_OBS3_CHNL255_CONFIG_ADDR A:0x33fb004
y.create.l HWIO_PMIC_ARB_OBS4_CHNL0_CONFIG_ADDR A:0x2c04004
y.create.l HWIO_PMIC_ARB_OBS4_CHNL1_CONFIG_ADDR A:0x2c0c004
y.create.l HWIO_PMIC_ARB_OBS4_CHNL2_CONFIG_ADDR A:0x2c14004
y.create.l HWIO_PMIC_ARB_OBS4_CHNL3_CONFIG_ADDR A:0x2c1c004
y.create.l HWIO_PMIC_ARB_OBS4_CHNL4_CONFIG_ADDR A:0x2c24004
y.create.l HWIO_PMIC_ARB_OBS4_CHNL5_CONFIG_ADDR A:0x2c2c004
y.create.l HWIO_PMIC_ARB_OBS4_CHNL6_CONFIG_ADDR A:0x2c34004
y.create.l HWIO_PMIC_ARB_OBS4_CHNL7_CONFIG_ADDR A:0x2c3c004
y.create.l HWIO_PMIC_ARB_OBS4_CHNL8_CONFIG_ADDR A:0x2c44004
y.create.l HWIO_PMIC_ARB_OBS4_CHNL9_CONFIG_ADDR A:0x2c4c004
y.create.l HWIO_PMIC_ARB_OBS4_CHNL10_CONFIG_ADDR A:0x2c54004
y.create.l HWIO_PMIC_ARB_OBS4_CHNL11_CONFIG_ADDR A:0x2c5c004
y.create.l HWIO_PMIC_ARB_OBS4_CHNL12_CONFIG_ADDR A:0x2c64004
y.create.l HWIO_PMIC_ARB_OBS4_CHNL13_CONFIG_ADDR A:0x2c6c004
y.create.l HWIO_PMIC_ARB_OBS4_CHNL14_CONFIG_ADDR A:0x2c74004
y.create.l HWIO_PMIC_ARB_OBS4_CHNL15_CONFIG_ADDR A:0x2c7c004
y.create.l HWIO_PMIC_ARB_OBS4_CHNL16_CONFIG_ADDR A:0x2c84004
y.create.l HWIO_PMIC_ARB_OBS4_CHNL17_CONFIG_ADDR A:0x2c8c004
y.create.l HWIO_PMIC_ARB_OBS4_CHNL18_CONFIG_ADDR A:0x2c94004
y.create.l HWIO_PMIC_ARB_OBS4_CHNL19_CONFIG_ADDR A:0x2c9c004
y.create.l HWIO_PMIC_ARB_OBS4_CHNL20_CONFIG_ADDR A:0x2ca4004
y.create.l HWIO_PMIC_ARB_OBS4_CHNL21_CONFIG_ADDR A:0x2cac004
y.create.l HWIO_PMIC_ARB_OBS4_CHNL22_CONFIG_ADDR A:0x2cb4004
y.create.l HWIO_PMIC_ARB_OBS4_CHNL23_CONFIG_ADDR A:0x2cbc004
y.create.l HWIO_PMIC_ARB_OBS4_CHNL24_CONFIG_ADDR A:0x2cc4004
y.create.l HWIO_PMIC_ARB_OBS4_CHNL25_CONFIG_ADDR A:0x2ccc004
y.create.l HWIO_PMIC_ARB_OBS4_CHNL26_CONFIG_ADDR A:0x2cd4004
y.create.l HWIO_PMIC_ARB_OBS4_CHNL27_CONFIG_ADDR A:0x2cdc004
y.create.l HWIO_PMIC_ARB_OBS4_CHNL28_CONFIG_ADDR A:0x2ce4004
y.create.l HWIO_PMIC_ARB_OBS4_CHNL29_CONFIG_ADDR A:0x2cec004
y.create.l HWIO_PMIC_ARB_OBS4_CHNL30_CONFIG_ADDR A:0x2cf4004
y.create.l HWIO_PMIC_ARB_OBS4_CHNL31_CONFIG_ADDR A:0x2cfc004
y.create.l HWIO_PMIC_ARB_OBS4_CHNL32_CONFIG_ADDR A:0x2d04004
y.create.l HWIO_PMIC_ARB_OBS4_CHNL33_CONFIG_ADDR A:0x2d0c004
y.create.l HWIO_PMIC_ARB_OBS4_CHNL34_CONFIG_ADDR A:0x2d14004
y.create.l HWIO_PMIC_ARB_OBS4_CHNL35_CONFIG_ADDR A:0x2d1c004
y.create.l HWIO_PMIC_ARB_OBS4_CHNL36_CONFIG_ADDR A:0x2d24004
y.create.l HWIO_PMIC_ARB_OBS4_CHNL37_CONFIG_ADDR A:0x2d2c004
y.create.l HWIO_PMIC_ARB_OBS4_CHNL38_CONFIG_ADDR A:0x2d34004
y.create.l HWIO_PMIC_ARB_OBS4_CHNL39_CONFIG_ADDR A:0x2d3c004
y.create.l HWIO_PMIC_ARB_OBS4_CHNL40_CONFIG_ADDR A:0x2d44004
y.create.l HWIO_PMIC_ARB_OBS4_CHNL41_CONFIG_ADDR A:0x2d4c004
y.create.l HWIO_PMIC_ARB_OBS4_CHNL42_CONFIG_ADDR A:0x2d54004
y.create.l HWIO_PMIC_ARB_OBS4_CHNL43_CONFIG_ADDR A:0x2d5c004
y.create.l HWIO_PMIC_ARB_OBS4_CHNL44_CONFIG_ADDR A:0x2d64004
y.create.l HWIO_PMIC_ARB_OBS4_CHNL45_CONFIG_ADDR A:0x2d6c004
y.create.l HWIO_PMIC_ARB_OBS4_CHNL46_CONFIG_ADDR A:0x2d74004
y.create.l HWIO_PMIC_ARB_OBS4_CHNL47_CONFIG_ADDR A:0x2d7c004
y.create.l HWIO_PMIC_ARB_OBS4_CHNL48_CONFIG_ADDR A:0x2d84004
y.create.l HWIO_PMIC_ARB_OBS4_CHNL49_CONFIG_ADDR A:0x2d8c004
y.create.l HWIO_PMIC_ARB_OBS4_CHNL50_CONFIG_ADDR A:0x2d94004
y.create.l HWIO_PMIC_ARB_OBS4_CHNL51_CONFIG_ADDR A:0x2d9c004
y.create.l HWIO_PMIC_ARB_OBS4_CHNL52_CONFIG_ADDR A:0x2da4004
y.create.l HWIO_PMIC_ARB_OBS4_CHNL53_CONFIG_ADDR A:0x2dac004
y.create.l HWIO_PMIC_ARB_OBS4_CHNL54_CONFIG_ADDR A:0x2db4004
y.create.l HWIO_PMIC_ARB_OBS4_CHNL55_CONFIG_ADDR A:0x2dbc004
y.create.l HWIO_PMIC_ARB_OBS4_CHNL56_CONFIG_ADDR A:0x2dc4004
y.create.l HWIO_PMIC_ARB_OBS4_CHNL57_CONFIG_ADDR A:0x2dcc004
y.create.l HWIO_PMIC_ARB_OBS4_CHNL58_CONFIG_ADDR A:0x2dd4004
y.create.l HWIO_PMIC_ARB_OBS4_CHNL59_CONFIG_ADDR A:0x2ddc004
y.create.l HWIO_PMIC_ARB_OBS4_CHNL60_CONFIG_ADDR A:0x2de4004
y.create.l HWIO_PMIC_ARB_OBS4_CHNL61_CONFIG_ADDR A:0x2dec004
y.create.l HWIO_PMIC_ARB_OBS4_CHNL62_CONFIG_ADDR A:0x2df4004
y.create.l HWIO_PMIC_ARB_OBS4_CHNL63_CONFIG_ADDR A:0x2dfc004
y.create.l HWIO_PMIC_ARB_OBS4_CHNL64_CONFIG_ADDR A:0x2e04004
y.create.l HWIO_PMIC_ARB_OBS4_CHNL65_CONFIG_ADDR A:0x2e0c004
y.create.l HWIO_PMIC_ARB_OBS4_CHNL66_CONFIG_ADDR A:0x2e14004
y.create.l HWIO_PMIC_ARB_OBS4_CHNL67_CONFIG_ADDR A:0x2e1c004
y.create.l HWIO_PMIC_ARB_OBS4_CHNL68_CONFIG_ADDR A:0x2e24004
y.create.l HWIO_PMIC_ARB_OBS4_CHNL69_CONFIG_ADDR A:0x2e2c004
y.create.l HWIO_PMIC_ARB_OBS4_CHNL70_CONFIG_ADDR A:0x2e34004
y.create.l HWIO_PMIC_ARB_OBS4_CHNL71_CONFIG_ADDR A:0x2e3c004
y.create.l HWIO_PMIC_ARB_OBS4_CHNL72_CONFIG_ADDR A:0x2e44004
y.create.l HWIO_PMIC_ARB_OBS4_CHNL73_CONFIG_ADDR A:0x2e4c004
y.create.l HWIO_PMIC_ARB_OBS4_CHNL74_CONFIG_ADDR A:0x2e54004
y.create.l HWIO_PMIC_ARB_OBS4_CHNL75_CONFIG_ADDR A:0x2e5c004
y.create.l HWIO_PMIC_ARB_OBS4_CHNL76_CONFIG_ADDR A:0x2e64004
y.create.l HWIO_PMIC_ARB_OBS4_CHNL77_CONFIG_ADDR A:0x2e6c004
y.create.l HWIO_PMIC_ARB_OBS4_CHNL78_CONFIG_ADDR A:0x2e74004
y.create.l HWIO_PMIC_ARB_OBS4_CHNL79_CONFIG_ADDR A:0x2e7c004
y.create.l HWIO_PMIC_ARB_OBS4_CHNL80_CONFIG_ADDR A:0x2e84004
y.create.l HWIO_PMIC_ARB_OBS4_CHNL81_CONFIG_ADDR A:0x2e8c004
y.create.l HWIO_PMIC_ARB_OBS4_CHNL82_CONFIG_ADDR A:0x2e94004
y.create.l HWIO_PMIC_ARB_OBS4_CHNL83_CONFIG_ADDR A:0x2e9c004
y.create.l HWIO_PMIC_ARB_OBS4_CHNL84_CONFIG_ADDR A:0x2ea4004
y.create.l HWIO_PMIC_ARB_OBS4_CHNL85_CONFIG_ADDR A:0x2eac004
y.create.l HWIO_PMIC_ARB_OBS4_CHNL86_CONFIG_ADDR A:0x2eb4004
y.create.l HWIO_PMIC_ARB_OBS4_CHNL87_CONFIG_ADDR A:0x2ebc004
y.create.l HWIO_PMIC_ARB_OBS4_CHNL88_CONFIG_ADDR A:0x2ec4004
y.create.l HWIO_PMIC_ARB_OBS4_CHNL89_CONFIG_ADDR A:0x2ecc004
y.create.l HWIO_PMIC_ARB_OBS4_CHNL90_CONFIG_ADDR A:0x2ed4004
y.create.l HWIO_PMIC_ARB_OBS4_CHNL91_CONFIG_ADDR A:0x2edc004
y.create.l HWIO_PMIC_ARB_OBS4_CHNL92_CONFIG_ADDR A:0x2ee4004
y.create.l HWIO_PMIC_ARB_OBS4_CHNL93_CONFIG_ADDR A:0x2eec004
y.create.l HWIO_PMIC_ARB_OBS4_CHNL94_CONFIG_ADDR A:0x2ef4004
y.create.l HWIO_PMIC_ARB_OBS4_CHNL95_CONFIG_ADDR A:0x2efc004
y.create.l HWIO_PMIC_ARB_OBS4_CHNL96_CONFIG_ADDR A:0x2f04004
y.create.l HWIO_PMIC_ARB_OBS4_CHNL97_CONFIG_ADDR A:0x2f0c004
y.create.l HWIO_PMIC_ARB_OBS4_CHNL98_CONFIG_ADDR A:0x2f14004
y.create.l HWIO_PMIC_ARB_OBS4_CHNL99_CONFIG_ADDR A:0x2f1c004
y.create.l HWIO_PMIC_ARB_OBS4_CHNL100_CONFIG_ADDR A:0x2f24004
y.create.l HWIO_PMIC_ARB_OBS4_CHNL101_CONFIG_ADDR A:0x2f2c004
y.create.l HWIO_PMIC_ARB_OBS4_CHNL102_CONFIG_ADDR A:0x2f34004
y.create.l HWIO_PMIC_ARB_OBS4_CHNL103_CONFIG_ADDR A:0x2f3c004
y.create.l HWIO_PMIC_ARB_OBS4_CHNL104_CONFIG_ADDR A:0x2f44004
y.create.l HWIO_PMIC_ARB_OBS4_CHNL105_CONFIG_ADDR A:0x2f4c004
y.create.l HWIO_PMIC_ARB_OBS4_CHNL106_CONFIG_ADDR A:0x2f54004
y.create.l HWIO_PMIC_ARB_OBS4_CHNL107_CONFIG_ADDR A:0x2f5c004
y.create.l HWIO_PMIC_ARB_OBS4_CHNL108_CONFIG_ADDR A:0x2f64004
y.create.l HWIO_PMIC_ARB_OBS4_CHNL109_CONFIG_ADDR A:0x2f6c004
y.create.l HWIO_PMIC_ARB_OBS4_CHNL110_CONFIG_ADDR A:0x2f74004
y.create.l HWIO_PMIC_ARB_OBS4_CHNL111_CONFIG_ADDR A:0x2f7c004
y.create.l HWIO_PMIC_ARB_OBS4_CHNL112_CONFIG_ADDR A:0x2f84004
y.create.l HWIO_PMIC_ARB_OBS4_CHNL113_CONFIG_ADDR A:0x2f8c004
y.create.l HWIO_PMIC_ARB_OBS4_CHNL114_CONFIG_ADDR A:0x2f94004
y.create.l HWIO_PMIC_ARB_OBS4_CHNL115_CONFIG_ADDR A:0x2f9c004
y.create.l HWIO_PMIC_ARB_OBS4_CHNL116_CONFIG_ADDR A:0x2fa4004
y.create.l HWIO_PMIC_ARB_OBS4_CHNL117_CONFIG_ADDR A:0x2fac004
y.create.l HWIO_PMIC_ARB_OBS4_CHNL118_CONFIG_ADDR A:0x2fb4004
y.create.l HWIO_PMIC_ARB_OBS4_CHNL119_CONFIG_ADDR A:0x2fbc004
y.create.l HWIO_PMIC_ARB_OBS4_CHNL120_CONFIG_ADDR A:0x2fc4004
y.create.l HWIO_PMIC_ARB_OBS4_CHNL121_CONFIG_ADDR A:0x2fcc004
y.create.l HWIO_PMIC_ARB_OBS4_CHNL122_CONFIG_ADDR A:0x2fd4004
y.create.l HWIO_PMIC_ARB_OBS4_CHNL123_CONFIG_ADDR A:0x2fdc004
y.create.l HWIO_PMIC_ARB_OBS4_CHNL124_CONFIG_ADDR A:0x2fe4004
y.create.l HWIO_PMIC_ARB_OBS4_CHNL125_CONFIG_ADDR A:0x2fec004
y.create.l HWIO_PMIC_ARB_OBS4_CHNL126_CONFIG_ADDR A:0x2ff4004
y.create.l HWIO_PMIC_ARB_OBS4_CHNL127_CONFIG_ADDR A:0x2ffc004
y.create.l HWIO_PMIC_ARB_OBS4_CHNL128_CONFIG_ADDR A:0x3004004
y.create.l HWIO_PMIC_ARB_OBS4_CHNL129_CONFIG_ADDR A:0x300c004
y.create.l HWIO_PMIC_ARB_OBS4_CHNL130_CONFIG_ADDR A:0x3014004
y.create.l HWIO_PMIC_ARB_OBS4_CHNL131_CONFIG_ADDR A:0x301c004
y.create.l HWIO_PMIC_ARB_OBS4_CHNL132_CONFIG_ADDR A:0x3024004
y.create.l HWIO_PMIC_ARB_OBS4_CHNL133_CONFIG_ADDR A:0x302c004
y.create.l HWIO_PMIC_ARB_OBS4_CHNL134_CONFIG_ADDR A:0x3034004
y.create.l HWIO_PMIC_ARB_OBS4_CHNL135_CONFIG_ADDR A:0x303c004
y.create.l HWIO_PMIC_ARB_OBS4_CHNL136_CONFIG_ADDR A:0x3044004
y.create.l HWIO_PMIC_ARB_OBS4_CHNL137_CONFIG_ADDR A:0x304c004
y.create.l HWIO_PMIC_ARB_OBS4_CHNL138_CONFIG_ADDR A:0x3054004
y.create.l HWIO_PMIC_ARB_OBS4_CHNL139_CONFIG_ADDR A:0x305c004
y.create.l HWIO_PMIC_ARB_OBS4_CHNL140_CONFIG_ADDR A:0x3064004
y.create.l HWIO_PMIC_ARB_OBS4_CHNL141_CONFIG_ADDR A:0x306c004
y.create.l HWIO_PMIC_ARB_OBS4_CHNL142_CONFIG_ADDR A:0x3074004
y.create.l HWIO_PMIC_ARB_OBS4_CHNL143_CONFIG_ADDR A:0x307c004
y.create.l HWIO_PMIC_ARB_OBS4_CHNL144_CONFIG_ADDR A:0x3084004
y.create.l HWIO_PMIC_ARB_OBS4_CHNL145_CONFIG_ADDR A:0x308c004
y.create.l HWIO_PMIC_ARB_OBS4_CHNL146_CONFIG_ADDR A:0x3094004
y.create.l HWIO_PMIC_ARB_OBS4_CHNL147_CONFIG_ADDR A:0x309c004
y.create.l HWIO_PMIC_ARB_OBS4_CHNL148_CONFIG_ADDR A:0x30a4004
y.create.l HWIO_PMIC_ARB_OBS4_CHNL149_CONFIG_ADDR A:0x30ac004
y.create.l HWIO_PMIC_ARB_OBS4_CHNL150_CONFIG_ADDR A:0x30b4004
y.create.l HWIO_PMIC_ARB_OBS4_CHNL151_CONFIG_ADDR A:0x30bc004
y.create.l HWIO_PMIC_ARB_OBS4_CHNL152_CONFIG_ADDR A:0x30c4004
y.create.l HWIO_PMIC_ARB_OBS4_CHNL153_CONFIG_ADDR A:0x30cc004
y.create.l HWIO_PMIC_ARB_OBS4_CHNL154_CONFIG_ADDR A:0x30d4004
y.create.l HWIO_PMIC_ARB_OBS4_CHNL155_CONFIG_ADDR A:0x30dc004
y.create.l HWIO_PMIC_ARB_OBS4_CHNL156_CONFIG_ADDR A:0x30e4004
y.create.l HWIO_PMIC_ARB_OBS4_CHNL157_CONFIG_ADDR A:0x30ec004
y.create.l HWIO_PMIC_ARB_OBS4_CHNL158_CONFIG_ADDR A:0x30f4004
y.create.l HWIO_PMIC_ARB_OBS4_CHNL159_CONFIG_ADDR A:0x30fc004
y.create.l HWIO_PMIC_ARB_OBS4_CHNL160_CONFIG_ADDR A:0x3104004
y.create.l HWIO_PMIC_ARB_OBS4_CHNL161_CONFIG_ADDR A:0x310c004
y.create.l HWIO_PMIC_ARB_OBS4_CHNL162_CONFIG_ADDR A:0x3114004
y.create.l HWIO_PMIC_ARB_OBS4_CHNL163_CONFIG_ADDR A:0x311c004
y.create.l HWIO_PMIC_ARB_OBS4_CHNL164_CONFIG_ADDR A:0x3124004
y.create.l HWIO_PMIC_ARB_OBS4_CHNL165_CONFIG_ADDR A:0x312c004
y.create.l HWIO_PMIC_ARB_OBS4_CHNL166_CONFIG_ADDR A:0x3134004
y.create.l HWIO_PMIC_ARB_OBS4_CHNL167_CONFIG_ADDR A:0x313c004
y.create.l HWIO_PMIC_ARB_OBS4_CHNL168_CONFIG_ADDR A:0x3144004
y.create.l HWIO_PMIC_ARB_OBS4_CHNL169_CONFIG_ADDR A:0x314c004
y.create.l HWIO_PMIC_ARB_OBS4_CHNL170_CONFIG_ADDR A:0x3154004
y.create.l HWIO_PMIC_ARB_OBS4_CHNL171_CONFIG_ADDR A:0x315c004
y.create.l HWIO_PMIC_ARB_OBS4_CHNL172_CONFIG_ADDR A:0x3164004
y.create.l HWIO_PMIC_ARB_OBS4_CHNL173_CONFIG_ADDR A:0x316c004
y.create.l HWIO_PMIC_ARB_OBS4_CHNL174_CONFIG_ADDR A:0x3174004
y.create.l HWIO_PMIC_ARB_OBS4_CHNL175_CONFIG_ADDR A:0x317c004
y.create.l HWIO_PMIC_ARB_OBS4_CHNL176_CONFIG_ADDR A:0x3184004
y.create.l HWIO_PMIC_ARB_OBS4_CHNL177_CONFIG_ADDR A:0x318c004
y.create.l HWIO_PMIC_ARB_OBS4_CHNL178_CONFIG_ADDR A:0x3194004
y.create.l HWIO_PMIC_ARB_OBS4_CHNL179_CONFIG_ADDR A:0x319c004
y.create.l HWIO_PMIC_ARB_OBS4_CHNL180_CONFIG_ADDR A:0x31a4004
y.create.l HWIO_PMIC_ARB_OBS4_CHNL181_CONFIG_ADDR A:0x31ac004
y.create.l HWIO_PMIC_ARB_OBS4_CHNL182_CONFIG_ADDR A:0x31b4004
y.create.l HWIO_PMIC_ARB_OBS4_CHNL183_CONFIG_ADDR A:0x31bc004
y.create.l HWIO_PMIC_ARB_OBS4_CHNL184_CONFIG_ADDR A:0x31c4004
y.create.l HWIO_PMIC_ARB_OBS4_CHNL185_CONFIG_ADDR A:0x31cc004
y.create.l HWIO_PMIC_ARB_OBS4_CHNL186_CONFIG_ADDR A:0x31d4004
y.create.l HWIO_PMIC_ARB_OBS4_CHNL187_CONFIG_ADDR A:0x31dc004
y.create.l HWIO_PMIC_ARB_OBS4_CHNL188_CONFIG_ADDR A:0x31e4004
y.create.l HWIO_PMIC_ARB_OBS4_CHNL189_CONFIG_ADDR A:0x31ec004
y.create.l HWIO_PMIC_ARB_OBS4_CHNL190_CONFIG_ADDR A:0x31f4004
y.create.l HWIO_PMIC_ARB_OBS4_CHNL191_CONFIG_ADDR A:0x31fc004
y.create.l HWIO_PMIC_ARB_OBS4_CHNL192_CONFIG_ADDR A:0x3204004
y.create.l HWIO_PMIC_ARB_OBS4_CHNL193_CONFIG_ADDR A:0x320c004
y.create.l HWIO_PMIC_ARB_OBS4_CHNL194_CONFIG_ADDR A:0x3214004
y.create.l HWIO_PMIC_ARB_OBS4_CHNL195_CONFIG_ADDR A:0x321c004
y.create.l HWIO_PMIC_ARB_OBS4_CHNL196_CONFIG_ADDR A:0x3224004
y.create.l HWIO_PMIC_ARB_OBS4_CHNL197_CONFIG_ADDR A:0x322c004
y.create.l HWIO_PMIC_ARB_OBS4_CHNL198_CONFIG_ADDR A:0x3234004
y.create.l HWIO_PMIC_ARB_OBS4_CHNL199_CONFIG_ADDR A:0x323c004
y.create.l HWIO_PMIC_ARB_OBS4_CHNL200_CONFIG_ADDR A:0x3244004
y.create.l HWIO_PMIC_ARB_OBS4_CHNL201_CONFIG_ADDR A:0x324c004
y.create.l HWIO_PMIC_ARB_OBS4_CHNL202_CONFIG_ADDR A:0x3254004
y.create.l HWIO_PMIC_ARB_OBS4_CHNL203_CONFIG_ADDR A:0x325c004
y.create.l HWIO_PMIC_ARB_OBS4_CHNL204_CONFIG_ADDR A:0x3264004
y.create.l HWIO_PMIC_ARB_OBS4_CHNL205_CONFIG_ADDR A:0x326c004
y.create.l HWIO_PMIC_ARB_OBS4_CHNL206_CONFIG_ADDR A:0x3274004
y.create.l HWIO_PMIC_ARB_OBS4_CHNL207_CONFIG_ADDR A:0x327c004
y.create.l HWIO_PMIC_ARB_OBS4_CHNL208_CONFIG_ADDR A:0x3284004
y.create.l HWIO_PMIC_ARB_OBS4_CHNL209_CONFIG_ADDR A:0x328c004
y.create.l HWIO_PMIC_ARB_OBS4_CHNL210_CONFIG_ADDR A:0x3294004
y.create.l HWIO_PMIC_ARB_OBS4_CHNL211_CONFIG_ADDR A:0x329c004
y.create.l HWIO_PMIC_ARB_OBS4_CHNL212_CONFIG_ADDR A:0x32a4004
y.create.l HWIO_PMIC_ARB_OBS4_CHNL213_CONFIG_ADDR A:0x32ac004
y.create.l HWIO_PMIC_ARB_OBS4_CHNL214_CONFIG_ADDR A:0x32b4004
y.create.l HWIO_PMIC_ARB_OBS4_CHNL215_CONFIG_ADDR A:0x32bc004
y.create.l HWIO_PMIC_ARB_OBS4_CHNL216_CONFIG_ADDR A:0x32c4004
y.create.l HWIO_PMIC_ARB_OBS4_CHNL217_CONFIG_ADDR A:0x32cc004
y.create.l HWIO_PMIC_ARB_OBS4_CHNL218_CONFIG_ADDR A:0x32d4004
y.create.l HWIO_PMIC_ARB_OBS4_CHNL219_CONFIG_ADDR A:0x32dc004
y.create.l HWIO_PMIC_ARB_OBS4_CHNL220_CONFIG_ADDR A:0x32e4004
y.create.l HWIO_PMIC_ARB_OBS4_CHNL221_CONFIG_ADDR A:0x32ec004
y.create.l HWIO_PMIC_ARB_OBS4_CHNL222_CONFIG_ADDR A:0x32f4004
y.create.l HWIO_PMIC_ARB_OBS4_CHNL223_CONFIG_ADDR A:0x32fc004
y.create.l HWIO_PMIC_ARB_OBS4_CHNL224_CONFIG_ADDR A:0x3304004
y.create.l HWIO_PMIC_ARB_OBS4_CHNL225_CONFIG_ADDR A:0x330c004
y.create.l HWIO_PMIC_ARB_OBS4_CHNL226_CONFIG_ADDR A:0x3314004
y.create.l HWIO_PMIC_ARB_OBS4_CHNL227_CONFIG_ADDR A:0x331c004
y.create.l HWIO_PMIC_ARB_OBS4_CHNL228_CONFIG_ADDR A:0x3324004
y.create.l HWIO_PMIC_ARB_OBS4_CHNL229_CONFIG_ADDR A:0x332c004
y.create.l HWIO_PMIC_ARB_OBS4_CHNL230_CONFIG_ADDR A:0x3334004
y.create.l HWIO_PMIC_ARB_OBS4_CHNL231_CONFIG_ADDR A:0x333c004
y.create.l HWIO_PMIC_ARB_OBS4_CHNL232_CONFIG_ADDR A:0x3344004
y.create.l HWIO_PMIC_ARB_OBS4_CHNL233_CONFIG_ADDR A:0x334c004
y.create.l HWIO_PMIC_ARB_OBS4_CHNL234_CONFIG_ADDR A:0x3354004
y.create.l HWIO_PMIC_ARB_OBS4_CHNL235_CONFIG_ADDR A:0x335c004
y.create.l HWIO_PMIC_ARB_OBS4_CHNL236_CONFIG_ADDR A:0x3364004
y.create.l HWIO_PMIC_ARB_OBS4_CHNL237_CONFIG_ADDR A:0x336c004
y.create.l HWIO_PMIC_ARB_OBS4_CHNL238_CONFIG_ADDR A:0x3374004
y.create.l HWIO_PMIC_ARB_OBS4_CHNL239_CONFIG_ADDR A:0x337c004
y.create.l HWIO_PMIC_ARB_OBS4_CHNL240_CONFIG_ADDR A:0x3384004
y.create.l HWIO_PMIC_ARB_OBS4_CHNL241_CONFIG_ADDR A:0x338c004
y.create.l HWIO_PMIC_ARB_OBS4_CHNL242_CONFIG_ADDR A:0x3394004
y.create.l HWIO_PMIC_ARB_OBS4_CHNL243_CONFIG_ADDR A:0x339c004
y.create.l HWIO_PMIC_ARB_OBS4_CHNL244_CONFIG_ADDR A:0x33a4004
y.create.l HWIO_PMIC_ARB_OBS4_CHNL245_CONFIG_ADDR A:0x33ac004
y.create.l HWIO_PMIC_ARB_OBS4_CHNL246_CONFIG_ADDR A:0x33b4004
y.create.l HWIO_PMIC_ARB_OBS4_CHNL247_CONFIG_ADDR A:0x33bc004
y.create.l HWIO_PMIC_ARB_OBS4_CHNL248_CONFIG_ADDR A:0x33c4004
y.create.l HWIO_PMIC_ARB_OBS4_CHNL249_CONFIG_ADDR A:0x33cc004
y.create.l HWIO_PMIC_ARB_OBS4_CHNL250_CONFIG_ADDR A:0x33d4004
y.create.l HWIO_PMIC_ARB_OBS4_CHNL251_CONFIG_ADDR A:0x33dc004
y.create.l HWIO_PMIC_ARB_OBS4_CHNL252_CONFIG_ADDR A:0x33e4004
y.create.l HWIO_PMIC_ARB_OBS4_CHNL253_CONFIG_ADDR A:0x33ec004
y.create.l HWIO_PMIC_ARB_OBS4_CHNL254_CONFIG_ADDR A:0x33f4004
y.create.l HWIO_PMIC_ARB_OBS4_CHNL255_CONFIG_ADDR A:0x33fc004
y.create.l HWIO_PMIC_ARB_OBS5_CHNL0_CONFIG_ADDR A:0x2c05004
y.create.l HWIO_PMIC_ARB_OBS5_CHNL1_CONFIG_ADDR A:0x2c0d004
y.create.l HWIO_PMIC_ARB_OBS5_CHNL2_CONFIG_ADDR A:0x2c15004
y.create.l HWIO_PMIC_ARB_OBS5_CHNL3_CONFIG_ADDR A:0x2c1d004
y.create.l HWIO_PMIC_ARB_OBS5_CHNL4_CONFIG_ADDR A:0x2c25004
y.create.l HWIO_PMIC_ARB_OBS5_CHNL5_CONFIG_ADDR A:0x2c2d004
y.create.l HWIO_PMIC_ARB_OBS5_CHNL6_CONFIG_ADDR A:0x2c35004
y.create.l HWIO_PMIC_ARB_OBS5_CHNL7_CONFIG_ADDR A:0x2c3d004
y.create.l HWIO_PMIC_ARB_OBS5_CHNL8_CONFIG_ADDR A:0x2c45004
y.create.l HWIO_PMIC_ARB_OBS5_CHNL9_CONFIG_ADDR A:0x2c4d004
y.create.l HWIO_PMIC_ARB_OBS5_CHNL10_CONFIG_ADDR A:0x2c55004
y.create.l HWIO_PMIC_ARB_OBS5_CHNL11_CONFIG_ADDR A:0x2c5d004
y.create.l HWIO_PMIC_ARB_OBS5_CHNL12_CONFIG_ADDR A:0x2c65004
y.create.l HWIO_PMIC_ARB_OBS5_CHNL13_CONFIG_ADDR A:0x2c6d004
y.create.l HWIO_PMIC_ARB_OBS5_CHNL14_CONFIG_ADDR A:0x2c75004
y.create.l HWIO_PMIC_ARB_OBS5_CHNL15_CONFIG_ADDR A:0x2c7d004
y.create.l HWIO_PMIC_ARB_OBS5_CHNL16_CONFIG_ADDR A:0x2c85004
y.create.l HWIO_PMIC_ARB_OBS5_CHNL17_CONFIG_ADDR A:0x2c8d004
y.create.l HWIO_PMIC_ARB_OBS5_CHNL18_CONFIG_ADDR A:0x2c95004
y.create.l HWIO_PMIC_ARB_OBS5_CHNL19_CONFIG_ADDR A:0x2c9d004
y.create.l HWIO_PMIC_ARB_OBS5_CHNL20_CONFIG_ADDR A:0x2ca5004
y.create.l HWIO_PMIC_ARB_OBS5_CHNL21_CONFIG_ADDR A:0x2cad004
y.create.l HWIO_PMIC_ARB_OBS5_CHNL22_CONFIG_ADDR A:0x2cb5004
y.create.l HWIO_PMIC_ARB_OBS5_CHNL23_CONFIG_ADDR A:0x2cbd004
y.create.l HWIO_PMIC_ARB_OBS5_CHNL24_CONFIG_ADDR A:0x2cc5004
y.create.l HWIO_PMIC_ARB_OBS5_CHNL25_CONFIG_ADDR A:0x2ccd004
y.create.l HWIO_PMIC_ARB_OBS5_CHNL26_CONFIG_ADDR A:0x2cd5004
y.create.l HWIO_PMIC_ARB_OBS5_CHNL27_CONFIG_ADDR A:0x2cdd004
y.create.l HWIO_PMIC_ARB_OBS5_CHNL28_CONFIG_ADDR A:0x2ce5004
y.create.l HWIO_PMIC_ARB_OBS5_CHNL29_CONFIG_ADDR A:0x2ced004
y.create.l HWIO_PMIC_ARB_OBS5_CHNL30_CONFIG_ADDR A:0x2cf5004
y.create.l HWIO_PMIC_ARB_OBS5_CHNL31_CONFIG_ADDR A:0x2cfd004
y.create.l HWIO_PMIC_ARB_OBS5_CHNL32_CONFIG_ADDR A:0x2d05004
y.create.l HWIO_PMIC_ARB_OBS5_CHNL33_CONFIG_ADDR A:0x2d0d004
y.create.l HWIO_PMIC_ARB_OBS5_CHNL34_CONFIG_ADDR A:0x2d15004
y.create.l HWIO_PMIC_ARB_OBS5_CHNL35_CONFIG_ADDR A:0x2d1d004
y.create.l HWIO_PMIC_ARB_OBS5_CHNL36_CONFIG_ADDR A:0x2d25004
y.create.l HWIO_PMIC_ARB_OBS5_CHNL37_CONFIG_ADDR A:0x2d2d004
y.create.l HWIO_PMIC_ARB_OBS5_CHNL38_CONFIG_ADDR A:0x2d35004
y.create.l HWIO_PMIC_ARB_OBS5_CHNL39_CONFIG_ADDR A:0x2d3d004
y.create.l HWIO_PMIC_ARB_OBS5_CHNL40_CONFIG_ADDR A:0x2d45004
y.create.l HWIO_PMIC_ARB_OBS5_CHNL41_CONFIG_ADDR A:0x2d4d004
y.create.l HWIO_PMIC_ARB_OBS5_CHNL42_CONFIG_ADDR A:0x2d55004
y.create.l HWIO_PMIC_ARB_OBS5_CHNL43_CONFIG_ADDR A:0x2d5d004
y.create.l HWIO_PMIC_ARB_OBS5_CHNL44_CONFIG_ADDR A:0x2d65004
y.create.l HWIO_PMIC_ARB_OBS5_CHNL45_CONFIG_ADDR A:0x2d6d004
y.create.l HWIO_PMIC_ARB_OBS5_CHNL46_CONFIG_ADDR A:0x2d75004
y.create.l HWIO_PMIC_ARB_OBS5_CHNL47_CONFIG_ADDR A:0x2d7d004
y.create.l HWIO_PMIC_ARB_OBS5_CHNL48_CONFIG_ADDR A:0x2d85004
y.create.l HWIO_PMIC_ARB_OBS5_CHNL49_CONFIG_ADDR A:0x2d8d004
y.create.l HWIO_PMIC_ARB_OBS5_CHNL50_CONFIG_ADDR A:0x2d95004
y.create.l HWIO_PMIC_ARB_OBS5_CHNL51_CONFIG_ADDR A:0x2d9d004
y.create.l HWIO_PMIC_ARB_OBS5_CHNL52_CONFIG_ADDR A:0x2da5004
y.create.l HWIO_PMIC_ARB_OBS5_CHNL53_CONFIG_ADDR A:0x2dad004
y.create.l HWIO_PMIC_ARB_OBS5_CHNL54_CONFIG_ADDR A:0x2db5004
y.create.l HWIO_PMIC_ARB_OBS5_CHNL55_CONFIG_ADDR A:0x2dbd004
y.create.l HWIO_PMIC_ARB_OBS5_CHNL56_CONFIG_ADDR A:0x2dc5004
y.create.l HWIO_PMIC_ARB_OBS5_CHNL57_CONFIG_ADDR A:0x2dcd004
y.create.l HWIO_PMIC_ARB_OBS5_CHNL58_CONFIG_ADDR A:0x2dd5004
y.create.l HWIO_PMIC_ARB_OBS5_CHNL59_CONFIG_ADDR A:0x2ddd004
y.create.l HWIO_PMIC_ARB_OBS5_CHNL60_CONFIG_ADDR A:0x2de5004
y.create.l HWIO_PMIC_ARB_OBS5_CHNL61_CONFIG_ADDR A:0x2ded004
y.create.l HWIO_PMIC_ARB_OBS5_CHNL62_CONFIG_ADDR A:0x2df5004
y.create.l HWIO_PMIC_ARB_OBS5_CHNL63_CONFIG_ADDR A:0x2dfd004
y.create.l HWIO_PMIC_ARB_OBS5_CHNL64_CONFIG_ADDR A:0x2e05004
y.create.l HWIO_PMIC_ARB_OBS5_CHNL65_CONFIG_ADDR A:0x2e0d004
y.create.l HWIO_PMIC_ARB_OBS5_CHNL66_CONFIG_ADDR A:0x2e15004
y.create.l HWIO_PMIC_ARB_OBS5_CHNL67_CONFIG_ADDR A:0x2e1d004
y.create.l HWIO_PMIC_ARB_OBS5_CHNL68_CONFIG_ADDR A:0x2e25004
y.create.l HWIO_PMIC_ARB_OBS5_CHNL69_CONFIG_ADDR A:0x2e2d004
y.create.l HWIO_PMIC_ARB_OBS5_CHNL70_CONFIG_ADDR A:0x2e35004
y.create.l HWIO_PMIC_ARB_OBS5_CHNL71_CONFIG_ADDR A:0x2e3d004
y.create.l HWIO_PMIC_ARB_OBS5_CHNL72_CONFIG_ADDR A:0x2e45004
y.create.l HWIO_PMIC_ARB_OBS5_CHNL73_CONFIG_ADDR A:0x2e4d004
y.create.l HWIO_PMIC_ARB_OBS5_CHNL74_CONFIG_ADDR A:0x2e55004
y.create.l HWIO_PMIC_ARB_OBS5_CHNL75_CONFIG_ADDR A:0x2e5d004
y.create.l HWIO_PMIC_ARB_OBS5_CHNL76_CONFIG_ADDR A:0x2e65004
y.create.l HWIO_PMIC_ARB_OBS5_CHNL77_CONFIG_ADDR A:0x2e6d004
y.create.l HWIO_PMIC_ARB_OBS5_CHNL78_CONFIG_ADDR A:0x2e75004
y.create.l HWIO_PMIC_ARB_OBS5_CHNL79_CONFIG_ADDR A:0x2e7d004
y.create.l HWIO_PMIC_ARB_OBS5_CHNL80_CONFIG_ADDR A:0x2e85004
y.create.l HWIO_PMIC_ARB_OBS5_CHNL81_CONFIG_ADDR A:0x2e8d004
y.create.l HWIO_PMIC_ARB_OBS5_CHNL82_CONFIG_ADDR A:0x2e95004
y.create.l HWIO_PMIC_ARB_OBS5_CHNL83_CONFIG_ADDR A:0x2e9d004
y.create.l HWIO_PMIC_ARB_OBS5_CHNL84_CONFIG_ADDR A:0x2ea5004
y.create.l HWIO_PMIC_ARB_OBS5_CHNL85_CONFIG_ADDR A:0x2ead004
y.create.l HWIO_PMIC_ARB_OBS5_CHNL86_CONFIG_ADDR A:0x2eb5004
y.create.l HWIO_PMIC_ARB_OBS5_CHNL87_CONFIG_ADDR A:0x2ebd004
y.create.l HWIO_PMIC_ARB_OBS5_CHNL88_CONFIG_ADDR A:0x2ec5004
y.create.l HWIO_PMIC_ARB_OBS5_CHNL89_CONFIG_ADDR A:0x2ecd004
y.create.l HWIO_PMIC_ARB_OBS5_CHNL90_CONFIG_ADDR A:0x2ed5004
y.create.l HWIO_PMIC_ARB_OBS5_CHNL91_CONFIG_ADDR A:0x2edd004
y.create.l HWIO_PMIC_ARB_OBS5_CHNL92_CONFIG_ADDR A:0x2ee5004
y.create.l HWIO_PMIC_ARB_OBS5_CHNL93_CONFIG_ADDR A:0x2eed004
y.create.l HWIO_PMIC_ARB_OBS5_CHNL94_CONFIG_ADDR A:0x2ef5004
y.create.l HWIO_PMIC_ARB_OBS5_CHNL95_CONFIG_ADDR A:0x2efd004
y.create.l HWIO_PMIC_ARB_OBS5_CHNL96_CONFIG_ADDR A:0x2f05004
y.create.l HWIO_PMIC_ARB_OBS5_CHNL97_CONFIG_ADDR A:0x2f0d004
y.create.l HWIO_PMIC_ARB_OBS5_CHNL98_CONFIG_ADDR A:0x2f15004
y.create.l HWIO_PMIC_ARB_OBS5_CHNL99_CONFIG_ADDR A:0x2f1d004
y.create.l HWIO_PMIC_ARB_OBS5_CHNL100_CONFIG_ADDR A:0x2f25004
y.create.l HWIO_PMIC_ARB_OBS5_CHNL101_CONFIG_ADDR A:0x2f2d004
y.create.l HWIO_PMIC_ARB_OBS5_CHNL102_CONFIG_ADDR A:0x2f35004
y.create.l HWIO_PMIC_ARB_OBS5_CHNL103_CONFIG_ADDR A:0x2f3d004
y.create.l HWIO_PMIC_ARB_OBS5_CHNL104_CONFIG_ADDR A:0x2f45004
y.create.l HWIO_PMIC_ARB_OBS5_CHNL105_CONFIG_ADDR A:0x2f4d004
y.create.l HWIO_PMIC_ARB_OBS5_CHNL106_CONFIG_ADDR A:0x2f55004
y.create.l HWIO_PMIC_ARB_OBS5_CHNL107_CONFIG_ADDR A:0x2f5d004
y.create.l HWIO_PMIC_ARB_OBS5_CHNL108_CONFIG_ADDR A:0x2f65004
y.create.l HWIO_PMIC_ARB_OBS5_CHNL109_CONFIG_ADDR A:0x2f6d004
y.create.l HWIO_PMIC_ARB_OBS5_CHNL110_CONFIG_ADDR A:0x2f75004
y.create.l HWIO_PMIC_ARB_OBS5_CHNL111_CONFIG_ADDR A:0x2f7d004
y.create.l HWIO_PMIC_ARB_OBS5_CHNL112_CONFIG_ADDR A:0x2f85004
y.create.l HWIO_PMIC_ARB_OBS5_CHNL113_CONFIG_ADDR A:0x2f8d004
y.create.l HWIO_PMIC_ARB_OBS5_CHNL114_CONFIG_ADDR A:0x2f95004
y.create.l HWIO_PMIC_ARB_OBS5_CHNL115_CONFIG_ADDR A:0x2f9d004
y.create.l HWIO_PMIC_ARB_OBS5_CHNL116_CONFIG_ADDR A:0x2fa5004
y.create.l HWIO_PMIC_ARB_OBS5_CHNL117_CONFIG_ADDR A:0x2fad004
y.create.l HWIO_PMIC_ARB_OBS5_CHNL118_CONFIG_ADDR A:0x2fb5004
y.create.l HWIO_PMIC_ARB_OBS5_CHNL119_CONFIG_ADDR A:0x2fbd004
y.create.l HWIO_PMIC_ARB_OBS5_CHNL120_CONFIG_ADDR A:0x2fc5004
y.create.l HWIO_PMIC_ARB_OBS5_CHNL121_CONFIG_ADDR A:0x2fcd004
y.create.l HWIO_PMIC_ARB_OBS5_CHNL122_CONFIG_ADDR A:0x2fd5004
y.create.l HWIO_PMIC_ARB_OBS5_CHNL123_CONFIG_ADDR A:0x2fdd004
y.create.l HWIO_PMIC_ARB_OBS5_CHNL124_CONFIG_ADDR A:0x2fe5004
y.create.l HWIO_PMIC_ARB_OBS5_CHNL125_CONFIG_ADDR A:0x2fed004
y.create.l HWIO_PMIC_ARB_OBS5_CHNL126_CONFIG_ADDR A:0x2ff5004
y.create.l HWIO_PMIC_ARB_OBS5_CHNL127_CONFIG_ADDR A:0x2ffd004
y.create.l HWIO_PMIC_ARB_OBS5_CHNL128_CONFIG_ADDR A:0x3005004
y.create.l HWIO_PMIC_ARB_OBS5_CHNL129_CONFIG_ADDR A:0x300d004
y.create.l HWIO_PMIC_ARB_OBS5_CHNL130_CONFIG_ADDR A:0x3015004
y.create.l HWIO_PMIC_ARB_OBS5_CHNL131_CONFIG_ADDR A:0x301d004
y.create.l HWIO_PMIC_ARB_OBS5_CHNL132_CONFIG_ADDR A:0x3025004
y.create.l HWIO_PMIC_ARB_OBS5_CHNL133_CONFIG_ADDR A:0x302d004
y.create.l HWIO_PMIC_ARB_OBS5_CHNL134_CONFIG_ADDR A:0x3035004
y.create.l HWIO_PMIC_ARB_OBS5_CHNL135_CONFIG_ADDR A:0x303d004
y.create.l HWIO_PMIC_ARB_OBS5_CHNL136_CONFIG_ADDR A:0x3045004
y.create.l HWIO_PMIC_ARB_OBS5_CHNL137_CONFIG_ADDR A:0x304d004
y.create.l HWIO_PMIC_ARB_OBS5_CHNL138_CONFIG_ADDR A:0x3055004
y.create.l HWIO_PMIC_ARB_OBS5_CHNL139_CONFIG_ADDR A:0x305d004
y.create.l HWIO_PMIC_ARB_OBS5_CHNL140_CONFIG_ADDR A:0x3065004
y.create.l HWIO_PMIC_ARB_OBS5_CHNL141_CONFIG_ADDR A:0x306d004
y.create.l HWIO_PMIC_ARB_OBS5_CHNL142_CONFIG_ADDR A:0x3075004
y.create.l HWIO_PMIC_ARB_OBS5_CHNL143_CONFIG_ADDR A:0x307d004
y.create.l HWIO_PMIC_ARB_OBS5_CHNL144_CONFIG_ADDR A:0x3085004
y.create.l HWIO_PMIC_ARB_OBS5_CHNL145_CONFIG_ADDR A:0x308d004
y.create.l HWIO_PMIC_ARB_OBS5_CHNL146_CONFIG_ADDR A:0x3095004
y.create.l HWIO_PMIC_ARB_OBS5_CHNL147_CONFIG_ADDR A:0x309d004
y.create.l HWIO_PMIC_ARB_OBS5_CHNL148_CONFIG_ADDR A:0x30a5004
y.create.l HWIO_PMIC_ARB_OBS5_CHNL149_CONFIG_ADDR A:0x30ad004
y.create.l HWIO_PMIC_ARB_OBS5_CHNL150_CONFIG_ADDR A:0x30b5004
y.create.l HWIO_PMIC_ARB_OBS5_CHNL151_CONFIG_ADDR A:0x30bd004
y.create.l HWIO_PMIC_ARB_OBS5_CHNL152_CONFIG_ADDR A:0x30c5004
y.create.l HWIO_PMIC_ARB_OBS5_CHNL153_CONFIG_ADDR A:0x30cd004
y.create.l HWIO_PMIC_ARB_OBS5_CHNL154_CONFIG_ADDR A:0x30d5004
y.create.l HWIO_PMIC_ARB_OBS5_CHNL155_CONFIG_ADDR A:0x30dd004
y.create.l HWIO_PMIC_ARB_OBS5_CHNL156_CONFIG_ADDR A:0x30e5004
y.create.l HWIO_PMIC_ARB_OBS5_CHNL157_CONFIG_ADDR A:0x30ed004
y.create.l HWIO_PMIC_ARB_OBS5_CHNL158_CONFIG_ADDR A:0x30f5004
y.create.l HWIO_PMIC_ARB_OBS5_CHNL159_CONFIG_ADDR A:0x30fd004
y.create.l HWIO_PMIC_ARB_OBS5_CHNL160_CONFIG_ADDR A:0x3105004
y.create.l HWIO_PMIC_ARB_OBS5_CHNL161_CONFIG_ADDR A:0x310d004
y.create.l HWIO_PMIC_ARB_OBS5_CHNL162_CONFIG_ADDR A:0x3115004
y.create.l HWIO_PMIC_ARB_OBS5_CHNL163_CONFIG_ADDR A:0x311d004
y.create.l HWIO_PMIC_ARB_OBS5_CHNL164_CONFIG_ADDR A:0x3125004
y.create.l HWIO_PMIC_ARB_OBS5_CHNL165_CONFIG_ADDR A:0x312d004
y.create.l HWIO_PMIC_ARB_OBS5_CHNL166_CONFIG_ADDR A:0x3135004
y.create.l HWIO_PMIC_ARB_OBS5_CHNL167_CONFIG_ADDR A:0x313d004
y.create.l HWIO_PMIC_ARB_OBS5_CHNL168_CONFIG_ADDR A:0x3145004
y.create.l HWIO_PMIC_ARB_OBS5_CHNL169_CONFIG_ADDR A:0x314d004
y.create.l HWIO_PMIC_ARB_OBS5_CHNL170_CONFIG_ADDR A:0x3155004
y.create.l HWIO_PMIC_ARB_OBS5_CHNL171_CONFIG_ADDR A:0x315d004
y.create.l HWIO_PMIC_ARB_OBS5_CHNL172_CONFIG_ADDR A:0x3165004
y.create.l HWIO_PMIC_ARB_OBS5_CHNL173_CONFIG_ADDR A:0x316d004
y.create.l HWIO_PMIC_ARB_OBS5_CHNL174_CONFIG_ADDR A:0x3175004
y.create.l HWIO_PMIC_ARB_OBS5_CHNL175_CONFIG_ADDR A:0x317d004
y.create.l HWIO_PMIC_ARB_OBS5_CHNL176_CONFIG_ADDR A:0x3185004
y.create.l HWIO_PMIC_ARB_OBS5_CHNL177_CONFIG_ADDR A:0x318d004
y.create.l HWIO_PMIC_ARB_OBS5_CHNL178_CONFIG_ADDR A:0x3195004
y.create.l HWIO_PMIC_ARB_OBS5_CHNL179_CONFIG_ADDR A:0x319d004
y.create.l HWIO_PMIC_ARB_OBS5_CHNL180_CONFIG_ADDR A:0x31a5004
y.create.l HWIO_PMIC_ARB_OBS5_CHNL181_CONFIG_ADDR A:0x31ad004
y.create.l HWIO_PMIC_ARB_OBS5_CHNL182_CONFIG_ADDR A:0x31b5004
y.create.l HWIO_PMIC_ARB_OBS5_CHNL183_CONFIG_ADDR A:0x31bd004
y.create.l HWIO_PMIC_ARB_OBS5_CHNL184_CONFIG_ADDR A:0x31c5004
y.create.l HWIO_PMIC_ARB_OBS5_CHNL185_CONFIG_ADDR A:0x31cd004
y.create.l HWIO_PMIC_ARB_OBS5_CHNL186_CONFIG_ADDR A:0x31d5004
y.create.l HWIO_PMIC_ARB_OBS5_CHNL187_CONFIG_ADDR A:0x31dd004
y.create.l HWIO_PMIC_ARB_OBS5_CHNL188_CONFIG_ADDR A:0x31e5004
y.create.l HWIO_PMIC_ARB_OBS5_CHNL189_CONFIG_ADDR A:0x31ed004
y.create.l HWIO_PMIC_ARB_OBS5_CHNL190_CONFIG_ADDR A:0x31f5004
y.create.l HWIO_PMIC_ARB_OBS5_CHNL191_CONFIG_ADDR A:0x31fd004
y.create.l HWIO_PMIC_ARB_OBS5_CHNL192_CONFIG_ADDR A:0x3205004
y.create.l HWIO_PMIC_ARB_OBS5_CHNL193_CONFIG_ADDR A:0x320d004
y.create.l HWIO_PMIC_ARB_OBS5_CHNL194_CONFIG_ADDR A:0x3215004
y.create.l HWIO_PMIC_ARB_OBS5_CHNL195_CONFIG_ADDR A:0x321d004
y.create.l HWIO_PMIC_ARB_OBS5_CHNL196_CONFIG_ADDR A:0x3225004
y.create.l HWIO_PMIC_ARB_OBS5_CHNL197_CONFIG_ADDR A:0x322d004
y.create.l HWIO_PMIC_ARB_OBS5_CHNL198_CONFIG_ADDR A:0x3235004
y.create.l HWIO_PMIC_ARB_OBS5_CHNL199_CONFIG_ADDR A:0x323d004
y.create.l HWIO_PMIC_ARB_OBS5_CHNL200_CONFIG_ADDR A:0x3245004
y.create.l HWIO_PMIC_ARB_OBS5_CHNL201_CONFIG_ADDR A:0x324d004
y.create.l HWIO_PMIC_ARB_OBS5_CHNL202_CONFIG_ADDR A:0x3255004
y.create.l HWIO_PMIC_ARB_OBS5_CHNL203_CONFIG_ADDR A:0x325d004
y.create.l HWIO_PMIC_ARB_OBS5_CHNL204_CONFIG_ADDR A:0x3265004
y.create.l HWIO_PMIC_ARB_OBS5_CHNL205_CONFIG_ADDR A:0x326d004
y.create.l HWIO_PMIC_ARB_OBS5_CHNL206_CONFIG_ADDR A:0x3275004
y.create.l HWIO_PMIC_ARB_OBS5_CHNL207_CONFIG_ADDR A:0x327d004
y.create.l HWIO_PMIC_ARB_OBS5_CHNL208_CONFIG_ADDR A:0x3285004
y.create.l HWIO_PMIC_ARB_OBS5_CHNL209_CONFIG_ADDR A:0x328d004
y.create.l HWIO_PMIC_ARB_OBS5_CHNL210_CONFIG_ADDR A:0x3295004
y.create.l HWIO_PMIC_ARB_OBS5_CHNL211_CONFIG_ADDR A:0x329d004
y.create.l HWIO_PMIC_ARB_OBS5_CHNL212_CONFIG_ADDR A:0x32a5004
y.create.l HWIO_PMIC_ARB_OBS5_CHNL213_CONFIG_ADDR A:0x32ad004
y.create.l HWIO_PMIC_ARB_OBS5_CHNL214_CONFIG_ADDR A:0x32b5004
y.create.l HWIO_PMIC_ARB_OBS5_CHNL215_CONFIG_ADDR A:0x32bd004
y.create.l HWIO_PMIC_ARB_OBS5_CHNL216_CONFIG_ADDR A:0x32c5004
y.create.l HWIO_PMIC_ARB_OBS5_CHNL217_CONFIG_ADDR A:0x32cd004
y.create.l HWIO_PMIC_ARB_OBS5_CHNL218_CONFIG_ADDR A:0x32d5004
y.create.l HWIO_PMIC_ARB_OBS5_CHNL219_CONFIG_ADDR A:0x32dd004
y.create.l HWIO_PMIC_ARB_OBS5_CHNL220_CONFIG_ADDR A:0x32e5004
y.create.l HWIO_PMIC_ARB_OBS5_CHNL221_CONFIG_ADDR A:0x32ed004
y.create.l HWIO_PMIC_ARB_OBS5_CHNL222_CONFIG_ADDR A:0x32f5004
y.create.l HWIO_PMIC_ARB_OBS5_CHNL223_CONFIG_ADDR A:0x32fd004
y.create.l HWIO_PMIC_ARB_OBS5_CHNL224_CONFIG_ADDR A:0x3305004
y.create.l HWIO_PMIC_ARB_OBS5_CHNL225_CONFIG_ADDR A:0x330d004
y.create.l HWIO_PMIC_ARB_OBS5_CHNL226_CONFIG_ADDR A:0x3315004
y.create.l HWIO_PMIC_ARB_OBS5_CHNL227_CONFIG_ADDR A:0x331d004
y.create.l HWIO_PMIC_ARB_OBS5_CHNL228_CONFIG_ADDR A:0x3325004
y.create.l HWIO_PMIC_ARB_OBS5_CHNL229_CONFIG_ADDR A:0x332d004
y.create.l HWIO_PMIC_ARB_OBS5_CHNL230_CONFIG_ADDR A:0x3335004
y.create.l HWIO_PMIC_ARB_OBS5_CHNL231_CONFIG_ADDR A:0x333d004
y.create.l HWIO_PMIC_ARB_OBS5_CHNL232_CONFIG_ADDR A:0x3345004
y.create.l HWIO_PMIC_ARB_OBS5_CHNL233_CONFIG_ADDR A:0x334d004
y.create.l HWIO_PMIC_ARB_OBS5_CHNL234_CONFIG_ADDR A:0x3355004
y.create.l HWIO_PMIC_ARB_OBS5_CHNL235_CONFIG_ADDR A:0x335d004
y.create.l HWIO_PMIC_ARB_OBS5_CHNL236_CONFIG_ADDR A:0x3365004
y.create.l HWIO_PMIC_ARB_OBS5_CHNL237_CONFIG_ADDR A:0x336d004
y.create.l HWIO_PMIC_ARB_OBS5_CHNL238_CONFIG_ADDR A:0x3375004
y.create.l HWIO_PMIC_ARB_OBS5_CHNL239_CONFIG_ADDR A:0x337d004
y.create.l HWIO_PMIC_ARB_OBS5_CHNL240_CONFIG_ADDR A:0x3385004
y.create.l HWIO_PMIC_ARB_OBS5_CHNL241_CONFIG_ADDR A:0x338d004
y.create.l HWIO_PMIC_ARB_OBS5_CHNL242_CONFIG_ADDR A:0x3395004
y.create.l HWIO_PMIC_ARB_OBS5_CHNL243_CONFIG_ADDR A:0x339d004
y.create.l HWIO_PMIC_ARB_OBS5_CHNL244_CONFIG_ADDR A:0x33a5004
y.create.l HWIO_PMIC_ARB_OBS5_CHNL245_CONFIG_ADDR A:0x33ad004
y.create.l HWIO_PMIC_ARB_OBS5_CHNL246_CONFIG_ADDR A:0x33b5004
y.create.l HWIO_PMIC_ARB_OBS5_CHNL247_CONFIG_ADDR A:0x33bd004
y.create.l HWIO_PMIC_ARB_OBS5_CHNL248_CONFIG_ADDR A:0x33c5004
y.create.l HWIO_PMIC_ARB_OBS5_CHNL249_CONFIG_ADDR A:0x33cd004
y.create.l HWIO_PMIC_ARB_OBS5_CHNL250_CONFIG_ADDR A:0x33d5004
y.create.l HWIO_PMIC_ARB_OBS5_CHNL251_CONFIG_ADDR A:0x33dd004
y.create.l HWIO_PMIC_ARB_OBS5_CHNL252_CONFIG_ADDR A:0x33e5004
y.create.l HWIO_PMIC_ARB_OBS5_CHNL253_CONFIG_ADDR A:0x33ed004
y.create.l HWIO_PMIC_ARB_OBS5_CHNL254_CONFIG_ADDR A:0x33f5004
y.create.l HWIO_PMIC_ARB_OBS5_CHNL255_CONFIG_ADDR A:0x33fd004
y.create.l HWIO_PMIC_ARB_OBS6_CHNL0_CONFIG_ADDR A:0x2c06004
y.create.l HWIO_PMIC_ARB_OBS6_CHNL1_CONFIG_ADDR A:0x2c0e004
y.create.l HWIO_PMIC_ARB_OBS6_CHNL2_CONFIG_ADDR A:0x2c16004
y.create.l HWIO_PMIC_ARB_OBS6_CHNL3_CONFIG_ADDR A:0x2c1e004
y.create.l HWIO_PMIC_ARB_OBS6_CHNL4_CONFIG_ADDR A:0x2c26004
y.create.l HWIO_PMIC_ARB_OBS6_CHNL5_CONFIG_ADDR A:0x2c2e004
y.create.l HWIO_PMIC_ARB_OBS6_CHNL6_CONFIG_ADDR A:0x2c36004
y.create.l HWIO_PMIC_ARB_OBS6_CHNL7_CONFIG_ADDR A:0x2c3e004
y.create.l HWIO_PMIC_ARB_OBS6_CHNL8_CONFIG_ADDR A:0x2c46004
y.create.l HWIO_PMIC_ARB_OBS6_CHNL9_CONFIG_ADDR A:0x2c4e004
y.create.l HWIO_PMIC_ARB_OBS6_CHNL10_CONFIG_ADDR A:0x2c56004
y.create.l HWIO_PMIC_ARB_OBS6_CHNL11_CONFIG_ADDR A:0x2c5e004
y.create.l HWIO_PMIC_ARB_OBS6_CHNL12_CONFIG_ADDR A:0x2c66004
y.create.l HWIO_PMIC_ARB_OBS6_CHNL13_CONFIG_ADDR A:0x2c6e004
y.create.l HWIO_PMIC_ARB_OBS6_CHNL14_CONFIG_ADDR A:0x2c76004
y.create.l HWIO_PMIC_ARB_OBS6_CHNL15_CONFIG_ADDR A:0x2c7e004
y.create.l HWIO_PMIC_ARB_OBS6_CHNL16_CONFIG_ADDR A:0x2c86004
y.create.l HWIO_PMIC_ARB_OBS6_CHNL17_CONFIG_ADDR A:0x2c8e004
y.create.l HWIO_PMIC_ARB_OBS6_CHNL18_CONFIG_ADDR A:0x2c96004
y.create.l HWIO_PMIC_ARB_OBS6_CHNL19_CONFIG_ADDR A:0x2c9e004
y.create.l HWIO_PMIC_ARB_OBS6_CHNL20_CONFIG_ADDR A:0x2ca6004
y.create.l HWIO_PMIC_ARB_OBS6_CHNL21_CONFIG_ADDR A:0x2cae004
y.create.l HWIO_PMIC_ARB_OBS6_CHNL22_CONFIG_ADDR A:0x2cb6004
y.create.l HWIO_PMIC_ARB_OBS6_CHNL23_CONFIG_ADDR A:0x2cbe004
y.create.l HWIO_PMIC_ARB_OBS6_CHNL24_CONFIG_ADDR A:0x2cc6004
y.create.l HWIO_PMIC_ARB_OBS6_CHNL25_CONFIG_ADDR A:0x2cce004
y.create.l HWIO_PMIC_ARB_OBS6_CHNL26_CONFIG_ADDR A:0x2cd6004
y.create.l HWIO_PMIC_ARB_OBS6_CHNL27_CONFIG_ADDR A:0x2cde004
y.create.l HWIO_PMIC_ARB_OBS6_CHNL28_CONFIG_ADDR A:0x2ce6004
y.create.l HWIO_PMIC_ARB_OBS6_CHNL29_CONFIG_ADDR A:0x2cee004
y.create.l HWIO_PMIC_ARB_OBS6_CHNL30_CONFIG_ADDR A:0x2cf6004
y.create.l HWIO_PMIC_ARB_OBS6_CHNL31_CONFIG_ADDR A:0x2cfe004
y.create.l HWIO_PMIC_ARB_OBS6_CHNL32_CONFIG_ADDR A:0x2d06004
y.create.l HWIO_PMIC_ARB_OBS6_CHNL33_CONFIG_ADDR A:0x2d0e004
y.create.l HWIO_PMIC_ARB_OBS6_CHNL34_CONFIG_ADDR A:0x2d16004
y.create.l HWIO_PMIC_ARB_OBS6_CHNL35_CONFIG_ADDR A:0x2d1e004
y.create.l HWIO_PMIC_ARB_OBS6_CHNL36_CONFIG_ADDR A:0x2d26004
y.create.l HWIO_PMIC_ARB_OBS6_CHNL37_CONFIG_ADDR A:0x2d2e004
y.create.l HWIO_PMIC_ARB_OBS6_CHNL38_CONFIG_ADDR A:0x2d36004
y.create.l HWIO_PMIC_ARB_OBS6_CHNL39_CONFIG_ADDR A:0x2d3e004
y.create.l HWIO_PMIC_ARB_OBS6_CHNL40_CONFIG_ADDR A:0x2d46004
y.create.l HWIO_PMIC_ARB_OBS6_CHNL41_CONFIG_ADDR A:0x2d4e004
y.create.l HWIO_PMIC_ARB_OBS6_CHNL42_CONFIG_ADDR A:0x2d56004
y.create.l HWIO_PMIC_ARB_OBS6_CHNL43_CONFIG_ADDR A:0x2d5e004
y.create.l HWIO_PMIC_ARB_OBS6_CHNL44_CONFIG_ADDR A:0x2d66004
y.create.l HWIO_PMIC_ARB_OBS6_CHNL45_CONFIG_ADDR A:0x2d6e004
y.create.l HWIO_PMIC_ARB_OBS6_CHNL46_CONFIG_ADDR A:0x2d76004
y.create.l HWIO_PMIC_ARB_OBS6_CHNL47_CONFIG_ADDR A:0x2d7e004
y.create.l HWIO_PMIC_ARB_OBS6_CHNL48_CONFIG_ADDR A:0x2d86004
y.create.l HWIO_PMIC_ARB_OBS6_CHNL49_CONFIG_ADDR A:0x2d8e004
y.create.l HWIO_PMIC_ARB_OBS6_CHNL50_CONFIG_ADDR A:0x2d96004
y.create.l HWIO_PMIC_ARB_OBS6_CHNL51_CONFIG_ADDR A:0x2d9e004
y.create.l HWIO_PMIC_ARB_OBS6_CHNL52_CONFIG_ADDR A:0x2da6004
y.create.l HWIO_PMIC_ARB_OBS6_CHNL53_CONFIG_ADDR A:0x2dae004
y.create.l HWIO_PMIC_ARB_OBS6_CHNL54_CONFIG_ADDR A:0x2db6004
y.create.l HWIO_PMIC_ARB_OBS6_CHNL55_CONFIG_ADDR A:0x2dbe004
y.create.l HWIO_PMIC_ARB_OBS6_CHNL56_CONFIG_ADDR A:0x2dc6004
y.create.l HWIO_PMIC_ARB_OBS6_CHNL57_CONFIG_ADDR A:0x2dce004
y.create.l HWIO_PMIC_ARB_OBS6_CHNL58_CONFIG_ADDR A:0x2dd6004
y.create.l HWIO_PMIC_ARB_OBS6_CHNL59_CONFIG_ADDR A:0x2dde004
y.create.l HWIO_PMIC_ARB_OBS6_CHNL60_CONFIG_ADDR A:0x2de6004
y.create.l HWIO_PMIC_ARB_OBS6_CHNL61_CONFIG_ADDR A:0x2dee004
y.create.l HWIO_PMIC_ARB_OBS6_CHNL62_CONFIG_ADDR A:0x2df6004
y.create.l HWIO_PMIC_ARB_OBS6_CHNL63_CONFIG_ADDR A:0x2dfe004
y.create.l HWIO_PMIC_ARB_OBS6_CHNL64_CONFIG_ADDR A:0x2e06004
y.create.l HWIO_PMIC_ARB_OBS6_CHNL65_CONFIG_ADDR A:0x2e0e004
y.create.l HWIO_PMIC_ARB_OBS6_CHNL66_CONFIG_ADDR A:0x2e16004
y.create.l HWIO_PMIC_ARB_OBS6_CHNL67_CONFIG_ADDR A:0x2e1e004
y.create.l HWIO_PMIC_ARB_OBS6_CHNL68_CONFIG_ADDR A:0x2e26004
y.create.l HWIO_PMIC_ARB_OBS6_CHNL69_CONFIG_ADDR A:0x2e2e004
y.create.l HWIO_PMIC_ARB_OBS6_CHNL70_CONFIG_ADDR A:0x2e36004
y.create.l HWIO_PMIC_ARB_OBS6_CHNL71_CONFIG_ADDR A:0x2e3e004
y.create.l HWIO_PMIC_ARB_OBS6_CHNL72_CONFIG_ADDR A:0x2e46004
y.create.l HWIO_PMIC_ARB_OBS6_CHNL73_CONFIG_ADDR A:0x2e4e004
y.create.l HWIO_PMIC_ARB_OBS6_CHNL74_CONFIG_ADDR A:0x2e56004
y.create.l HWIO_PMIC_ARB_OBS6_CHNL75_CONFIG_ADDR A:0x2e5e004
y.create.l HWIO_PMIC_ARB_OBS6_CHNL76_CONFIG_ADDR A:0x2e66004
y.create.l HWIO_PMIC_ARB_OBS6_CHNL77_CONFIG_ADDR A:0x2e6e004
y.create.l HWIO_PMIC_ARB_OBS6_CHNL78_CONFIG_ADDR A:0x2e76004
y.create.l HWIO_PMIC_ARB_OBS6_CHNL79_CONFIG_ADDR A:0x2e7e004
y.create.l HWIO_PMIC_ARB_OBS6_CHNL80_CONFIG_ADDR A:0x2e86004
y.create.l HWIO_PMIC_ARB_OBS6_CHNL81_CONFIG_ADDR A:0x2e8e004
y.create.l HWIO_PMIC_ARB_OBS6_CHNL82_CONFIG_ADDR A:0x2e96004
y.create.l HWIO_PMIC_ARB_OBS6_CHNL83_CONFIG_ADDR A:0x2e9e004
y.create.l HWIO_PMIC_ARB_OBS6_CHNL84_CONFIG_ADDR A:0x2ea6004
y.create.l HWIO_PMIC_ARB_OBS6_CHNL85_CONFIG_ADDR A:0x2eae004
y.create.l HWIO_PMIC_ARB_OBS6_CHNL86_CONFIG_ADDR A:0x2eb6004
y.create.l HWIO_PMIC_ARB_OBS6_CHNL87_CONFIG_ADDR A:0x2ebe004
y.create.l HWIO_PMIC_ARB_OBS6_CHNL88_CONFIG_ADDR A:0x2ec6004
y.create.l HWIO_PMIC_ARB_OBS6_CHNL89_CONFIG_ADDR A:0x2ece004
y.create.l HWIO_PMIC_ARB_OBS6_CHNL90_CONFIG_ADDR A:0x2ed6004
y.create.l HWIO_PMIC_ARB_OBS6_CHNL91_CONFIG_ADDR A:0x2ede004
y.create.l HWIO_PMIC_ARB_OBS6_CHNL92_CONFIG_ADDR A:0x2ee6004
y.create.l HWIO_PMIC_ARB_OBS6_CHNL93_CONFIG_ADDR A:0x2eee004
y.create.l HWIO_PMIC_ARB_OBS6_CHNL94_CONFIG_ADDR A:0x2ef6004
y.create.l HWIO_PMIC_ARB_OBS6_CHNL95_CONFIG_ADDR A:0x2efe004
y.create.l HWIO_PMIC_ARB_OBS6_CHNL96_CONFIG_ADDR A:0x2f06004
y.create.l HWIO_PMIC_ARB_OBS6_CHNL97_CONFIG_ADDR A:0x2f0e004
y.create.l HWIO_PMIC_ARB_OBS6_CHNL98_CONFIG_ADDR A:0x2f16004
y.create.l HWIO_PMIC_ARB_OBS6_CHNL99_CONFIG_ADDR A:0x2f1e004
y.create.l HWIO_PMIC_ARB_OBS6_CHNL100_CONFIG_ADDR A:0x2f26004
y.create.l HWIO_PMIC_ARB_OBS6_CHNL101_CONFIG_ADDR A:0x2f2e004
y.create.l HWIO_PMIC_ARB_OBS6_CHNL102_CONFIG_ADDR A:0x2f36004
y.create.l HWIO_PMIC_ARB_OBS6_CHNL103_CONFIG_ADDR A:0x2f3e004
y.create.l HWIO_PMIC_ARB_OBS6_CHNL104_CONFIG_ADDR A:0x2f46004
y.create.l HWIO_PMIC_ARB_OBS6_CHNL105_CONFIG_ADDR A:0x2f4e004
y.create.l HWIO_PMIC_ARB_OBS6_CHNL106_CONFIG_ADDR A:0x2f56004
y.create.l HWIO_PMIC_ARB_OBS6_CHNL107_CONFIG_ADDR A:0x2f5e004
y.create.l HWIO_PMIC_ARB_OBS6_CHNL108_CONFIG_ADDR A:0x2f66004
y.create.l HWIO_PMIC_ARB_OBS6_CHNL109_CONFIG_ADDR A:0x2f6e004
y.create.l HWIO_PMIC_ARB_OBS6_CHNL110_CONFIG_ADDR A:0x2f76004
y.create.l HWIO_PMIC_ARB_OBS6_CHNL111_CONFIG_ADDR A:0x2f7e004
y.create.l HWIO_PMIC_ARB_OBS6_CHNL112_CONFIG_ADDR A:0x2f86004
y.create.l HWIO_PMIC_ARB_OBS6_CHNL113_CONFIG_ADDR A:0x2f8e004
y.create.l HWIO_PMIC_ARB_OBS6_CHNL114_CONFIG_ADDR A:0x2f96004
y.create.l HWIO_PMIC_ARB_OBS6_CHNL115_CONFIG_ADDR A:0x2f9e004
y.create.l HWIO_PMIC_ARB_OBS6_CHNL116_CONFIG_ADDR A:0x2fa6004
y.create.l HWIO_PMIC_ARB_OBS6_CHNL117_CONFIG_ADDR A:0x2fae004
y.create.l HWIO_PMIC_ARB_OBS6_CHNL118_CONFIG_ADDR A:0x2fb6004
y.create.l HWIO_PMIC_ARB_OBS6_CHNL119_CONFIG_ADDR A:0x2fbe004
y.create.l HWIO_PMIC_ARB_OBS6_CHNL120_CONFIG_ADDR A:0x2fc6004
y.create.l HWIO_PMIC_ARB_OBS6_CHNL121_CONFIG_ADDR A:0x2fce004
y.create.l HWIO_PMIC_ARB_OBS6_CHNL122_CONFIG_ADDR A:0x2fd6004
y.create.l HWIO_PMIC_ARB_OBS6_CHNL123_CONFIG_ADDR A:0x2fde004
y.create.l HWIO_PMIC_ARB_OBS6_CHNL124_CONFIG_ADDR A:0x2fe6004
y.create.l HWIO_PMIC_ARB_OBS6_CHNL125_CONFIG_ADDR A:0x2fee004
y.create.l HWIO_PMIC_ARB_OBS6_CHNL126_CONFIG_ADDR A:0x2ff6004
y.create.l HWIO_PMIC_ARB_OBS6_CHNL127_CONFIG_ADDR A:0x2ffe004
y.create.l HWIO_PMIC_ARB_OBS6_CHNL128_CONFIG_ADDR A:0x3006004
y.create.l HWIO_PMIC_ARB_OBS6_CHNL129_CONFIG_ADDR A:0x300e004
y.create.l HWIO_PMIC_ARB_OBS6_CHNL130_CONFIG_ADDR A:0x3016004
y.create.l HWIO_PMIC_ARB_OBS6_CHNL131_CONFIG_ADDR A:0x301e004
y.create.l HWIO_PMIC_ARB_OBS6_CHNL132_CONFIG_ADDR A:0x3026004
y.create.l HWIO_PMIC_ARB_OBS6_CHNL133_CONFIG_ADDR A:0x302e004
y.create.l HWIO_PMIC_ARB_OBS6_CHNL134_CONFIG_ADDR A:0x3036004
y.create.l HWIO_PMIC_ARB_OBS6_CHNL135_CONFIG_ADDR A:0x303e004
y.create.l HWIO_PMIC_ARB_OBS6_CHNL136_CONFIG_ADDR A:0x3046004
y.create.l HWIO_PMIC_ARB_OBS6_CHNL137_CONFIG_ADDR A:0x304e004
y.create.l HWIO_PMIC_ARB_OBS6_CHNL138_CONFIG_ADDR A:0x3056004
y.create.l HWIO_PMIC_ARB_OBS6_CHNL139_CONFIG_ADDR A:0x305e004
y.create.l HWIO_PMIC_ARB_OBS6_CHNL140_CONFIG_ADDR A:0x3066004
y.create.l HWIO_PMIC_ARB_OBS6_CHNL141_CONFIG_ADDR A:0x306e004
y.create.l HWIO_PMIC_ARB_OBS6_CHNL142_CONFIG_ADDR A:0x3076004
y.create.l HWIO_PMIC_ARB_OBS6_CHNL143_CONFIG_ADDR A:0x307e004
y.create.l HWIO_PMIC_ARB_OBS6_CHNL144_CONFIG_ADDR A:0x3086004
y.create.l HWIO_PMIC_ARB_OBS6_CHNL145_CONFIG_ADDR A:0x308e004
y.create.l HWIO_PMIC_ARB_OBS6_CHNL146_CONFIG_ADDR A:0x3096004
y.create.l HWIO_PMIC_ARB_OBS6_CHNL147_CONFIG_ADDR A:0x309e004
y.create.l HWIO_PMIC_ARB_OBS6_CHNL148_CONFIG_ADDR A:0x30a6004
y.create.l HWIO_PMIC_ARB_OBS6_CHNL149_CONFIG_ADDR A:0x30ae004
y.create.l HWIO_PMIC_ARB_OBS6_CHNL150_CONFIG_ADDR A:0x30b6004
y.create.l HWIO_PMIC_ARB_OBS6_CHNL151_CONFIG_ADDR A:0x30be004
y.create.l HWIO_PMIC_ARB_OBS6_CHNL152_CONFIG_ADDR A:0x30c6004
y.create.l HWIO_PMIC_ARB_OBS6_CHNL153_CONFIG_ADDR A:0x30ce004
y.create.l HWIO_PMIC_ARB_OBS6_CHNL154_CONFIG_ADDR A:0x30d6004
y.create.l HWIO_PMIC_ARB_OBS6_CHNL155_CONFIG_ADDR A:0x30de004
y.create.l HWIO_PMIC_ARB_OBS6_CHNL156_CONFIG_ADDR A:0x30e6004
y.create.l HWIO_PMIC_ARB_OBS6_CHNL157_CONFIG_ADDR A:0x30ee004
y.create.l HWIO_PMIC_ARB_OBS6_CHNL158_CONFIG_ADDR A:0x30f6004
y.create.l HWIO_PMIC_ARB_OBS6_CHNL159_CONFIG_ADDR A:0x30fe004
y.create.l HWIO_PMIC_ARB_OBS6_CHNL160_CONFIG_ADDR A:0x3106004
y.create.l HWIO_PMIC_ARB_OBS6_CHNL161_CONFIG_ADDR A:0x310e004
y.create.l HWIO_PMIC_ARB_OBS6_CHNL162_CONFIG_ADDR A:0x3116004
y.create.l HWIO_PMIC_ARB_OBS6_CHNL163_CONFIG_ADDR A:0x311e004
y.create.l HWIO_PMIC_ARB_OBS6_CHNL164_CONFIG_ADDR A:0x3126004
y.create.l HWIO_PMIC_ARB_OBS6_CHNL165_CONFIG_ADDR A:0x312e004
y.create.l HWIO_PMIC_ARB_OBS6_CHNL166_CONFIG_ADDR A:0x3136004
y.create.l HWIO_PMIC_ARB_OBS6_CHNL167_CONFIG_ADDR A:0x313e004
y.create.l HWIO_PMIC_ARB_OBS6_CHNL168_CONFIG_ADDR A:0x3146004
y.create.l HWIO_PMIC_ARB_OBS6_CHNL169_CONFIG_ADDR A:0x314e004
y.create.l HWIO_PMIC_ARB_OBS6_CHNL170_CONFIG_ADDR A:0x3156004
y.create.l HWIO_PMIC_ARB_OBS6_CHNL171_CONFIG_ADDR A:0x315e004
y.create.l HWIO_PMIC_ARB_OBS6_CHNL172_CONFIG_ADDR A:0x3166004
y.create.l HWIO_PMIC_ARB_OBS6_CHNL173_CONFIG_ADDR A:0x316e004
y.create.l HWIO_PMIC_ARB_OBS6_CHNL174_CONFIG_ADDR A:0x3176004
y.create.l HWIO_PMIC_ARB_OBS6_CHNL175_CONFIG_ADDR A:0x317e004
y.create.l HWIO_PMIC_ARB_OBS6_CHNL176_CONFIG_ADDR A:0x3186004
y.create.l HWIO_PMIC_ARB_OBS6_CHNL177_CONFIG_ADDR A:0x318e004
y.create.l HWIO_PMIC_ARB_OBS6_CHNL178_CONFIG_ADDR A:0x3196004
y.create.l HWIO_PMIC_ARB_OBS6_CHNL179_CONFIG_ADDR A:0x319e004
y.create.l HWIO_PMIC_ARB_OBS6_CHNL180_CONFIG_ADDR A:0x31a6004
y.create.l HWIO_PMIC_ARB_OBS6_CHNL181_CONFIG_ADDR A:0x31ae004
y.create.l HWIO_PMIC_ARB_OBS6_CHNL182_CONFIG_ADDR A:0x31b6004
y.create.l HWIO_PMIC_ARB_OBS6_CHNL183_CONFIG_ADDR A:0x31be004
y.create.l HWIO_PMIC_ARB_OBS6_CHNL184_CONFIG_ADDR A:0x31c6004
y.create.l HWIO_PMIC_ARB_OBS6_CHNL185_CONFIG_ADDR A:0x31ce004
y.create.l HWIO_PMIC_ARB_OBS6_CHNL186_CONFIG_ADDR A:0x31d6004
y.create.l HWIO_PMIC_ARB_OBS6_CHNL187_CONFIG_ADDR A:0x31de004
y.create.l HWIO_PMIC_ARB_OBS6_CHNL188_CONFIG_ADDR A:0x31e6004
y.create.l HWIO_PMIC_ARB_OBS6_CHNL189_CONFIG_ADDR A:0x31ee004
y.create.l HWIO_PMIC_ARB_OBS6_CHNL190_CONFIG_ADDR A:0x31f6004
y.create.l HWIO_PMIC_ARB_OBS6_CHNL191_CONFIG_ADDR A:0x31fe004
y.create.l HWIO_PMIC_ARB_OBS6_CHNL192_CONFIG_ADDR A:0x3206004
y.create.l HWIO_PMIC_ARB_OBS6_CHNL193_CONFIG_ADDR A:0x320e004
y.create.l HWIO_PMIC_ARB_OBS6_CHNL194_CONFIG_ADDR A:0x3216004
y.create.l HWIO_PMIC_ARB_OBS6_CHNL195_CONFIG_ADDR A:0x321e004
y.create.l HWIO_PMIC_ARB_OBS6_CHNL196_CONFIG_ADDR A:0x3226004
y.create.l HWIO_PMIC_ARB_OBS6_CHNL197_CONFIG_ADDR A:0x322e004
y.create.l HWIO_PMIC_ARB_OBS6_CHNL198_CONFIG_ADDR A:0x3236004
y.create.l HWIO_PMIC_ARB_OBS6_CHNL199_CONFIG_ADDR A:0x323e004
y.create.l HWIO_PMIC_ARB_OBS6_CHNL200_CONFIG_ADDR A:0x3246004
y.create.l HWIO_PMIC_ARB_OBS6_CHNL201_CONFIG_ADDR A:0x324e004
y.create.l HWIO_PMIC_ARB_OBS6_CHNL202_CONFIG_ADDR A:0x3256004
y.create.l HWIO_PMIC_ARB_OBS6_CHNL203_CONFIG_ADDR A:0x325e004
y.create.l HWIO_PMIC_ARB_OBS6_CHNL204_CONFIG_ADDR A:0x3266004
y.create.l HWIO_PMIC_ARB_OBS6_CHNL205_CONFIG_ADDR A:0x326e004
y.create.l HWIO_PMIC_ARB_OBS6_CHNL206_CONFIG_ADDR A:0x3276004
y.create.l HWIO_PMIC_ARB_OBS6_CHNL207_CONFIG_ADDR A:0x327e004
y.create.l HWIO_PMIC_ARB_OBS6_CHNL208_CONFIG_ADDR A:0x3286004
y.create.l HWIO_PMIC_ARB_OBS6_CHNL209_CONFIG_ADDR A:0x328e004
y.create.l HWIO_PMIC_ARB_OBS6_CHNL210_CONFIG_ADDR A:0x3296004
y.create.l HWIO_PMIC_ARB_OBS6_CHNL211_CONFIG_ADDR A:0x329e004
y.create.l HWIO_PMIC_ARB_OBS6_CHNL212_CONFIG_ADDR A:0x32a6004
y.create.l HWIO_PMIC_ARB_OBS6_CHNL213_CONFIG_ADDR A:0x32ae004
y.create.l HWIO_PMIC_ARB_OBS6_CHNL214_CONFIG_ADDR A:0x32b6004
y.create.l HWIO_PMIC_ARB_OBS6_CHNL215_CONFIG_ADDR A:0x32be004
y.create.l HWIO_PMIC_ARB_OBS6_CHNL216_CONFIG_ADDR A:0x32c6004
y.create.l HWIO_PMIC_ARB_OBS6_CHNL217_CONFIG_ADDR A:0x32ce004
y.create.l HWIO_PMIC_ARB_OBS6_CHNL218_CONFIG_ADDR A:0x32d6004
y.create.l HWIO_PMIC_ARB_OBS6_CHNL219_CONFIG_ADDR A:0x32de004
y.create.l HWIO_PMIC_ARB_OBS6_CHNL220_CONFIG_ADDR A:0x32e6004
y.create.l HWIO_PMIC_ARB_OBS6_CHNL221_CONFIG_ADDR A:0x32ee004
y.create.l HWIO_PMIC_ARB_OBS6_CHNL222_CONFIG_ADDR A:0x32f6004
y.create.l HWIO_PMIC_ARB_OBS6_CHNL223_CONFIG_ADDR A:0x32fe004
y.create.l HWIO_PMIC_ARB_OBS6_CHNL224_CONFIG_ADDR A:0x3306004
y.create.l HWIO_PMIC_ARB_OBS6_CHNL225_CONFIG_ADDR A:0x330e004
y.create.l HWIO_PMIC_ARB_OBS6_CHNL226_CONFIG_ADDR A:0x3316004
y.create.l HWIO_PMIC_ARB_OBS6_CHNL227_CONFIG_ADDR A:0x331e004
y.create.l HWIO_PMIC_ARB_OBS6_CHNL228_CONFIG_ADDR A:0x3326004
y.create.l HWIO_PMIC_ARB_OBS6_CHNL229_CONFIG_ADDR A:0x332e004
y.create.l HWIO_PMIC_ARB_OBS6_CHNL230_CONFIG_ADDR A:0x3336004
y.create.l HWIO_PMIC_ARB_OBS6_CHNL231_CONFIG_ADDR A:0x333e004
y.create.l HWIO_PMIC_ARB_OBS6_CHNL232_CONFIG_ADDR A:0x3346004
y.create.l HWIO_PMIC_ARB_OBS6_CHNL233_CONFIG_ADDR A:0x334e004
y.create.l HWIO_PMIC_ARB_OBS6_CHNL234_CONFIG_ADDR A:0x3356004
y.create.l HWIO_PMIC_ARB_OBS6_CHNL235_CONFIG_ADDR A:0x335e004
y.create.l HWIO_PMIC_ARB_OBS6_CHNL236_CONFIG_ADDR A:0x3366004
y.create.l HWIO_PMIC_ARB_OBS6_CHNL237_CONFIG_ADDR A:0x336e004
y.create.l HWIO_PMIC_ARB_OBS6_CHNL238_CONFIG_ADDR A:0x3376004
y.create.l HWIO_PMIC_ARB_OBS6_CHNL239_CONFIG_ADDR A:0x337e004
y.create.l HWIO_PMIC_ARB_OBS6_CHNL240_CONFIG_ADDR A:0x3386004
y.create.l HWIO_PMIC_ARB_OBS6_CHNL241_CONFIG_ADDR A:0x338e004
y.create.l HWIO_PMIC_ARB_OBS6_CHNL242_CONFIG_ADDR A:0x3396004
y.create.l HWIO_PMIC_ARB_OBS6_CHNL243_CONFIG_ADDR A:0x339e004
y.create.l HWIO_PMIC_ARB_OBS6_CHNL244_CONFIG_ADDR A:0x33a6004
y.create.l HWIO_PMIC_ARB_OBS6_CHNL245_CONFIG_ADDR A:0x33ae004
y.create.l HWIO_PMIC_ARB_OBS6_CHNL246_CONFIG_ADDR A:0x33b6004
y.create.l HWIO_PMIC_ARB_OBS6_CHNL247_CONFIG_ADDR A:0x33be004
y.create.l HWIO_PMIC_ARB_OBS6_CHNL248_CONFIG_ADDR A:0x33c6004
y.create.l HWIO_PMIC_ARB_OBS6_CHNL249_CONFIG_ADDR A:0x33ce004
y.create.l HWIO_PMIC_ARB_OBS6_CHNL250_CONFIG_ADDR A:0x33d6004
y.create.l HWIO_PMIC_ARB_OBS6_CHNL251_CONFIG_ADDR A:0x33de004
y.create.l HWIO_PMIC_ARB_OBS6_CHNL252_CONFIG_ADDR A:0x33e6004
y.create.l HWIO_PMIC_ARB_OBS6_CHNL253_CONFIG_ADDR A:0x33ee004
y.create.l HWIO_PMIC_ARB_OBS6_CHNL254_CONFIG_ADDR A:0x33f6004
y.create.l HWIO_PMIC_ARB_OBS6_CHNL255_CONFIG_ADDR A:0x33fe004
y.create.l HWIO_PMIC_ARB_OBS0_CHNL0_STATUS_ADDR A:0x2c00008
y.create.l HWIO_PMIC_ARB_OBS0_CHNL1_STATUS_ADDR A:0x2c08008
y.create.l HWIO_PMIC_ARB_OBS0_CHNL2_STATUS_ADDR A:0x2c10008
y.create.l HWIO_PMIC_ARB_OBS0_CHNL3_STATUS_ADDR A:0x2c18008
y.create.l HWIO_PMIC_ARB_OBS0_CHNL4_STATUS_ADDR A:0x2c20008
y.create.l HWIO_PMIC_ARB_OBS0_CHNL5_STATUS_ADDR A:0x2c28008
y.create.l HWIO_PMIC_ARB_OBS0_CHNL6_STATUS_ADDR A:0x2c30008
y.create.l HWIO_PMIC_ARB_OBS0_CHNL7_STATUS_ADDR A:0x2c38008
y.create.l HWIO_PMIC_ARB_OBS0_CHNL8_STATUS_ADDR A:0x2c40008
y.create.l HWIO_PMIC_ARB_OBS0_CHNL9_STATUS_ADDR A:0x2c48008
y.create.l HWIO_PMIC_ARB_OBS0_CHNL10_STATUS_ADDR A:0x2c50008
y.create.l HWIO_PMIC_ARB_OBS0_CHNL11_STATUS_ADDR A:0x2c58008
y.create.l HWIO_PMIC_ARB_OBS0_CHNL12_STATUS_ADDR A:0x2c60008
y.create.l HWIO_PMIC_ARB_OBS0_CHNL13_STATUS_ADDR A:0x2c68008
y.create.l HWIO_PMIC_ARB_OBS0_CHNL14_STATUS_ADDR A:0x2c70008
y.create.l HWIO_PMIC_ARB_OBS0_CHNL15_STATUS_ADDR A:0x2c78008
y.create.l HWIO_PMIC_ARB_OBS0_CHNL16_STATUS_ADDR A:0x2c80008
y.create.l HWIO_PMIC_ARB_OBS0_CHNL17_STATUS_ADDR A:0x2c88008
y.create.l HWIO_PMIC_ARB_OBS0_CHNL18_STATUS_ADDR A:0x2c90008
y.create.l HWIO_PMIC_ARB_OBS0_CHNL19_STATUS_ADDR A:0x2c98008
y.create.l HWIO_PMIC_ARB_OBS0_CHNL20_STATUS_ADDR A:0x2ca0008
y.create.l HWIO_PMIC_ARB_OBS0_CHNL21_STATUS_ADDR A:0x2ca8008
y.create.l HWIO_PMIC_ARB_OBS0_CHNL22_STATUS_ADDR A:0x2cb0008
y.create.l HWIO_PMIC_ARB_OBS0_CHNL23_STATUS_ADDR A:0x2cb8008
y.create.l HWIO_PMIC_ARB_OBS0_CHNL24_STATUS_ADDR A:0x2cc0008
y.create.l HWIO_PMIC_ARB_OBS0_CHNL25_STATUS_ADDR A:0x2cc8008
y.create.l HWIO_PMIC_ARB_OBS0_CHNL26_STATUS_ADDR A:0x2cd0008
y.create.l HWIO_PMIC_ARB_OBS0_CHNL27_STATUS_ADDR A:0x2cd8008
y.create.l HWIO_PMIC_ARB_OBS0_CHNL28_STATUS_ADDR A:0x2ce0008
y.create.l HWIO_PMIC_ARB_OBS0_CHNL29_STATUS_ADDR A:0x2ce8008
y.create.l HWIO_PMIC_ARB_OBS0_CHNL30_STATUS_ADDR A:0x2cf0008
y.create.l HWIO_PMIC_ARB_OBS0_CHNL31_STATUS_ADDR A:0x2cf8008
y.create.l HWIO_PMIC_ARB_OBS0_CHNL32_STATUS_ADDR A:0x2d00008
y.create.l HWIO_PMIC_ARB_OBS0_CHNL33_STATUS_ADDR A:0x2d08008
y.create.l HWIO_PMIC_ARB_OBS0_CHNL34_STATUS_ADDR A:0x2d10008
y.create.l HWIO_PMIC_ARB_OBS0_CHNL35_STATUS_ADDR A:0x2d18008
y.create.l HWIO_PMIC_ARB_OBS0_CHNL36_STATUS_ADDR A:0x2d20008
y.create.l HWIO_PMIC_ARB_OBS0_CHNL37_STATUS_ADDR A:0x2d28008
y.create.l HWIO_PMIC_ARB_OBS0_CHNL38_STATUS_ADDR A:0x2d30008
y.create.l HWIO_PMIC_ARB_OBS0_CHNL39_STATUS_ADDR A:0x2d38008
y.create.l HWIO_PMIC_ARB_OBS0_CHNL40_STATUS_ADDR A:0x2d40008
y.create.l HWIO_PMIC_ARB_OBS0_CHNL41_STATUS_ADDR A:0x2d48008
y.create.l HWIO_PMIC_ARB_OBS0_CHNL42_STATUS_ADDR A:0x2d50008
y.create.l HWIO_PMIC_ARB_OBS0_CHNL43_STATUS_ADDR A:0x2d58008
y.create.l HWIO_PMIC_ARB_OBS0_CHNL44_STATUS_ADDR A:0x2d60008
y.create.l HWIO_PMIC_ARB_OBS0_CHNL45_STATUS_ADDR A:0x2d68008
y.create.l HWIO_PMIC_ARB_OBS0_CHNL46_STATUS_ADDR A:0x2d70008
y.create.l HWIO_PMIC_ARB_OBS0_CHNL47_STATUS_ADDR A:0x2d78008
y.create.l HWIO_PMIC_ARB_OBS0_CHNL48_STATUS_ADDR A:0x2d80008
y.create.l HWIO_PMIC_ARB_OBS0_CHNL49_STATUS_ADDR A:0x2d88008
y.create.l HWIO_PMIC_ARB_OBS0_CHNL50_STATUS_ADDR A:0x2d90008
y.create.l HWIO_PMIC_ARB_OBS0_CHNL51_STATUS_ADDR A:0x2d98008
y.create.l HWIO_PMIC_ARB_OBS0_CHNL52_STATUS_ADDR A:0x2da0008
y.create.l HWIO_PMIC_ARB_OBS0_CHNL53_STATUS_ADDR A:0x2da8008
y.create.l HWIO_PMIC_ARB_OBS0_CHNL54_STATUS_ADDR A:0x2db0008
y.create.l HWIO_PMIC_ARB_OBS0_CHNL55_STATUS_ADDR A:0x2db8008
y.create.l HWIO_PMIC_ARB_OBS0_CHNL56_STATUS_ADDR A:0x2dc0008
y.create.l HWIO_PMIC_ARB_OBS0_CHNL57_STATUS_ADDR A:0x2dc8008
y.create.l HWIO_PMIC_ARB_OBS0_CHNL58_STATUS_ADDR A:0x2dd0008
y.create.l HWIO_PMIC_ARB_OBS0_CHNL59_STATUS_ADDR A:0x2dd8008
y.create.l HWIO_PMIC_ARB_OBS0_CHNL60_STATUS_ADDR A:0x2de0008
y.create.l HWIO_PMIC_ARB_OBS0_CHNL61_STATUS_ADDR A:0x2de8008
y.create.l HWIO_PMIC_ARB_OBS0_CHNL62_STATUS_ADDR A:0x2df0008
y.create.l HWIO_PMIC_ARB_OBS0_CHNL63_STATUS_ADDR A:0x2df8008
y.create.l HWIO_PMIC_ARB_OBS0_CHNL64_STATUS_ADDR A:0x2e00008
y.create.l HWIO_PMIC_ARB_OBS0_CHNL65_STATUS_ADDR A:0x2e08008
y.create.l HWIO_PMIC_ARB_OBS0_CHNL66_STATUS_ADDR A:0x2e10008
y.create.l HWIO_PMIC_ARB_OBS0_CHNL67_STATUS_ADDR A:0x2e18008
y.create.l HWIO_PMIC_ARB_OBS0_CHNL68_STATUS_ADDR A:0x2e20008
y.create.l HWIO_PMIC_ARB_OBS0_CHNL69_STATUS_ADDR A:0x2e28008
y.create.l HWIO_PMIC_ARB_OBS0_CHNL70_STATUS_ADDR A:0x2e30008
y.create.l HWIO_PMIC_ARB_OBS0_CHNL71_STATUS_ADDR A:0x2e38008
y.create.l HWIO_PMIC_ARB_OBS0_CHNL72_STATUS_ADDR A:0x2e40008
y.create.l HWIO_PMIC_ARB_OBS0_CHNL73_STATUS_ADDR A:0x2e48008
y.create.l HWIO_PMIC_ARB_OBS0_CHNL74_STATUS_ADDR A:0x2e50008
y.create.l HWIO_PMIC_ARB_OBS0_CHNL75_STATUS_ADDR A:0x2e58008
y.create.l HWIO_PMIC_ARB_OBS0_CHNL76_STATUS_ADDR A:0x2e60008
y.create.l HWIO_PMIC_ARB_OBS0_CHNL77_STATUS_ADDR A:0x2e68008
y.create.l HWIO_PMIC_ARB_OBS0_CHNL78_STATUS_ADDR A:0x2e70008
y.create.l HWIO_PMIC_ARB_OBS0_CHNL79_STATUS_ADDR A:0x2e78008
y.create.l HWIO_PMIC_ARB_OBS0_CHNL80_STATUS_ADDR A:0x2e80008
y.create.l HWIO_PMIC_ARB_OBS0_CHNL81_STATUS_ADDR A:0x2e88008
y.create.l HWIO_PMIC_ARB_OBS0_CHNL82_STATUS_ADDR A:0x2e90008
y.create.l HWIO_PMIC_ARB_OBS0_CHNL83_STATUS_ADDR A:0x2e98008
y.create.l HWIO_PMIC_ARB_OBS0_CHNL84_STATUS_ADDR A:0x2ea0008
y.create.l HWIO_PMIC_ARB_OBS0_CHNL85_STATUS_ADDR A:0x2ea8008
y.create.l HWIO_PMIC_ARB_OBS0_CHNL86_STATUS_ADDR A:0x2eb0008
y.create.l HWIO_PMIC_ARB_OBS0_CHNL87_STATUS_ADDR A:0x2eb8008
y.create.l HWIO_PMIC_ARB_OBS0_CHNL88_STATUS_ADDR A:0x2ec0008
y.create.l HWIO_PMIC_ARB_OBS0_CHNL89_STATUS_ADDR A:0x2ec8008
y.create.l HWIO_PMIC_ARB_OBS0_CHNL90_STATUS_ADDR A:0x2ed0008
y.create.l HWIO_PMIC_ARB_OBS0_CHNL91_STATUS_ADDR A:0x2ed8008
y.create.l HWIO_PMIC_ARB_OBS0_CHNL92_STATUS_ADDR A:0x2ee0008
y.create.l HWIO_PMIC_ARB_OBS0_CHNL93_STATUS_ADDR A:0x2ee8008
y.create.l HWIO_PMIC_ARB_OBS0_CHNL94_STATUS_ADDR A:0x2ef0008
y.create.l HWIO_PMIC_ARB_OBS0_CHNL95_STATUS_ADDR A:0x2ef8008
y.create.l HWIO_PMIC_ARB_OBS0_CHNL96_STATUS_ADDR A:0x2f00008
y.create.l HWIO_PMIC_ARB_OBS0_CHNL97_STATUS_ADDR A:0x2f08008
y.create.l HWIO_PMIC_ARB_OBS0_CHNL98_STATUS_ADDR A:0x2f10008
y.create.l HWIO_PMIC_ARB_OBS0_CHNL99_STATUS_ADDR A:0x2f18008
y.create.l HWIO_PMIC_ARB_OBS0_CHNL100_STATUS_ADDR A:0x2f20008
y.create.l HWIO_PMIC_ARB_OBS0_CHNL101_STATUS_ADDR A:0x2f28008
y.create.l HWIO_PMIC_ARB_OBS0_CHNL102_STATUS_ADDR A:0x2f30008
y.create.l HWIO_PMIC_ARB_OBS0_CHNL103_STATUS_ADDR A:0x2f38008
y.create.l HWIO_PMIC_ARB_OBS0_CHNL104_STATUS_ADDR A:0x2f40008
y.create.l HWIO_PMIC_ARB_OBS0_CHNL105_STATUS_ADDR A:0x2f48008
y.create.l HWIO_PMIC_ARB_OBS0_CHNL106_STATUS_ADDR A:0x2f50008
y.create.l HWIO_PMIC_ARB_OBS0_CHNL107_STATUS_ADDR A:0x2f58008
y.create.l HWIO_PMIC_ARB_OBS0_CHNL108_STATUS_ADDR A:0x2f60008
y.create.l HWIO_PMIC_ARB_OBS0_CHNL109_STATUS_ADDR A:0x2f68008
y.create.l HWIO_PMIC_ARB_OBS0_CHNL110_STATUS_ADDR A:0x2f70008
y.create.l HWIO_PMIC_ARB_OBS0_CHNL111_STATUS_ADDR A:0x2f78008
y.create.l HWIO_PMIC_ARB_OBS0_CHNL112_STATUS_ADDR A:0x2f80008
y.create.l HWIO_PMIC_ARB_OBS0_CHNL113_STATUS_ADDR A:0x2f88008
y.create.l HWIO_PMIC_ARB_OBS0_CHNL114_STATUS_ADDR A:0x2f90008
y.create.l HWIO_PMIC_ARB_OBS0_CHNL115_STATUS_ADDR A:0x2f98008
y.create.l HWIO_PMIC_ARB_OBS0_CHNL116_STATUS_ADDR A:0x2fa0008
y.create.l HWIO_PMIC_ARB_OBS0_CHNL117_STATUS_ADDR A:0x2fa8008
y.create.l HWIO_PMIC_ARB_OBS0_CHNL118_STATUS_ADDR A:0x2fb0008
y.create.l HWIO_PMIC_ARB_OBS0_CHNL119_STATUS_ADDR A:0x2fb8008
y.create.l HWIO_PMIC_ARB_OBS0_CHNL120_STATUS_ADDR A:0x2fc0008
y.create.l HWIO_PMIC_ARB_OBS0_CHNL121_STATUS_ADDR A:0x2fc8008
y.create.l HWIO_PMIC_ARB_OBS0_CHNL122_STATUS_ADDR A:0x2fd0008
y.create.l HWIO_PMIC_ARB_OBS0_CHNL123_STATUS_ADDR A:0x2fd8008
y.create.l HWIO_PMIC_ARB_OBS0_CHNL124_STATUS_ADDR A:0x2fe0008
y.create.l HWIO_PMIC_ARB_OBS0_CHNL125_STATUS_ADDR A:0x2fe8008
y.create.l HWIO_PMIC_ARB_OBS0_CHNL126_STATUS_ADDR A:0x2ff0008
y.create.l HWIO_PMIC_ARB_OBS0_CHNL127_STATUS_ADDR A:0x2ff8008
y.create.l HWIO_PMIC_ARB_OBS0_CHNL128_STATUS_ADDR A:0x3000008
y.create.l HWIO_PMIC_ARB_OBS0_CHNL129_STATUS_ADDR A:0x3008008
y.create.l HWIO_PMIC_ARB_OBS0_CHNL130_STATUS_ADDR A:0x3010008
y.create.l HWIO_PMIC_ARB_OBS0_CHNL131_STATUS_ADDR A:0x3018008
y.create.l HWIO_PMIC_ARB_OBS0_CHNL132_STATUS_ADDR A:0x3020008
y.create.l HWIO_PMIC_ARB_OBS0_CHNL133_STATUS_ADDR A:0x3028008
y.create.l HWIO_PMIC_ARB_OBS0_CHNL134_STATUS_ADDR A:0x3030008
y.create.l HWIO_PMIC_ARB_OBS0_CHNL135_STATUS_ADDR A:0x3038008
y.create.l HWIO_PMIC_ARB_OBS0_CHNL136_STATUS_ADDR A:0x3040008
y.create.l HWIO_PMIC_ARB_OBS0_CHNL137_STATUS_ADDR A:0x3048008
y.create.l HWIO_PMIC_ARB_OBS0_CHNL138_STATUS_ADDR A:0x3050008
y.create.l HWIO_PMIC_ARB_OBS0_CHNL139_STATUS_ADDR A:0x3058008
y.create.l HWIO_PMIC_ARB_OBS0_CHNL140_STATUS_ADDR A:0x3060008
y.create.l HWIO_PMIC_ARB_OBS0_CHNL141_STATUS_ADDR A:0x3068008
y.create.l HWIO_PMIC_ARB_OBS0_CHNL142_STATUS_ADDR A:0x3070008
y.create.l HWIO_PMIC_ARB_OBS0_CHNL143_STATUS_ADDR A:0x3078008
y.create.l HWIO_PMIC_ARB_OBS0_CHNL144_STATUS_ADDR A:0x3080008
y.create.l HWIO_PMIC_ARB_OBS0_CHNL145_STATUS_ADDR A:0x3088008
y.create.l HWIO_PMIC_ARB_OBS0_CHNL146_STATUS_ADDR A:0x3090008
y.create.l HWIO_PMIC_ARB_OBS0_CHNL147_STATUS_ADDR A:0x3098008
y.create.l HWIO_PMIC_ARB_OBS0_CHNL148_STATUS_ADDR A:0x30a0008
y.create.l HWIO_PMIC_ARB_OBS0_CHNL149_STATUS_ADDR A:0x30a8008
y.create.l HWIO_PMIC_ARB_OBS0_CHNL150_STATUS_ADDR A:0x30b0008
y.create.l HWIO_PMIC_ARB_OBS0_CHNL151_STATUS_ADDR A:0x30b8008
y.create.l HWIO_PMIC_ARB_OBS0_CHNL152_STATUS_ADDR A:0x30c0008
y.create.l HWIO_PMIC_ARB_OBS0_CHNL153_STATUS_ADDR A:0x30c8008
y.create.l HWIO_PMIC_ARB_OBS0_CHNL154_STATUS_ADDR A:0x30d0008
y.create.l HWIO_PMIC_ARB_OBS0_CHNL155_STATUS_ADDR A:0x30d8008
y.create.l HWIO_PMIC_ARB_OBS0_CHNL156_STATUS_ADDR A:0x30e0008
y.create.l HWIO_PMIC_ARB_OBS0_CHNL157_STATUS_ADDR A:0x30e8008
y.create.l HWIO_PMIC_ARB_OBS0_CHNL158_STATUS_ADDR A:0x30f0008
y.create.l HWIO_PMIC_ARB_OBS0_CHNL159_STATUS_ADDR A:0x30f8008
y.create.l HWIO_PMIC_ARB_OBS0_CHNL160_STATUS_ADDR A:0x3100008
y.create.l HWIO_PMIC_ARB_OBS0_CHNL161_STATUS_ADDR A:0x3108008
y.create.l HWIO_PMIC_ARB_OBS0_CHNL162_STATUS_ADDR A:0x3110008
y.create.l HWIO_PMIC_ARB_OBS0_CHNL163_STATUS_ADDR A:0x3118008
y.create.l HWIO_PMIC_ARB_OBS0_CHNL164_STATUS_ADDR A:0x3120008
y.create.l HWIO_PMIC_ARB_OBS0_CHNL165_STATUS_ADDR A:0x3128008
y.create.l HWIO_PMIC_ARB_OBS0_CHNL166_STATUS_ADDR A:0x3130008
y.create.l HWIO_PMIC_ARB_OBS0_CHNL167_STATUS_ADDR A:0x3138008
y.create.l HWIO_PMIC_ARB_OBS0_CHNL168_STATUS_ADDR A:0x3140008
y.create.l HWIO_PMIC_ARB_OBS0_CHNL169_STATUS_ADDR A:0x3148008
y.create.l HWIO_PMIC_ARB_OBS0_CHNL170_STATUS_ADDR A:0x3150008
y.create.l HWIO_PMIC_ARB_OBS0_CHNL171_STATUS_ADDR A:0x3158008
y.create.l HWIO_PMIC_ARB_OBS0_CHNL172_STATUS_ADDR A:0x3160008
y.create.l HWIO_PMIC_ARB_OBS0_CHNL173_STATUS_ADDR A:0x3168008
y.create.l HWIO_PMIC_ARB_OBS0_CHNL174_STATUS_ADDR A:0x3170008
y.create.l HWIO_PMIC_ARB_OBS0_CHNL175_STATUS_ADDR A:0x3178008
y.create.l HWIO_PMIC_ARB_OBS0_CHNL176_STATUS_ADDR A:0x3180008
y.create.l HWIO_PMIC_ARB_OBS0_CHNL177_STATUS_ADDR A:0x3188008
y.create.l HWIO_PMIC_ARB_OBS0_CHNL178_STATUS_ADDR A:0x3190008
y.create.l HWIO_PMIC_ARB_OBS0_CHNL179_STATUS_ADDR A:0x3198008
y.create.l HWIO_PMIC_ARB_OBS0_CHNL180_STATUS_ADDR A:0x31a0008
y.create.l HWIO_PMIC_ARB_OBS0_CHNL181_STATUS_ADDR A:0x31a8008
y.create.l HWIO_PMIC_ARB_OBS0_CHNL182_STATUS_ADDR A:0x31b0008
y.create.l HWIO_PMIC_ARB_OBS0_CHNL183_STATUS_ADDR A:0x31b8008
y.create.l HWIO_PMIC_ARB_OBS0_CHNL184_STATUS_ADDR A:0x31c0008
y.create.l HWIO_PMIC_ARB_OBS0_CHNL185_STATUS_ADDR A:0x31c8008
y.create.l HWIO_PMIC_ARB_OBS0_CHNL186_STATUS_ADDR A:0x31d0008
y.create.l HWIO_PMIC_ARB_OBS0_CHNL187_STATUS_ADDR A:0x31d8008
y.create.l HWIO_PMIC_ARB_OBS0_CHNL188_STATUS_ADDR A:0x31e0008
y.create.l HWIO_PMIC_ARB_OBS0_CHNL189_STATUS_ADDR A:0x31e8008
y.create.l HWIO_PMIC_ARB_OBS0_CHNL190_STATUS_ADDR A:0x31f0008
y.create.l HWIO_PMIC_ARB_OBS0_CHNL191_STATUS_ADDR A:0x31f8008
y.create.l HWIO_PMIC_ARB_OBS0_CHNL192_STATUS_ADDR A:0x3200008
y.create.l HWIO_PMIC_ARB_OBS0_CHNL193_STATUS_ADDR A:0x3208008
y.create.l HWIO_PMIC_ARB_OBS0_CHNL194_STATUS_ADDR A:0x3210008
y.create.l HWIO_PMIC_ARB_OBS0_CHNL195_STATUS_ADDR A:0x3218008
y.create.l HWIO_PMIC_ARB_OBS0_CHNL196_STATUS_ADDR A:0x3220008
y.create.l HWIO_PMIC_ARB_OBS0_CHNL197_STATUS_ADDR A:0x3228008
y.create.l HWIO_PMIC_ARB_OBS0_CHNL198_STATUS_ADDR A:0x3230008
y.create.l HWIO_PMIC_ARB_OBS0_CHNL199_STATUS_ADDR A:0x3238008
y.create.l HWIO_PMIC_ARB_OBS0_CHNL200_STATUS_ADDR A:0x3240008
y.create.l HWIO_PMIC_ARB_OBS0_CHNL201_STATUS_ADDR A:0x3248008
y.create.l HWIO_PMIC_ARB_OBS0_CHNL202_STATUS_ADDR A:0x3250008
y.create.l HWIO_PMIC_ARB_OBS0_CHNL203_STATUS_ADDR A:0x3258008
y.create.l HWIO_PMIC_ARB_OBS0_CHNL204_STATUS_ADDR A:0x3260008
y.create.l HWIO_PMIC_ARB_OBS0_CHNL205_STATUS_ADDR A:0x3268008
y.create.l HWIO_PMIC_ARB_OBS0_CHNL206_STATUS_ADDR A:0x3270008
y.create.l HWIO_PMIC_ARB_OBS0_CHNL207_STATUS_ADDR A:0x3278008
y.create.l HWIO_PMIC_ARB_OBS0_CHNL208_STATUS_ADDR A:0x3280008
y.create.l HWIO_PMIC_ARB_OBS0_CHNL209_STATUS_ADDR A:0x3288008
y.create.l HWIO_PMIC_ARB_OBS0_CHNL210_STATUS_ADDR A:0x3290008
y.create.l HWIO_PMIC_ARB_OBS0_CHNL211_STATUS_ADDR A:0x3298008
y.create.l HWIO_PMIC_ARB_OBS0_CHNL212_STATUS_ADDR A:0x32a0008
y.create.l HWIO_PMIC_ARB_OBS0_CHNL213_STATUS_ADDR A:0x32a8008
y.create.l HWIO_PMIC_ARB_OBS0_CHNL214_STATUS_ADDR A:0x32b0008
y.create.l HWIO_PMIC_ARB_OBS0_CHNL215_STATUS_ADDR A:0x32b8008
y.create.l HWIO_PMIC_ARB_OBS0_CHNL216_STATUS_ADDR A:0x32c0008
y.create.l HWIO_PMIC_ARB_OBS0_CHNL217_STATUS_ADDR A:0x32c8008
y.create.l HWIO_PMIC_ARB_OBS0_CHNL218_STATUS_ADDR A:0x32d0008
y.create.l HWIO_PMIC_ARB_OBS0_CHNL219_STATUS_ADDR A:0x32d8008
y.create.l HWIO_PMIC_ARB_OBS0_CHNL220_STATUS_ADDR A:0x32e0008
y.create.l HWIO_PMIC_ARB_OBS0_CHNL221_STATUS_ADDR A:0x32e8008
y.create.l HWIO_PMIC_ARB_OBS0_CHNL222_STATUS_ADDR A:0x32f0008
y.create.l HWIO_PMIC_ARB_OBS0_CHNL223_STATUS_ADDR A:0x32f8008
y.create.l HWIO_PMIC_ARB_OBS0_CHNL224_STATUS_ADDR A:0x3300008
y.create.l HWIO_PMIC_ARB_OBS0_CHNL225_STATUS_ADDR A:0x3308008
y.create.l HWIO_PMIC_ARB_OBS0_CHNL226_STATUS_ADDR A:0x3310008
y.create.l HWIO_PMIC_ARB_OBS0_CHNL227_STATUS_ADDR A:0x3318008
y.create.l HWIO_PMIC_ARB_OBS0_CHNL228_STATUS_ADDR A:0x3320008
y.create.l HWIO_PMIC_ARB_OBS0_CHNL229_STATUS_ADDR A:0x3328008
y.create.l HWIO_PMIC_ARB_OBS0_CHNL230_STATUS_ADDR A:0x3330008
y.create.l HWIO_PMIC_ARB_OBS0_CHNL231_STATUS_ADDR A:0x3338008
y.create.l HWIO_PMIC_ARB_OBS0_CHNL232_STATUS_ADDR A:0x3340008
y.create.l HWIO_PMIC_ARB_OBS0_CHNL233_STATUS_ADDR A:0x3348008
y.create.l HWIO_PMIC_ARB_OBS0_CHNL234_STATUS_ADDR A:0x3350008
y.create.l HWIO_PMIC_ARB_OBS0_CHNL235_STATUS_ADDR A:0x3358008
y.create.l HWIO_PMIC_ARB_OBS0_CHNL236_STATUS_ADDR A:0x3360008
y.create.l HWIO_PMIC_ARB_OBS0_CHNL237_STATUS_ADDR A:0x3368008
y.create.l HWIO_PMIC_ARB_OBS0_CHNL238_STATUS_ADDR A:0x3370008
y.create.l HWIO_PMIC_ARB_OBS0_CHNL239_STATUS_ADDR A:0x3378008
y.create.l HWIO_PMIC_ARB_OBS0_CHNL240_STATUS_ADDR A:0x3380008
y.create.l HWIO_PMIC_ARB_OBS0_CHNL241_STATUS_ADDR A:0x3388008
y.create.l HWIO_PMIC_ARB_OBS0_CHNL242_STATUS_ADDR A:0x3390008
y.create.l HWIO_PMIC_ARB_OBS0_CHNL243_STATUS_ADDR A:0x3398008
y.create.l HWIO_PMIC_ARB_OBS0_CHNL244_STATUS_ADDR A:0x33a0008
y.create.l HWIO_PMIC_ARB_OBS0_CHNL245_STATUS_ADDR A:0x33a8008
y.create.l HWIO_PMIC_ARB_OBS0_CHNL246_STATUS_ADDR A:0x33b0008
y.create.l HWIO_PMIC_ARB_OBS0_CHNL247_STATUS_ADDR A:0x33b8008
y.create.l HWIO_PMIC_ARB_OBS0_CHNL248_STATUS_ADDR A:0x33c0008
y.create.l HWIO_PMIC_ARB_OBS0_CHNL249_STATUS_ADDR A:0x33c8008
y.create.l HWIO_PMIC_ARB_OBS0_CHNL250_STATUS_ADDR A:0x33d0008
y.create.l HWIO_PMIC_ARB_OBS0_CHNL251_STATUS_ADDR A:0x33d8008
y.create.l HWIO_PMIC_ARB_OBS0_CHNL252_STATUS_ADDR A:0x33e0008
y.create.l HWIO_PMIC_ARB_OBS0_CHNL253_STATUS_ADDR A:0x33e8008
y.create.l HWIO_PMIC_ARB_OBS0_CHNL254_STATUS_ADDR A:0x33f0008
y.create.l HWIO_PMIC_ARB_OBS0_CHNL255_STATUS_ADDR A:0x33f8008
y.create.l HWIO_PMIC_ARB_OBS1_CHNL0_STATUS_ADDR A:0x2c01008
y.create.l HWIO_PMIC_ARB_OBS1_CHNL1_STATUS_ADDR A:0x2c09008
y.create.l HWIO_PMIC_ARB_OBS1_CHNL2_STATUS_ADDR A:0x2c11008
y.create.l HWIO_PMIC_ARB_OBS1_CHNL3_STATUS_ADDR A:0x2c19008
y.create.l HWIO_PMIC_ARB_OBS1_CHNL4_STATUS_ADDR A:0x2c21008
y.create.l HWIO_PMIC_ARB_OBS1_CHNL5_STATUS_ADDR A:0x2c29008
y.create.l HWIO_PMIC_ARB_OBS1_CHNL6_STATUS_ADDR A:0x2c31008
y.create.l HWIO_PMIC_ARB_OBS1_CHNL7_STATUS_ADDR A:0x2c39008
y.create.l HWIO_PMIC_ARB_OBS1_CHNL8_STATUS_ADDR A:0x2c41008
y.create.l HWIO_PMIC_ARB_OBS1_CHNL9_STATUS_ADDR A:0x2c49008
y.create.l HWIO_PMIC_ARB_OBS1_CHNL10_STATUS_ADDR A:0x2c51008
y.create.l HWIO_PMIC_ARB_OBS1_CHNL11_STATUS_ADDR A:0x2c59008
y.create.l HWIO_PMIC_ARB_OBS1_CHNL12_STATUS_ADDR A:0x2c61008
y.create.l HWIO_PMIC_ARB_OBS1_CHNL13_STATUS_ADDR A:0x2c69008
y.create.l HWIO_PMIC_ARB_OBS1_CHNL14_STATUS_ADDR A:0x2c71008
y.create.l HWIO_PMIC_ARB_OBS1_CHNL15_STATUS_ADDR A:0x2c79008
y.create.l HWIO_PMIC_ARB_OBS1_CHNL16_STATUS_ADDR A:0x2c81008
y.create.l HWIO_PMIC_ARB_OBS1_CHNL17_STATUS_ADDR A:0x2c89008
y.create.l HWIO_PMIC_ARB_OBS1_CHNL18_STATUS_ADDR A:0x2c91008
y.create.l HWIO_PMIC_ARB_OBS1_CHNL19_STATUS_ADDR A:0x2c99008
y.create.l HWIO_PMIC_ARB_OBS1_CHNL20_STATUS_ADDR A:0x2ca1008
y.create.l HWIO_PMIC_ARB_OBS1_CHNL21_STATUS_ADDR A:0x2ca9008
y.create.l HWIO_PMIC_ARB_OBS1_CHNL22_STATUS_ADDR A:0x2cb1008
y.create.l HWIO_PMIC_ARB_OBS1_CHNL23_STATUS_ADDR A:0x2cb9008
y.create.l HWIO_PMIC_ARB_OBS1_CHNL24_STATUS_ADDR A:0x2cc1008
y.create.l HWIO_PMIC_ARB_OBS1_CHNL25_STATUS_ADDR A:0x2cc9008
y.create.l HWIO_PMIC_ARB_OBS1_CHNL26_STATUS_ADDR A:0x2cd1008
y.create.l HWIO_PMIC_ARB_OBS1_CHNL27_STATUS_ADDR A:0x2cd9008
y.create.l HWIO_PMIC_ARB_OBS1_CHNL28_STATUS_ADDR A:0x2ce1008
y.create.l HWIO_PMIC_ARB_OBS1_CHNL29_STATUS_ADDR A:0x2ce9008
y.create.l HWIO_PMIC_ARB_OBS1_CHNL30_STATUS_ADDR A:0x2cf1008
y.create.l HWIO_PMIC_ARB_OBS1_CHNL31_STATUS_ADDR A:0x2cf9008
y.create.l HWIO_PMIC_ARB_OBS1_CHNL32_STATUS_ADDR A:0x2d01008
y.create.l HWIO_PMIC_ARB_OBS1_CHNL33_STATUS_ADDR A:0x2d09008
y.create.l HWIO_PMIC_ARB_OBS1_CHNL34_STATUS_ADDR A:0x2d11008
y.create.l HWIO_PMIC_ARB_OBS1_CHNL35_STATUS_ADDR A:0x2d19008
y.create.l HWIO_PMIC_ARB_OBS1_CHNL36_STATUS_ADDR A:0x2d21008
y.create.l HWIO_PMIC_ARB_OBS1_CHNL37_STATUS_ADDR A:0x2d29008
y.create.l HWIO_PMIC_ARB_OBS1_CHNL38_STATUS_ADDR A:0x2d31008
y.create.l HWIO_PMIC_ARB_OBS1_CHNL39_STATUS_ADDR A:0x2d39008
y.create.l HWIO_PMIC_ARB_OBS1_CHNL40_STATUS_ADDR A:0x2d41008
y.create.l HWIO_PMIC_ARB_OBS1_CHNL41_STATUS_ADDR A:0x2d49008
y.create.l HWIO_PMIC_ARB_OBS1_CHNL42_STATUS_ADDR A:0x2d51008
y.create.l HWIO_PMIC_ARB_OBS1_CHNL43_STATUS_ADDR A:0x2d59008
y.create.l HWIO_PMIC_ARB_OBS1_CHNL44_STATUS_ADDR A:0x2d61008
y.create.l HWIO_PMIC_ARB_OBS1_CHNL45_STATUS_ADDR A:0x2d69008
y.create.l HWIO_PMIC_ARB_OBS1_CHNL46_STATUS_ADDR A:0x2d71008
y.create.l HWIO_PMIC_ARB_OBS1_CHNL47_STATUS_ADDR A:0x2d79008
y.create.l HWIO_PMIC_ARB_OBS1_CHNL48_STATUS_ADDR A:0x2d81008
y.create.l HWIO_PMIC_ARB_OBS1_CHNL49_STATUS_ADDR A:0x2d89008
y.create.l HWIO_PMIC_ARB_OBS1_CHNL50_STATUS_ADDR A:0x2d91008
y.create.l HWIO_PMIC_ARB_OBS1_CHNL51_STATUS_ADDR A:0x2d99008
y.create.l HWIO_PMIC_ARB_OBS1_CHNL52_STATUS_ADDR A:0x2da1008
y.create.l HWIO_PMIC_ARB_OBS1_CHNL53_STATUS_ADDR A:0x2da9008
y.create.l HWIO_PMIC_ARB_OBS1_CHNL54_STATUS_ADDR A:0x2db1008
y.create.l HWIO_PMIC_ARB_OBS1_CHNL55_STATUS_ADDR A:0x2db9008
y.create.l HWIO_PMIC_ARB_OBS1_CHNL56_STATUS_ADDR A:0x2dc1008
y.create.l HWIO_PMIC_ARB_OBS1_CHNL57_STATUS_ADDR A:0x2dc9008
y.create.l HWIO_PMIC_ARB_OBS1_CHNL58_STATUS_ADDR A:0x2dd1008
y.create.l HWIO_PMIC_ARB_OBS1_CHNL59_STATUS_ADDR A:0x2dd9008
y.create.l HWIO_PMIC_ARB_OBS1_CHNL60_STATUS_ADDR A:0x2de1008
y.create.l HWIO_PMIC_ARB_OBS1_CHNL61_STATUS_ADDR A:0x2de9008
y.create.l HWIO_PMIC_ARB_OBS1_CHNL62_STATUS_ADDR A:0x2df1008
y.create.l HWIO_PMIC_ARB_OBS1_CHNL63_STATUS_ADDR A:0x2df9008
y.create.l HWIO_PMIC_ARB_OBS1_CHNL64_STATUS_ADDR A:0x2e01008
y.create.l HWIO_PMIC_ARB_OBS1_CHNL65_STATUS_ADDR A:0x2e09008
y.create.l HWIO_PMIC_ARB_OBS1_CHNL66_STATUS_ADDR A:0x2e11008
y.create.l HWIO_PMIC_ARB_OBS1_CHNL67_STATUS_ADDR A:0x2e19008
y.create.l HWIO_PMIC_ARB_OBS1_CHNL68_STATUS_ADDR A:0x2e21008
y.create.l HWIO_PMIC_ARB_OBS1_CHNL69_STATUS_ADDR A:0x2e29008
y.create.l HWIO_PMIC_ARB_OBS1_CHNL70_STATUS_ADDR A:0x2e31008
y.create.l HWIO_PMIC_ARB_OBS1_CHNL71_STATUS_ADDR A:0x2e39008
y.create.l HWIO_PMIC_ARB_OBS1_CHNL72_STATUS_ADDR A:0x2e41008
y.create.l HWIO_PMIC_ARB_OBS1_CHNL73_STATUS_ADDR A:0x2e49008
y.create.l HWIO_PMIC_ARB_OBS1_CHNL74_STATUS_ADDR A:0x2e51008
y.create.l HWIO_PMIC_ARB_OBS1_CHNL75_STATUS_ADDR A:0x2e59008
y.create.l HWIO_PMIC_ARB_OBS1_CHNL76_STATUS_ADDR A:0x2e61008
y.create.l HWIO_PMIC_ARB_OBS1_CHNL77_STATUS_ADDR A:0x2e69008
y.create.l HWIO_PMIC_ARB_OBS1_CHNL78_STATUS_ADDR A:0x2e71008
y.create.l HWIO_PMIC_ARB_OBS1_CHNL79_STATUS_ADDR A:0x2e79008
y.create.l HWIO_PMIC_ARB_OBS1_CHNL80_STATUS_ADDR A:0x2e81008
y.create.l HWIO_PMIC_ARB_OBS1_CHNL81_STATUS_ADDR A:0x2e89008
y.create.l HWIO_PMIC_ARB_OBS1_CHNL82_STATUS_ADDR A:0x2e91008
y.create.l HWIO_PMIC_ARB_OBS1_CHNL83_STATUS_ADDR A:0x2e99008
y.create.l HWIO_PMIC_ARB_OBS1_CHNL84_STATUS_ADDR A:0x2ea1008
y.create.l HWIO_PMIC_ARB_OBS1_CHNL85_STATUS_ADDR A:0x2ea9008
y.create.l HWIO_PMIC_ARB_OBS1_CHNL86_STATUS_ADDR A:0x2eb1008
y.create.l HWIO_PMIC_ARB_OBS1_CHNL87_STATUS_ADDR A:0x2eb9008
y.create.l HWIO_PMIC_ARB_OBS1_CHNL88_STATUS_ADDR A:0x2ec1008
y.create.l HWIO_PMIC_ARB_OBS1_CHNL89_STATUS_ADDR A:0x2ec9008
y.create.l HWIO_PMIC_ARB_OBS1_CHNL90_STATUS_ADDR A:0x2ed1008
y.create.l HWIO_PMIC_ARB_OBS1_CHNL91_STATUS_ADDR A:0x2ed9008
y.create.l HWIO_PMIC_ARB_OBS1_CHNL92_STATUS_ADDR A:0x2ee1008
y.create.l HWIO_PMIC_ARB_OBS1_CHNL93_STATUS_ADDR A:0x2ee9008
y.create.l HWIO_PMIC_ARB_OBS1_CHNL94_STATUS_ADDR A:0x2ef1008
y.create.l HWIO_PMIC_ARB_OBS1_CHNL95_STATUS_ADDR A:0x2ef9008
y.create.l HWIO_PMIC_ARB_OBS1_CHNL96_STATUS_ADDR A:0x2f01008
y.create.l HWIO_PMIC_ARB_OBS1_CHNL97_STATUS_ADDR A:0x2f09008
y.create.l HWIO_PMIC_ARB_OBS1_CHNL98_STATUS_ADDR A:0x2f11008
y.create.l HWIO_PMIC_ARB_OBS1_CHNL99_STATUS_ADDR A:0x2f19008
y.create.l HWIO_PMIC_ARB_OBS1_CHNL100_STATUS_ADDR A:0x2f21008
y.create.l HWIO_PMIC_ARB_OBS1_CHNL101_STATUS_ADDR A:0x2f29008
y.create.l HWIO_PMIC_ARB_OBS1_CHNL102_STATUS_ADDR A:0x2f31008
y.create.l HWIO_PMIC_ARB_OBS1_CHNL103_STATUS_ADDR A:0x2f39008
y.create.l HWIO_PMIC_ARB_OBS1_CHNL104_STATUS_ADDR A:0x2f41008
y.create.l HWIO_PMIC_ARB_OBS1_CHNL105_STATUS_ADDR A:0x2f49008
y.create.l HWIO_PMIC_ARB_OBS1_CHNL106_STATUS_ADDR A:0x2f51008
y.create.l HWIO_PMIC_ARB_OBS1_CHNL107_STATUS_ADDR A:0x2f59008
y.create.l HWIO_PMIC_ARB_OBS1_CHNL108_STATUS_ADDR A:0x2f61008
y.create.l HWIO_PMIC_ARB_OBS1_CHNL109_STATUS_ADDR A:0x2f69008
y.create.l HWIO_PMIC_ARB_OBS1_CHNL110_STATUS_ADDR A:0x2f71008
y.create.l HWIO_PMIC_ARB_OBS1_CHNL111_STATUS_ADDR A:0x2f79008
y.create.l HWIO_PMIC_ARB_OBS1_CHNL112_STATUS_ADDR A:0x2f81008
y.create.l HWIO_PMIC_ARB_OBS1_CHNL113_STATUS_ADDR A:0x2f89008
y.create.l HWIO_PMIC_ARB_OBS1_CHNL114_STATUS_ADDR A:0x2f91008
y.create.l HWIO_PMIC_ARB_OBS1_CHNL115_STATUS_ADDR A:0x2f99008
y.create.l HWIO_PMIC_ARB_OBS1_CHNL116_STATUS_ADDR A:0x2fa1008
y.create.l HWIO_PMIC_ARB_OBS1_CHNL117_STATUS_ADDR A:0x2fa9008
y.create.l HWIO_PMIC_ARB_OBS1_CHNL118_STATUS_ADDR A:0x2fb1008
y.create.l HWIO_PMIC_ARB_OBS1_CHNL119_STATUS_ADDR A:0x2fb9008
y.create.l HWIO_PMIC_ARB_OBS1_CHNL120_STATUS_ADDR A:0x2fc1008
y.create.l HWIO_PMIC_ARB_OBS1_CHNL121_STATUS_ADDR A:0x2fc9008
y.create.l HWIO_PMIC_ARB_OBS1_CHNL122_STATUS_ADDR A:0x2fd1008
y.create.l HWIO_PMIC_ARB_OBS1_CHNL123_STATUS_ADDR A:0x2fd9008
y.create.l HWIO_PMIC_ARB_OBS1_CHNL124_STATUS_ADDR A:0x2fe1008
y.create.l HWIO_PMIC_ARB_OBS1_CHNL125_STATUS_ADDR A:0x2fe9008
y.create.l HWIO_PMIC_ARB_OBS1_CHNL126_STATUS_ADDR A:0x2ff1008
y.create.l HWIO_PMIC_ARB_OBS1_CHNL127_STATUS_ADDR A:0x2ff9008
y.create.l HWIO_PMIC_ARB_OBS1_CHNL128_STATUS_ADDR A:0x3001008
y.create.l HWIO_PMIC_ARB_OBS1_CHNL129_STATUS_ADDR A:0x3009008
y.create.l HWIO_PMIC_ARB_OBS1_CHNL130_STATUS_ADDR A:0x3011008
y.create.l HWIO_PMIC_ARB_OBS1_CHNL131_STATUS_ADDR A:0x3019008
y.create.l HWIO_PMIC_ARB_OBS1_CHNL132_STATUS_ADDR A:0x3021008
y.create.l HWIO_PMIC_ARB_OBS1_CHNL133_STATUS_ADDR A:0x3029008
y.create.l HWIO_PMIC_ARB_OBS1_CHNL134_STATUS_ADDR A:0x3031008
y.create.l HWIO_PMIC_ARB_OBS1_CHNL135_STATUS_ADDR A:0x3039008
y.create.l HWIO_PMIC_ARB_OBS1_CHNL136_STATUS_ADDR A:0x3041008
y.create.l HWIO_PMIC_ARB_OBS1_CHNL137_STATUS_ADDR A:0x3049008
y.create.l HWIO_PMIC_ARB_OBS1_CHNL138_STATUS_ADDR A:0x3051008
y.create.l HWIO_PMIC_ARB_OBS1_CHNL139_STATUS_ADDR A:0x3059008
y.create.l HWIO_PMIC_ARB_OBS1_CHNL140_STATUS_ADDR A:0x3061008
y.create.l HWIO_PMIC_ARB_OBS1_CHNL141_STATUS_ADDR A:0x3069008
y.create.l HWIO_PMIC_ARB_OBS1_CHNL142_STATUS_ADDR A:0x3071008
y.create.l HWIO_PMIC_ARB_OBS1_CHNL143_STATUS_ADDR A:0x3079008
y.create.l HWIO_PMIC_ARB_OBS1_CHNL144_STATUS_ADDR A:0x3081008
y.create.l HWIO_PMIC_ARB_OBS1_CHNL145_STATUS_ADDR A:0x3089008
y.create.l HWIO_PMIC_ARB_OBS1_CHNL146_STATUS_ADDR A:0x3091008
y.create.l HWIO_PMIC_ARB_OBS1_CHNL147_STATUS_ADDR A:0x3099008
y.create.l HWIO_PMIC_ARB_OBS1_CHNL148_STATUS_ADDR A:0x30a1008
y.create.l HWIO_PMIC_ARB_OBS1_CHNL149_STATUS_ADDR A:0x30a9008
y.create.l HWIO_PMIC_ARB_OBS1_CHNL150_STATUS_ADDR A:0x30b1008
y.create.l HWIO_PMIC_ARB_OBS1_CHNL151_STATUS_ADDR A:0x30b9008
y.create.l HWIO_PMIC_ARB_OBS1_CHNL152_STATUS_ADDR A:0x30c1008
y.create.l HWIO_PMIC_ARB_OBS1_CHNL153_STATUS_ADDR A:0x30c9008
y.create.l HWIO_PMIC_ARB_OBS1_CHNL154_STATUS_ADDR A:0x30d1008
y.create.l HWIO_PMIC_ARB_OBS1_CHNL155_STATUS_ADDR A:0x30d9008
y.create.l HWIO_PMIC_ARB_OBS1_CHNL156_STATUS_ADDR A:0x30e1008
y.create.l HWIO_PMIC_ARB_OBS1_CHNL157_STATUS_ADDR A:0x30e9008
y.create.l HWIO_PMIC_ARB_OBS1_CHNL158_STATUS_ADDR A:0x30f1008
y.create.l HWIO_PMIC_ARB_OBS1_CHNL159_STATUS_ADDR A:0x30f9008
y.create.l HWIO_PMIC_ARB_OBS1_CHNL160_STATUS_ADDR A:0x3101008
y.create.l HWIO_PMIC_ARB_OBS1_CHNL161_STATUS_ADDR A:0x3109008
y.create.l HWIO_PMIC_ARB_OBS1_CHNL162_STATUS_ADDR A:0x3111008
y.create.l HWIO_PMIC_ARB_OBS1_CHNL163_STATUS_ADDR A:0x3119008
y.create.l HWIO_PMIC_ARB_OBS1_CHNL164_STATUS_ADDR A:0x3121008
y.create.l HWIO_PMIC_ARB_OBS1_CHNL165_STATUS_ADDR A:0x3129008
y.create.l HWIO_PMIC_ARB_OBS1_CHNL166_STATUS_ADDR A:0x3131008
y.create.l HWIO_PMIC_ARB_OBS1_CHNL167_STATUS_ADDR A:0x3139008
y.create.l HWIO_PMIC_ARB_OBS1_CHNL168_STATUS_ADDR A:0x3141008
y.create.l HWIO_PMIC_ARB_OBS1_CHNL169_STATUS_ADDR A:0x3149008
y.create.l HWIO_PMIC_ARB_OBS1_CHNL170_STATUS_ADDR A:0x3151008
y.create.l HWIO_PMIC_ARB_OBS1_CHNL171_STATUS_ADDR A:0x3159008
y.create.l HWIO_PMIC_ARB_OBS1_CHNL172_STATUS_ADDR A:0x3161008
y.create.l HWIO_PMIC_ARB_OBS1_CHNL173_STATUS_ADDR A:0x3169008
y.create.l HWIO_PMIC_ARB_OBS1_CHNL174_STATUS_ADDR A:0x3171008
y.create.l HWIO_PMIC_ARB_OBS1_CHNL175_STATUS_ADDR A:0x3179008
y.create.l HWIO_PMIC_ARB_OBS1_CHNL176_STATUS_ADDR A:0x3181008
y.create.l HWIO_PMIC_ARB_OBS1_CHNL177_STATUS_ADDR A:0x3189008
y.create.l HWIO_PMIC_ARB_OBS1_CHNL178_STATUS_ADDR A:0x3191008
y.create.l HWIO_PMIC_ARB_OBS1_CHNL179_STATUS_ADDR A:0x3199008
y.create.l HWIO_PMIC_ARB_OBS1_CHNL180_STATUS_ADDR A:0x31a1008
y.create.l HWIO_PMIC_ARB_OBS1_CHNL181_STATUS_ADDR A:0x31a9008
y.create.l HWIO_PMIC_ARB_OBS1_CHNL182_STATUS_ADDR A:0x31b1008
y.create.l HWIO_PMIC_ARB_OBS1_CHNL183_STATUS_ADDR A:0x31b9008
y.create.l HWIO_PMIC_ARB_OBS1_CHNL184_STATUS_ADDR A:0x31c1008
y.create.l HWIO_PMIC_ARB_OBS1_CHNL185_STATUS_ADDR A:0x31c9008
y.create.l HWIO_PMIC_ARB_OBS1_CHNL186_STATUS_ADDR A:0x31d1008
y.create.l HWIO_PMIC_ARB_OBS1_CHNL187_STATUS_ADDR A:0x31d9008
y.create.l HWIO_PMIC_ARB_OBS1_CHNL188_STATUS_ADDR A:0x31e1008
y.create.l HWIO_PMIC_ARB_OBS1_CHNL189_STATUS_ADDR A:0x31e9008
y.create.l HWIO_PMIC_ARB_OBS1_CHNL190_STATUS_ADDR A:0x31f1008
y.create.l HWIO_PMIC_ARB_OBS1_CHNL191_STATUS_ADDR A:0x31f9008
y.create.l HWIO_PMIC_ARB_OBS1_CHNL192_STATUS_ADDR A:0x3201008
y.create.l HWIO_PMIC_ARB_OBS1_CHNL193_STATUS_ADDR A:0x3209008
y.create.l HWIO_PMIC_ARB_OBS1_CHNL194_STATUS_ADDR A:0x3211008
y.create.l HWIO_PMIC_ARB_OBS1_CHNL195_STATUS_ADDR A:0x3219008
y.create.l HWIO_PMIC_ARB_OBS1_CHNL196_STATUS_ADDR A:0x3221008
y.create.l HWIO_PMIC_ARB_OBS1_CHNL197_STATUS_ADDR A:0x3229008
y.create.l HWIO_PMIC_ARB_OBS1_CHNL198_STATUS_ADDR A:0x3231008
y.create.l HWIO_PMIC_ARB_OBS1_CHNL199_STATUS_ADDR A:0x3239008
y.create.l HWIO_PMIC_ARB_OBS1_CHNL200_STATUS_ADDR A:0x3241008
y.create.l HWIO_PMIC_ARB_OBS1_CHNL201_STATUS_ADDR A:0x3249008
y.create.l HWIO_PMIC_ARB_OBS1_CHNL202_STATUS_ADDR A:0x3251008
y.create.l HWIO_PMIC_ARB_OBS1_CHNL203_STATUS_ADDR A:0x3259008
y.create.l HWIO_PMIC_ARB_OBS1_CHNL204_STATUS_ADDR A:0x3261008
y.create.l HWIO_PMIC_ARB_OBS1_CHNL205_STATUS_ADDR A:0x3269008
y.create.l HWIO_PMIC_ARB_OBS1_CHNL206_STATUS_ADDR A:0x3271008
y.create.l HWIO_PMIC_ARB_OBS1_CHNL207_STATUS_ADDR A:0x3279008
y.create.l HWIO_PMIC_ARB_OBS1_CHNL208_STATUS_ADDR A:0x3281008
y.create.l HWIO_PMIC_ARB_OBS1_CHNL209_STATUS_ADDR A:0x3289008
y.create.l HWIO_PMIC_ARB_OBS1_CHNL210_STATUS_ADDR A:0x3291008
y.create.l HWIO_PMIC_ARB_OBS1_CHNL211_STATUS_ADDR A:0x3299008
y.create.l HWIO_PMIC_ARB_OBS1_CHNL212_STATUS_ADDR A:0x32a1008
y.create.l HWIO_PMIC_ARB_OBS1_CHNL213_STATUS_ADDR A:0x32a9008
y.create.l HWIO_PMIC_ARB_OBS1_CHNL214_STATUS_ADDR A:0x32b1008
y.create.l HWIO_PMIC_ARB_OBS1_CHNL215_STATUS_ADDR A:0x32b9008
y.create.l HWIO_PMIC_ARB_OBS1_CHNL216_STATUS_ADDR A:0x32c1008
y.create.l HWIO_PMIC_ARB_OBS1_CHNL217_STATUS_ADDR A:0x32c9008
y.create.l HWIO_PMIC_ARB_OBS1_CHNL218_STATUS_ADDR A:0x32d1008
y.create.l HWIO_PMIC_ARB_OBS1_CHNL219_STATUS_ADDR A:0x32d9008
y.create.l HWIO_PMIC_ARB_OBS1_CHNL220_STATUS_ADDR A:0x32e1008
y.create.l HWIO_PMIC_ARB_OBS1_CHNL221_STATUS_ADDR A:0x32e9008
y.create.l HWIO_PMIC_ARB_OBS1_CHNL222_STATUS_ADDR A:0x32f1008
y.create.l HWIO_PMIC_ARB_OBS1_CHNL223_STATUS_ADDR A:0x32f9008
y.create.l HWIO_PMIC_ARB_OBS1_CHNL224_STATUS_ADDR A:0x3301008
y.create.l HWIO_PMIC_ARB_OBS1_CHNL225_STATUS_ADDR A:0x3309008
y.create.l HWIO_PMIC_ARB_OBS1_CHNL226_STATUS_ADDR A:0x3311008
y.create.l HWIO_PMIC_ARB_OBS1_CHNL227_STATUS_ADDR A:0x3319008
y.create.l HWIO_PMIC_ARB_OBS1_CHNL228_STATUS_ADDR A:0x3321008
y.create.l HWIO_PMIC_ARB_OBS1_CHNL229_STATUS_ADDR A:0x3329008
y.create.l HWIO_PMIC_ARB_OBS1_CHNL230_STATUS_ADDR A:0x3331008
y.create.l HWIO_PMIC_ARB_OBS1_CHNL231_STATUS_ADDR A:0x3339008
y.create.l HWIO_PMIC_ARB_OBS1_CHNL232_STATUS_ADDR A:0x3341008
y.create.l HWIO_PMIC_ARB_OBS1_CHNL233_STATUS_ADDR A:0x3349008
y.create.l HWIO_PMIC_ARB_OBS1_CHNL234_STATUS_ADDR A:0x3351008
y.create.l HWIO_PMIC_ARB_OBS1_CHNL235_STATUS_ADDR A:0x3359008
y.create.l HWIO_PMIC_ARB_OBS1_CHNL236_STATUS_ADDR A:0x3361008
y.create.l HWIO_PMIC_ARB_OBS1_CHNL237_STATUS_ADDR A:0x3369008
y.create.l HWIO_PMIC_ARB_OBS1_CHNL238_STATUS_ADDR A:0x3371008
y.create.l HWIO_PMIC_ARB_OBS1_CHNL239_STATUS_ADDR A:0x3379008
y.create.l HWIO_PMIC_ARB_OBS1_CHNL240_STATUS_ADDR A:0x3381008
y.create.l HWIO_PMIC_ARB_OBS1_CHNL241_STATUS_ADDR A:0x3389008
y.create.l HWIO_PMIC_ARB_OBS1_CHNL242_STATUS_ADDR A:0x3391008
y.create.l HWIO_PMIC_ARB_OBS1_CHNL243_STATUS_ADDR A:0x3399008
y.create.l HWIO_PMIC_ARB_OBS1_CHNL244_STATUS_ADDR A:0x33a1008
y.create.l HWIO_PMIC_ARB_OBS1_CHNL245_STATUS_ADDR A:0x33a9008
y.create.l HWIO_PMIC_ARB_OBS1_CHNL246_STATUS_ADDR A:0x33b1008
y.create.l HWIO_PMIC_ARB_OBS1_CHNL247_STATUS_ADDR A:0x33b9008
y.create.l HWIO_PMIC_ARB_OBS1_CHNL248_STATUS_ADDR A:0x33c1008
y.create.l HWIO_PMIC_ARB_OBS1_CHNL249_STATUS_ADDR A:0x33c9008
y.create.l HWIO_PMIC_ARB_OBS1_CHNL250_STATUS_ADDR A:0x33d1008
y.create.l HWIO_PMIC_ARB_OBS1_CHNL251_STATUS_ADDR A:0x33d9008
y.create.l HWIO_PMIC_ARB_OBS1_CHNL252_STATUS_ADDR A:0x33e1008
y.create.l HWIO_PMIC_ARB_OBS1_CHNL253_STATUS_ADDR A:0x33e9008
y.create.l HWIO_PMIC_ARB_OBS1_CHNL254_STATUS_ADDR A:0x33f1008
y.create.l HWIO_PMIC_ARB_OBS1_CHNL255_STATUS_ADDR A:0x33f9008
y.create.l HWIO_PMIC_ARB_OBS2_CHNL0_STATUS_ADDR A:0x2c02008
y.create.l HWIO_PMIC_ARB_OBS2_CHNL1_STATUS_ADDR A:0x2c0a008
y.create.l HWIO_PMIC_ARB_OBS2_CHNL2_STATUS_ADDR A:0x2c12008
y.create.l HWIO_PMIC_ARB_OBS2_CHNL3_STATUS_ADDR A:0x2c1a008
y.create.l HWIO_PMIC_ARB_OBS2_CHNL4_STATUS_ADDR A:0x2c22008
y.create.l HWIO_PMIC_ARB_OBS2_CHNL5_STATUS_ADDR A:0x2c2a008
y.create.l HWIO_PMIC_ARB_OBS2_CHNL6_STATUS_ADDR A:0x2c32008
y.create.l HWIO_PMIC_ARB_OBS2_CHNL7_STATUS_ADDR A:0x2c3a008
y.create.l HWIO_PMIC_ARB_OBS2_CHNL8_STATUS_ADDR A:0x2c42008
y.create.l HWIO_PMIC_ARB_OBS2_CHNL9_STATUS_ADDR A:0x2c4a008
y.create.l HWIO_PMIC_ARB_OBS2_CHNL10_STATUS_ADDR A:0x2c52008
y.create.l HWIO_PMIC_ARB_OBS2_CHNL11_STATUS_ADDR A:0x2c5a008
y.create.l HWIO_PMIC_ARB_OBS2_CHNL12_STATUS_ADDR A:0x2c62008
y.create.l HWIO_PMIC_ARB_OBS2_CHNL13_STATUS_ADDR A:0x2c6a008
y.create.l HWIO_PMIC_ARB_OBS2_CHNL14_STATUS_ADDR A:0x2c72008
y.create.l HWIO_PMIC_ARB_OBS2_CHNL15_STATUS_ADDR A:0x2c7a008
y.create.l HWIO_PMIC_ARB_OBS2_CHNL16_STATUS_ADDR A:0x2c82008
y.create.l HWIO_PMIC_ARB_OBS2_CHNL17_STATUS_ADDR A:0x2c8a008
y.create.l HWIO_PMIC_ARB_OBS2_CHNL18_STATUS_ADDR A:0x2c92008
y.create.l HWIO_PMIC_ARB_OBS2_CHNL19_STATUS_ADDR A:0x2c9a008
y.create.l HWIO_PMIC_ARB_OBS2_CHNL20_STATUS_ADDR A:0x2ca2008
y.create.l HWIO_PMIC_ARB_OBS2_CHNL21_STATUS_ADDR A:0x2caa008
y.create.l HWIO_PMIC_ARB_OBS2_CHNL22_STATUS_ADDR A:0x2cb2008
y.create.l HWIO_PMIC_ARB_OBS2_CHNL23_STATUS_ADDR A:0x2cba008
y.create.l HWIO_PMIC_ARB_OBS2_CHNL24_STATUS_ADDR A:0x2cc2008
y.create.l HWIO_PMIC_ARB_OBS2_CHNL25_STATUS_ADDR A:0x2cca008
y.create.l HWIO_PMIC_ARB_OBS2_CHNL26_STATUS_ADDR A:0x2cd2008
y.create.l HWIO_PMIC_ARB_OBS2_CHNL27_STATUS_ADDR A:0x2cda008
y.create.l HWIO_PMIC_ARB_OBS2_CHNL28_STATUS_ADDR A:0x2ce2008
y.create.l HWIO_PMIC_ARB_OBS2_CHNL29_STATUS_ADDR A:0x2cea008
y.create.l HWIO_PMIC_ARB_OBS2_CHNL30_STATUS_ADDR A:0x2cf2008
y.create.l HWIO_PMIC_ARB_OBS2_CHNL31_STATUS_ADDR A:0x2cfa008
y.create.l HWIO_PMIC_ARB_OBS2_CHNL32_STATUS_ADDR A:0x2d02008
y.create.l HWIO_PMIC_ARB_OBS2_CHNL33_STATUS_ADDR A:0x2d0a008
y.create.l HWIO_PMIC_ARB_OBS2_CHNL34_STATUS_ADDR A:0x2d12008
y.create.l HWIO_PMIC_ARB_OBS2_CHNL35_STATUS_ADDR A:0x2d1a008
y.create.l HWIO_PMIC_ARB_OBS2_CHNL36_STATUS_ADDR A:0x2d22008
y.create.l HWIO_PMIC_ARB_OBS2_CHNL37_STATUS_ADDR A:0x2d2a008
y.create.l HWIO_PMIC_ARB_OBS2_CHNL38_STATUS_ADDR A:0x2d32008
y.create.l HWIO_PMIC_ARB_OBS2_CHNL39_STATUS_ADDR A:0x2d3a008
y.create.l HWIO_PMIC_ARB_OBS2_CHNL40_STATUS_ADDR A:0x2d42008
y.create.l HWIO_PMIC_ARB_OBS2_CHNL41_STATUS_ADDR A:0x2d4a008
y.create.l HWIO_PMIC_ARB_OBS2_CHNL42_STATUS_ADDR A:0x2d52008
y.create.l HWIO_PMIC_ARB_OBS2_CHNL43_STATUS_ADDR A:0x2d5a008
y.create.l HWIO_PMIC_ARB_OBS2_CHNL44_STATUS_ADDR A:0x2d62008
y.create.l HWIO_PMIC_ARB_OBS2_CHNL45_STATUS_ADDR A:0x2d6a008
y.create.l HWIO_PMIC_ARB_OBS2_CHNL46_STATUS_ADDR A:0x2d72008
y.create.l HWIO_PMIC_ARB_OBS2_CHNL47_STATUS_ADDR A:0x2d7a008
y.create.l HWIO_PMIC_ARB_OBS2_CHNL48_STATUS_ADDR A:0x2d82008
y.create.l HWIO_PMIC_ARB_OBS2_CHNL49_STATUS_ADDR A:0x2d8a008
y.create.l HWIO_PMIC_ARB_OBS2_CHNL50_STATUS_ADDR A:0x2d92008
y.create.l HWIO_PMIC_ARB_OBS2_CHNL51_STATUS_ADDR A:0x2d9a008
y.create.l HWIO_PMIC_ARB_OBS2_CHNL52_STATUS_ADDR A:0x2da2008
y.create.l HWIO_PMIC_ARB_OBS2_CHNL53_STATUS_ADDR A:0x2daa008
y.create.l HWIO_PMIC_ARB_OBS2_CHNL54_STATUS_ADDR A:0x2db2008
y.create.l HWIO_PMIC_ARB_OBS2_CHNL55_STATUS_ADDR A:0x2dba008
y.create.l HWIO_PMIC_ARB_OBS2_CHNL56_STATUS_ADDR A:0x2dc2008
y.create.l HWIO_PMIC_ARB_OBS2_CHNL57_STATUS_ADDR A:0x2dca008
y.create.l HWIO_PMIC_ARB_OBS2_CHNL58_STATUS_ADDR A:0x2dd2008
y.create.l HWIO_PMIC_ARB_OBS2_CHNL59_STATUS_ADDR A:0x2dda008
y.create.l HWIO_PMIC_ARB_OBS2_CHNL60_STATUS_ADDR A:0x2de2008
y.create.l HWIO_PMIC_ARB_OBS2_CHNL61_STATUS_ADDR A:0x2dea008
y.create.l HWIO_PMIC_ARB_OBS2_CHNL62_STATUS_ADDR A:0x2df2008
y.create.l HWIO_PMIC_ARB_OBS2_CHNL63_STATUS_ADDR A:0x2dfa008
y.create.l HWIO_PMIC_ARB_OBS2_CHNL64_STATUS_ADDR A:0x2e02008
y.create.l HWIO_PMIC_ARB_OBS2_CHNL65_STATUS_ADDR A:0x2e0a008
y.create.l HWIO_PMIC_ARB_OBS2_CHNL66_STATUS_ADDR A:0x2e12008
y.create.l HWIO_PMIC_ARB_OBS2_CHNL67_STATUS_ADDR A:0x2e1a008
y.create.l HWIO_PMIC_ARB_OBS2_CHNL68_STATUS_ADDR A:0x2e22008
y.create.l HWIO_PMIC_ARB_OBS2_CHNL69_STATUS_ADDR A:0x2e2a008
y.create.l HWIO_PMIC_ARB_OBS2_CHNL70_STATUS_ADDR A:0x2e32008
y.create.l HWIO_PMIC_ARB_OBS2_CHNL71_STATUS_ADDR A:0x2e3a008
y.create.l HWIO_PMIC_ARB_OBS2_CHNL72_STATUS_ADDR A:0x2e42008
y.create.l HWIO_PMIC_ARB_OBS2_CHNL73_STATUS_ADDR A:0x2e4a008
y.create.l HWIO_PMIC_ARB_OBS2_CHNL74_STATUS_ADDR A:0x2e52008
y.create.l HWIO_PMIC_ARB_OBS2_CHNL75_STATUS_ADDR A:0x2e5a008
y.create.l HWIO_PMIC_ARB_OBS2_CHNL76_STATUS_ADDR A:0x2e62008
y.create.l HWIO_PMIC_ARB_OBS2_CHNL77_STATUS_ADDR A:0x2e6a008
y.create.l HWIO_PMIC_ARB_OBS2_CHNL78_STATUS_ADDR A:0x2e72008
y.create.l HWIO_PMIC_ARB_OBS2_CHNL79_STATUS_ADDR A:0x2e7a008
y.create.l HWIO_PMIC_ARB_OBS2_CHNL80_STATUS_ADDR A:0x2e82008
y.create.l HWIO_PMIC_ARB_OBS2_CHNL81_STATUS_ADDR A:0x2e8a008
y.create.l HWIO_PMIC_ARB_OBS2_CHNL82_STATUS_ADDR A:0x2e92008
y.create.l HWIO_PMIC_ARB_OBS2_CHNL83_STATUS_ADDR A:0x2e9a008
y.create.l HWIO_PMIC_ARB_OBS2_CHNL84_STATUS_ADDR A:0x2ea2008
y.create.l HWIO_PMIC_ARB_OBS2_CHNL85_STATUS_ADDR A:0x2eaa008
y.create.l HWIO_PMIC_ARB_OBS2_CHNL86_STATUS_ADDR A:0x2eb2008
y.create.l HWIO_PMIC_ARB_OBS2_CHNL87_STATUS_ADDR A:0x2eba008
y.create.l HWIO_PMIC_ARB_OBS2_CHNL88_STATUS_ADDR A:0x2ec2008
y.create.l HWIO_PMIC_ARB_OBS2_CHNL89_STATUS_ADDR A:0x2eca008
y.create.l HWIO_PMIC_ARB_OBS2_CHNL90_STATUS_ADDR A:0x2ed2008
y.create.l HWIO_PMIC_ARB_OBS2_CHNL91_STATUS_ADDR A:0x2eda008
y.create.l HWIO_PMIC_ARB_OBS2_CHNL92_STATUS_ADDR A:0x2ee2008
y.create.l HWIO_PMIC_ARB_OBS2_CHNL93_STATUS_ADDR A:0x2eea008
y.create.l HWIO_PMIC_ARB_OBS2_CHNL94_STATUS_ADDR A:0x2ef2008
y.create.l HWIO_PMIC_ARB_OBS2_CHNL95_STATUS_ADDR A:0x2efa008
y.create.l HWIO_PMIC_ARB_OBS2_CHNL96_STATUS_ADDR A:0x2f02008
y.create.l HWIO_PMIC_ARB_OBS2_CHNL97_STATUS_ADDR A:0x2f0a008
y.create.l HWIO_PMIC_ARB_OBS2_CHNL98_STATUS_ADDR A:0x2f12008
y.create.l HWIO_PMIC_ARB_OBS2_CHNL99_STATUS_ADDR A:0x2f1a008
y.create.l HWIO_PMIC_ARB_OBS2_CHNL100_STATUS_ADDR A:0x2f22008
y.create.l HWIO_PMIC_ARB_OBS2_CHNL101_STATUS_ADDR A:0x2f2a008
y.create.l HWIO_PMIC_ARB_OBS2_CHNL102_STATUS_ADDR A:0x2f32008
y.create.l HWIO_PMIC_ARB_OBS2_CHNL103_STATUS_ADDR A:0x2f3a008
y.create.l HWIO_PMIC_ARB_OBS2_CHNL104_STATUS_ADDR A:0x2f42008
y.create.l HWIO_PMIC_ARB_OBS2_CHNL105_STATUS_ADDR A:0x2f4a008
y.create.l HWIO_PMIC_ARB_OBS2_CHNL106_STATUS_ADDR A:0x2f52008
y.create.l HWIO_PMIC_ARB_OBS2_CHNL107_STATUS_ADDR A:0x2f5a008
y.create.l HWIO_PMIC_ARB_OBS2_CHNL108_STATUS_ADDR A:0x2f62008
y.create.l HWIO_PMIC_ARB_OBS2_CHNL109_STATUS_ADDR A:0x2f6a008
y.create.l HWIO_PMIC_ARB_OBS2_CHNL110_STATUS_ADDR A:0x2f72008
y.create.l HWIO_PMIC_ARB_OBS2_CHNL111_STATUS_ADDR A:0x2f7a008
y.create.l HWIO_PMIC_ARB_OBS2_CHNL112_STATUS_ADDR A:0x2f82008
y.create.l HWIO_PMIC_ARB_OBS2_CHNL113_STATUS_ADDR A:0x2f8a008
y.create.l HWIO_PMIC_ARB_OBS2_CHNL114_STATUS_ADDR A:0x2f92008
y.create.l HWIO_PMIC_ARB_OBS2_CHNL115_STATUS_ADDR A:0x2f9a008
y.create.l HWIO_PMIC_ARB_OBS2_CHNL116_STATUS_ADDR A:0x2fa2008
y.create.l HWIO_PMIC_ARB_OBS2_CHNL117_STATUS_ADDR A:0x2faa008
y.create.l HWIO_PMIC_ARB_OBS2_CHNL118_STATUS_ADDR A:0x2fb2008
y.create.l HWIO_PMIC_ARB_OBS2_CHNL119_STATUS_ADDR A:0x2fba008
y.create.l HWIO_PMIC_ARB_OBS2_CHNL120_STATUS_ADDR A:0x2fc2008
y.create.l HWIO_PMIC_ARB_OBS2_CHNL121_STATUS_ADDR A:0x2fca008
y.create.l HWIO_PMIC_ARB_OBS2_CHNL122_STATUS_ADDR A:0x2fd2008
y.create.l HWIO_PMIC_ARB_OBS2_CHNL123_STATUS_ADDR A:0x2fda008
y.create.l HWIO_PMIC_ARB_OBS2_CHNL124_STATUS_ADDR A:0x2fe2008
y.create.l HWIO_PMIC_ARB_OBS2_CHNL125_STATUS_ADDR A:0x2fea008
y.create.l HWIO_PMIC_ARB_OBS2_CHNL126_STATUS_ADDR A:0x2ff2008
y.create.l HWIO_PMIC_ARB_OBS2_CHNL127_STATUS_ADDR A:0x2ffa008
y.create.l HWIO_PMIC_ARB_OBS2_CHNL128_STATUS_ADDR A:0x3002008
y.create.l HWIO_PMIC_ARB_OBS2_CHNL129_STATUS_ADDR A:0x300a008
y.create.l HWIO_PMIC_ARB_OBS2_CHNL130_STATUS_ADDR A:0x3012008
y.create.l HWIO_PMIC_ARB_OBS2_CHNL131_STATUS_ADDR A:0x301a008
y.create.l HWIO_PMIC_ARB_OBS2_CHNL132_STATUS_ADDR A:0x3022008
y.create.l HWIO_PMIC_ARB_OBS2_CHNL133_STATUS_ADDR A:0x302a008
y.create.l HWIO_PMIC_ARB_OBS2_CHNL134_STATUS_ADDR A:0x3032008
y.create.l HWIO_PMIC_ARB_OBS2_CHNL135_STATUS_ADDR A:0x303a008
y.create.l HWIO_PMIC_ARB_OBS2_CHNL136_STATUS_ADDR A:0x3042008
y.create.l HWIO_PMIC_ARB_OBS2_CHNL137_STATUS_ADDR A:0x304a008
y.create.l HWIO_PMIC_ARB_OBS2_CHNL138_STATUS_ADDR A:0x3052008
y.create.l HWIO_PMIC_ARB_OBS2_CHNL139_STATUS_ADDR A:0x305a008
y.create.l HWIO_PMIC_ARB_OBS2_CHNL140_STATUS_ADDR A:0x3062008
y.create.l HWIO_PMIC_ARB_OBS2_CHNL141_STATUS_ADDR A:0x306a008
y.create.l HWIO_PMIC_ARB_OBS2_CHNL142_STATUS_ADDR A:0x3072008
y.create.l HWIO_PMIC_ARB_OBS2_CHNL143_STATUS_ADDR A:0x307a008
y.create.l HWIO_PMIC_ARB_OBS2_CHNL144_STATUS_ADDR A:0x3082008
y.create.l HWIO_PMIC_ARB_OBS2_CHNL145_STATUS_ADDR A:0x308a008
y.create.l HWIO_PMIC_ARB_OBS2_CHNL146_STATUS_ADDR A:0x3092008
y.create.l HWIO_PMIC_ARB_OBS2_CHNL147_STATUS_ADDR A:0x309a008
y.create.l HWIO_PMIC_ARB_OBS2_CHNL148_STATUS_ADDR A:0x30a2008
y.create.l HWIO_PMIC_ARB_OBS2_CHNL149_STATUS_ADDR A:0x30aa008
y.create.l HWIO_PMIC_ARB_OBS2_CHNL150_STATUS_ADDR A:0x30b2008
y.create.l HWIO_PMIC_ARB_OBS2_CHNL151_STATUS_ADDR A:0x30ba008
y.create.l HWIO_PMIC_ARB_OBS2_CHNL152_STATUS_ADDR A:0x30c2008
y.create.l HWIO_PMIC_ARB_OBS2_CHNL153_STATUS_ADDR A:0x30ca008
y.create.l HWIO_PMIC_ARB_OBS2_CHNL154_STATUS_ADDR A:0x30d2008
y.create.l HWIO_PMIC_ARB_OBS2_CHNL155_STATUS_ADDR A:0x30da008
y.create.l HWIO_PMIC_ARB_OBS2_CHNL156_STATUS_ADDR A:0x30e2008
y.create.l HWIO_PMIC_ARB_OBS2_CHNL157_STATUS_ADDR A:0x30ea008
y.create.l HWIO_PMIC_ARB_OBS2_CHNL158_STATUS_ADDR A:0x30f2008
y.create.l HWIO_PMIC_ARB_OBS2_CHNL159_STATUS_ADDR A:0x30fa008
y.create.l HWIO_PMIC_ARB_OBS2_CHNL160_STATUS_ADDR A:0x3102008
y.create.l HWIO_PMIC_ARB_OBS2_CHNL161_STATUS_ADDR A:0x310a008
y.create.l HWIO_PMIC_ARB_OBS2_CHNL162_STATUS_ADDR A:0x3112008
y.create.l HWIO_PMIC_ARB_OBS2_CHNL163_STATUS_ADDR A:0x311a008
y.create.l HWIO_PMIC_ARB_OBS2_CHNL164_STATUS_ADDR A:0x3122008
y.create.l HWIO_PMIC_ARB_OBS2_CHNL165_STATUS_ADDR A:0x312a008
y.create.l HWIO_PMIC_ARB_OBS2_CHNL166_STATUS_ADDR A:0x3132008
y.create.l HWIO_PMIC_ARB_OBS2_CHNL167_STATUS_ADDR A:0x313a008
y.create.l HWIO_PMIC_ARB_OBS2_CHNL168_STATUS_ADDR A:0x3142008
y.create.l HWIO_PMIC_ARB_OBS2_CHNL169_STATUS_ADDR A:0x314a008
y.create.l HWIO_PMIC_ARB_OBS2_CHNL170_STATUS_ADDR A:0x3152008
y.create.l HWIO_PMIC_ARB_OBS2_CHNL171_STATUS_ADDR A:0x315a008
y.create.l HWIO_PMIC_ARB_OBS2_CHNL172_STATUS_ADDR A:0x3162008
y.create.l HWIO_PMIC_ARB_OBS2_CHNL173_STATUS_ADDR A:0x316a008
y.create.l HWIO_PMIC_ARB_OBS2_CHNL174_STATUS_ADDR A:0x3172008
y.create.l HWIO_PMIC_ARB_OBS2_CHNL175_STATUS_ADDR A:0x317a008
y.create.l HWIO_PMIC_ARB_OBS2_CHNL176_STATUS_ADDR A:0x3182008
y.create.l HWIO_PMIC_ARB_OBS2_CHNL177_STATUS_ADDR A:0x318a008
y.create.l HWIO_PMIC_ARB_OBS2_CHNL178_STATUS_ADDR A:0x3192008
y.create.l HWIO_PMIC_ARB_OBS2_CHNL179_STATUS_ADDR A:0x319a008
y.create.l HWIO_PMIC_ARB_OBS2_CHNL180_STATUS_ADDR A:0x31a2008
y.create.l HWIO_PMIC_ARB_OBS2_CHNL181_STATUS_ADDR A:0x31aa008
y.create.l HWIO_PMIC_ARB_OBS2_CHNL182_STATUS_ADDR A:0x31b2008
y.create.l HWIO_PMIC_ARB_OBS2_CHNL183_STATUS_ADDR A:0x31ba008
y.create.l HWIO_PMIC_ARB_OBS2_CHNL184_STATUS_ADDR A:0x31c2008
y.create.l HWIO_PMIC_ARB_OBS2_CHNL185_STATUS_ADDR A:0x31ca008
y.create.l HWIO_PMIC_ARB_OBS2_CHNL186_STATUS_ADDR A:0x31d2008
y.create.l HWIO_PMIC_ARB_OBS2_CHNL187_STATUS_ADDR A:0x31da008
y.create.l HWIO_PMIC_ARB_OBS2_CHNL188_STATUS_ADDR A:0x31e2008
y.create.l HWIO_PMIC_ARB_OBS2_CHNL189_STATUS_ADDR A:0x31ea008
y.create.l HWIO_PMIC_ARB_OBS2_CHNL190_STATUS_ADDR A:0x31f2008
y.create.l HWIO_PMIC_ARB_OBS2_CHNL191_STATUS_ADDR A:0x31fa008
y.create.l HWIO_PMIC_ARB_OBS2_CHNL192_STATUS_ADDR A:0x3202008
y.create.l HWIO_PMIC_ARB_OBS2_CHNL193_STATUS_ADDR A:0x320a008
y.create.l HWIO_PMIC_ARB_OBS2_CHNL194_STATUS_ADDR A:0x3212008
y.create.l HWIO_PMIC_ARB_OBS2_CHNL195_STATUS_ADDR A:0x321a008
y.create.l HWIO_PMIC_ARB_OBS2_CHNL196_STATUS_ADDR A:0x3222008
y.create.l HWIO_PMIC_ARB_OBS2_CHNL197_STATUS_ADDR A:0x322a008
y.create.l HWIO_PMIC_ARB_OBS2_CHNL198_STATUS_ADDR A:0x3232008
y.create.l HWIO_PMIC_ARB_OBS2_CHNL199_STATUS_ADDR A:0x323a008
y.create.l HWIO_PMIC_ARB_OBS2_CHNL200_STATUS_ADDR A:0x3242008
y.create.l HWIO_PMIC_ARB_OBS2_CHNL201_STATUS_ADDR A:0x324a008
y.create.l HWIO_PMIC_ARB_OBS2_CHNL202_STATUS_ADDR A:0x3252008
y.create.l HWIO_PMIC_ARB_OBS2_CHNL203_STATUS_ADDR A:0x325a008
y.create.l HWIO_PMIC_ARB_OBS2_CHNL204_STATUS_ADDR A:0x3262008
y.create.l HWIO_PMIC_ARB_OBS2_CHNL205_STATUS_ADDR A:0x326a008
y.create.l HWIO_PMIC_ARB_OBS2_CHNL206_STATUS_ADDR A:0x3272008
y.create.l HWIO_PMIC_ARB_OBS2_CHNL207_STATUS_ADDR A:0x327a008
y.create.l HWIO_PMIC_ARB_OBS2_CHNL208_STATUS_ADDR A:0x3282008
y.create.l HWIO_PMIC_ARB_OBS2_CHNL209_STATUS_ADDR A:0x328a008
y.create.l HWIO_PMIC_ARB_OBS2_CHNL210_STATUS_ADDR A:0x3292008
y.create.l HWIO_PMIC_ARB_OBS2_CHNL211_STATUS_ADDR A:0x329a008
y.create.l HWIO_PMIC_ARB_OBS2_CHNL212_STATUS_ADDR A:0x32a2008
y.create.l HWIO_PMIC_ARB_OBS2_CHNL213_STATUS_ADDR A:0x32aa008
y.create.l HWIO_PMIC_ARB_OBS2_CHNL214_STATUS_ADDR A:0x32b2008
y.create.l HWIO_PMIC_ARB_OBS2_CHNL215_STATUS_ADDR A:0x32ba008
y.create.l HWIO_PMIC_ARB_OBS2_CHNL216_STATUS_ADDR A:0x32c2008
y.create.l HWIO_PMIC_ARB_OBS2_CHNL217_STATUS_ADDR A:0x32ca008
y.create.l HWIO_PMIC_ARB_OBS2_CHNL218_STATUS_ADDR A:0x32d2008
y.create.l HWIO_PMIC_ARB_OBS2_CHNL219_STATUS_ADDR A:0x32da008
y.create.l HWIO_PMIC_ARB_OBS2_CHNL220_STATUS_ADDR A:0x32e2008
y.create.l HWIO_PMIC_ARB_OBS2_CHNL221_STATUS_ADDR A:0x32ea008
y.create.l HWIO_PMIC_ARB_OBS2_CHNL222_STATUS_ADDR A:0x32f2008
y.create.l HWIO_PMIC_ARB_OBS2_CHNL223_STATUS_ADDR A:0x32fa008
y.create.l HWIO_PMIC_ARB_OBS2_CHNL224_STATUS_ADDR A:0x3302008
y.create.l HWIO_PMIC_ARB_OBS2_CHNL225_STATUS_ADDR A:0x330a008
y.create.l HWIO_PMIC_ARB_OBS2_CHNL226_STATUS_ADDR A:0x3312008
y.create.l HWIO_PMIC_ARB_OBS2_CHNL227_STATUS_ADDR A:0x331a008
y.create.l HWIO_PMIC_ARB_OBS2_CHNL228_STATUS_ADDR A:0x3322008
y.create.l HWIO_PMIC_ARB_OBS2_CHNL229_STATUS_ADDR A:0x332a008
y.create.l HWIO_PMIC_ARB_OBS2_CHNL230_STATUS_ADDR A:0x3332008
y.create.l HWIO_PMIC_ARB_OBS2_CHNL231_STATUS_ADDR A:0x333a008
y.create.l HWIO_PMIC_ARB_OBS2_CHNL232_STATUS_ADDR A:0x3342008
y.create.l HWIO_PMIC_ARB_OBS2_CHNL233_STATUS_ADDR A:0x334a008
y.create.l HWIO_PMIC_ARB_OBS2_CHNL234_STATUS_ADDR A:0x3352008
y.create.l HWIO_PMIC_ARB_OBS2_CHNL235_STATUS_ADDR A:0x335a008
y.create.l HWIO_PMIC_ARB_OBS2_CHNL236_STATUS_ADDR A:0x3362008
y.create.l HWIO_PMIC_ARB_OBS2_CHNL237_STATUS_ADDR A:0x336a008
y.create.l HWIO_PMIC_ARB_OBS2_CHNL238_STATUS_ADDR A:0x3372008
y.create.l HWIO_PMIC_ARB_OBS2_CHNL239_STATUS_ADDR A:0x337a008
y.create.l HWIO_PMIC_ARB_OBS2_CHNL240_STATUS_ADDR A:0x3382008
y.create.l HWIO_PMIC_ARB_OBS2_CHNL241_STATUS_ADDR A:0x338a008
y.create.l HWIO_PMIC_ARB_OBS2_CHNL242_STATUS_ADDR A:0x3392008
y.create.l HWIO_PMIC_ARB_OBS2_CHNL243_STATUS_ADDR A:0x339a008
y.create.l HWIO_PMIC_ARB_OBS2_CHNL244_STATUS_ADDR A:0x33a2008
y.create.l HWIO_PMIC_ARB_OBS2_CHNL245_STATUS_ADDR A:0x33aa008
y.create.l HWIO_PMIC_ARB_OBS2_CHNL246_STATUS_ADDR A:0x33b2008
y.create.l HWIO_PMIC_ARB_OBS2_CHNL247_STATUS_ADDR A:0x33ba008
y.create.l HWIO_PMIC_ARB_OBS2_CHNL248_STATUS_ADDR A:0x33c2008
y.create.l HWIO_PMIC_ARB_OBS2_CHNL249_STATUS_ADDR A:0x33ca008
y.create.l HWIO_PMIC_ARB_OBS2_CHNL250_STATUS_ADDR A:0x33d2008
y.create.l HWIO_PMIC_ARB_OBS2_CHNL251_STATUS_ADDR A:0x33da008
y.create.l HWIO_PMIC_ARB_OBS2_CHNL252_STATUS_ADDR A:0x33e2008
y.create.l HWIO_PMIC_ARB_OBS2_CHNL253_STATUS_ADDR A:0x33ea008
y.create.l HWIO_PMIC_ARB_OBS2_CHNL254_STATUS_ADDR A:0x33f2008
y.create.l HWIO_PMIC_ARB_OBS2_CHNL255_STATUS_ADDR A:0x33fa008
y.create.l HWIO_PMIC_ARB_OBS3_CHNL0_STATUS_ADDR A:0x2c03008
y.create.l HWIO_PMIC_ARB_OBS3_CHNL1_STATUS_ADDR A:0x2c0b008
y.create.l HWIO_PMIC_ARB_OBS3_CHNL2_STATUS_ADDR A:0x2c13008
y.create.l HWIO_PMIC_ARB_OBS3_CHNL3_STATUS_ADDR A:0x2c1b008
y.create.l HWIO_PMIC_ARB_OBS3_CHNL4_STATUS_ADDR A:0x2c23008
y.create.l HWIO_PMIC_ARB_OBS3_CHNL5_STATUS_ADDR A:0x2c2b008
y.create.l HWIO_PMIC_ARB_OBS3_CHNL6_STATUS_ADDR A:0x2c33008
y.create.l HWIO_PMIC_ARB_OBS3_CHNL7_STATUS_ADDR A:0x2c3b008
y.create.l HWIO_PMIC_ARB_OBS3_CHNL8_STATUS_ADDR A:0x2c43008
y.create.l HWIO_PMIC_ARB_OBS3_CHNL9_STATUS_ADDR A:0x2c4b008
y.create.l HWIO_PMIC_ARB_OBS3_CHNL10_STATUS_ADDR A:0x2c53008
y.create.l HWIO_PMIC_ARB_OBS3_CHNL11_STATUS_ADDR A:0x2c5b008
y.create.l HWIO_PMIC_ARB_OBS3_CHNL12_STATUS_ADDR A:0x2c63008
y.create.l HWIO_PMIC_ARB_OBS3_CHNL13_STATUS_ADDR A:0x2c6b008
y.create.l HWIO_PMIC_ARB_OBS3_CHNL14_STATUS_ADDR A:0x2c73008
y.create.l HWIO_PMIC_ARB_OBS3_CHNL15_STATUS_ADDR A:0x2c7b008
y.create.l HWIO_PMIC_ARB_OBS3_CHNL16_STATUS_ADDR A:0x2c83008
y.create.l HWIO_PMIC_ARB_OBS3_CHNL17_STATUS_ADDR A:0x2c8b008
y.create.l HWIO_PMIC_ARB_OBS3_CHNL18_STATUS_ADDR A:0x2c93008
y.create.l HWIO_PMIC_ARB_OBS3_CHNL19_STATUS_ADDR A:0x2c9b008
y.create.l HWIO_PMIC_ARB_OBS3_CHNL20_STATUS_ADDR A:0x2ca3008
y.create.l HWIO_PMIC_ARB_OBS3_CHNL21_STATUS_ADDR A:0x2cab008
y.create.l HWIO_PMIC_ARB_OBS3_CHNL22_STATUS_ADDR A:0x2cb3008
y.create.l HWIO_PMIC_ARB_OBS3_CHNL23_STATUS_ADDR A:0x2cbb008
y.create.l HWIO_PMIC_ARB_OBS3_CHNL24_STATUS_ADDR A:0x2cc3008
y.create.l HWIO_PMIC_ARB_OBS3_CHNL25_STATUS_ADDR A:0x2ccb008
y.create.l HWIO_PMIC_ARB_OBS3_CHNL26_STATUS_ADDR A:0x2cd3008
y.create.l HWIO_PMIC_ARB_OBS3_CHNL27_STATUS_ADDR A:0x2cdb008
y.create.l HWIO_PMIC_ARB_OBS3_CHNL28_STATUS_ADDR A:0x2ce3008
y.create.l HWIO_PMIC_ARB_OBS3_CHNL29_STATUS_ADDR A:0x2ceb008
y.create.l HWIO_PMIC_ARB_OBS3_CHNL30_STATUS_ADDR A:0x2cf3008
y.create.l HWIO_PMIC_ARB_OBS3_CHNL31_STATUS_ADDR A:0x2cfb008
y.create.l HWIO_PMIC_ARB_OBS3_CHNL32_STATUS_ADDR A:0x2d03008
y.create.l HWIO_PMIC_ARB_OBS3_CHNL33_STATUS_ADDR A:0x2d0b008
y.create.l HWIO_PMIC_ARB_OBS3_CHNL34_STATUS_ADDR A:0x2d13008
y.create.l HWIO_PMIC_ARB_OBS3_CHNL35_STATUS_ADDR A:0x2d1b008
y.create.l HWIO_PMIC_ARB_OBS3_CHNL36_STATUS_ADDR A:0x2d23008
y.create.l HWIO_PMIC_ARB_OBS3_CHNL37_STATUS_ADDR A:0x2d2b008
y.create.l HWIO_PMIC_ARB_OBS3_CHNL38_STATUS_ADDR A:0x2d33008
y.create.l HWIO_PMIC_ARB_OBS3_CHNL39_STATUS_ADDR A:0x2d3b008
y.create.l HWIO_PMIC_ARB_OBS3_CHNL40_STATUS_ADDR A:0x2d43008
y.create.l HWIO_PMIC_ARB_OBS3_CHNL41_STATUS_ADDR A:0x2d4b008
y.create.l HWIO_PMIC_ARB_OBS3_CHNL42_STATUS_ADDR A:0x2d53008
y.create.l HWIO_PMIC_ARB_OBS3_CHNL43_STATUS_ADDR A:0x2d5b008
y.create.l HWIO_PMIC_ARB_OBS3_CHNL44_STATUS_ADDR A:0x2d63008
y.create.l HWIO_PMIC_ARB_OBS3_CHNL45_STATUS_ADDR A:0x2d6b008
y.create.l HWIO_PMIC_ARB_OBS3_CHNL46_STATUS_ADDR A:0x2d73008
y.create.l HWIO_PMIC_ARB_OBS3_CHNL47_STATUS_ADDR A:0x2d7b008
y.create.l HWIO_PMIC_ARB_OBS3_CHNL48_STATUS_ADDR A:0x2d83008
y.create.l HWIO_PMIC_ARB_OBS3_CHNL49_STATUS_ADDR A:0x2d8b008
y.create.l HWIO_PMIC_ARB_OBS3_CHNL50_STATUS_ADDR A:0x2d93008
y.create.l HWIO_PMIC_ARB_OBS3_CHNL51_STATUS_ADDR A:0x2d9b008
y.create.l HWIO_PMIC_ARB_OBS3_CHNL52_STATUS_ADDR A:0x2da3008
y.create.l HWIO_PMIC_ARB_OBS3_CHNL53_STATUS_ADDR A:0x2dab008
y.create.l HWIO_PMIC_ARB_OBS3_CHNL54_STATUS_ADDR A:0x2db3008
y.create.l HWIO_PMIC_ARB_OBS3_CHNL55_STATUS_ADDR A:0x2dbb008
y.create.l HWIO_PMIC_ARB_OBS3_CHNL56_STATUS_ADDR A:0x2dc3008
y.create.l HWIO_PMIC_ARB_OBS3_CHNL57_STATUS_ADDR A:0x2dcb008
y.create.l HWIO_PMIC_ARB_OBS3_CHNL58_STATUS_ADDR A:0x2dd3008
y.create.l HWIO_PMIC_ARB_OBS3_CHNL59_STATUS_ADDR A:0x2ddb008
y.create.l HWIO_PMIC_ARB_OBS3_CHNL60_STATUS_ADDR A:0x2de3008
y.create.l HWIO_PMIC_ARB_OBS3_CHNL61_STATUS_ADDR A:0x2deb008
y.create.l HWIO_PMIC_ARB_OBS3_CHNL62_STATUS_ADDR A:0x2df3008
y.create.l HWIO_PMIC_ARB_OBS3_CHNL63_STATUS_ADDR A:0x2dfb008
y.create.l HWIO_PMIC_ARB_OBS3_CHNL64_STATUS_ADDR A:0x2e03008
y.create.l HWIO_PMIC_ARB_OBS3_CHNL65_STATUS_ADDR A:0x2e0b008
y.create.l HWIO_PMIC_ARB_OBS3_CHNL66_STATUS_ADDR A:0x2e13008
y.create.l HWIO_PMIC_ARB_OBS3_CHNL67_STATUS_ADDR A:0x2e1b008
y.create.l HWIO_PMIC_ARB_OBS3_CHNL68_STATUS_ADDR A:0x2e23008
y.create.l HWIO_PMIC_ARB_OBS3_CHNL69_STATUS_ADDR A:0x2e2b008
y.create.l HWIO_PMIC_ARB_OBS3_CHNL70_STATUS_ADDR A:0x2e33008
y.create.l HWIO_PMIC_ARB_OBS3_CHNL71_STATUS_ADDR A:0x2e3b008
y.create.l HWIO_PMIC_ARB_OBS3_CHNL72_STATUS_ADDR A:0x2e43008
y.create.l HWIO_PMIC_ARB_OBS3_CHNL73_STATUS_ADDR A:0x2e4b008
y.create.l HWIO_PMIC_ARB_OBS3_CHNL74_STATUS_ADDR A:0x2e53008
y.create.l HWIO_PMIC_ARB_OBS3_CHNL75_STATUS_ADDR A:0x2e5b008
y.create.l HWIO_PMIC_ARB_OBS3_CHNL76_STATUS_ADDR A:0x2e63008
y.create.l HWIO_PMIC_ARB_OBS3_CHNL77_STATUS_ADDR A:0x2e6b008
y.create.l HWIO_PMIC_ARB_OBS3_CHNL78_STATUS_ADDR A:0x2e73008
y.create.l HWIO_PMIC_ARB_OBS3_CHNL79_STATUS_ADDR A:0x2e7b008
y.create.l HWIO_PMIC_ARB_OBS3_CHNL80_STATUS_ADDR A:0x2e83008
y.create.l HWIO_PMIC_ARB_OBS3_CHNL81_STATUS_ADDR A:0x2e8b008
y.create.l HWIO_PMIC_ARB_OBS3_CHNL82_STATUS_ADDR A:0x2e93008
y.create.l HWIO_PMIC_ARB_OBS3_CHNL83_STATUS_ADDR A:0x2e9b008
y.create.l HWIO_PMIC_ARB_OBS3_CHNL84_STATUS_ADDR A:0x2ea3008
y.create.l HWIO_PMIC_ARB_OBS3_CHNL85_STATUS_ADDR A:0x2eab008
y.create.l HWIO_PMIC_ARB_OBS3_CHNL86_STATUS_ADDR A:0x2eb3008
y.create.l HWIO_PMIC_ARB_OBS3_CHNL87_STATUS_ADDR A:0x2ebb008
y.create.l HWIO_PMIC_ARB_OBS3_CHNL88_STATUS_ADDR A:0x2ec3008
y.create.l HWIO_PMIC_ARB_OBS3_CHNL89_STATUS_ADDR A:0x2ecb008
y.create.l HWIO_PMIC_ARB_OBS3_CHNL90_STATUS_ADDR A:0x2ed3008
y.create.l HWIO_PMIC_ARB_OBS3_CHNL91_STATUS_ADDR A:0x2edb008
y.create.l HWIO_PMIC_ARB_OBS3_CHNL92_STATUS_ADDR A:0x2ee3008
y.create.l HWIO_PMIC_ARB_OBS3_CHNL93_STATUS_ADDR A:0x2eeb008
y.create.l HWIO_PMIC_ARB_OBS3_CHNL94_STATUS_ADDR A:0x2ef3008
y.create.l HWIO_PMIC_ARB_OBS3_CHNL95_STATUS_ADDR A:0x2efb008
y.create.l HWIO_PMIC_ARB_OBS3_CHNL96_STATUS_ADDR A:0x2f03008
y.create.l HWIO_PMIC_ARB_OBS3_CHNL97_STATUS_ADDR A:0x2f0b008
y.create.l HWIO_PMIC_ARB_OBS3_CHNL98_STATUS_ADDR A:0x2f13008
y.create.l HWIO_PMIC_ARB_OBS3_CHNL99_STATUS_ADDR A:0x2f1b008
y.create.l HWIO_PMIC_ARB_OBS3_CHNL100_STATUS_ADDR A:0x2f23008
y.create.l HWIO_PMIC_ARB_OBS3_CHNL101_STATUS_ADDR A:0x2f2b008
y.create.l HWIO_PMIC_ARB_OBS3_CHNL102_STATUS_ADDR A:0x2f33008
y.create.l HWIO_PMIC_ARB_OBS3_CHNL103_STATUS_ADDR A:0x2f3b008
y.create.l HWIO_PMIC_ARB_OBS3_CHNL104_STATUS_ADDR A:0x2f43008
y.create.l HWIO_PMIC_ARB_OBS3_CHNL105_STATUS_ADDR A:0x2f4b008
y.create.l HWIO_PMIC_ARB_OBS3_CHNL106_STATUS_ADDR A:0x2f53008
y.create.l HWIO_PMIC_ARB_OBS3_CHNL107_STATUS_ADDR A:0x2f5b008
y.create.l HWIO_PMIC_ARB_OBS3_CHNL108_STATUS_ADDR A:0x2f63008
y.create.l HWIO_PMIC_ARB_OBS3_CHNL109_STATUS_ADDR A:0x2f6b008
y.create.l HWIO_PMIC_ARB_OBS3_CHNL110_STATUS_ADDR A:0x2f73008
y.create.l HWIO_PMIC_ARB_OBS3_CHNL111_STATUS_ADDR A:0x2f7b008
y.create.l HWIO_PMIC_ARB_OBS3_CHNL112_STATUS_ADDR A:0x2f83008
y.create.l HWIO_PMIC_ARB_OBS3_CHNL113_STATUS_ADDR A:0x2f8b008
y.create.l HWIO_PMIC_ARB_OBS3_CHNL114_STATUS_ADDR A:0x2f93008
y.create.l HWIO_PMIC_ARB_OBS3_CHNL115_STATUS_ADDR A:0x2f9b008
y.create.l HWIO_PMIC_ARB_OBS3_CHNL116_STATUS_ADDR A:0x2fa3008
y.create.l HWIO_PMIC_ARB_OBS3_CHNL117_STATUS_ADDR A:0x2fab008
y.create.l HWIO_PMIC_ARB_OBS3_CHNL118_STATUS_ADDR A:0x2fb3008
y.create.l HWIO_PMIC_ARB_OBS3_CHNL119_STATUS_ADDR A:0x2fbb008
y.create.l HWIO_PMIC_ARB_OBS3_CHNL120_STATUS_ADDR A:0x2fc3008
y.create.l HWIO_PMIC_ARB_OBS3_CHNL121_STATUS_ADDR A:0x2fcb008
y.create.l HWIO_PMIC_ARB_OBS3_CHNL122_STATUS_ADDR A:0x2fd3008
y.create.l HWIO_PMIC_ARB_OBS3_CHNL123_STATUS_ADDR A:0x2fdb008
y.create.l HWIO_PMIC_ARB_OBS3_CHNL124_STATUS_ADDR A:0x2fe3008
y.create.l HWIO_PMIC_ARB_OBS3_CHNL125_STATUS_ADDR A:0x2feb008
y.create.l HWIO_PMIC_ARB_OBS3_CHNL126_STATUS_ADDR A:0x2ff3008
y.create.l HWIO_PMIC_ARB_OBS3_CHNL127_STATUS_ADDR A:0x2ffb008
y.create.l HWIO_PMIC_ARB_OBS3_CHNL128_STATUS_ADDR A:0x3003008
y.create.l HWIO_PMIC_ARB_OBS3_CHNL129_STATUS_ADDR A:0x300b008
y.create.l HWIO_PMIC_ARB_OBS3_CHNL130_STATUS_ADDR A:0x3013008
y.create.l HWIO_PMIC_ARB_OBS3_CHNL131_STATUS_ADDR A:0x301b008
y.create.l HWIO_PMIC_ARB_OBS3_CHNL132_STATUS_ADDR A:0x3023008
y.create.l HWIO_PMIC_ARB_OBS3_CHNL133_STATUS_ADDR A:0x302b008
y.create.l HWIO_PMIC_ARB_OBS3_CHNL134_STATUS_ADDR A:0x3033008
y.create.l HWIO_PMIC_ARB_OBS3_CHNL135_STATUS_ADDR A:0x303b008
y.create.l HWIO_PMIC_ARB_OBS3_CHNL136_STATUS_ADDR A:0x3043008
y.create.l HWIO_PMIC_ARB_OBS3_CHNL137_STATUS_ADDR A:0x304b008
y.create.l HWIO_PMIC_ARB_OBS3_CHNL138_STATUS_ADDR A:0x3053008
y.create.l HWIO_PMIC_ARB_OBS3_CHNL139_STATUS_ADDR A:0x305b008
y.create.l HWIO_PMIC_ARB_OBS3_CHNL140_STATUS_ADDR A:0x3063008
y.create.l HWIO_PMIC_ARB_OBS3_CHNL141_STATUS_ADDR A:0x306b008
y.create.l HWIO_PMIC_ARB_OBS3_CHNL142_STATUS_ADDR A:0x3073008
y.create.l HWIO_PMIC_ARB_OBS3_CHNL143_STATUS_ADDR A:0x307b008
y.create.l HWIO_PMIC_ARB_OBS3_CHNL144_STATUS_ADDR A:0x3083008
y.create.l HWIO_PMIC_ARB_OBS3_CHNL145_STATUS_ADDR A:0x308b008
y.create.l HWIO_PMIC_ARB_OBS3_CHNL146_STATUS_ADDR A:0x3093008
y.create.l HWIO_PMIC_ARB_OBS3_CHNL147_STATUS_ADDR A:0x309b008
y.create.l HWIO_PMIC_ARB_OBS3_CHNL148_STATUS_ADDR A:0x30a3008
y.create.l HWIO_PMIC_ARB_OBS3_CHNL149_STATUS_ADDR A:0x30ab008
y.create.l HWIO_PMIC_ARB_OBS3_CHNL150_STATUS_ADDR A:0x30b3008
y.create.l HWIO_PMIC_ARB_OBS3_CHNL151_STATUS_ADDR A:0x30bb008
y.create.l HWIO_PMIC_ARB_OBS3_CHNL152_STATUS_ADDR A:0x30c3008
y.create.l HWIO_PMIC_ARB_OBS3_CHNL153_STATUS_ADDR A:0x30cb008
y.create.l HWIO_PMIC_ARB_OBS3_CHNL154_STATUS_ADDR A:0x30d3008
y.create.l HWIO_PMIC_ARB_OBS3_CHNL155_STATUS_ADDR A:0x30db008
y.create.l HWIO_PMIC_ARB_OBS3_CHNL156_STATUS_ADDR A:0x30e3008
y.create.l HWIO_PMIC_ARB_OBS3_CHNL157_STATUS_ADDR A:0x30eb008
y.create.l HWIO_PMIC_ARB_OBS3_CHNL158_STATUS_ADDR A:0x30f3008
y.create.l HWIO_PMIC_ARB_OBS3_CHNL159_STATUS_ADDR A:0x30fb008
y.create.l HWIO_PMIC_ARB_OBS3_CHNL160_STATUS_ADDR A:0x3103008
y.create.l HWIO_PMIC_ARB_OBS3_CHNL161_STATUS_ADDR A:0x310b008
y.create.l HWIO_PMIC_ARB_OBS3_CHNL162_STATUS_ADDR A:0x3113008
y.create.l HWIO_PMIC_ARB_OBS3_CHNL163_STATUS_ADDR A:0x311b008
y.create.l HWIO_PMIC_ARB_OBS3_CHNL164_STATUS_ADDR A:0x3123008
y.create.l HWIO_PMIC_ARB_OBS3_CHNL165_STATUS_ADDR A:0x312b008
y.create.l HWIO_PMIC_ARB_OBS3_CHNL166_STATUS_ADDR A:0x3133008
y.create.l HWIO_PMIC_ARB_OBS3_CHNL167_STATUS_ADDR A:0x313b008
y.create.l HWIO_PMIC_ARB_OBS3_CHNL168_STATUS_ADDR A:0x3143008
y.create.l HWIO_PMIC_ARB_OBS3_CHNL169_STATUS_ADDR A:0x314b008
y.create.l HWIO_PMIC_ARB_OBS3_CHNL170_STATUS_ADDR A:0x3153008
y.create.l HWIO_PMIC_ARB_OBS3_CHNL171_STATUS_ADDR A:0x315b008
y.create.l HWIO_PMIC_ARB_OBS3_CHNL172_STATUS_ADDR A:0x3163008
y.create.l HWIO_PMIC_ARB_OBS3_CHNL173_STATUS_ADDR A:0x316b008
y.create.l HWIO_PMIC_ARB_OBS3_CHNL174_STATUS_ADDR A:0x3173008
y.create.l HWIO_PMIC_ARB_OBS3_CHNL175_STATUS_ADDR A:0x317b008
y.create.l HWIO_PMIC_ARB_OBS3_CHNL176_STATUS_ADDR A:0x3183008
y.create.l HWIO_PMIC_ARB_OBS3_CHNL177_STATUS_ADDR A:0x318b008
y.create.l HWIO_PMIC_ARB_OBS3_CHNL178_STATUS_ADDR A:0x3193008
y.create.l HWIO_PMIC_ARB_OBS3_CHNL179_STATUS_ADDR A:0x319b008
y.create.l HWIO_PMIC_ARB_OBS3_CHNL180_STATUS_ADDR A:0x31a3008
y.create.l HWIO_PMIC_ARB_OBS3_CHNL181_STATUS_ADDR A:0x31ab008
y.create.l HWIO_PMIC_ARB_OBS3_CHNL182_STATUS_ADDR A:0x31b3008
y.create.l HWIO_PMIC_ARB_OBS3_CHNL183_STATUS_ADDR A:0x31bb008
y.create.l HWIO_PMIC_ARB_OBS3_CHNL184_STATUS_ADDR A:0x31c3008
y.create.l HWIO_PMIC_ARB_OBS3_CHNL185_STATUS_ADDR A:0x31cb008
y.create.l HWIO_PMIC_ARB_OBS3_CHNL186_STATUS_ADDR A:0x31d3008
y.create.l HWIO_PMIC_ARB_OBS3_CHNL187_STATUS_ADDR A:0x31db008
y.create.l HWIO_PMIC_ARB_OBS3_CHNL188_STATUS_ADDR A:0x31e3008
y.create.l HWIO_PMIC_ARB_OBS3_CHNL189_STATUS_ADDR A:0x31eb008
y.create.l HWIO_PMIC_ARB_OBS3_CHNL190_STATUS_ADDR A:0x31f3008
y.create.l HWIO_PMIC_ARB_OBS3_CHNL191_STATUS_ADDR A:0x31fb008
y.create.l HWIO_PMIC_ARB_OBS3_CHNL192_STATUS_ADDR A:0x3203008
y.create.l HWIO_PMIC_ARB_OBS3_CHNL193_STATUS_ADDR A:0x320b008
y.create.l HWIO_PMIC_ARB_OBS3_CHNL194_STATUS_ADDR A:0x3213008
y.create.l HWIO_PMIC_ARB_OBS3_CHNL195_STATUS_ADDR A:0x321b008
y.create.l HWIO_PMIC_ARB_OBS3_CHNL196_STATUS_ADDR A:0x3223008
y.create.l HWIO_PMIC_ARB_OBS3_CHNL197_STATUS_ADDR A:0x322b008
y.create.l HWIO_PMIC_ARB_OBS3_CHNL198_STATUS_ADDR A:0x3233008
y.create.l HWIO_PMIC_ARB_OBS3_CHNL199_STATUS_ADDR A:0x323b008
y.create.l HWIO_PMIC_ARB_OBS3_CHNL200_STATUS_ADDR A:0x3243008
y.create.l HWIO_PMIC_ARB_OBS3_CHNL201_STATUS_ADDR A:0x324b008
y.create.l HWIO_PMIC_ARB_OBS3_CHNL202_STATUS_ADDR A:0x3253008
y.create.l HWIO_PMIC_ARB_OBS3_CHNL203_STATUS_ADDR A:0x325b008
y.create.l HWIO_PMIC_ARB_OBS3_CHNL204_STATUS_ADDR A:0x3263008
y.create.l HWIO_PMIC_ARB_OBS3_CHNL205_STATUS_ADDR A:0x326b008
y.create.l HWIO_PMIC_ARB_OBS3_CHNL206_STATUS_ADDR A:0x3273008
y.create.l HWIO_PMIC_ARB_OBS3_CHNL207_STATUS_ADDR A:0x327b008
y.create.l HWIO_PMIC_ARB_OBS3_CHNL208_STATUS_ADDR A:0x3283008
y.create.l HWIO_PMIC_ARB_OBS3_CHNL209_STATUS_ADDR A:0x328b008
y.create.l HWIO_PMIC_ARB_OBS3_CHNL210_STATUS_ADDR A:0x3293008
y.create.l HWIO_PMIC_ARB_OBS3_CHNL211_STATUS_ADDR A:0x329b008
y.create.l HWIO_PMIC_ARB_OBS3_CHNL212_STATUS_ADDR A:0x32a3008
y.create.l HWIO_PMIC_ARB_OBS3_CHNL213_STATUS_ADDR A:0x32ab008
y.create.l HWIO_PMIC_ARB_OBS3_CHNL214_STATUS_ADDR A:0x32b3008
y.create.l HWIO_PMIC_ARB_OBS3_CHNL215_STATUS_ADDR A:0x32bb008
y.create.l HWIO_PMIC_ARB_OBS3_CHNL216_STATUS_ADDR A:0x32c3008
y.create.l HWIO_PMIC_ARB_OBS3_CHNL217_STATUS_ADDR A:0x32cb008
y.create.l HWIO_PMIC_ARB_OBS3_CHNL218_STATUS_ADDR A:0x32d3008
y.create.l HWIO_PMIC_ARB_OBS3_CHNL219_STATUS_ADDR A:0x32db008
y.create.l HWIO_PMIC_ARB_OBS3_CHNL220_STATUS_ADDR A:0x32e3008
y.create.l HWIO_PMIC_ARB_OBS3_CHNL221_STATUS_ADDR A:0x32eb008
y.create.l HWIO_PMIC_ARB_OBS3_CHNL222_STATUS_ADDR A:0x32f3008
y.create.l HWIO_PMIC_ARB_OBS3_CHNL223_STATUS_ADDR A:0x32fb008
y.create.l HWIO_PMIC_ARB_OBS3_CHNL224_STATUS_ADDR A:0x3303008
y.create.l HWIO_PMIC_ARB_OBS3_CHNL225_STATUS_ADDR A:0x330b008
y.create.l HWIO_PMIC_ARB_OBS3_CHNL226_STATUS_ADDR A:0x3313008
y.create.l HWIO_PMIC_ARB_OBS3_CHNL227_STATUS_ADDR A:0x331b008
y.create.l HWIO_PMIC_ARB_OBS3_CHNL228_STATUS_ADDR A:0x3323008
y.create.l HWIO_PMIC_ARB_OBS3_CHNL229_STATUS_ADDR A:0x332b008
y.create.l HWIO_PMIC_ARB_OBS3_CHNL230_STATUS_ADDR A:0x3333008
y.create.l HWIO_PMIC_ARB_OBS3_CHNL231_STATUS_ADDR A:0x333b008
y.create.l HWIO_PMIC_ARB_OBS3_CHNL232_STATUS_ADDR A:0x3343008
y.create.l HWIO_PMIC_ARB_OBS3_CHNL233_STATUS_ADDR A:0x334b008
y.create.l HWIO_PMIC_ARB_OBS3_CHNL234_STATUS_ADDR A:0x3353008
y.create.l HWIO_PMIC_ARB_OBS3_CHNL235_STATUS_ADDR A:0x335b008
y.create.l HWIO_PMIC_ARB_OBS3_CHNL236_STATUS_ADDR A:0x3363008
y.create.l HWIO_PMIC_ARB_OBS3_CHNL237_STATUS_ADDR A:0x336b008
y.create.l HWIO_PMIC_ARB_OBS3_CHNL238_STATUS_ADDR A:0x3373008
y.create.l HWIO_PMIC_ARB_OBS3_CHNL239_STATUS_ADDR A:0x337b008
y.create.l HWIO_PMIC_ARB_OBS3_CHNL240_STATUS_ADDR A:0x3383008
y.create.l HWIO_PMIC_ARB_OBS3_CHNL241_STATUS_ADDR A:0x338b008
y.create.l HWIO_PMIC_ARB_OBS3_CHNL242_STATUS_ADDR A:0x3393008
y.create.l HWIO_PMIC_ARB_OBS3_CHNL243_STATUS_ADDR A:0x339b008
y.create.l HWIO_PMIC_ARB_OBS3_CHNL244_STATUS_ADDR A:0x33a3008
y.create.l HWIO_PMIC_ARB_OBS3_CHNL245_STATUS_ADDR A:0x33ab008
y.create.l HWIO_PMIC_ARB_OBS3_CHNL246_STATUS_ADDR A:0x33b3008
y.create.l HWIO_PMIC_ARB_OBS3_CHNL247_STATUS_ADDR A:0x33bb008
y.create.l HWIO_PMIC_ARB_OBS3_CHNL248_STATUS_ADDR A:0x33c3008
y.create.l HWIO_PMIC_ARB_OBS3_CHNL249_STATUS_ADDR A:0x33cb008
y.create.l HWIO_PMIC_ARB_OBS3_CHNL250_STATUS_ADDR A:0x33d3008
y.create.l HWIO_PMIC_ARB_OBS3_CHNL251_STATUS_ADDR A:0x33db008
y.create.l HWIO_PMIC_ARB_OBS3_CHNL252_STATUS_ADDR A:0x33e3008
y.create.l HWIO_PMIC_ARB_OBS3_CHNL253_STATUS_ADDR A:0x33eb008
y.create.l HWIO_PMIC_ARB_OBS3_CHNL254_STATUS_ADDR A:0x33f3008
y.create.l HWIO_PMIC_ARB_OBS3_CHNL255_STATUS_ADDR A:0x33fb008
y.create.l HWIO_PMIC_ARB_OBS4_CHNL0_STATUS_ADDR A:0x2c04008
y.create.l HWIO_PMIC_ARB_OBS4_CHNL1_STATUS_ADDR A:0x2c0c008
y.create.l HWIO_PMIC_ARB_OBS4_CHNL2_STATUS_ADDR A:0x2c14008
y.create.l HWIO_PMIC_ARB_OBS4_CHNL3_STATUS_ADDR A:0x2c1c008
y.create.l HWIO_PMIC_ARB_OBS4_CHNL4_STATUS_ADDR A:0x2c24008
y.create.l HWIO_PMIC_ARB_OBS4_CHNL5_STATUS_ADDR A:0x2c2c008
y.create.l HWIO_PMIC_ARB_OBS4_CHNL6_STATUS_ADDR A:0x2c34008
y.create.l HWIO_PMIC_ARB_OBS4_CHNL7_STATUS_ADDR A:0x2c3c008
y.create.l HWIO_PMIC_ARB_OBS4_CHNL8_STATUS_ADDR A:0x2c44008
y.create.l HWIO_PMIC_ARB_OBS4_CHNL9_STATUS_ADDR A:0x2c4c008
y.create.l HWIO_PMIC_ARB_OBS4_CHNL10_STATUS_ADDR A:0x2c54008
y.create.l HWIO_PMIC_ARB_OBS4_CHNL11_STATUS_ADDR A:0x2c5c008
y.create.l HWIO_PMIC_ARB_OBS4_CHNL12_STATUS_ADDR A:0x2c64008
y.create.l HWIO_PMIC_ARB_OBS4_CHNL13_STATUS_ADDR A:0x2c6c008
y.create.l HWIO_PMIC_ARB_OBS4_CHNL14_STATUS_ADDR A:0x2c74008
y.create.l HWIO_PMIC_ARB_OBS4_CHNL15_STATUS_ADDR A:0x2c7c008
y.create.l HWIO_PMIC_ARB_OBS4_CHNL16_STATUS_ADDR A:0x2c84008
y.create.l HWIO_PMIC_ARB_OBS4_CHNL17_STATUS_ADDR A:0x2c8c008
y.create.l HWIO_PMIC_ARB_OBS4_CHNL18_STATUS_ADDR A:0x2c94008
y.create.l HWIO_PMIC_ARB_OBS4_CHNL19_STATUS_ADDR A:0x2c9c008
y.create.l HWIO_PMIC_ARB_OBS4_CHNL20_STATUS_ADDR A:0x2ca4008
y.create.l HWIO_PMIC_ARB_OBS4_CHNL21_STATUS_ADDR A:0x2cac008
y.create.l HWIO_PMIC_ARB_OBS4_CHNL22_STATUS_ADDR A:0x2cb4008
y.create.l HWIO_PMIC_ARB_OBS4_CHNL23_STATUS_ADDR A:0x2cbc008
y.create.l HWIO_PMIC_ARB_OBS4_CHNL24_STATUS_ADDR A:0x2cc4008
y.create.l HWIO_PMIC_ARB_OBS4_CHNL25_STATUS_ADDR A:0x2ccc008
y.create.l HWIO_PMIC_ARB_OBS4_CHNL26_STATUS_ADDR A:0x2cd4008
y.create.l HWIO_PMIC_ARB_OBS4_CHNL27_STATUS_ADDR A:0x2cdc008
y.create.l HWIO_PMIC_ARB_OBS4_CHNL28_STATUS_ADDR A:0x2ce4008
y.create.l HWIO_PMIC_ARB_OBS4_CHNL29_STATUS_ADDR A:0x2cec008
y.create.l HWIO_PMIC_ARB_OBS4_CHNL30_STATUS_ADDR A:0x2cf4008
y.create.l HWIO_PMIC_ARB_OBS4_CHNL31_STATUS_ADDR A:0x2cfc008
y.create.l HWIO_PMIC_ARB_OBS4_CHNL32_STATUS_ADDR A:0x2d04008
y.create.l HWIO_PMIC_ARB_OBS4_CHNL33_STATUS_ADDR A:0x2d0c008
y.create.l HWIO_PMIC_ARB_OBS4_CHNL34_STATUS_ADDR A:0x2d14008
y.create.l HWIO_PMIC_ARB_OBS4_CHNL35_STATUS_ADDR A:0x2d1c008
y.create.l HWIO_PMIC_ARB_OBS4_CHNL36_STATUS_ADDR A:0x2d24008
y.create.l HWIO_PMIC_ARB_OBS4_CHNL37_STATUS_ADDR A:0x2d2c008
y.create.l HWIO_PMIC_ARB_OBS4_CHNL38_STATUS_ADDR A:0x2d34008
y.create.l HWIO_PMIC_ARB_OBS4_CHNL39_STATUS_ADDR A:0x2d3c008
y.create.l HWIO_PMIC_ARB_OBS4_CHNL40_STATUS_ADDR A:0x2d44008
y.create.l HWIO_PMIC_ARB_OBS4_CHNL41_STATUS_ADDR A:0x2d4c008
y.create.l HWIO_PMIC_ARB_OBS4_CHNL42_STATUS_ADDR A:0x2d54008
y.create.l HWIO_PMIC_ARB_OBS4_CHNL43_STATUS_ADDR A:0x2d5c008
y.create.l HWIO_PMIC_ARB_OBS4_CHNL44_STATUS_ADDR A:0x2d64008
y.create.l HWIO_PMIC_ARB_OBS4_CHNL45_STATUS_ADDR A:0x2d6c008
y.create.l HWIO_PMIC_ARB_OBS4_CHNL46_STATUS_ADDR A:0x2d74008
y.create.l HWIO_PMIC_ARB_OBS4_CHNL47_STATUS_ADDR A:0x2d7c008
y.create.l HWIO_PMIC_ARB_OBS4_CHNL48_STATUS_ADDR A:0x2d84008
y.create.l HWIO_PMIC_ARB_OBS4_CHNL49_STATUS_ADDR A:0x2d8c008
y.create.l HWIO_PMIC_ARB_OBS4_CHNL50_STATUS_ADDR A:0x2d94008
y.create.l HWIO_PMIC_ARB_OBS4_CHNL51_STATUS_ADDR A:0x2d9c008
y.create.l HWIO_PMIC_ARB_OBS4_CHNL52_STATUS_ADDR A:0x2da4008
y.create.l HWIO_PMIC_ARB_OBS4_CHNL53_STATUS_ADDR A:0x2dac008
y.create.l HWIO_PMIC_ARB_OBS4_CHNL54_STATUS_ADDR A:0x2db4008
y.create.l HWIO_PMIC_ARB_OBS4_CHNL55_STATUS_ADDR A:0x2dbc008
y.create.l HWIO_PMIC_ARB_OBS4_CHNL56_STATUS_ADDR A:0x2dc4008
y.create.l HWIO_PMIC_ARB_OBS4_CHNL57_STATUS_ADDR A:0x2dcc008
y.create.l HWIO_PMIC_ARB_OBS4_CHNL58_STATUS_ADDR A:0x2dd4008
y.create.l HWIO_PMIC_ARB_OBS4_CHNL59_STATUS_ADDR A:0x2ddc008
y.create.l HWIO_PMIC_ARB_OBS4_CHNL60_STATUS_ADDR A:0x2de4008
y.create.l HWIO_PMIC_ARB_OBS4_CHNL61_STATUS_ADDR A:0x2dec008
y.create.l HWIO_PMIC_ARB_OBS4_CHNL62_STATUS_ADDR A:0x2df4008
y.create.l HWIO_PMIC_ARB_OBS4_CHNL63_STATUS_ADDR A:0x2dfc008
y.create.l HWIO_PMIC_ARB_OBS4_CHNL64_STATUS_ADDR A:0x2e04008
y.create.l HWIO_PMIC_ARB_OBS4_CHNL65_STATUS_ADDR A:0x2e0c008
y.create.l HWIO_PMIC_ARB_OBS4_CHNL66_STATUS_ADDR A:0x2e14008
y.create.l HWIO_PMIC_ARB_OBS4_CHNL67_STATUS_ADDR A:0x2e1c008
y.create.l HWIO_PMIC_ARB_OBS4_CHNL68_STATUS_ADDR A:0x2e24008
y.create.l HWIO_PMIC_ARB_OBS4_CHNL69_STATUS_ADDR A:0x2e2c008
y.create.l HWIO_PMIC_ARB_OBS4_CHNL70_STATUS_ADDR A:0x2e34008
y.create.l HWIO_PMIC_ARB_OBS4_CHNL71_STATUS_ADDR A:0x2e3c008
y.create.l HWIO_PMIC_ARB_OBS4_CHNL72_STATUS_ADDR A:0x2e44008
y.create.l HWIO_PMIC_ARB_OBS4_CHNL73_STATUS_ADDR A:0x2e4c008
y.create.l HWIO_PMIC_ARB_OBS4_CHNL74_STATUS_ADDR A:0x2e54008
y.create.l HWIO_PMIC_ARB_OBS4_CHNL75_STATUS_ADDR A:0x2e5c008
y.create.l HWIO_PMIC_ARB_OBS4_CHNL76_STATUS_ADDR A:0x2e64008
y.create.l HWIO_PMIC_ARB_OBS4_CHNL77_STATUS_ADDR A:0x2e6c008
y.create.l HWIO_PMIC_ARB_OBS4_CHNL78_STATUS_ADDR A:0x2e74008
y.create.l HWIO_PMIC_ARB_OBS4_CHNL79_STATUS_ADDR A:0x2e7c008
y.create.l HWIO_PMIC_ARB_OBS4_CHNL80_STATUS_ADDR A:0x2e84008
y.create.l HWIO_PMIC_ARB_OBS4_CHNL81_STATUS_ADDR A:0x2e8c008
y.create.l HWIO_PMIC_ARB_OBS4_CHNL82_STATUS_ADDR A:0x2e94008
y.create.l HWIO_PMIC_ARB_OBS4_CHNL83_STATUS_ADDR A:0x2e9c008
y.create.l HWIO_PMIC_ARB_OBS4_CHNL84_STATUS_ADDR A:0x2ea4008
y.create.l HWIO_PMIC_ARB_OBS4_CHNL85_STATUS_ADDR A:0x2eac008
y.create.l HWIO_PMIC_ARB_OBS4_CHNL86_STATUS_ADDR A:0x2eb4008
y.create.l HWIO_PMIC_ARB_OBS4_CHNL87_STATUS_ADDR A:0x2ebc008
y.create.l HWIO_PMIC_ARB_OBS4_CHNL88_STATUS_ADDR A:0x2ec4008
y.create.l HWIO_PMIC_ARB_OBS4_CHNL89_STATUS_ADDR A:0x2ecc008
y.create.l HWIO_PMIC_ARB_OBS4_CHNL90_STATUS_ADDR A:0x2ed4008
y.create.l HWIO_PMIC_ARB_OBS4_CHNL91_STATUS_ADDR A:0x2edc008
y.create.l HWIO_PMIC_ARB_OBS4_CHNL92_STATUS_ADDR A:0x2ee4008
y.create.l HWIO_PMIC_ARB_OBS4_CHNL93_STATUS_ADDR A:0x2eec008
y.create.l HWIO_PMIC_ARB_OBS4_CHNL94_STATUS_ADDR A:0x2ef4008
y.create.l HWIO_PMIC_ARB_OBS4_CHNL95_STATUS_ADDR A:0x2efc008
y.create.l HWIO_PMIC_ARB_OBS4_CHNL96_STATUS_ADDR A:0x2f04008
y.create.l HWIO_PMIC_ARB_OBS4_CHNL97_STATUS_ADDR A:0x2f0c008
y.create.l HWIO_PMIC_ARB_OBS4_CHNL98_STATUS_ADDR A:0x2f14008
y.create.l HWIO_PMIC_ARB_OBS4_CHNL99_STATUS_ADDR A:0x2f1c008
y.create.l HWIO_PMIC_ARB_OBS4_CHNL100_STATUS_ADDR A:0x2f24008
y.create.l HWIO_PMIC_ARB_OBS4_CHNL101_STATUS_ADDR A:0x2f2c008
y.create.l HWIO_PMIC_ARB_OBS4_CHNL102_STATUS_ADDR A:0x2f34008
y.create.l HWIO_PMIC_ARB_OBS4_CHNL103_STATUS_ADDR A:0x2f3c008
y.create.l HWIO_PMIC_ARB_OBS4_CHNL104_STATUS_ADDR A:0x2f44008
y.create.l HWIO_PMIC_ARB_OBS4_CHNL105_STATUS_ADDR A:0x2f4c008
y.create.l HWIO_PMIC_ARB_OBS4_CHNL106_STATUS_ADDR A:0x2f54008
y.create.l HWIO_PMIC_ARB_OBS4_CHNL107_STATUS_ADDR A:0x2f5c008
y.create.l HWIO_PMIC_ARB_OBS4_CHNL108_STATUS_ADDR A:0x2f64008
y.create.l HWIO_PMIC_ARB_OBS4_CHNL109_STATUS_ADDR A:0x2f6c008
y.create.l HWIO_PMIC_ARB_OBS4_CHNL110_STATUS_ADDR A:0x2f74008
y.create.l HWIO_PMIC_ARB_OBS4_CHNL111_STATUS_ADDR A:0x2f7c008
y.create.l HWIO_PMIC_ARB_OBS4_CHNL112_STATUS_ADDR A:0x2f84008
y.create.l HWIO_PMIC_ARB_OBS4_CHNL113_STATUS_ADDR A:0x2f8c008
y.create.l HWIO_PMIC_ARB_OBS4_CHNL114_STATUS_ADDR A:0x2f94008
y.create.l HWIO_PMIC_ARB_OBS4_CHNL115_STATUS_ADDR A:0x2f9c008
y.create.l HWIO_PMIC_ARB_OBS4_CHNL116_STATUS_ADDR A:0x2fa4008
y.create.l HWIO_PMIC_ARB_OBS4_CHNL117_STATUS_ADDR A:0x2fac008
y.create.l HWIO_PMIC_ARB_OBS4_CHNL118_STATUS_ADDR A:0x2fb4008
y.create.l HWIO_PMIC_ARB_OBS4_CHNL119_STATUS_ADDR A:0x2fbc008
y.create.l HWIO_PMIC_ARB_OBS4_CHNL120_STATUS_ADDR A:0x2fc4008
y.create.l HWIO_PMIC_ARB_OBS4_CHNL121_STATUS_ADDR A:0x2fcc008
y.create.l HWIO_PMIC_ARB_OBS4_CHNL122_STATUS_ADDR A:0x2fd4008
y.create.l HWIO_PMIC_ARB_OBS4_CHNL123_STATUS_ADDR A:0x2fdc008
y.create.l HWIO_PMIC_ARB_OBS4_CHNL124_STATUS_ADDR A:0x2fe4008
y.create.l HWIO_PMIC_ARB_OBS4_CHNL125_STATUS_ADDR A:0x2fec008
y.create.l HWIO_PMIC_ARB_OBS4_CHNL126_STATUS_ADDR A:0x2ff4008
y.create.l HWIO_PMIC_ARB_OBS4_CHNL127_STATUS_ADDR A:0x2ffc008
y.create.l HWIO_PMIC_ARB_OBS4_CHNL128_STATUS_ADDR A:0x3004008
y.create.l HWIO_PMIC_ARB_OBS4_CHNL129_STATUS_ADDR A:0x300c008
y.create.l HWIO_PMIC_ARB_OBS4_CHNL130_STATUS_ADDR A:0x3014008
y.create.l HWIO_PMIC_ARB_OBS4_CHNL131_STATUS_ADDR A:0x301c008
y.create.l HWIO_PMIC_ARB_OBS4_CHNL132_STATUS_ADDR A:0x3024008
y.create.l HWIO_PMIC_ARB_OBS4_CHNL133_STATUS_ADDR A:0x302c008
y.create.l HWIO_PMIC_ARB_OBS4_CHNL134_STATUS_ADDR A:0x3034008
y.create.l HWIO_PMIC_ARB_OBS4_CHNL135_STATUS_ADDR A:0x303c008
y.create.l HWIO_PMIC_ARB_OBS4_CHNL136_STATUS_ADDR A:0x3044008
y.create.l HWIO_PMIC_ARB_OBS4_CHNL137_STATUS_ADDR A:0x304c008
y.create.l HWIO_PMIC_ARB_OBS4_CHNL138_STATUS_ADDR A:0x3054008
y.create.l HWIO_PMIC_ARB_OBS4_CHNL139_STATUS_ADDR A:0x305c008
y.create.l HWIO_PMIC_ARB_OBS4_CHNL140_STATUS_ADDR A:0x3064008
y.create.l HWIO_PMIC_ARB_OBS4_CHNL141_STATUS_ADDR A:0x306c008
y.create.l HWIO_PMIC_ARB_OBS4_CHNL142_STATUS_ADDR A:0x3074008
y.create.l HWIO_PMIC_ARB_OBS4_CHNL143_STATUS_ADDR A:0x307c008
y.create.l HWIO_PMIC_ARB_OBS4_CHNL144_STATUS_ADDR A:0x3084008
y.create.l HWIO_PMIC_ARB_OBS4_CHNL145_STATUS_ADDR A:0x308c008
y.create.l HWIO_PMIC_ARB_OBS4_CHNL146_STATUS_ADDR A:0x3094008
y.create.l HWIO_PMIC_ARB_OBS4_CHNL147_STATUS_ADDR A:0x309c008
y.create.l HWIO_PMIC_ARB_OBS4_CHNL148_STATUS_ADDR A:0x30a4008
y.create.l HWIO_PMIC_ARB_OBS4_CHNL149_STATUS_ADDR A:0x30ac008
y.create.l HWIO_PMIC_ARB_OBS4_CHNL150_STATUS_ADDR A:0x30b4008
y.create.l HWIO_PMIC_ARB_OBS4_CHNL151_STATUS_ADDR A:0x30bc008
y.create.l HWIO_PMIC_ARB_OBS4_CHNL152_STATUS_ADDR A:0x30c4008
y.create.l HWIO_PMIC_ARB_OBS4_CHNL153_STATUS_ADDR A:0x30cc008
y.create.l HWIO_PMIC_ARB_OBS4_CHNL154_STATUS_ADDR A:0x30d4008
y.create.l HWIO_PMIC_ARB_OBS4_CHNL155_STATUS_ADDR A:0x30dc008
y.create.l HWIO_PMIC_ARB_OBS4_CHNL156_STATUS_ADDR A:0x30e4008
y.create.l HWIO_PMIC_ARB_OBS4_CHNL157_STATUS_ADDR A:0x30ec008
y.create.l HWIO_PMIC_ARB_OBS4_CHNL158_STATUS_ADDR A:0x30f4008
y.create.l HWIO_PMIC_ARB_OBS4_CHNL159_STATUS_ADDR A:0x30fc008
y.create.l HWIO_PMIC_ARB_OBS4_CHNL160_STATUS_ADDR A:0x3104008
y.create.l HWIO_PMIC_ARB_OBS4_CHNL161_STATUS_ADDR A:0x310c008
y.create.l HWIO_PMIC_ARB_OBS4_CHNL162_STATUS_ADDR A:0x3114008
y.create.l HWIO_PMIC_ARB_OBS4_CHNL163_STATUS_ADDR A:0x311c008
y.create.l HWIO_PMIC_ARB_OBS4_CHNL164_STATUS_ADDR A:0x3124008
y.create.l HWIO_PMIC_ARB_OBS4_CHNL165_STATUS_ADDR A:0x312c008
y.create.l HWIO_PMIC_ARB_OBS4_CHNL166_STATUS_ADDR A:0x3134008
y.create.l HWIO_PMIC_ARB_OBS4_CHNL167_STATUS_ADDR A:0x313c008
y.create.l HWIO_PMIC_ARB_OBS4_CHNL168_STATUS_ADDR A:0x3144008
y.create.l HWIO_PMIC_ARB_OBS4_CHNL169_STATUS_ADDR A:0x314c008
y.create.l HWIO_PMIC_ARB_OBS4_CHNL170_STATUS_ADDR A:0x3154008
y.create.l HWIO_PMIC_ARB_OBS4_CHNL171_STATUS_ADDR A:0x315c008
y.create.l HWIO_PMIC_ARB_OBS4_CHNL172_STATUS_ADDR A:0x3164008
y.create.l HWIO_PMIC_ARB_OBS4_CHNL173_STATUS_ADDR A:0x316c008
y.create.l HWIO_PMIC_ARB_OBS4_CHNL174_STATUS_ADDR A:0x3174008
y.create.l HWIO_PMIC_ARB_OBS4_CHNL175_STATUS_ADDR A:0x317c008
y.create.l HWIO_PMIC_ARB_OBS4_CHNL176_STATUS_ADDR A:0x3184008
y.create.l HWIO_PMIC_ARB_OBS4_CHNL177_STATUS_ADDR A:0x318c008
y.create.l HWIO_PMIC_ARB_OBS4_CHNL178_STATUS_ADDR A:0x3194008
y.create.l HWIO_PMIC_ARB_OBS4_CHNL179_STATUS_ADDR A:0x319c008
y.create.l HWIO_PMIC_ARB_OBS4_CHNL180_STATUS_ADDR A:0x31a4008
y.create.l HWIO_PMIC_ARB_OBS4_CHNL181_STATUS_ADDR A:0x31ac008
y.create.l HWIO_PMIC_ARB_OBS4_CHNL182_STATUS_ADDR A:0x31b4008
y.create.l HWIO_PMIC_ARB_OBS4_CHNL183_STATUS_ADDR A:0x31bc008
y.create.l HWIO_PMIC_ARB_OBS4_CHNL184_STATUS_ADDR A:0x31c4008
y.create.l HWIO_PMIC_ARB_OBS4_CHNL185_STATUS_ADDR A:0x31cc008
y.create.l HWIO_PMIC_ARB_OBS4_CHNL186_STATUS_ADDR A:0x31d4008
y.create.l HWIO_PMIC_ARB_OBS4_CHNL187_STATUS_ADDR A:0x31dc008
y.create.l HWIO_PMIC_ARB_OBS4_CHNL188_STATUS_ADDR A:0x31e4008
y.create.l HWIO_PMIC_ARB_OBS4_CHNL189_STATUS_ADDR A:0x31ec008
y.create.l HWIO_PMIC_ARB_OBS4_CHNL190_STATUS_ADDR A:0x31f4008
y.create.l HWIO_PMIC_ARB_OBS4_CHNL191_STATUS_ADDR A:0x31fc008
y.create.l HWIO_PMIC_ARB_OBS4_CHNL192_STATUS_ADDR A:0x3204008
y.create.l HWIO_PMIC_ARB_OBS4_CHNL193_STATUS_ADDR A:0x320c008
y.create.l HWIO_PMIC_ARB_OBS4_CHNL194_STATUS_ADDR A:0x3214008
y.create.l HWIO_PMIC_ARB_OBS4_CHNL195_STATUS_ADDR A:0x321c008
y.create.l HWIO_PMIC_ARB_OBS4_CHNL196_STATUS_ADDR A:0x3224008
y.create.l HWIO_PMIC_ARB_OBS4_CHNL197_STATUS_ADDR A:0x322c008
y.create.l HWIO_PMIC_ARB_OBS4_CHNL198_STATUS_ADDR A:0x3234008
y.create.l HWIO_PMIC_ARB_OBS4_CHNL199_STATUS_ADDR A:0x323c008
y.create.l HWIO_PMIC_ARB_OBS4_CHNL200_STATUS_ADDR A:0x3244008
y.create.l HWIO_PMIC_ARB_OBS4_CHNL201_STATUS_ADDR A:0x324c008
y.create.l HWIO_PMIC_ARB_OBS4_CHNL202_STATUS_ADDR A:0x3254008
y.create.l HWIO_PMIC_ARB_OBS4_CHNL203_STATUS_ADDR A:0x325c008
y.create.l HWIO_PMIC_ARB_OBS4_CHNL204_STATUS_ADDR A:0x3264008
y.create.l HWIO_PMIC_ARB_OBS4_CHNL205_STATUS_ADDR A:0x326c008
y.create.l HWIO_PMIC_ARB_OBS4_CHNL206_STATUS_ADDR A:0x3274008
y.create.l HWIO_PMIC_ARB_OBS4_CHNL207_STATUS_ADDR A:0x327c008
y.create.l HWIO_PMIC_ARB_OBS4_CHNL208_STATUS_ADDR A:0x3284008
y.create.l HWIO_PMIC_ARB_OBS4_CHNL209_STATUS_ADDR A:0x328c008
y.create.l HWIO_PMIC_ARB_OBS4_CHNL210_STATUS_ADDR A:0x3294008
y.create.l HWIO_PMIC_ARB_OBS4_CHNL211_STATUS_ADDR A:0x329c008
y.create.l HWIO_PMIC_ARB_OBS4_CHNL212_STATUS_ADDR A:0x32a4008
y.create.l HWIO_PMIC_ARB_OBS4_CHNL213_STATUS_ADDR A:0x32ac008
y.create.l HWIO_PMIC_ARB_OBS4_CHNL214_STATUS_ADDR A:0x32b4008
y.create.l HWIO_PMIC_ARB_OBS4_CHNL215_STATUS_ADDR A:0x32bc008
y.create.l HWIO_PMIC_ARB_OBS4_CHNL216_STATUS_ADDR A:0x32c4008
y.create.l HWIO_PMIC_ARB_OBS4_CHNL217_STATUS_ADDR A:0x32cc008
y.create.l HWIO_PMIC_ARB_OBS4_CHNL218_STATUS_ADDR A:0x32d4008
y.create.l HWIO_PMIC_ARB_OBS4_CHNL219_STATUS_ADDR A:0x32dc008
y.create.l HWIO_PMIC_ARB_OBS4_CHNL220_STATUS_ADDR A:0x32e4008
y.create.l HWIO_PMIC_ARB_OBS4_CHNL221_STATUS_ADDR A:0x32ec008
y.create.l HWIO_PMIC_ARB_OBS4_CHNL222_STATUS_ADDR A:0x32f4008
y.create.l HWIO_PMIC_ARB_OBS4_CHNL223_STATUS_ADDR A:0x32fc008
y.create.l HWIO_PMIC_ARB_OBS4_CHNL224_STATUS_ADDR A:0x3304008
y.create.l HWIO_PMIC_ARB_OBS4_CHNL225_STATUS_ADDR A:0x330c008
y.create.l HWIO_PMIC_ARB_OBS4_CHNL226_STATUS_ADDR A:0x3314008
y.create.l HWIO_PMIC_ARB_OBS4_CHNL227_STATUS_ADDR A:0x331c008
y.create.l HWIO_PMIC_ARB_OBS4_CHNL228_STATUS_ADDR A:0x3324008
y.create.l HWIO_PMIC_ARB_OBS4_CHNL229_STATUS_ADDR A:0x332c008
y.create.l HWIO_PMIC_ARB_OBS4_CHNL230_STATUS_ADDR A:0x3334008
y.create.l HWIO_PMIC_ARB_OBS4_CHNL231_STATUS_ADDR A:0x333c008
y.create.l HWIO_PMIC_ARB_OBS4_CHNL232_STATUS_ADDR A:0x3344008
y.create.l HWIO_PMIC_ARB_OBS4_CHNL233_STATUS_ADDR A:0x334c008
y.create.l HWIO_PMIC_ARB_OBS4_CHNL234_STATUS_ADDR A:0x3354008
y.create.l HWIO_PMIC_ARB_OBS4_CHNL235_STATUS_ADDR A:0x335c008
y.create.l HWIO_PMIC_ARB_OBS4_CHNL236_STATUS_ADDR A:0x3364008
y.create.l HWIO_PMIC_ARB_OBS4_CHNL237_STATUS_ADDR A:0x336c008
y.create.l HWIO_PMIC_ARB_OBS4_CHNL238_STATUS_ADDR A:0x3374008
y.create.l HWIO_PMIC_ARB_OBS4_CHNL239_STATUS_ADDR A:0x337c008
y.create.l HWIO_PMIC_ARB_OBS4_CHNL240_STATUS_ADDR A:0x3384008
y.create.l HWIO_PMIC_ARB_OBS4_CHNL241_STATUS_ADDR A:0x338c008
y.create.l HWIO_PMIC_ARB_OBS4_CHNL242_STATUS_ADDR A:0x3394008
y.create.l HWIO_PMIC_ARB_OBS4_CHNL243_STATUS_ADDR A:0x339c008
y.create.l HWIO_PMIC_ARB_OBS4_CHNL244_STATUS_ADDR A:0x33a4008
y.create.l HWIO_PMIC_ARB_OBS4_CHNL245_STATUS_ADDR A:0x33ac008
y.create.l HWIO_PMIC_ARB_OBS4_CHNL246_STATUS_ADDR A:0x33b4008
y.create.l HWIO_PMIC_ARB_OBS4_CHNL247_STATUS_ADDR A:0x33bc008
y.create.l HWIO_PMIC_ARB_OBS4_CHNL248_STATUS_ADDR A:0x33c4008
y.create.l HWIO_PMIC_ARB_OBS4_CHNL249_STATUS_ADDR A:0x33cc008
y.create.l HWIO_PMIC_ARB_OBS4_CHNL250_STATUS_ADDR A:0x33d4008
y.create.l HWIO_PMIC_ARB_OBS4_CHNL251_STATUS_ADDR A:0x33dc008
y.create.l HWIO_PMIC_ARB_OBS4_CHNL252_STATUS_ADDR A:0x33e4008
y.create.l HWIO_PMIC_ARB_OBS4_CHNL253_STATUS_ADDR A:0x33ec008
y.create.l HWIO_PMIC_ARB_OBS4_CHNL254_STATUS_ADDR A:0x33f4008
y.create.l HWIO_PMIC_ARB_OBS4_CHNL255_STATUS_ADDR A:0x33fc008
y.create.l HWIO_PMIC_ARB_OBS5_CHNL0_STATUS_ADDR A:0x2c05008
y.create.l HWIO_PMIC_ARB_OBS5_CHNL1_STATUS_ADDR A:0x2c0d008
y.create.l HWIO_PMIC_ARB_OBS5_CHNL2_STATUS_ADDR A:0x2c15008
y.create.l HWIO_PMIC_ARB_OBS5_CHNL3_STATUS_ADDR A:0x2c1d008
y.create.l HWIO_PMIC_ARB_OBS5_CHNL4_STATUS_ADDR A:0x2c25008
y.create.l HWIO_PMIC_ARB_OBS5_CHNL5_STATUS_ADDR A:0x2c2d008
y.create.l HWIO_PMIC_ARB_OBS5_CHNL6_STATUS_ADDR A:0x2c35008
y.create.l HWIO_PMIC_ARB_OBS5_CHNL7_STATUS_ADDR A:0x2c3d008
y.create.l HWIO_PMIC_ARB_OBS5_CHNL8_STATUS_ADDR A:0x2c45008
y.create.l HWIO_PMIC_ARB_OBS5_CHNL9_STATUS_ADDR A:0x2c4d008
y.create.l HWIO_PMIC_ARB_OBS5_CHNL10_STATUS_ADDR A:0x2c55008
y.create.l HWIO_PMIC_ARB_OBS5_CHNL11_STATUS_ADDR A:0x2c5d008
y.create.l HWIO_PMIC_ARB_OBS5_CHNL12_STATUS_ADDR A:0x2c65008
y.create.l HWIO_PMIC_ARB_OBS5_CHNL13_STATUS_ADDR A:0x2c6d008
y.create.l HWIO_PMIC_ARB_OBS5_CHNL14_STATUS_ADDR A:0x2c75008
y.create.l HWIO_PMIC_ARB_OBS5_CHNL15_STATUS_ADDR A:0x2c7d008
y.create.l HWIO_PMIC_ARB_OBS5_CHNL16_STATUS_ADDR A:0x2c85008
y.create.l HWIO_PMIC_ARB_OBS5_CHNL17_STATUS_ADDR A:0x2c8d008
y.create.l HWIO_PMIC_ARB_OBS5_CHNL18_STATUS_ADDR A:0x2c95008
y.create.l HWIO_PMIC_ARB_OBS5_CHNL19_STATUS_ADDR A:0x2c9d008
y.create.l HWIO_PMIC_ARB_OBS5_CHNL20_STATUS_ADDR A:0x2ca5008
y.create.l HWIO_PMIC_ARB_OBS5_CHNL21_STATUS_ADDR A:0x2cad008
y.create.l HWIO_PMIC_ARB_OBS5_CHNL22_STATUS_ADDR A:0x2cb5008
y.create.l HWIO_PMIC_ARB_OBS5_CHNL23_STATUS_ADDR A:0x2cbd008
y.create.l HWIO_PMIC_ARB_OBS5_CHNL24_STATUS_ADDR A:0x2cc5008
y.create.l HWIO_PMIC_ARB_OBS5_CHNL25_STATUS_ADDR A:0x2ccd008
y.create.l HWIO_PMIC_ARB_OBS5_CHNL26_STATUS_ADDR A:0x2cd5008
y.create.l HWIO_PMIC_ARB_OBS5_CHNL27_STATUS_ADDR A:0x2cdd008
y.create.l HWIO_PMIC_ARB_OBS5_CHNL28_STATUS_ADDR A:0x2ce5008
y.create.l HWIO_PMIC_ARB_OBS5_CHNL29_STATUS_ADDR A:0x2ced008
y.create.l HWIO_PMIC_ARB_OBS5_CHNL30_STATUS_ADDR A:0x2cf5008
y.create.l HWIO_PMIC_ARB_OBS5_CHNL31_STATUS_ADDR A:0x2cfd008
y.create.l HWIO_PMIC_ARB_OBS5_CHNL32_STATUS_ADDR A:0x2d05008
y.create.l HWIO_PMIC_ARB_OBS5_CHNL33_STATUS_ADDR A:0x2d0d008
y.create.l HWIO_PMIC_ARB_OBS5_CHNL34_STATUS_ADDR A:0x2d15008
y.create.l HWIO_PMIC_ARB_OBS5_CHNL35_STATUS_ADDR A:0x2d1d008
y.create.l HWIO_PMIC_ARB_OBS5_CHNL36_STATUS_ADDR A:0x2d25008
y.create.l HWIO_PMIC_ARB_OBS5_CHNL37_STATUS_ADDR A:0x2d2d008
y.create.l HWIO_PMIC_ARB_OBS5_CHNL38_STATUS_ADDR A:0x2d35008
y.create.l HWIO_PMIC_ARB_OBS5_CHNL39_STATUS_ADDR A:0x2d3d008
y.create.l HWIO_PMIC_ARB_OBS5_CHNL40_STATUS_ADDR A:0x2d45008
y.create.l HWIO_PMIC_ARB_OBS5_CHNL41_STATUS_ADDR A:0x2d4d008
y.create.l HWIO_PMIC_ARB_OBS5_CHNL42_STATUS_ADDR A:0x2d55008
y.create.l HWIO_PMIC_ARB_OBS5_CHNL43_STATUS_ADDR A:0x2d5d008
y.create.l HWIO_PMIC_ARB_OBS5_CHNL44_STATUS_ADDR A:0x2d65008
y.create.l HWIO_PMIC_ARB_OBS5_CHNL45_STATUS_ADDR A:0x2d6d008
y.create.l HWIO_PMIC_ARB_OBS5_CHNL46_STATUS_ADDR A:0x2d75008
y.create.l HWIO_PMIC_ARB_OBS5_CHNL47_STATUS_ADDR A:0x2d7d008
y.create.l HWIO_PMIC_ARB_OBS5_CHNL48_STATUS_ADDR A:0x2d85008
y.create.l HWIO_PMIC_ARB_OBS5_CHNL49_STATUS_ADDR A:0x2d8d008
y.create.l HWIO_PMIC_ARB_OBS5_CHNL50_STATUS_ADDR A:0x2d95008
y.create.l HWIO_PMIC_ARB_OBS5_CHNL51_STATUS_ADDR A:0x2d9d008
y.create.l HWIO_PMIC_ARB_OBS5_CHNL52_STATUS_ADDR A:0x2da5008
y.create.l HWIO_PMIC_ARB_OBS5_CHNL53_STATUS_ADDR A:0x2dad008
y.create.l HWIO_PMIC_ARB_OBS5_CHNL54_STATUS_ADDR A:0x2db5008
y.create.l HWIO_PMIC_ARB_OBS5_CHNL55_STATUS_ADDR A:0x2dbd008
y.create.l HWIO_PMIC_ARB_OBS5_CHNL56_STATUS_ADDR A:0x2dc5008
y.create.l HWIO_PMIC_ARB_OBS5_CHNL57_STATUS_ADDR A:0x2dcd008
y.create.l HWIO_PMIC_ARB_OBS5_CHNL58_STATUS_ADDR A:0x2dd5008
y.create.l HWIO_PMIC_ARB_OBS5_CHNL59_STATUS_ADDR A:0x2ddd008
y.create.l HWIO_PMIC_ARB_OBS5_CHNL60_STATUS_ADDR A:0x2de5008
y.create.l HWIO_PMIC_ARB_OBS5_CHNL61_STATUS_ADDR A:0x2ded008
y.create.l HWIO_PMIC_ARB_OBS5_CHNL62_STATUS_ADDR A:0x2df5008
y.create.l HWIO_PMIC_ARB_OBS5_CHNL63_STATUS_ADDR A:0x2dfd008
y.create.l HWIO_PMIC_ARB_OBS5_CHNL64_STATUS_ADDR A:0x2e05008
y.create.l HWIO_PMIC_ARB_OBS5_CHNL65_STATUS_ADDR A:0x2e0d008
y.create.l HWIO_PMIC_ARB_OBS5_CHNL66_STATUS_ADDR A:0x2e15008
y.create.l HWIO_PMIC_ARB_OBS5_CHNL67_STATUS_ADDR A:0x2e1d008
y.create.l HWIO_PMIC_ARB_OBS5_CHNL68_STATUS_ADDR A:0x2e25008
y.create.l HWIO_PMIC_ARB_OBS5_CHNL69_STATUS_ADDR A:0x2e2d008
y.create.l HWIO_PMIC_ARB_OBS5_CHNL70_STATUS_ADDR A:0x2e35008
y.create.l HWIO_PMIC_ARB_OBS5_CHNL71_STATUS_ADDR A:0x2e3d008
y.create.l HWIO_PMIC_ARB_OBS5_CHNL72_STATUS_ADDR A:0x2e45008
y.create.l HWIO_PMIC_ARB_OBS5_CHNL73_STATUS_ADDR A:0x2e4d008
y.create.l HWIO_PMIC_ARB_OBS5_CHNL74_STATUS_ADDR A:0x2e55008
y.create.l HWIO_PMIC_ARB_OBS5_CHNL75_STATUS_ADDR A:0x2e5d008
y.create.l HWIO_PMIC_ARB_OBS5_CHNL76_STATUS_ADDR A:0x2e65008
y.create.l HWIO_PMIC_ARB_OBS5_CHNL77_STATUS_ADDR A:0x2e6d008
y.create.l HWIO_PMIC_ARB_OBS5_CHNL78_STATUS_ADDR A:0x2e75008
y.create.l HWIO_PMIC_ARB_OBS5_CHNL79_STATUS_ADDR A:0x2e7d008
y.create.l HWIO_PMIC_ARB_OBS5_CHNL80_STATUS_ADDR A:0x2e85008
y.create.l HWIO_PMIC_ARB_OBS5_CHNL81_STATUS_ADDR A:0x2e8d008
y.create.l HWIO_PMIC_ARB_OBS5_CHNL82_STATUS_ADDR A:0x2e95008
y.create.l HWIO_PMIC_ARB_OBS5_CHNL83_STATUS_ADDR A:0x2e9d008
y.create.l HWIO_PMIC_ARB_OBS5_CHNL84_STATUS_ADDR A:0x2ea5008
y.create.l HWIO_PMIC_ARB_OBS5_CHNL85_STATUS_ADDR A:0x2ead008
y.create.l HWIO_PMIC_ARB_OBS5_CHNL86_STATUS_ADDR A:0x2eb5008
y.create.l HWIO_PMIC_ARB_OBS5_CHNL87_STATUS_ADDR A:0x2ebd008
y.create.l HWIO_PMIC_ARB_OBS5_CHNL88_STATUS_ADDR A:0x2ec5008
y.create.l HWIO_PMIC_ARB_OBS5_CHNL89_STATUS_ADDR A:0x2ecd008
y.create.l HWIO_PMIC_ARB_OBS5_CHNL90_STATUS_ADDR A:0x2ed5008
y.create.l HWIO_PMIC_ARB_OBS5_CHNL91_STATUS_ADDR A:0x2edd008
y.create.l HWIO_PMIC_ARB_OBS5_CHNL92_STATUS_ADDR A:0x2ee5008
y.create.l HWIO_PMIC_ARB_OBS5_CHNL93_STATUS_ADDR A:0x2eed008
y.create.l HWIO_PMIC_ARB_OBS5_CHNL94_STATUS_ADDR A:0x2ef5008
y.create.l HWIO_PMIC_ARB_OBS5_CHNL95_STATUS_ADDR A:0x2efd008
y.create.l HWIO_PMIC_ARB_OBS5_CHNL96_STATUS_ADDR A:0x2f05008
y.create.l HWIO_PMIC_ARB_OBS5_CHNL97_STATUS_ADDR A:0x2f0d008
y.create.l HWIO_PMIC_ARB_OBS5_CHNL98_STATUS_ADDR A:0x2f15008
y.create.l HWIO_PMIC_ARB_OBS5_CHNL99_STATUS_ADDR A:0x2f1d008
y.create.l HWIO_PMIC_ARB_OBS5_CHNL100_STATUS_ADDR A:0x2f25008
y.create.l HWIO_PMIC_ARB_OBS5_CHNL101_STATUS_ADDR A:0x2f2d008
y.create.l HWIO_PMIC_ARB_OBS5_CHNL102_STATUS_ADDR A:0x2f35008
y.create.l HWIO_PMIC_ARB_OBS5_CHNL103_STATUS_ADDR A:0x2f3d008
y.create.l HWIO_PMIC_ARB_OBS5_CHNL104_STATUS_ADDR A:0x2f45008
y.create.l HWIO_PMIC_ARB_OBS5_CHNL105_STATUS_ADDR A:0x2f4d008
y.create.l HWIO_PMIC_ARB_OBS5_CHNL106_STATUS_ADDR A:0x2f55008
y.create.l HWIO_PMIC_ARB_OBS5_CHNL107_STATUS_ADDR A:0x2f5d008
y.create.l HWIO_PMIC_ARB_OBS5_CHNL108_STATUS_ADDR A:0x2f65008
y.create.l HWIO_PMIC_ARB_OBS5_CHNL109_STATUS_ADDR A:0x2f6d008
y.create.l HWIO_PMIC_ARB_OBS5_CHNL110_STATUS_ADDR A:0x2f75008
y.create.l HWIO_PMIC_ARB_OBS5_CHNL111_STATUS_ADDR A:0x2f7d008
y.create.l HWIO_PMIC_ARB_OBS5_CHNL112_STATUS_ADDR A:0x2f85008
y.create.l HWIO_PMIC_ARB_OBS5_CHNL113_STATUS_ADDR A:0x2f8d008
y.create.l HWIO_PMIC_ARB_OBS5_CHNL114_STATUS_ADDR A:0x2f95008
y.create.l HWIO_PMIC_ARB_OBS5_CHNL115_STATUS_ADDR A:0x2f9d008
y.create.l HWIO_PMIC_ARB_OBS5_CHNL116_STATUS_ADDR A:0x2fa5008
y.create.l HWIO_PMIC_ARB_OBS5_CHNL117_STATUS_ADDR A:0x2fad008
y.create.l HWIO_PMIC_ARB_OBS5_CHNL118_STATUS_ADDR A:0x2fb5008
y.create.l HWIO_PMIC_ARB_OBS5_CHNL119_STATUS_ADDR A:0x2fbd008
y.create.l HWIO_PMIC_ARB_OBS5_CHNL120_STATUS_ADDR A:0x2fc5008
y.create.l HWIO_PMIC_ARB_OBS5_CHNL121_STATUS_ADDR A:0x2fcd008
y.create.l HWIO_PMIC_ARB_OBS5_CHNL122_STATUS_ADDR A:0x2fd5008
y.create.l HWIO_PMIC_ARB_OBS5_CHNL123_STATUS_ADDR A:0x2fdd008
y.create.l HWIO_PMIC_ARB_OBS5_CHNL124_STATUS_ADDR A:0x2fe5008
y.create.l HWIO_PMIC_ARB_OBS5_CHNL125_STATUS_ADDR A:0x2fed008
y.create.l HWIO_PMIC_ARB_OBS5_CHNL126_STATUS_ADDR A:0x2ff5008
y.create.l HWIO_PMIC_ARB_OBS5_CHNL127_STATUS_ADDR A:0x2ffd008
y.create.l HWIO_PMIC_ARB_OBS5_CHNL128_STATUS_ADDR A:0x3005008
y.create.l HWIO_PMIC_ARB_OBS5_CHNL129_STATUS_ADDR A:0x300d008
y.create.l HWIO_PMIC_ARB_OBS5_CHNL130_STATUS_ADDR A:0x3015008
y.create.l HWIO_PMIC_ARB_OBS5_CHNL131_STATUS_ADDR A:0x301d008
y.create.l HWIO_PMIC_ARB_OBS5_CHNL132_STATUS_ADDR A:0x3025008
y.create.l HWIO_PMIC_ARB_OBS5_CHNL133_STATUS_ADDR A:0x302d008
y.create.l HWIO_PMIC_ARB_OBS5_CHNL134_STATUS_ADDR A:0x3035008
y.create.l HWIO_PMIC_ARB_OBS5_CHNL135_STATUS_ADDR A:0x303d008
y.create.l HWIO_PMIC_ARB_OBS5_CHNL136_STATUS_ADDR A:0x3045008
y.create.l HWIO_PMIC_ARB_OBS5_CHNL137_STATUS_ADDR A:0x304d008
y.create.l HWIO_PMIC_ARB_OBS5_CHNL138_STATUS_ADDR A:0x3055008
y.create.l HWIO_PMIC_ARB_OBS5_CHNL139_STATUS_ADDR A:0x305d008
y.create.l HWIO_PMIC_ARB_OBS5_CHNL140_STATUS_ADDR A:0x3065008
y.create.l HWIO_PMIC_ARB_OBS5_CHNL141_STATUS_ADDR A:0x306d008
y.create.l HWIO_PMIC_ARB_OBS5_CHNL142_STATUS_ADDR A:0x3075008
y.create.l HWIO_PMIC_ARB_OBS5_CHNL143_STATUS_ADDR A:0x307d008
y.create.l HWIO_PMIC_ARB_OBS5_CHNL144_STATUS_ADDR A:0x3085008
y.create.l HWIO_PMIC_ARB_OBS5_CHNL145_STATUS_ADDR A:0x308d008
y.create.l HWIO_PMIC_ARB_OBS5_CHNL146_STATUS_ADDR A:0x3095008
y.create.l HWIO_PMIC_ARB_OBS5_CHNL147_STATUS_ADDR A:0x309d008
y.create.l HWIO_PMIC_ARB_OBS5_CHNL148_STATUS_ADDR A:0x30a5008
y.create.l HWIO_PMIC_ARB_OBS5_CHNL149_STATUS_ADDR A:0x30ad008
y.create.l HWIO_PMIC_ARB_OBS5_CHNL150_STATUS_ADDR A:0x30b5008
y.create.l HWIO_PMIC_ARB_OBS5_CHNL151_STATUS_ADDR A:0x30bd008
y.create.l HWIO_PMIC_ARB_OBS5_CHNL152_STATUS_ADDR A:0x30c5008
y.create.l HWIO_PMIC_ARB_OBS5_CHNL153_STATUS_ADDR A:0x30cd008
y.create.l HWIO_PMIC_ARB_OBS5_CHNL154_STATUS_ADDR A:0x30d5008
y.create.l HWIO_PMIC_ARB_OBS5_CHNL155_STATUS_ADDR A:0x30dd008
y.create.l HWIO_PMIC_ARB_OBS5_CHNL156_STATUS_ADDR A:0x30e5008
y.create.l HWIO_PMIC_ARB_OBS5_CHNL157_STATUS_ADDR A:0x30ed008
y.create.l HWIO_PMIC_ARB_OBS5_CHNL158_STATUS_ADDR A:0x30f5008
y.create.l HWIO_PMIC_ARB_OBS5_CHNL159_STATUS_ADDR A:0x30fd008
y.create.l HWIO_PMIC_ARB_OBS5_CHNL160_STATUS_ADDR A:0x3105008
y.create.l HWIO_PMIC_ARB_OBS5_CHNL161_STATUS_ADDR A:0x310d008
y.create.l HWIO_PMIC_ARB_OBS5_CHNL162_STATUS_ADDR A:0x3115008
y.create.l HWIO_PMIC_ARB_OBS5_CHNL163_STATUS_ADDR A:0x311d008
y.create.l HWIO_PMIC_ARB_OBS5_CHNL164_STATUS_ADDR A:0x3125008
y.create.l HWIO_PMIC_ARB_OBS5_CHNL165_STATUS_ADDR A:0x312d008
y.create.l HWIO_PMIC_ARB_OBS5_CHNL166_STATUS_ADDR A:0x3135008
y.create.l HWIO_PMIC_ARB_OBS5_CHNL167_STATUS_ADDR A:0x313d008
y.create.l HWIO_PMIC_ARB_OBS5_CHNL168_STATUS_ADDR A:0x3145008
y.create.l HWIO_PMIC_ARB_OBS5_CHNL169_STATUS_ADDR A:0x314d008
y.create.l HWIO_PMIC_ARB_OBS5_CHNL170_STATUS_ADDR A:0x3155008
y.create.l HWIO_PMIC_ARB_OBS5_CHNL171_STATUS_ADDR A:0x315d008
y.create.l HWIO_PMIC_ARB_OBS5_CHNL172_STATUS_ADDR A:0x3165008
y.create.l HWIO_PMIC_ARB_OBS5_CHNL173_STATUS_ADDR A:0x316d008
y.create.l HWIO_PMIC_ARB_OBS5_CHNL174_STATUS_ADDR A:0x3175008
y.create.l HWIO_PMIC_ARB_OBS5_CHNL175_STATUS_ADDR A:0x317d008
y.create.l HWIO_PMIC_ARB_OBS5_CHNL176_STATUS_ADDR A:0x3185008
y.create.l HWIO_PMIC_ARB_OBS5_CHNL177_STATUS_ADDR A:0x318d008
y.create.l HWIO_PMIC_ARB_OBS5_CHNL178_STATUS_ADDR A:0x3195008
y.create.l HWIO_PMIC_ARB_OBS5_CHNL179_STATUS_ADDR A:0x319d008
y.create.l HWIO_PMIC_ARB_OBS5_CHNL180_STATUS_ADDR A:0x31a5008
y.create.l HWIO_PMIC_ARB_OBS5_CHNL181_STATUS_ADDR A:0x31ad008
y.create.l HWIO_PMIC_ARB_OBS5_CHNL182_STATUS_ADDR A:0x31b5008
y.create.l HWIO_PMIC_ARB_OBS5_CHNL183_STATUS_ADDR A:0x31bd008
y.create.l HWIO_PMIC_ARB_OBS5_CHNL184_STATUS_ADDR A:0x31c5008
y.create.l HWIO_PMIC_ARB_OBS5_CHNL185_STATUS_ADDR A:0x31cd008
y.create.l HWIO_PMIC_ARB_OBS5_CHNL186_STATUS_ADDR A:0x31d5008
y.create.l HWIO_PMIC_ARB_OBS5_CHNL187_STATUS_ADDR A:0x31dd008
y.create.l HWIO_PMIC_ARB_OBS5_CHNL188_STATUS_ADDR A:0x31e5008
y.create.l HWIO_PMIC_ARB_OBS5_CHNL189_STATUS_ADDR A:0x31ed008
y.create.l HWIO_PMIC_ARB_OBS5_CHNL190_STATUS_ADDR A:0x31f5008
y.create.l HWIO_PMIC_ARB_OBS5_CHNL191_STATUS_ADDR A:0x31fd008
y.create.l HWIO_PMIC_ARB_OBS5_CHNL192_STATUS_ADDR A:0x3205008
y.create.l HWIO_PMIC_ARB_OBS5_CHNL193_STATUS_ADDR A:0x320d008
y.create.l HWIO_PMIC_ARB_OBS5_CHNL194_STATUS_ADDR A:0x3215008
y.create.l HWIO_PMIC_ARB_OBS5_CHNL195_STATUS_ADDR A:0x321d008
y.create.l HWIO_PMIC_ARB_OBS5_CHNL196_STATUS_ADDR A:0x3225008
y.create.l HWIO_PMIC_ARB_OBS5_CHNL197_STATUS_ADDR A:0x322d008
y.create.l HWIO_PMIC_ARB_OBS5_CHNL198_STATUS_ADDR A:0x3235008
y.create.l HWIO_PMIC_ARB_OBS5_CHNL199_STATUS_ADDR A:0x323d008
y.create.l HWIO_PMIC_ARB_OBS5_CHNL200_STATUS_ADDR A:0x3245008
y.create.l HWIO_PMIC_ARB_OBS5_CHNL201_STATUS_ADDR A:0x324d008
y.create.l HWIO_PMIC_ARB_OBS5_CHNL202_STATUS_ADDR A:0x3255008
y.create.l HWIO_PMIC_ARB_OBS5_CHNL203_STATUS_ADDR A:0x325d008
y.create.l HWIO_PMIC_ARB_OBS5_CHNL204_STATUS_ADDR A:0x3265008
y.create.l HWIO_PMIC_ARB_OBS5_CHNL205_STATUS_ADDR A:0x326d008
y.create.l HWIO_PMIC_ARB_OBS5_CHNL206_STATUS_ADDR A:0x3275008
y.create.l HWIO_PMIC_ARB_OBS5_CHNL207_STATUS_ADDR A:0x327d008
y.create.l HWIO_PMIC_ARB_OBS5_CHNL208_STATUS_ADDR A:0x3285008
y.create.l HWIO_PMIC_ARB_OBS5_CHNL209_STATUS_ADDR A:0x328d008
y.create.l HWIO_PMIC_ARB_OBS5_CHNL210_STATUS_ADDR A:0x3295008
y.create.l HWIO_PMIC_ARB_OBS5_CHNL211_STATUS_ADDR A:0x329d008
y.create.l HWIO_PMIC_ARB_OBS5_CHNL212_STATUS_ADDR A:0x32a5008
y.create.l HWIO_PMIC_ARB_OBS5_CHNL213_STATUS_ADDR A:0x32ad008
y.create.l HWIO_PMIC_ARB_OBS5_CHNL214_STATUS_ADDR A:0x32b5008
y.create.l HWIO_PMIC_ARB_OBS5_CHNL215_STATUS_ADDR A:0x32bd008
y.create.l HWIO_PMIC_ARB_OBS5_CHNL216_STATUS_ADDR A:0x32c5008
y.create.l HWIO_PMIC_ARB_OBS5_CHNL217_STATUS_ADDR A:0x32cd008
y.create.l HWIO_PMIC_ARB_OBS5_CHNL218_STATUS_ADDR A:0x32d5008
y.create.l HWIO_PMIC_ARB_OBS5_CHNL219_STATUS_ADDR A:0x32dd008
y.create.l HWIO_PMIC_ARB_OBS5_CHNL220_STATUS_ADDR A:0x32e5008
y.create.l HWIO_PMIC_ARB_OBS5_CHNL221_STATUS_ADDR A:0x32ed008
y.create.l HWIO_PMIC_ARB_OBS5_CHNL222_STATUS_ADDR A:0x32f5008
y.create.l HWIO_PMIC_ARB_OBS5_CHNL223_STATUS_ADDR A:0x32fd008
y.create.l HWIO_PMIC_ARB_OBS5_CHNL224_STATUS_ADDR A:0x3305008
y.create.l HWIO_PMIC_ARB_OBS5_CHNL225_STATUS_ADDR A:0x330d008
y.create.l HWIO_PMIC_ARB_OBS5_CHNL226_STATUS_ADDR A:0x3315008
y.create.l HWIO_PMIC_ARB_OBS5_CHNL227_STATUS_ADDR A:0x331d008
y.create.l HWIO_PMIC_ARB_OBS5_CHNL228_STATUS_ADDR A:0x3325008
y.create.l HWIO_PMIC_ARB_OBS5_CHNL229_STATUS_ADDR A:0x332d008
y.create.l HWIO_PMIC_ARB_OBS5_CHNL230_STATUS_ADDR A:0x3335008
y.create.l HWIO_PMIC_ARB_OBS5_CHNL231_STATUS_ADDR A:0x333d008
y.create.l HWIO_PMIC_ARB_OBS5_CHNL232_STATUS_ADDR A:0x3345008
y.create.l HWIO_PMIC_ARB_OBS5_CHNL233_STATUS_ADDR A:0x334d008
y.create.l HWIO_PMIC_ARB_OBS5_CHNL234_STATUS_ADDR A:0x3355008
y.create.l HWIO_PMIC_ARB_OBS5_CHNL235_STATUS_ADDR A:0x335d008
y.create.l HWIO_PMIC_ARB_OBS5_CHNL236_STATUS_ADDR A:0x3365008
y.create.l HWIO_PMIC_ARB_OBS5_CHNL237_STATUS_ADDR A:0x336d008
y.create.l HWIO_PMIC_ARB_OBS5_CHNL238_STATUS_ADDR A:0x3375008
y.create.l HWIO_PMIC_ARB_OBS5_CHNL239_STATUS_ADDR A:0x337d008
y.create.l HWIO_PMIC_ARB_OBS5_CHNL240_STATUS_ADDR A:0x3385008
y.create.l HWIO_PMIC_ARB_OBS5_CHNL241_STATUS_ADDR A:0x338d008
y.create.l HWIO_PMIC_ARB_OBS5_CHNL242_STATUS_ADDR A:0x3395008
y.create.l HWIO_PMIC_ARB_OBS5_CHNL243_STATUS_ADDR A:0x339d008
y.create.l HWIO_PMIC_ARB_OBS5_CHNL244_STATUS_ADDR A:0x33a5008
y.create.l HWIO_PMIC_ARB_OBS5_CHNL245_STATUS_ADDR A:0x33ad008
y.create.l HWIO_PMIC_ARB_OBS5_CHNL246_STATUS_ADDR A:0x33b5008
y.create.l HWIO_PMIC_ARB_OBS5_CHNL247_STATUS_ADDR A:0x33bd008
y.create.l HWIO_PMIC_ARB_OBS5_CHNL248_STATUS_ADDR A:0x33c5008
y.create.l HWIO_PMIC_ARB_OBS5_CHNL249_STATUS_ADDR A:0x33cd008
y.create.l HWIO_PMIC_ARB_OBS5_CHNL250_STATUS_ADDR A:0x33d5008
y.create.l HWIO_PMIC_ARB_OBS5_CHNL251_STATUS_ADDR A:0x33dd008
y.create.l HWIO_PMIC_ARB_OBS5_CHNL252_STATUS_ADDR A:0x33e5008
y.create.l HWIO_PMIC_ARB_OBS5_CHNL253_STATUS_ADDR A:0x33ed008
y.create.l HWIO_PMIC_ARB_OBS5_CHNL254_STATUS_ADDR A:0x33f5008
y.create.l HWIO_PMIC_ARB_OBS5_CHNL255_STATUS_ADDR A:0x33fd008
y.create.l HWIO_PMIC_ARB_OBS6_CHNL0_STATUS_ADDR A:0x2c06008
y.create.l HWIO_PMIC_ARB_OBS6_CHNL1_STATUS_ADDR A:0x2c0e008
y.create.l HWIO_PMIC_ARB_OBS6_CHNL2_STATUS_ADDR A:0x2c16008
y.create.l HWIO_PMIC_ARB_OBS6_CHNL3_STATUS_ADDR A:0x2c1e008
y.create.l HWIO_PMIC_ARB_OBS6_CHNL4_STATUS_ADDR A:0x2c26008
y.create.l HWIO_PMIC_ARB_OBS6_CHNL5_STATUS_ADDR A:0x2c2e008
y.create.l HWIO_PMIC_ARB_OBS6_CHNL6_STATUS_ADDR A:0x2c36008
y.create.l HWIO_PMIC_ARB_OBS6_CHNL7_STATUS_ADDR A:0x2c3e008
y.create.l HWIO_PMIC_ARB_OBS6_CHNL8_STATUS_ADDR A:0x2c46008
y.create.l HWIO_PMIC_ARB_OBS6_CHNL9_STATUS_ADDR A:0x2c4e008
y.create.l HWIO_PMIC_ARB_OBS6_CHNL10_STATUS_ADDR A:0x2c56008
y.create.l HWIO_PMIC_ARB_OBS6_CHNL11_STATUS_ADDR A:0x2c5e008
y.create.l HWIO_PMIC_ARB_OBS6_CHNL12_STATUS_ADDR A:0x2c66008
y.create.l HWIO_PMIC_ARB_OBS6_CHNL13_STATUS_ADDR A:0x2c6e008
y.create.l HWIO_PMIC_ARB_OBS6_CHNL14_STATUS_ADDR A:0x2c76008
y.create.l HWIO_PMIC_ARB_OBS6_CHNL15_STATUS_ADDR A:0x2c7e008
y.create.l HWIO_PMIC_ARB_OBS6_CHNL16_STATUS_ADDR A:0x2c86008
y.create.l HWIO_PMIC_ARB_OBS6_CHNL17_STATUS_ADDR A:0x2c8e008
y.create.l HWIO_PMIC_ARB_OBS6_CHNL18_STATUS_ADDR A:0x2c96008
y.create.l HWIO_PMIC_ARB_OBS6_CHNL19_STATUS_ADDR A:0x2c9e008
y.create.l HWIO_PMIC_ARB_OBS6_CHNL20_STATUS_ADDR A:0x2ca6008
y.create.l HWIO_PMIC_ARB_OBS6_CHNL21_STATUS_ADDR A:0x2cae008
y.create.l HWIO_PMIC_ARB_OBS6_CHNL22_STATUS_ADDR A:0x2cb6008
y.create.l HWIO_PMIC_ARB_OBS6_CHNL23_STATUS_ADDR A:0x2cbe008
y.create.l HWIO_PMIC_ARB_OBS6_CHNL24_STATUS_ADDR A:0x2cc6008
y.create.l HWIO_PMIC_ARB_OBS6_CHNL25_STATUS_ADDR A:0x2cce008
y.create.l HWIO_PMIC_ARB_OBS6_CHNL26_STATUS_ADDR A:0x2cd6008
y.create.l HWIO_PMIC_ARB_OBS6_CHNL27_STATUS_ADDR A:0x2cde008
y.create.l HWIO_PMIC_ARB_OBS6_CHNL28_STATUS_ADDR A:0x2ce6008
y.create.l HWIO_PMIC_ARB_OBS6_CHNL29_STATUS_ADDR A:0x2cee008
y.create.l HWIO_PMIC_ARB_OBS6_CHNL30_STATUS_ADDR A:0x2cf6008
y.create.l HWIO_PMIC_ARB_OBS6_CHNL31_STATUS_ADDR A:0x2cfe008
y.create.l HWIO_PMIC_ARB_OBS6_CHNL32_STATUS_ADDR A:0x2d06008
y.create.l HWIO_PMIC_ARB_OBS6_CHNL33_STATUS_ADDR A:0x2d0e008
y.create.l HWIO_PMIC_ARB_OBS6_CHNL34_STATUS_ADDR A:0x2d16008
y.create.l HWIO_PMIC_ARB_OBS6_CHNL35_STATUS_ADDR A:0x2d1e008
y.create.l HWIO_PMIC_ARB_OBS6_CHNL36_STATUS_ADDR A:0x2d26008
y.create.l HWIO_PMIC_ARB_OBS6_CHNL37_STATUS_ADDR A:0x2d2e008
y.create.l HWIO_PMIC_ARB_OBS6_CHNL38_STATUS_ADDR A:0x2d36008
y.create.l HWIO_PMIC_ARB_OBS6_CHNL39_STATUS_ADDR A:0x2d3e008
y.create.l HWIO_PMIC_ARB_OBS6_CHNL40_STATUS_ADDR A:0x2d46008
y.create.l HWIO_PMIC_ARB_OBS6_CHNL41_STATUS_ADDR A:0x2d4e008
y.create.l HWIO_PMIC_ARB_OBS6_CHNL42_STATUS_ADDR A:0x2d56008
y.create.l HWIO_PMIC_ARB_OBS6_CHNL43_STATUS_ADDR A:0x2d5e008
y.create.l HWIO_PMIC_ARB_OBS6_CHNL44_STATUS_ADDR A:0x2d66008
y.create.l HWIO_PMIC_ARB_OBS6_CHNL45_STATUS_ADDR A:0x2d6e008
y.create.l HWIO_PMIC_ARB_OBS6_CHNL46_STATUS_ADDR A:0x2d76008
y.create.l HWIO_PMIC_ARB_OBS6_CHNL47_STATUS_ADDR A:0x2d7e008
y.create.l HWIO_PMIC_ARB_OBS6_CHNL48_STATUS_ADDR A:0x2d86008
y.create.l HWIO_PMIC_ARB_OBS6_CHNL49_STATUS_ADDR A:0x2d8e008
y.create.l HWIO_PMIC_ARB_OBS6_CHNL50_STATUS_ADDR A:0x2d96008
y.create.l HWIO_PMIC_ARB_OBS6_CHNL51_STATUS_ADDR A:0x2d9e008
y.create.l HWIO_PMIC_ARB_OBS6_CHNL52_STATUS_ADDR A:0x2da6008
y.create.l HWIO_PMIC_ARB_OBS6_CHNL53_STATUS_ADDR A:0x2dae008
y.create.l HWIO_PMIC_ARB_OBS6_CHNL54_STATUS_ADDR A:0x2db6008
y.create.l HWIO_PMIC_ARB_OBS6_CHNL55_STATUS_ADDR A:0x2dbe008
y.create.l HWIO_PMIC_ARB_OBS6_CHNL56_STATUS_ADDR A:0x2dc6008
y.create.l HWIO_PMIC_ARB_OBS6_CHNL57_STATUS_ADDR A:0x2dce008
y.create.l HWIO_PMIC_ARB_OBS6_CHNL58_STATUS_ADDR A:0x2dd6008
y.create.l HWIO_PMIC_ARB_OBS6_CHNL59_STATUS_ADDR A:0x2dde008
y.create.l HWIO_PMIC_ARB_OBS6_CHNL60_STATUS_ADDR A:0x2de6008
y.create.l HWIO_PMIC_ARB_OBS6_CHNL61_STATUS_ADDR A:0x2dee008
y.create.l HWIO_PMIC_ARB_OBS6_CHNL62_STATUS_ADDR A:0x2df6008
y.create.l HWIO_PMIC_ARB_OBS6_CHNL63_STATUS_ADDR A:0x2dfe008
y.create.l HWIO_PMIC_ARB_OBS6_CHNL64_STATUS_ADDR A:0x2e06008
y.create.l HWIO_PMIC_ARB_OBS6_CHNL65_STATUS_ADDR A:0x2e0e008
y.create.l HWIO_PMIC_ARB_OBS6_CHNL66_STATUS_ADDR A:0x2e16008
y.create.l HWIO_PMIC_ARB_OBS6_CHNL67_STATUS_ADDR A:0x2e1e008
y.create.l HWIO_PMIC_ARB_OBS6_CHNL68_STATUS_ADDR A:0x2e26008
y.create.l HWIO_PMIC_ARB_OBS6_CHNL69_STATUS_ADDR A:0x2e2e008
y.create.l HWIO_PMIC_ARB_OBS6_CHNL70_STATUS_ADDR A:0x2e36008
y.create.l HWIO_PMIC_ARB_OBS6_CHNL71_STATUS_ADDR A:0x2e3e008
y.create.l HWIO_PMIC_ARB_OBS6_CHNL72_STATUS_ADDR A:0x2e46008
y.create.l HWIO_PMIC_ARB_OBS6_CHNL73_STATUS_ADDR A:0x2e4e008
y.create.l HWIO_PMIC_ARB_OBS6_CHNL74_STATUS_ADDR A:0x2e56008
y.create.l HWIO_PMIC_ARB_OBS6_CHNL75_STATUS_ADDR A:0x2e5e008
y.create.l HWIO_PMIC_ARB_OBS6_CHNL76_STATUS_ADDR A:0x2e66008
y.create.l HWIO_PMIC_ARB_OBS6_CHNL77_STATUS_ADDR A:0x2e6e008
y.create.l HWIO_PMIC_ARB_OBS6_CHNL78_STATUS_ADDR A:0x2e76008
y.create.l HWIO_PMIC_ARB_OBS6_CHNL79_STATUS_ADDR A:0x2e7e008
y.create.l HWIO_PMIC_ARB_OBS6_CHNL80_STATUS_ADDR A:0x2e86008
y.create.l HWIO_PMIC_ARB_OBS6_CHNL81_STATUS_ADDR A:0x2e8e008
y.create.l HWIO_PMIC_ARB_OBS6_CHNL82_STATUS_ADDR A:0x2e96008
y.create.l HWIO_PMIC_ARB_OBS6_CHNL83_STATUS_ADDR A:0x2e9e008
y.create.l HWIO_PMIC_ARB_OBS6_CHNL84_STATUS_ADDR A:0x2ea6008
y.create.l HWIO_PMIC_ARB_OBS6_CHNL85_STATUS_ADDR A:0x2eae008
y.create.l HWIO_PMIC_ARB_OBS6_CHNL86_STATUS_ADDR A:0x2eb6008
y.create.l HWIO_PMIC_ARB_OBS6_CHNL87_STATUS_ADDR A:0x2ebe008
y.create.l HWIO_PMIC_ARB_OBS6_CHNL88_STATUS_ADDR A:0x2ec6008
y.create.l HWIO_PMIC_ARB_OBS6_CHNL89_STATUS_ADDR A:0x2ece008
y.create.l HWIO_PMIC_ARB_OBS6_CHNL90_STATUS_ADDR A:0x2ed6008
y.create.l HWIO_PMIC_ARB_OBS6_CHNL91_STATUS_ADDR A:0x2ede008
y.create.l HWIO_PMIC_ARB_OBS6_CHNL92_STATUS_ADDR A:0x2ee6008
y.create.l HWIO_PMIC_ARB_OBS6_CHNL93_STATUS_ADDR A:0x2eee008
y.create.l HWIO_PMIC_ARB_OBS6_CHNL94_STATUS_ADDR A:0x2ef6008
y.create.l HWIO_PMIC_ARB_OBS6_CHNL95_STATUS_ADDR A:0x2efe008
y.create.l HWIO_PMIC_ARB_OBS6_CHNL96_STATUS_ADDR A:0x2f06008
y.create.l HWIO_PMIC_ARB_OBS6_CHNL97_STATUS_ADDR A:0x2f0e008
y.create.l HWIO_PMIC_ARB_OBS6_CHNL98_STATUS_ADDR A:0x2f16008
y.create.l HWIO_PMIC_ARB_OBS6_CHNL99_STATUS_ADDR A:0x2f1e008
y.create.l HWIO_PMIC_ARB_OBS6_CHNL100_STATUS_ADDR A:0x2f26008
y.create.l HWIO_PMIC_ARB_OBS6_CHNL101_STATUS_ADDR A:0x2f2e008
y.create.l HWIO_PMIC_ARB_OBS6_CHNL102_STATUS_ADDR A:0x2f36008
y.create.l HWIO_PMIC_ARB_OBS6_CHNL103_STATUS_ADDR A:0x2f3e008
y.create.l HWIO_PMIC_ARB_OBS6_CHNL104_STATUS_ADDR A:0x2f46008
y.create.l HWIO_PMIC_ARB_OBS6_CHNL105_STATUS_ADDR A:0x2f4e008
y.create.l HWIO_PMIC_ARB_OBS6_CHNL106_STATUS_ADDR A:0x2f56008
y.create.l HWIO_PMIC_ARB_OBS6_CHNL107_STATUS_ADDR A:0x2f5e008
y.create.l HWIO_PMIC_ARB_OBS6_CHNL108_STATUS_ADDR A:0x2f66008
y.create.l HWIO_PMIC_ARB_OBS6_CHNL109_STATUS_ADDR A:0x2f6e008
y.create.l HWIO_PMIC_ARB_OBS6_CHNL110_STATUS_ADDR A:0x2f76008
y.create.l HWIO_PMIC_ARB_OBS6_CHNL111_STATUS_ADDR A:0x2f7e008
y.create.l HWIO_PMIC_ARB_OBS6_CHNL112_STATUS_ADDR A:0x2f86008
y.create.l HWIO_PMIC_ARB_OBS6_CHNL113_STATUS_ADDR A:0x2f8e008
y.create.l HWIO_PMIC_ARB_OBS6_CHNL114_STATUS_ADDR A:0x2f96008
y.create.l HWIO_PMIC_ARB_OBS6_CHNL115_STATUS_ADDR A:0x2f9e008
y.create.l HWIO_PMIC_ARB_OBS6_CHNL116_STATUS_ADDR A:0x2fa6008
y.create.l HWIO_PMIC_ARB_OBS6_CHNL117_STATUS_ADDR A:0x2fae008
y.create.l HWIO_PMIC_ARB_OBS6_CHNL118_STATUS_ADDR A:0x2fb6008
y.create.l HWIO_PMIC_ARB_OBS6_CHNL119_STATUS_ADDR A:0x2fbe008
y.create.l HWIO_PMIC_ARB_OBS6_CHNL120_STATUS_ADDR A:0x2fc6008
y.create.l HWIO_PMIC_ARB_OBS6_CHNL121_STATUS_ADDR A:0x2fce008
y.create.l HWIO_PMIC_ARB_OBS6_CHNL122_STATUS_ADDR A:0x2fd6008
y.create.l HWIO_PMIC_ARB_OBS6_CHNL123_STATUS_ADDR A:0x2fde008
y.create.l HWIO_PMIC_ARB_OBS6_CHNL124_STATUS_ADDR A:0x2fe6008
y.create.l HWIO_PMIC_ARB_OBS6_CHNL125_STATUS_ADDR A:0x2fee008
y.create.l HWIO_PMIC_ARB_OBS6_CHNL126_STATUS_ADDR A:0x2ff6008
y.create.l HWIO_PMIC_ARB_OBS6_CHNL127_STATUS_ADDR A:0x2ffe008
y.create.l HWIO_PMIC_ARB_OBS6_CHNL128_STATUS_ADDR A:0x3006008
y.create.l HWIO_PMIC_ARB_OBS6_CHNL129_STATUS_ADDR A:0x300e008
y.create.l HWIO_PMIC_ARB_OBS6_CHNL130_STATUS_ADDR A:0x3016008
y.create.l HWIO_PMIC_ARB_OBS6_CHNL131_STATUS_ADDR A:0x301e008
y.create.l HWIO_PMIC_ARB_OBS6_CHNL132_STATUS_ADDR A:0x3026008
y.create.l HWIO_PMIC_ARB_OBS6_CHNL133_STATUS_ADDR A:0x302e008
y.create.l HWIO_PMIC_ARB_OBS6_CHNL134_STATUS_ADDR A:0x3036008
y.create.l HWIO_PMIC_ARB_OBS6_CHNL135_STATUS_ADDR A:0x303e008
y.create.l HWIO_PMIC_ARB_OBS6_CHNL136_STATUS_ADDR A:0x3046008
y.create.l HWIO_PMIC_ARB_OBS6_CHNL137_STATUS_ADDR A:0x304e008
y.create.l HWIO_PMIC_ARB_OBS6_CHNL138_STATUS_ADDR A:0x3056008
y.create.l HWIO_PMIC_ARB_OBS6_CHNL139_STATUS_ADDR A:0x305e008
y.create.l HWIO_PMIC_ARB_OBS6_CHNL140_STATUS_ADDR A:0x3066008
y.create.l HWIO_PMIC_ARB_OBS6_CHNL141_STATUS_ADDR A:0x306e008
y.create.l HWIO_PMIC_ARB_OBS6_CHNL142_STATUS_ADDR A:0x3076008
y.create.l HWIO_PMIC_ARB_OBS6_CHNL143_STATUS_ADDR A:0x307e008
y.create.l HWIO_PMIC_ARB_OBS6_CHNL144_STATUS_ADDR A:0x3086008
y.create.l HWIO_PMIC_ARB_OBS6_CHNL145_STATUS_ADDR A:0x308e008
y.create.l HWIO_PMIC_ARB_OBS6_CHNL146_STATUS_ADDR A:0x3096008
y.create.l HWIO_PMIC_ARB_OBS6_CHNL147_STATUS_ADDR A:0x309e008
y.create.l HWIO_PMIC_ARB_OBS6_CHNL148_STATUS_ADDR A:0x30a6008
y.create.l HWIO_PMIC_ARB_OBS6_CHNL149_STATUS_ADDR A:0x30ae008
y.create.l HWIO_PMIC_ARB_OBS6_CHNL150_STATUS_ADDR A:0x30b6008
y.create.l HWIO_PMIC_ARB_OBS6_CHNL151_STATUS_ADDR A:0x30be008
y.create.l HWIO_PMIC_ARB_OBS6_CHNL152_STATUS_ADDR A:0x30c6008
y.create.l HWIO_PMIC_ARB_OBS6_CHNL153_STATUS_ADDR A:0x30ce008
y.create.l HWIO_PMIC_ARB_OBS6_CHNL154_STATUS_ADDR A:0x30d6008
y.create.l HWIO_PMIC_ARB_OBS6_CHNL155_STATUS_ADDR A:0x30de008
y.create.l HWIO_PMIC_ARB_OBS6_CHNL156_STATUS_ADDR A:0x30e6008
y.create.l HWIO_PMIC_ARB_OBS6_CHNL157_STATUS_ADDR A:0x30ee008
y.create.l HWIO_PMIC_ARB_OBS6_CHNL158_STATUS_ADDR A:0x30f6008
y.create.l HWIO_PMIC_ARB_OBS6_CHNL159_STATUS_ADDR A:0x30fe008
y.create.l HWIO_PMIC_ARB_OBS6_CHNL160_STATUS_ADDR A:0x3106008
y.create.l HWIO_PMIC_ARB_OBS6_CHNL161_STATUS_ADDR A:0x310e008
y.create.l HWIO_PMIC_ARB_OBS6_CHNL162_STATUS_ADDR A:0x3116008
y.create.l HWIO_PMIC_ARB_OBS6_CHNL163_STATUS_ADDR A:0x311e008
y.create.l HWIO_PMIC_ARB_OBS6_CHNL164_STATUS_ADDR A:0x3126008
y.create.l HWIO_PMIC_ARB_OBS6_CHNL165_STATUS_ADDR A:0x312e008
y.create.l HWIO_PMIC_ARB_OBS6_CHNL166_STATUS_ADDR A:0x3136008
y.create.l HWIO_PMIC_ARB_OBS6_CHNL167_STATUS_ADDR A:0x313e008
y.create.l HWIO_PMIC_ARB_OBS6_CHNL168_STATUS_ADDR A:0x3146008
y.create.l HWIO_PMIC_ARB_OBS6_CHNL169_STATUS_ADDR A:0x314e008
y.create.l HWIO_PMIC_ARB_OBS6_CHNL170_STATUS_ADDR A:0x3156008
y.create.l HWIO_PMIC_ARB_OBS6_CHNL171_STATUS_ADDR A:0x315e008
y.create.l HWIO_PMIC_ARB_OBS6_CHNL172_STATUS_ADDR A:0x3166008
y.create.l HWIO_PMIC_ARB_OBS6_CHNL173_STATUS_ADDR A:0x316e008
y.create.l HWIO_PMIC_ARB_OBS6_CHNL174_STATUS_ADDR A:0x3176008
y.create.l HWIO_PMIC_ARB_OBS6_CHNL175_STATUS_ADDR A:0x317e008
y.create.l HWIO_PMIC_ARB_OBS6_CHNL176_STATUS_ADDR A:0x3186008
y.create.l HWIO_PMIC_ARB_OBS6_CHNL177_STATUS_ADDR A:0x318e008
y.create.l HWIO_PMIC_ARB_OBS6_CHNL178_STATUS_ADDR A:0x3196008
y.create.l HWIO_PMIC_ARB_OBS6_CHNL179_STATUS_ADDR A:0x319e008
y.create.l HWIO_PMIC_ARB_OBS6_CHNL180_STATUS_ADDR A:0x31a6008
y.create.l HWIO_PMIC_ARB_OBS6_CHNL181_STATUS_ADDR A:0x31ae008
y.create.l HWIO_PMIC_ARB_OBS6_CHNL182_STATUS_ADDR A:0x31b6008
y.create.l HWIO_PMIC_ARB_OBS6_CHNL183_STATUS_ADDR A:0x31be008
y.create.l HWIO_PMIC_ARB_OBS6_CHNL184_STATUS_ADDR A:0x31c6008
y.create.l HWIO_PMIC_ARB_OBS6_CHNL185_STATUS_ADDR A:0x31ce008
y.create.l HWIO_PMIC_ARB_OBS6_CHNL186_STATUS_ADDR A:0x31d6008
y.create.l HWIO_PMIC_ARB_OBS6_CHNL187_STATUS_ADDR A:0x31de008
y.create.l HWIO_PMIC_ARB_OBS6_CHNL188_STATUS_ADDR A:0x31e6008
y.create.l HWIO_PMIC_ARB_OBS6_CHNL189_STATUS_ADDR A:0x31ee008
y.create.l HWIO_PMIC_ARB_OBS6_CHNL190_STATUS_ADDR A:0x31f6008
y.create.l HWIO_PMIC_ARB_OBS6_CHNL191_STATUS_ADDR A:0x31fe008
y.create.l HWIO_PMIC_ARB_OBS6_CHNL192_STATUS_ADDR A:0x3206008
y.create.l HWIO_PMIC_ARB_OBS6_CHNL193_STATUS_ADDR A:0x320e008
y.create.l HWIO_PMIC_ARB_OBS6_CHNL194_STATUS_ADDR A:0x3216008
y.create.l HWIO_PMIC_ARB_OBS6_CHNL195_STATUS_ADDR A:0x321e008
y.create.l HWIO_PMIC_ARB_OBS6_CHNL196_STATUS_ADDR A:0x3226008
y.create.l HWIO_PMIC_ARB_OBS6_CHNL197_STATUS_ADDR A:0x322e008
y.create.l HWIO_PMIC_ARB_OBS6_CHNL198_STATUS_ADDR A:0x3236008
y.create.l HWIO_PMIC_ARB_OBS6_CHNL199_STATUS_ADDR A:0x323e008
y.create.l HWIO_PMIC_ARB_OBS6_CHNL200_STATUS_ADDR A:0x3246008
y.create.l HWIO_PMIC_ARB_OBS6_CHNL201_STATUS_ADDR A:0x324e008
y.create.l HWIO_PMIC_ARB_OBS6_CHNL202_STATUS_ADDR A:0x3256008
y.create.l HWIO_PMIC_ARB_OBS6_CHNL203_STATUS_ADDR A:0x325e008
y.create.l HWIO_PMIC_ARB_OBS6_CHNL204_STATUS_ADDR A:0x3266008
y.create.l HWIO_PMIC_ARB_OBS6_CHNL205_STATUS_ADDR A:0x326e008
y.create.l HWIO_PMIC_ARB_OBS6_CHNL206_STATUS_ADDR A:0x3276008
y.create.l HWIO_PMIC_ARB_OBS6_CHNL207_STATUS_ADDR A:0x327e008
y.create.l HWIO_PMIC_ARB_OBS6_CHNL208_STATUS_ADDR A:0x3286008
y.create.l HWIO_PMIC_ARB_OBS6_CHNL209_STATUS_ADDR A:0x328e008
y.create.l HWIO_PMIC_ARB_OBS6_CHNL210_STATUS_ADDR A:0x3296008
y.create.l HWIO_PMIC_ARB_OBS6_CHNL211_STATUS_ADDR A:0x329e008
y.create.l HWIO_PMIC_ARB_OBS6_CHNL212_STATUS_ADDR A:0x32a6008
y.create.l HWIO_PMIC_ARB_OBS6_CHNL213_STATUS_ADDR A:0x32ae008
y.create.l HWIO_PMIC_ARB_OBS6_CHNL214_STATUS_ADDR A:0x32b6008
y.create.l HWIO_PMIC_ARB_OBS6_CHNL215_STATUS_ADDR A:0x32be008
y.create.l HWIO_PMIC_ARB_OBS6_CHNL216_STATUS_ADDR A:0x32c6008
y.create.l HWIO_PMIC_ARB_OBS6_CHNL217_STATUS_ADDR A:0x32ce008
y.create.l HWIO_PMIC_ARB_OBS6_CHNL218_STATUS_ADDR A:0x32d6008
y.create.l HWIO_PMIC_ARB_OBS6_CHNL219_STATUS_ADDR A:0x32de008
y.create.l HWIO_PMIC_ARB_OBS6_CHNL220_STATUS_ADDR A:0x32e6008
y.create.l HWIO_PMIC_ARB_OBS6_CHNL221_STATUS_ADDR A:0x32ee008
y.create.l HWIO_PMIC_ARB_OBS6_CHNL222_STATUS_ADDR A:0x32f6008
y.create.l HWIO_PMIC_ARB_OBS6_CHNL223_STATUS_ADDR A:0x32fe008
y.create.l HWIO_PMIC_ARB_OBS6_CHNL224_STATUS_ADDR A:0x3306008
y.create.l HWIO_PMIC_ARB_OBS6_CHNL225_STATUS_ADDR A:0x330e008
y.create.l HWIO_PMIC_ARB_OBS6_CHNL226_STATUS_ADDR A:0x3316008
y.create.l HWIO_PMIC_ARB_OBS6_CHNL227_STATUS_ADDR A:0x331e008
y.create.l HWIO_PMIC_ARB_OBS6_CHNL228_STATUS_ADDR A:0x3326008
y.create.l HWIO_PMIC_ARB_OBS6_CHNL229_STATUS_ADDR A:0x332e008
y.create.l HWIO_PMIC_ARB_OBS6_CHNL230_STATUS_ADDR A:0x3336008
y.create.l HWIO_PMIC_ARB_OBS6_CHNL231_STATUS_ADDR A:0x333e008
y.create.l HWIO_PMIC_ARB_OBS6_CHNL232_STATUS_ADDR A:0x3346008
y.create.l HWIO_PMIC_ARB_OBS6_CHNL233_STATUS_ADDR A:0x334e008
y.create.l HWIO_PMIC_ARB_OBS6_CHNL234_STATUS_ADDR A:0x3356008
y.create.l HWIO_PMIC_ARB_OBS6_CHNL235_STATUS_ADDR A:0x335e008
y.create.l HWIO_PMIC_ARB_OBS6_CHNL236_STATUS_ADDR A:0x3366008
y.create.l HWIO_PMIC_ARB_OBS6_CHNL237_STATUS_ADDR A:0x336e008
y.create.l HWIO_PMIC_ARB_OBS6_CHNL238_STATUS_ADDR A:0x3376008
y.create.l HWIO_PMIC_ARB_OBS6_CHNL239_STATUS_ADDR A:0x337e008
y.create.l HWIO_PMIC_ARB_OBS6_CHNL240_STATUS_ADDR A:0x3386008
y.create.l HWIO_PMIC_ARB_OBS6_CHNL241_STATUS_ADDR A:0x338e008
y.create.l HWIO_PMIC_ARB_OBS6_CHNL242_STATUS_ADDR A:0x3396008
y.create.l HWIO_PMIC_ARB_OBS6_CHNL243_STATUS_ADDR A:0x339e008
y.create.l HWIO_PMIC_ARB_OBS6_CHNL244_STATUS_ADDR A:0x33a6008
y.create.l HWIO_PMIC_ARB_OBS6_CHNL245_STATUS_ADDR A:0x33ae008
y.create.l HWIO_PMIC_ARB_OBS6_CHNL246_STATUS_ADDR A:0x33b6008
y.create.l HWIO_PMIC_ARB_OBS6_CHNL247_STATUS_ADDR A:0x33be008
y.create.l HWIO_PMIC_ARB_OBS6_CHNL248_STATUS_ADDR A:0x33c6008
y.create.l HWIO_PMIC_ARB_OBS6_CHNL249_STATUS_ADDR A:0x33ce008
y.create.l HWIO_PMIC_ARB_OBS6_CHNL250_STATUS_ADDR A:0x33d6008
y.create.l HWIO_PMIC_ARB_OBS6_CHNL251_STATUS_ADDR A:0x33de008
y.create.l HWIO_PMIC_ARB_OBS6_CHNL252_STATUS_ADDR A:0x33e6008
y.create.l HWIO_PMIC_ARB_OBS6_CHNL253_STATUS_ADDR A:0x33ee008
y.create.l HWIO_PMIC_ARB_OBS6_CHNL254_STATUS_ADDR A:0x33f6008
y.create.l HWIO_PMIC_ARB_OBS6_CHNL255_STATUS_ADDR A:0x33fe008
y.create.l HWIO_PMIC_ARB_OBS0_CHNL0_RDATA0_ADDR A:0x2c00018
y.create.l HWIO_PMIC_ARB_OBS0_CHNL1_RDATA0_ADDR A:0x2c08018
y.create.l HWIO_PMIC_ARB_OBS0_CHNL2_RDATA0_ADDR A:0x2c10018
y.create.l HWIO_PMIC_ARB_OBS0_CHNL3_RDATA0_ADDR A:0x2c18018
y.create.l HWIO_PMIC_ARB_OBS0_CHNL4_RDATA0_ADDR A:0x2c20018
y.create.l HWIO_PMIC_ARB_OBS0_CHNL5_RDATA0_ADDR A:0x2c28018
y.create.l HWIO_PMIC_ARB_OBS0_CHNL6_RDATA0_ADDR A:0x2c30018
y.create.l HWIO_PMIC_ARB_OBS0_CHNL7_RDATA0_ADDR A:0x2c38018
y.create.l HWIO_PMIC_ARB_OBS0_CHNL8_RDATA0_ADDR A:0x2c40018
y.create.l HWIO_PMIC_ARB_OBS0_CHNL9_RDATA0_ADDR A:0x2c48018
y.create.l HWIO_PMIC_ARB_OBS0_CHNL10_RDATA0_ADDR A:0x2c50018
y.create.l HWIO_PMIC_ARB_OBS0_CHNL11_RDATA0_ADDR A:0x2c58018
y.create.l HWIO_PMIC_ARB_OBS0_CHNL12_RDATA0_ADDR A:0x2c60018
y.create.l HWIO_PMIC_ARB_OBS0_CHNL13_RDATA0_ADDR A:0x2c68018
y.create.l HWIO_PMIC_ARB_OBS0_CHNL14_RDATA0_ADDR A:0x2c70018
y.create.l HWIO_PMIC_ARB_OBS0_CHNL15_RDATA0_ADDR A:0x2c78018
y.create.l HWIO_PMIC_ARB_OBS0_CHNL16_RDATA0_ADDR A:0x2c80018
y.create.l HWIO_PMIC_ARB_OBS0_CHNL17_RDATA0_ADDR A:0x2c88018
y.create.l HWIO_PMIC_ARB_OBS0_CHNL18_RDATA0_ADDR A:0x2c90018
y.create.l HWIO_PMIC_ARB_OBS0_CHNL19_RDATA0_ADDR A:0x2c98018
y.create.l HWIO_PMIC_ARB_OBS0_CHNL20_RDATA0_ADDR A:0x2ca0018
y.create.l HWIO_PMIC_ARB_OBS0_CHNL21_RDATA0_ADDR A:0x2ca8018
y.create.l HWIO_PMIC_ARB_OBS0_CHNL22_RDATA0_ADDR A:0x2cb0018
y.create.l HWIO_PMIC_ARB_OBS0_CHNL23_RDATA0_ADDR A:0x2cb8018
y.create.l HWIO_PMIC_ARB_OBS0_CHNL24_RDATA0_ADDR A:0x2cc0018
y.create.l HWIO_PMIC_ARB_OBS0_CHNL25_RDATA0_ADDR A:0x2cc8018
y.create.l HWIO_PMIC_ARB_OBS0_CHNL26_RDATA0_ADDR A:0x2cd0018
y.create.l HWIO_PMIC_ARB_OBS0_CHNL27_RDATA0_ADDR A:0x2cd8018
y.create.l HWIO_PMIC_ARB_OBS0_CHNL28_RDATA0_ADDR A:0x2ce0018
y.create.l HWIO_PMIC_ARB_OBS0_CHNL29_RDATA0_ADDR A:0x2ce8018
y.create.l HWIO_PMIC_ARB_OBS0_CHNL30_RDATA0_ADDR A:0x2cf0018
y.create.l HWIO_PMIC_ARB_OBS0_CHNL31_RDATA0_ADDR A:0x2cf8018
y.create.l HWIO_PMIC_ARB_OBS0_CHNL32_RDATA0_ADDR A:0x2d00018
y.create.l HWIO_PMIC_ARB_OBS0_CHNL33_RDATA0_ADDR A:0x2d08018
y.create.l HWIO_PMIC_ARB_OBS0_CHNL34_RDATA0_ADDR A:0x2d10018
y.create.l HWIO_PMIC_ARB_OBS0_CHNL35_RDATA0_ADDR A:0x2d18018
y.create.l HWIO_PMIC_ARB_OBS0_CHNL36_RDATA0_ADDR A:0x2d20018
y.create.l HWIO_PMIC_ARB_OBS0_CHNL37_RDATA0_ADDR A:0x2d28018
y.create.l HWIO_PMIC_ARB_OBS0_CHNL38_RDATA0_ADDR A:0x2d30018
y.create.l HWIO_PMIC_ARB_OBS0_CHNL39_RDATA0_ADDR A:0x2d38018
y.create.l HWIO_PMIC_ARB_OBS0_CHNL40_RDATA0_ADDR A:0x2d40018
y.create.l HWIO_PMIC_ARB_OBS0_CHNL41_RDATA0_ADDR A:0x2d48018
y.create.l HWIO_PMIC_ARB_OBS0_CHNL42_RDATA0_ADDR A:0x2d50018
y.create.l HWIO_PMIC_ARB_OBS0_CHNL43_RDATA0_ADDR A:0x2d58018
y.create.l HWIO_PMIC_ARB_OBS0_CHNL44_RDATA0_ADDR A:0x2d60018
y.create.l HWIO_PMIC_ARB_OBS0_CHNL45_RDATA0_ADDR A:0x2d68018
y.create.l HWIO_PMIC_ARB_OBS0_CHNL46_RDATA0_ADDR A:0x2d70018
y.create.l HWIO_PMIC_ARB_OBS0_CHNL47_RDATA0_ADDR A:0x2d78018
y.create.l HWIO_PMIC_ARB_OBS0_CHNL48_RDATA0_ADDR A:0x2d80018
y.create.l HWIO_PMIC_ARB_OBS0_CHNL49_RDATA0_ADDR A:0x2d88018
y.create.l HWIO_PMIC_ARB_OBS0_CHNL50_RDATA0_ADDR A:0x2d90018
y.create.l HWIO_PMIC_ARB_OBS0_CHNL51_RDATA0_ADDR A:0x2d98018
y.create.l HWIO_PMIC_ARB_OBS0_CHNL52_RDATA0_ADDR A:0x2da0018
y.create.l HWIO_PMIC_ARB_OBS0_CHNL53_RDATA0_ADDR A:0x2da8018
y.create.l HWIO_PMIC_ARB_OBS0_CHNL54_RDATA0_ADDR A:0x2db0018
y.create.l HWIO_PMIC_ARB_OBS0_CHNL55_RDATA0_ADDR A:0x2db8018
y.create.l HWIO_PMIC_ARB_OBS0_CHNL56_RDATA0_ADDR A:0x2dc0018
y.create.l HWIO_PMIC_ARB_OBS0_CHNL57_RDATA0_ADDR A:0x2dc8018
y.create.l HWIO_PMIC_ARB_OBS0_CHNL58_RDATA0_ADDR A:0x2dd0018
y.create.l HWIO_PMIC_ARB_OBS0_CHNL59_RDATA0_ADDR A:0x2dd8018
y.create.l HWIO_PMIC_ARB_OBS0_CHNL60_RDATA0_ADDR A:0x2de0018
y.create.l HWIO_PMIC_ARB_OBS0_CHNL61_RDATA0_ADDR A:0x2de8018
y.create.l HWIO_PMIC_ARB_OBS0_CHNL62_RDATA0_ADDR A:0x2df0018
y.create.l HWIO_PMIC_ARB_OBS0_CHNL63_RDATA0_ADDR A:0x2df8018
y.create.l HWIO_PMIC_ARB_OBS0_CHNL64_RDATA0_ADDR A:0x2e00018
y.create.l HWIO_PMIC_ARB_OBS0_CHNL65_RDATA0_ADDR A:0x2e08018
y.create.l HWIO_PMIC_ARB_OBS0_CHNL66_RDATA0_ADDR A:0x2e10018
y.create.l HWIO_PMIC_ARB_OBS0_CHNL67_RDATA0_ADDR A:0x2e18018
y.create.l HWIO_PMIC_ARB_OBS0_CHNL68_RDATA0_ADDR A:0x2e20018
y.create.l HWIO_PMIC_ARB_OBS0_CHNL69_RDATA0_ADDR A:0x2e28018
y.create.l HWIO_PMIC_ARB_OBS0_CHNL70_RDATA0_ADDR A:0x2e30018
y.create.l HWIO_PMIC_ARB_OBS0_CHNL71_RDATA0_ADDR A:0x2e38018
y.create.l HWIO_PMIC_ARB_OBS0_CHNL72_RDATA0_ADDR A:0x2e40018
y.create.l HWIO_PMIC_ARB_OBS0_CHNL73_RDATA0_ADDR A:0x2e48018
y.create.l HWIO_PMIC_ARB_OBS0_CHNL74_RDATA0_ADDR A:0x2e50018
y.create.l HWIO_PMIC_ARB_OBS0_CHNL75_RDATA0_ADDR A:0x2e58018
y.create.l HWIO_PMIC_ARB_OBS0_CHNL76_RDATA0_ADDR A:0x2e60018
y.create.l HWIO_PMIC_ARB_OBS0_CHNL77_RDATA0_ADDR A:0x2e68018
y.create.l HWIO_PMIC_ARB_OBS0_CHNL78_RDATA0_ADDR A:0x2e70018
y.create.l HWIO_PMIC_ARB_OBS0_CHNL79_RDATA0_ADDR A:0x2e78018
y.create.l HWIO_PMIC_ARB_OBS0_CHNL80_RDATA0_ADDR A:0x2e80018
y.create.l HWIO_PMIC_ARB_OBS0_CHNL81_RDATA0_ADDR A:0x2e88018
y.create.l HWIO_PMIC_ARB_OBS0_CHNL82_RDATA0_ADDR A:0x2e90018
y.create.l HWIO_PMIC_ARB_OBS0_CHNL83_RDATA0_ADDR A:0x2e98018
y.create.l HWIO_PMIC_ARB_OBS0_CHNL84_RDATA0_ADDR A:0x2ea0018
y.create.l HWIO_PMIC_ARB_OBS0_CHNL85_RDATA0_ADDR A:0x2ea8018
y.create.l HWIO_PMIC_ARB_OBS0_CHNL86_RDATA0_ADDR A:0x2eb0018
y.create.l HWIO_PMIC_ARB_OBS0_CHNL87_RDATA0_ADDR A:0x2eb8018
y.create.l HWIO_PMIC_ARB_OBS0_CHNL88_RDATA0_ADDR A:0x2ec0018
y.create.l HWIO_PMIC_ARB_OBS0_CHNL89_RDATA0_ADDR A:0x2ec8018
y.create.l HWIO_PMIC_ARB_OBS0_CHNL90_RDATA0_ADDR A:0x2ed0018
y.create.l HWIO_PMIC_ARB_OBS0_CHNL91_RDATA0_ADDR A:0x2ed8018
y.create.l HWIO_PMIC_ARB_OBS0_CHNL92_RDATA0_ADDR A:0x2ee0018
y.create.l HWIO_PMIC_ARB_OBS0_CHNL93_RDATA0_ADDR A:0x2ee8018
y.create.l HWIO_PMIC_ARB_OBS0_CHNL94_RDATA0_ADDR A:0x2ef0018
y.create.l HWIO_PMIC_ARB_OBS0_CHNL95_RDATA0_ADDR A:0x2ef8018
y.create.l HWIO_PMIC_ARB_OBS0_CHNL96_RDATA0_ADDR A:0x2f00018
y.create.l HWIO_PMIC_ARB_OBS0_CHNL97_RDATA0_ADDR A:0x2f08018
y.create.l HWIO_PMIC_ARB_OBS0_CHNL98_RDATA0_ADDR A:0x2f10018
y.create.l HWIO_PMIC_ARB_OBS0_CHNL99_RDATA0_ADDR A:0x2f18018
y.create.l HWIO_PMIC_ARB_OBS0_CHNL100_RDATA0_ADDR A:0x2f20018
y.create.l HWIO_PMIC_ARB_OBS0_CHNL101_RDATA0_ADDR A:0x2f28018
y.create.l HWIO_PMIC_ARB_OBS0_CHNL102_RDATA0_ADDR A:0x2f30018
y.create.l HWIO_PMIC_ARB_OBS0_CHNL103_RDATA0_ADDR A:0x2f38018
y.create.l HWIO_PMIC_ARB_OBS0_CHNL104_RDATA0_ADDR A:0x2f40018
y.create.l HWIO_PMIC_ARB_OBS0_CHNL105_RDATA0_ADDR A:0x2f48018
y.create.l HWIO_PMIC_ARB_OBS0_CHNL106_RDATA0_ADDR A:0x2f50018
y.create.l HWIO_PMIC_ARB_OBS0_CHNL107_RDATA0_ADDR A:0x2f58018
y.create.l HWIO_PMIC_ARB_OBS0_CHNL108_RDATA0_ADDR A:0x2f60018
y.create.l HWIO_PMIC_ARB_OBS0_CHNL109_RDATA0_ADDR A:0x2f68018
y.create.l HWIO_PMIC_ARB_OBS0_CHNL110_RDATA0_ADDR A:0x2f70018
y.create.l HWIO_PMIC_ARB_OBS0_CHNL111_RDATA0_ADDR A:0x2f78018
y.create.l HWIO_PMIC_ARB_OBS0_CHNL112_RDATA0_ADDR A:0x2f80018
y.create.l HWIO_PMIC_ARB_OBS0_CHNL113_RDATA0_ADDR A:0x2f88018
y.create.l HWIO_PMIC_ARB_OBS0_CHNL114_RDATA0_ADDR A:0x2f90018
y.create.l HWIO_PMIC_ARB_OBS0_CHNL115_RDATA0_ADDR A:0x2f98018
y.create.l HWIO_PMIC_ARB_OBS0_CHNL116_RDATA0_ADDR A:0x2fa0018
y.create.l HWIO_PMIC_ARB_OBS0_CHNL117_RDATA0_ADDR A:0x2fa8018
y.create.l HWIO_PMIC_ARB_OBS0_CHNL118_RDATA0_ADDR A:0x2fb0018
y.create.l HWIO_PMIC_ARB_OBS0_CHNL119_RDATA0_ADDR A:0x2fb8018
y.create.l HWIO_PMIC_ARB_OBS0_CHNL120_RDATA0_ADDR A:0x2fc0018
y.create.l HWIO_PMIC_ARB_OBS0_CHNL121_RDATA0_ADDR A:0x2fc8018
y.create.l HWIO_PMIC_ARB_OBS0_CHNL122_RDATA0_ADDR A:0x2fd0018
y.create.l HWIO_PMIC_ARB_OBS0_CHNL123_RDATA0_ADDR A:0x2fd8018
y.create.l HWIO_PMIC_ARB_OBS0_CHNL124_RDATA0_ADDR A:0x2fe0018
y.create.l HWIO_PMIC_ARB_OBS0_CHNL125_RDATA0_ADDR A:0x2fe8018
y.create.l HWIO_PMIC_ARB_OBS0_CHNL126_RDATA0_ADDR A:0x2ff0018
y.create.l HWIO_PMIC_ARB_OBS0_CHNL127_RDATA0_ADDR A:0x2ff8018
y.create.l HWIO_PMIC_ARB_OBS0_CHNL128_RDATA0_ADDR A:0x3000018
y.create.l HWIO_PMIC_ARB_OBS0_CHNL129_RDATA0_ADDR A:0x3008018
y.create.l HWIO_PMIC_ARB_OBS0_CHNL130_RDATA0_ADDR A:0x3010018
y.create.l HWIO_PMIC_ARB_OBS0_CHNL131_RDATA0_ADDR A:0x3018018
y.create.l HWIO_PMIC_ARB_OBS0_CHNL132_RDATA0_ADDR A:0x3020018
y.create.l HWIO_PMIC_ARB_OBS0_CHNL133_RDATA0_ADDR A:0x3028018
y.create.l HWIO_PMIC_ARB_OBS0_CHNL134_RDATA0_ADDR A:0x3030018
y.create.l HWIO_PMIC_ARB_OBS0_CHNL135_RDATA0_ADDR A:0x3038018
y.create.l HWIO_PMIC_ARB_OBS0_CHNL136_RDATA0_ADDR A:0x3040018
y.create.l HWIO_PMIC_ARB_OBS0_CHNL137_RDATA0_ADDR A:0x3048018
y.create.l HWIO_PMIC_ARB_OBS0_CHNL138_RDATA0_ADDR A:0x3050018
y.create.l HWIO_PMIC_ARB_OBS0_CHNL139_RDATA0_ADDR A:0x3058018
y.create.l HWIO_PMIC_ARB_OBS0_CHNL140_RDATA0_ADDR A:0x3060018
y.create.l HWIO_PMIC_ARB_OBS0_CHNL141_RDATA0_ADDR A:0x3068018
y.create.l HWIO_PMIC_ARB_OBS0_CHNL142_RDATA0_ADDR A:0x3070018
y.create.l HWIO_PMIC_ARB_OBS0_CHNL143_RDATA0_ADDR A:0x3078018
y.create.l HWIO_PMIC_ARB_OBS0_CHNL144_RDATA0_ADDR A:0x3080018
y.create.l HWIO_PMIC_ARB_OBS0_CHNL145_RDATA0_ADDR A:0x3088018
y.create.l HWIO_PMIC_ARB_OBS0_CHNL146_RDATA0_ADDR A:0x3090018
y.create.l HWIO_PMIC_ARB_OBS0_CHNL147_RDATA0_ADDR A:0x3098018
y.create.l HWIO_PMIC_ARB_OBS0_CHNL148_RDATA0_ADDR A:0x30a0018
y.create.l HWIO_PMIC_ARB_OBS0_CHNL149_RDATA0_ADDR A:0x30a8018
y.create.l HWIO_PMIC_ARB_OBS0_CHNL150_RDATA0_ADDR A:0x30b0018
y.create.l HWIO_PMIC_ARB_OBS0_CHNL151_RDATA0_ADDR A:0x30b8018
y.create.l HWIO_PMIC_ARB_OBS0_CHNL152_RDATA0_ADDR A:0x30c0018
y.create.l HWIO_PMIC_ARB_OBS0_CHNL153_RDATA0_ADDR A:0x30c8018
y.create.l HWIO_PMIC_ARB_OBS0_CHNL154_RDATA0_ADDR A:0x30d0018
y.create.l HWIO_PMIC_ARB_OBS0_CHNL155_RDATA0_ADDR A:0x30d8018
y.create.l HWIO_PMIC_ARB_OBS0_CHNL156_RDATA0_ADDR A:0x30e0018
y.create.l HWIO_PMIC_ARB_OBS0_CHNL157_RDATA0_ADDR A:0x30e8018
y.create.l HWIO_PMIC_ARB_OBS0_CHNL158_RDATA0_ADDR A:0x30f0018
y.create.l HWIO_PMIC_ARB_OBS0_CHNL159_RDATA0_ADDR A:0x30f8018
y.create.l HWIO_PMIC_ARB_OBS0_CHNL160_RDATA0_ADDR A:0x3100018
y.create.l HWIO_PMIC_ARB_OBS0_CHNL161_RDATA0_ADDR A:0x3108018
y.create.l HWIO_PMIC_ARB_OBS0_CHNL162_RDATA0_ADDR A:0x3110018
y.create.l HWIO_PMIC_ARB_OBS0_CHNL163_RDATA0_ADDR A:0x3118018
y.create.l HWIO_PMIC_ARB_OBS0_CHNL164_RDATA0_ADDR A:0x3120018
y.create.l HWIO_PMIC_ARB_OBS0_CHNL165_RDATA0_ADDR A:0x3128018
y.create.l HWIO_PMIC_ARB_OBS0_CHNL166_RDATA0_ADDR A:0x3130018
y.create.l HWIO_PMIC_ARB_OBS0_CHNL167_RDATA0_ADDR A:0x3138018
y.create.l HWIO_PMIC_ARB_OBS0_CHNL168_RDATA0_ADDR A:0x3140018
y.create.l HWIO_PMIC_ARB_OBS0_CHNL169_RDATA0_ADDR A:0x3148018
y.create.l HWIO_PMIC_ARB_OBS0_CHNL170_RDATA0_ADDR A:0x3150018
y.create.l HWIO_PMIC_ARB_OBS0_CHNL171_RDATA0_ADDR A:0x3158018
y.create.l HWIO_PMIC_ARB_OBS0_CHNL172_RDATA0_ADDR A:0x3160018
y.create.l HWIO_PMIC_ARB_OBS0_CHNL173_RDATA0_ADDR A:0x3168018
y.create.l HWIO_PMIC_ARB_OBS0_CHNL174_RDATA0_ADDR A:0x3170018
y.create.l HWIO_PMIC_ARB_OBS0_CHNL175_RDATA0_ADDR A:0x3178018
y.create.l HWIO_PMIC_ARB_OBS0_CHNL176_RDATA0_ADDR A:0x3180018
y.create.l HWIO_PMIC_ARB_OBS0_CHNL177_RDATA0_ADDR A:0x3188018
y.create.l HWIO_PMIC_ARB_OBS0_CHNL178_RDATA0_ADDR A:0x3190018
y.create.l HWIO_PMIC_ARB_OBS0_CHNL179_RDATA0_ADDR A:0x3198018
y.create.l HWIO_PMIC_ARB_OBS0_CHNL180_RDATA0_ADDR A:0x31a0018
y.create.l HWIO_PMIC_ARB_OBS0_CHNL181_RDATA0_ADDR A:0x31a8018
y.create.l HWIO_PMIC_ARB_OBS0_CHNL182_RDATA0_ADDR A:0x31b0018
y.create.l HWIO_PMIC_ARB_OBS0_CHNL183_RDATA0_ADDR A:0x31b8018
y.create.l HWIO_PMIC_ARB_OBS0_CHNL184_RDATA0_ADDR A:0x31c0018
y.create.l HWIO_PMIC_ARB_OBS0_CHNL185_RDATA0_ADDR A:0x31c8018
y.create.l HWIO_PMIC_ARB_OBS0_CHNL186_RDATA0_ADDR A:0x31d0018
y.create.l HWIO_PMIC_ARB_OBS0_CHNL187_RDATA0_ADDR A:0x31d8018
y.create.l HWIO_PMIC_ARB_OBS0_CHNL188_RDATA0_ADDR A:0x31e0018
y.create.l HWIO_PMIC_ARB_OBS0_CHNL189_RDATA0_ADDR A:0x31e8018
y.create.l HWIO_PMIC_ARB_OBS0_CHNL190_RDATA0_ADDR A:0x31f0018
y.create.l HWIO_PMIC_ARB_OBS0_CHNL191_RDATA0_ADDR A:0x31f8018
y.create.l HWIO_PMIC_ARB_OBS0_CHNL192_RDATA0_ADDR A:0x3200018
y.create.l HWIO_PMIC_ARB_OBS0_CHNL193_RDATA0_ADDR A:0x3208018
y.create.l HWIO_PMIC_ARB_OBS0_CHNL194_RDATA0_ADDR A:0x3210018
y.create.l HWIO_PMIC_ARB_OBS0_CHNL195_RDATA0_ADDR A:0x3218018
y.create.l HWIO_PMIC_ARB_OBS0_CHNL196_RDATA0_ADDR A:0x3220018
y.create.l HWIO_PMIC_ARB_OBS0_CHNL197_RDATA0_ADDR A:0x3228018
y.create.l HWIO_PMIC_ARB_OBS0_CHNL198_RDATA0_ADDR A:0x3230018
y.create.l HWIO_PMIC_ARB_OBS0_CHNL199_RDATA0_ADDR A:0x3238018
y.create.l HWIO_PMIC_ARB_OBS0_CHNL200_RDATA0_ADDR A:0x3240018
y.create.l HWIO_PMIC_ARB_OBS0_CHNL201_RDATA0_ADDR A:0x3248018
y.create.l HWIO_PMIC_ARB_OBS0_CHNL202_RDATA0_ADDR A:0x3250018
y.create.l HWIO_PMIC_ARB_OBS0_CHNL203_RDATA0_ADDR A:0x3258018
y.create.l HWIO_PMIC_ARB_OBS0_CHNL204_RDATA0_ADDR A:0x3260018
y.create.l HWIO_PMIC_ARB_OBS0_CHNL205_RDATA0_ADDR A:0x3268018
y.create.l HWIO_PMIC_ARB_OBS0_CHNL206_RDATA0_ADDR A:0x3270018
y.create.l HWIO_PMIC_ARB_OBS0_CHNL207_RDATA0_ADDR A:0x3278018
y.create.l HWIO_PMIC_ARB_OBS0_CHNL208_RDATA0_ADDR A:0x3280018
y.create.l HWIO_PMIC_ARB_OBS0_CHNL209_RDATA0_ADDR A:0x3288018
y.create.l HWIO_PMIC_ARB_OBS0_CHNL210_RDATA0_ADDR A:0x3290018
y.create.l HWIO_PMIC_ARB_OBS0_CHNL211_RDATA0_ADDR A:0x3298018
y.create.l HWIO_PMIC_ARB_OBS0_CHNL212_RDATA0_ADDR A:0x32a0018
y.create.l HWIO_PMIC_ARB_OBS0_CHNL213_RDATA0_ADDR A:0x32a8018
y.create.l HWIO_PMIC_ARB_OBS0_CHNL214_RDATA0_ADDR A:0x32b0018
y.create.l HWIO_PMIC_ARB_OBS0_CHNL215_RDATA0_ADDR A:0x32b8018
y.create.l HWIO_PMIC_ARB_OBS0_CHNL216_RDATA0_ADDR A:0x32c0018
y.create.l HWIO_PMIC_ARB_OBS0_CHNL217_RDATA0_ADDR A:0x32c8018
y.create.l HWIO_PMIC_ARB_OBS0_CHNL218_RDATA0_ADDR A:0x32d0018
y.create.l HWIO_PMIC_ARB_OBS0_CHNL219_RDATA0_ADDR A:0x32d8018
y.create.l HWIO_PMIC_ARB_OBS0_CHNL220_RDATA0_ADDR A:0x32e0018
y.create.l HWIO_PMIC_ARB_OBS0_CHNL221_RDATA0_ADDR A:0x32e8018
y.create.l HWIO_PMIC_ARB_OBS0_CHNL222_RDATA0_ADDR A:0x32f0018
y.create.l HWIO_PMIC_ARB_OBS0_CHNL223_RDATA0_ADDR A:0x32f8018
y.create.l HWIO_PMIC_ARB_OBS0_CHNL224_RDATA0_ADDR A:0x3300018
y.create.l HWIO_PMIC_ARB_OBS0_CHNL225_RDATA0_ADDR A:0x3308018
y.create.l HWIO_PMIC_ARB_OBS0_CHNL226_RDATA0_ADDR A:0x3310018
y.create.l HWIO_PMIC_ARB_OBS0_CHNL227_RDATA0_ADDR A:0x3318018
y.create.l HWIO_PMIC_ARB_OBS0_CHNL228_RDATA0_ADDR A:0x3320018
y.create.l HWIO_PMIC_ARB_OBS0_CHNL229_RDATA0_ADDR A:0x3328018
y.create.l HWIO_PMIC_ARB_OBS0_CHNL230_RDATA0_ADDR A:0x3330018
y.create.l HWIO_PMIC_ARB_OBS0_CHNL231_RDATA0_ADDR A:0x3338018
y.create.l HWIO_PMIC_ARB_OBS0_CHNL232_RDATA0_ADDR A:0x3340018
y.create.l HWIO_PMIC_ARB_OBS0_CHNL233_RDATA0_ADDR A:0x3348018
y.create.l HWIO_PMIC_ARB_OBS0_CHNL234_RDATA0_ADDR A:0x3350018
y.create.l HWIO_PMIC_ARB_OBS0_CHNL235_RDATA0_ADDR A:0x3358018
y.create.l HWIO_PMIC_ARB_OBS0_CHNL236_RDATA0_ADDR A:0x3360018
y.create.l HWIO_PMIC_ARB_OBS0_CHNL237_RDATA0_ADDR A:0x3368018
y.create.l HWIO_PMIC_ARB_OBS0_CHNL238_RDATA0_ADDR A:0x3370018
y.create.l HWIO_PMIC_ARB_OBS0_CHNL239_RDATA0_ADDR A:0x3378018
y.create.l HWIO_PMIC_ARB_OBS0_CHNL240_RDATA0_ADDR A:0x3380018
y.create.l HWIO_PMIC_ARB_OBS0_CHNL241_RDATA0_ADDR A:0x3388018
y.create.l HWIO_PMIC_ARB_OBS0_CHNL242_RDATA0_ADDR A:0x3390018
y.create.l HWIO_PMIC_ARB_OBS0_CHNL243_RDATA0_ADDR A:0x3398018
y.create.l HWIO_PMIC_ARB_OBS0_CHNL244_RDATA0_ADDR A:0x33a0018
y.create.l HWIO_PMIC_ARB_OBS0_CHNL245_RDATA0_ADDR A:0x33a8018
y.create.l HWIO_PMIC_ARB_OBS0_CHNL246_RDATA0_ADDR A:0x33b0018
y.create.l HWIO_PMIC_ARB_OBS0_CHNL247_RDATA0_ADDR A:0x33b8018
y.create.l HWIO_PMIC_ARB_OBS0_CHNL248_RDATA0_ADDR A:0x33c0018
y.create.l HWIO_PMIC_ARB_OBS0_CHNL249_RDATA0_ADDR A:0x33c8018
y.create.l HWIO_PMIC_ARB_OBS0_CHNL250_RDATA0_ADDR A:0x33d0018
y.create.l HWIO_PMIC_ARB_OBS0_CHNL251_RDATA0_ADDR A:0x33d8018
y.create.l HWIO_PMIC_ARB_OBS0_CHNL252_RDATA0_ADDR A:0x33e0018
y.create.l HWIO_PMIC_ARB_OBS0_CHNL253_RDATA0_ADDR A:0x33e8018
y.create.l HWIO_PMIC_ARB_OBS0_CHNL254_RDATA0_ADDR A:0x33f0018
y.create.l HWIO_PMIC_ARB_OBS0_CHNL255_RDATA0_ADDR A:0x33f8018
y.create.l HWIO_PMIC_ARB_OBS1_CHNL0_RDATA0_ADDR A:0x2c01018
y.create.l HWIO_PMIC_ARB_OBS1_CHNL1_RDATA0_ADDR A:0x2c09018
y.create.l HWIO_PMIC_ARB_OBS1_CHNL2_RDATA0_ADDR A:0x2c11018
y.create.l HWIO_PMIC_ARB_OBS1_CHNL3_RDATA0_ADDR A:0x2c19018
y.create.l HWIO_PMIC_ARB_OBS1_CHNL4_RDATA0_ADDR A:0x2c21018
y.create.l HWIO_PMIC_ARB_OBS1_CHNL5_RDATA0_ADDR A:0x2c29018
y.create.l HWIO_PMIC_ARB_OBS1_CHNL6_RDATA0_ADDR A:0x2c31018
y.create.l HWIO_PMIC_ARB_OBS1_CHNL7_RDATA0_ADDR A:0x2c39018
y.create.l HWIO_PMIC_ARB_OBS1_CHNL8_RDATA0_ADDR A:0x2c41018
y.create.l HWIO_PMIC_ARB_OBS1_CHNL9_RDATA0_ADDR A:0x2c49018
y.create.l HWIO_PMIC_ARB_OBS1_CHNL10_RDATA0_ADDR A:0x2c51018
y.create.l HWIO_PMIC_ARB_OBS1_CHNL11_RDATA0_ADDR A:0x2c59018
y.create.l HWIO_PMIC_ARB_OBS1_CHNL12_RDATA0_ADDR A:0x2c61018
y.create.l HWIO_PMIC_ARB_OBS1_CHNL13_RDATA0_ADDR A:0x2c69018
y.create.l HWIO_PMIC_ARB_OBS1_CHNL14_RDATA0_ADDR A:0x2c71018
y.create.l HWIO_PMIC_ARB_OBS1_CHNL15_RDATA0_ADDR A:0x2c79018
y.create.l HWIO_PMIC_ARB_OBS1_CHNL16_RDATA0_ADDR A:0x2c81018
y.create.l HWIO_PMIC_ARB_OBS1_CHNL17_RDATA0_ADDR A:0x2c89018
y.create.l HWIO_PMIC_ARB_OBS1_CHNL18_RDATA0_ADDR A:0x2c91018
y.create.l HWIO_PMIC_ARB_OBS1_CHNL19_RDATA0_ADDR A:0x2c99018
y.create.l HWIO_PMIC_ARB_OBS1_CHNL20_RDATA0_ADDR A:0x2ca1018
y.create.l HWIO_PMIC_ARB_OBS1_CHNL21_RDATA0_ADDR A:0x2ca9018
y.create.l HWIO_PMIC_ARB_OBS1_CHNL22_RDATA0_ADDR A:0x2cb1018
y.create.l HWIO_PMIC_ARB_OBS1_CHNL23_RDATA0_ADDR A:0x2cb9018
y.create.l HWIO_PMIC_ARB_OBS1_CHNL24_RDATA0_ADDR A:0x2cc1018
y.create.l HWIO_PMIC_ARB_OBS1_CHNL25_RDATA0_ADDR A:0x2cc9018
y.create.l HWIO_PMIC_ARB_OBS1_CHNL26_RDATA0_ADDR A:0x2cd1018
y.create.l HWIO_PMIC_ARB_OBS1_CHNL27_RDATA0_ADDR A:0x2cd9018
y.create.l HWIO_PMIC_ARB_OBS1_CHNL28_RDATA0_ADDR A:0x2ce1018
y.create.l HWIO_PMIC_ARB_OBS1_CHNL29_RDATA0_ADDR A:0x2ce9018
y.create.l HWIO_PMIC_ARB_OBS1_CHNL30_RDATA0_ADDR A:0x2cf1018
y.create.l HWIO_PMIC_ARB_OBS1_CHNL31_RDATA0_ADDR A:0x2cf9018
y.create.l HWIO_PMIC_ARB_OBS1_CHNL32_RDATA0_ADDR A:0x2d01018
y.create.l HWIO_PMIC_ARB_OBS1_CHNL33_RDATA0_ADDR A:0x2d09018
y.create.l HWIO_PMIC_ARB_OBS1_CHNL34_RDATA0_ADDR A:0x2d11018
y.create.l HWIO_PMIC_ARB_OBS1_CHNL35_RDATA0_ADDR A:0x2d19018
y.create.l HWIO_PMIC_ARB_OBS1_CHNL36_RDATA0_ADDR A:0x2d21018
y.create.l HWIO_PMIC_ARB_OBS1_CHNL37_RDATA0_ADDR A:0x2d29018
y.create.l HWIO_PMIC_ARB_OBS1_CHNL38_RDATA0_ADDR A:0x2d31018
y.create.l HWIO_PMIC_ARB_OBS1_CHNL39_RDATA0_ADDR A:0x2d39018
y.create.l HWIO_PMIC_ARB_OBS1_CHNL40_RDATA0_ADDR A:0x2d41018
y.create.l HWIO_PMIC_ARB_OBS1_CHNL41_RDATA0_ADDR A:0x2d49018
y.create.l HWIO_PMIC_ARB_OBS1_CHNL42_RDATA0_ADDR A:0x2d51018
y.create.l HWIO_PMIC_ARB_OBS1_CHNL43_RDATA0_ADDR A:0x2d59018
y.create.l HWIO_PMIC_ARB_OBS1_CHNL44_RDATA0_ADDR A:0x2d61018
y.create.l HWIO_PMIC_ARB_OBS1_CHNL45_RDATA0_ADDR A:0x2d69018
y.create.l HWIO_PMIC_ARB_OBS1_CHNL46_RDATA0_ADDR A:0x2d71018
y.create.l HWIO_PMIC_ARB_OBS1_CHNL47_RDATA0_ADDR A:0x2d79018
y.create.l HWIO_PMIC_ARB_OBS1_CHNL48_RDATA0_ADDR A:0x2d81018
y.create.l HWIO_PMIC_ARB_OBS1_CHNL49_RDATA0_ADDR A:0x2d89018
y.create.l HWIO_PMIC_ARB_OBS1_CHNL50_RDATA0_ADDR A:0x2d91018
y.create.l HWIO_PMIC_ARB_OBS1_CHNL51_RDATA0_ADDR A:0x2d99018
y.create.l HWIO_PMIC_ARB_OBS1_CHNL52_RDATA0_ADDR A:0x2da1018
y.create.l HWIO_PMIC_ARB_OBS1_CHNL53_RDATA0_ADDR A:0x2da9018
y.create.l HWIO_PMIC_ARB_OBS1_CHNL54_RDATA0_ADDR A:0x2db1018
y.create.l HWIO_PMIC_ARB_OBS1_CHNL55_RDATA0_ADDR A:0x2db9018
y.create.l HWIO_PMIC_ARB_OBS1_CHNL56_RDATA0_ADDR A:0x2dc1018
y.create.l HWIO_PMIC_ARB_OBS1_CHNL57_RDATA0_ADDR A:0x2dc9018
y.create.l HWIO_PMIC_ARB_OBS1_CHNL58_RDATA0_ADDR A:0x2dd1018
y.create.l HWIO_PMIC_ARB_OBS1_CHNL59_RDATA0_ADDR A:0x2dd9018
y.create.l HWIO_PMIC_ARB_OBS1_CHNL60_RDATA0_ADDR A:0x2de1018
y.create.l HWIO_PMIC_ARB_OBS1_CHNL61_RDATA0_ADDR A:0x2de9018
y.create.l HWIO_PMIC_ARB_OBS1_CHNL62_RDATA0_ADDR A:0x2df1018
y.create.l HWIO_PMIC_ARB_OBS1_CHNL63_RDATA0_ADDR A:0x2df9018
y.create.l HWIO_PMIC_ARB_OBS1_CHNL64_RDATA0_ADDR A:0x2e01018
y.create.l HWIO_PMIC_ARB_OBS1_CHNL65_RDATA0_ADDR A:0x2e09018
y.create.l HWIO_PMIC_ARB_OBS1_CHNL66_RDATA0_ADDR A:0x2e11018
y.create.l HWIO_PMIC_ARB_OBS1_CHNL67_RDATA0_ADDR A:0x2e19018
y.create.l HWIO_PMIC_ARB_OBS1_CHNL68_RDATA0_ADDR A:0x2e21018
y.create.l HWIO_PMIC_ARB_OBS1_CHNL69_RDATA0_ADDR A:0x2e29018
y.create.l HWIO_PMIC_ARB_OBS1_CHNL70_RDATA0_ADDR A:0x2e31018
y.create.l HWIO_PMIC_ARB_OBS1_CHNL71_RDATA0_ADDR A:0x2e39018
y.create.l HWIO_PMIC_ARB_OBS1_CHNL72_RDATA0_ADDR A:0x2e41018
y.create.l HWIO_PMIC_ARB_OBS1_CHNL73_RDATA0_ADDR A:0x2e49018
y.create.l HWIO_PMIC_ARB_OBS1_CHNL74_RDATA0_ADDR A:0x2e51018
y.create.l HWIO_PMIC_ARB_OBS1_CHNL75_RDATA0_ADDR A:0x2e59018
y.create.l HWIO_PMIC_ARB_OBS1_CHNL76_RDATA0_ADDR A:0x2e61018
y.create.l HWIO_PMIC_ARB_OBS1_CHNL77_RDATA0_ADDR A:0x2e69018
y.create.l HWIO_PMIC_ARB_OBS1_CHNL78_RDATA0_ADDR A:0x2e71018
y.create.l HWIO_PMIC_ARB_OBS1_CHNL79_RDATA0_ADDR A:0x2e79018
y.create.l HWIO_PMIC_ARB_OBS1_CHNL80_RDATA0_ADDR A:0x2e81018
y.create.l HWIO_PMIC_ARB_OBS1_CHNL81_RDATA0_ADDR A:0x2e89018
y.create.l HWIO_PMIC_ARB_OBS1_CHNL82_RDATA0_ADDR A:0x2e91018
y.create.l HWIO_PMIC_ARB_OBS1_CHNL83_RDATA0_ADDR A:0x2e99018
y.create.l HWIO_PMIC_ARB_OBS1_CHNL84_RDATA0_ADDR A:0x2ea1018
y.create.l HWIO_PMIC_ARB_OBS1_CHNL85_RDATA0_ADDR A:0x2ea9018
y.create.l HWIO_PMIC_ARB_OBS1_CHNL86_RDATA0_ADDR A:0x2eb1018
y.create.l HWIO_PMIC_ARB_OBS1_CHNL87_RDATA0_ADDR A:0x2eb9018
y.create.l HWIO_PMIC_ARB_OBS1_CHNL88_RDATA0_ADDR A:0x2ec1018
y.create.l HWIO_PMIC_ARB_OBS1_CHNL89_RDATA0_ADDR A:0x2ec9018
y.create.l HWIO_PMIC_ARB_OBS1_CHNL90_RDATA0_ADDR A:0x2ed1018
y.create.l HWIO_PMIC_ARB_OBS1_CHNL91_RDATA0_ADDR A:0x2ed9018
y.create.l HWIO_PMIC_ARB_OBS1_CHNL92_RDATA0_ADDR A:0x2ee1018
y.create.l HWIO_PMIC_ARB_OBS1_CHNL93_RDATA0_ADDR A:0x2ee9018
y.create.l HWIO_PMIC_ARB_OBS1_CHNL94_RDATA0_ADDR A:0x2ef1018
y.create.l HWIO_PMIC_ARB_OBS1_CHNL95_RDATA0_ADDR A:0x2ef9018
y.create.l HWIO_PMIC_ARB_OBS1_CHNL96_RDATA0_ADDR A:0x2f01018
y.create.l HWIO_PMIC_ARB_OBS1_CHNL97_RDATA0_ADDR A:0x2f09018
y.create.l HWIO_PMIC_ARB_OBS1_CHNL98_RDATA0_ADDR A:0x2f11018
y.create.l HWIO_PMIC_ARB_OBS1_CHNL99_RDATA0_ADDR A:0x2f19018
y.create.l HWIO_PMIC_ARB_OBS1_CHNL100_RDATA0_ADDR A:0x2f21018
y.create.l HWIO_PMIC_ARB_OBS1_CHNL101_RDATA0_ADDR A:0x2f29018
y.create.l HWIO_PMIC_ARB_OBS1_CHNL102_RDATA0_ADDR A:0x2f31018
y.create.l HWIO_PMIC_ARB_OBS1_CHNL103_RDATA0_ADDR A:0x2f39018
y.create.l HWIO_PMIC_ARB_OBS1_CHNL104_RDATA0_ADDR A:0x2f41018
y.create.l HWIO_PMIC_ARB_OBS1_CHNL105_RDATA0_ADDR A:0x2f49018
y.create.l HWIO_PMIC_ARB_OBS1_CHNL106_RDATA0_ADDR A:0x2f51018
y.create.l HWIO_PMIC_ARB_OBS1_CHNL107_RDATA0_ADDR A:0x2f59018
y.create.l HWIO_PMIC_ARB_OBS1_CHNL108_RDATA0_ADDR A:0x2f61018
y.create.l HWIO_PMIC_ARB_OBS1_CHNL109_RDATA0_ADDR A:0x2f69018
y.create.l HWIO_PMIC_ARB_OBS1_CHNL110_RDATA0_ADDR A:0x2f71018
y.create.l HWIO_PMIC_ARB_OBS1_CHNL111_RDATA0_ADDR A:0x2f79018
y.create.l HWIO_PMIC_ARB_OBS1_CHNL112_RDATA0_ADDR A:0x2f81018
y.create.l HWIO_PMIC_ARB_OBS1_CHNL113_RDATA0_ADDR A:0x2f89018
y.create.l HWIO_PMIC_ARB_OBS1_CHNL114_RDATA0_ADDR A:0x2f91018
y.create.l HWIO_PMIC_ARB_OBS1_CHNL115_RDATA0_ADDR A:0x2f99018
y.create.l HWIO_PMIC_ARB_OBS1_CHNL116_RDATA0_ADDR A:0x2fa1018
y.create.l HWIO_PMIC_ARB_OBS1_CHNL117_RDATA0_ADDR A:0x2fa9018
y.create.l HWIO_PMIC_ARB_OBS1_CHNL118_RDATA0_ADDR A:0x2fb1018
y.create.l HWIO_PMIC_ARB_OBS1_CHNL119_RDATA0_ADDR A:0x2fb9018
y.create.l HWIO_PMIC_ARB_OBS1_CHNL120_RDATA0_ADDR A:0x2fc1018
y.create.l HWIO_PMIC_ARB_OBS1_CHNL121_RDATA0_ADDR A:0x2fc9018
y.create.l HWIO_PMIC_ARB_OBS1_CHNL122_RDATA0_ADDR A:0x2fd1018
y.create.l HWIO_PMIC_ARB_OBS1_CHNL123_RDATA0_ADDR A:0x2fd9018
y.create.l HWIO_PMIC_ARB_OBS1_CHNL124_RDATA0_ADDR A:0x2fe1018
y.create.l HWIO_PMIC_ARB_OBS1_CHNL125_RDATA0_ADDR A:0x2fe9018
y.create.l HWIO_PMIC_ARB_OBS1_CHNL126_RDATA0_ADDR A:0x2ff1018
y.create.l HWIO_PMIC_ARB_OBS1_CHNL127_RDATA0_ADDR A:0x2ff9018
y.create.l HWIO_PMIC_ARB_OBS1_CHNL128_RDATA0_ADDR A:0x3001018
y.create.l HWIO_PMIC_ARB_OBS1_CHNL129_RDATA0_ADDR A:0x3009018
y.create.l HWIO_PMIC_ARB_OBS1_CHNL130_RDATA0_ADDR A:0x3011018
y.create.l HWIO_PMIC_ARB_OBS1_CHNL131_RDATA0_ADDR A:0x3019018
y.create.l HWIO_PMIC_ARB_OBS1_CHNL132_RDATA0_ADDR A:0x3021018
y.create.l HWIO_PMIC_ARB_OBS1_CHNL133_RDATA0_ADDR A:0x3029018
y.create.l HWIO_PMIC_ARB_OBS1_CHNL134_RDATA0_ADDR A:0x3031018
y.create.l HWIO_PMIC_ARB_OBS1_CHNL135_RDATA0_ADDR A:0x3039018
y.create.l HWIO_PMIC_ARB_OBS1_CHNL136_RDATA0_ADDR A:0x3041018
y.create.l HWIO_PMIC_ARB_OBS1_CHNL137_RDATA0_ADDR A:0x3049018
y.create.l HWIO_PMIC_ARB_OBS1_CHNL138_RDATA0_ADDR A:0x3051018
y.create.l HWIO_PMIC_ARB_OBS1_CHNL139_RDATA0_ADDR A:0x3059018
y.create.l HWIO_PMIC_ARB_OBS1_CHNL140_RDATA0_ADDR A:0x3061018
y.create.l HWIO_PMIC_ARB_OBS1_CHNL141_RDATA0_ADDR A:0x3069018
y.create.l HWIO_PMIC_ARB_OBS1_CHNL142_RDATA0_ADDR A:0x3071018
y.create.l HWIO_PMIC_ARB_OBS1_CHNL143_RDATA0_ADDR A:0x3079018
y.create.l HWIO_PMIC_ARB_OBS1_CHNL144_RDATA0_ADDR A:0x3081018
y.create.l HWIO_PMIC_ARB_OBS1_CHNL145_RDATA0_ADDR A:0x3089018
y.create.l HWIO_PMIC_ARB_OBS1_CHNL146_RDATA0_ADDR A:0x3091018
y.create.l HWIO_PMIC_ARB_OBS1_CHNL147_RDATA0_ADDR A:0x3099018
y.create.l HWIO_PMIC_ARB_OBS1_CHNL148_RDATA0_ADDR A:0x30a1018
y.create.l HWIO_PMIC_ARB_OBS1_CHNL149_RDATA0_ADDR A:0x30a9018
y.create.l HWIO_PMIC_ARB_OBS1_CHNL150_RDATA0_ADDR A:0x30b1018
y.create.l HWIO_PMIC_ARB_OBS1_CHNL151_RDATA0_ADDR A:0x30b9018
y.create.l HWIO_PMIC_ARB_OBS1_CHNL152_RDATA0_ADDR A:0x30c1018
y.create.l HWIO_PMIC_ARB_OBS1_CHNL153_RDATA0_ADDR A:0x30c9018
y.create.l HWIO_PMIC_ARB_OBS1_CHNL154_RDATA0_ADDR A:0x30d1018
y.create.l HWIO_PMIC_ARB_OBS1_CHNL155_RDATA0_ADDR A:0x30d9018
y.create.l HWIO_PMIC_ARB_OBS1_CHNL156_RDATA0_ADDR A:0x30e1018
y.create.l HWIO_PMIC_ARB_OBS1_CHNL157_RDATA0_ADDR A:0x30e9018
y.create.l HWIO_PMIC_ARB_OBS1_CHNL158_RDATA0_ADDR A:0x30f1018
y.create.l HWIO_PMIC_ARB_OBS1_CHNL159_RDATA0_ADDR A:0x30f9018
y.create.l HWIO_PMIC_ARB_OBS1_CHNL160_RDATA0_ADDR A:0x3101018
y.create.l HWIO_PMIC_ARB_OBS1_CHNL161_RDATA0_ADDR A:0x3109018
y.create.l HWIO_PMIC_ARB_OBS1_CHNL162_RDATA0_ADDR A:0x3111018
y.create.l HWIO_PMIC_ARB_OBS1_CHNL163_RDATA0_ADDR A:0x3119018
y.create.l HWIO_PMIC_ARB_OBS1_CHNL164_RDATA0_ADDR A:0x3121018
y.create.l HWIO_PMIC_ARB_OBS1_CHNL165_RDATA0_ADDR A:0x3129018
y.create.l HWIO_PMIC_ARB_OBS1_CHNL166_RDATA0_ADDR A:0x3131018
y.create.l HWIO_PMIC_ARB_OBS1_CHNL167_RDATA0_ADDR A:0x3139018
y.create.l HWIO_PMIC_ARB_OBS1_CHNL168_RDATA0_ADDR A:0x3141018
y.create.l HWIO_PMIC_ARB_OBS1_CHNL169_RDATA0_ADDR A:0x3149018
y.create.l HWIO_PMIC_ARB_OBS1_CHNL170_RDATA0_ADDR A:0x3151018
y.create.l HWIO_PMIC_ARB_OBS1_CHNL171_RDATA0_ADDR A:0x3159018
y.create.l HWIO_PMIC_ARB_OBS1_CHNL172_RDATA0_ADDR A:0x3161018
y.create.l HWIO_PMIC_ARB_OBS1_CHNL173_RDATA0_ADDR A:0x3169018
y.create.l HWIO_PMIC_ARB_OBS1_CHNL174_RDATA0_ADDR A:0x3171018
y.create.l HWIO_PMIC_ARB_OBS1_CHNL175_RDATA0_ADDR A:0x3179018
y.create.l HWIO_PMIC_ARB_OBS1_CHNL176_RDATA0_ADDR A:0x3181018
y.create.l HWIO_PMIC_ARB_OBS1_CHNL177_RDATA0_ADDR A:0x3189018
y.create.l HWIO_PMIC_ARB_OBS1_CHNL178_RDATA0_ADDR A:0x3191018
y.create.l HWIO_PMIC_ARB_OBS1_CHNL179_RDATA0_ADDR A:0x3199018
y.create.l HWIO_PMIC_ARB_OBS1_CHNL180_RDATA0_ADDR A:0x31a1018
y.create.l HWIO_PMIC_ARB_OBS1_CHNL181_RDATA0_ADDR A:0x31a9018
y.create.l HWIO_PMIC_ARB_OBS1_CHNL182_RDATA0_ADDR A:0x31b1018
y.create.l HWIO_PMIC_ARB_OBS1_CHNL183_RDATA0_ADDR A:0x31b9018
y.create.l HWIO_PMIC_ARB_OBS1_CHNL184_RDATA0_ADDR A:0x31c1018
y.create.l HWIO_PMIC_ARB_OBS1_CHNL185_RDATA0_ADDR A:0x31c9018
y.create.l HWIO_PMIC_ARB_OBS1_CHNL186_RDATA0_ADDR A:0x31d1018
y.create.l HWIO_PMIC_ARB_OBS1_CHNL187_RDATA0_ADDR A:0x31d9018
y.create.l HWIO_PMIC_ARB_OBS1_CHNL188_RDATA0_ADDR A:0x31e1018
y.create.l HWIO_PMIC_ARB_OBS1_CHNL189_RDATA0_ADDR A:0x31e9018
y.create.l HWIO_PMIC_ARB_OBS1_CHNL190_RDATA0_ADDR A:0x31f1018
y.create.l HWIO_PMIC_ARB_OBS1_CHNL191_RDATA0_ADDR A:0x31f9018
y.create.l HWIO_PMIC_ARB_OBS1_CHNL192_RDATA0_ADDR A:0x3201018
y.create.l HWIO_PMIC_ARB_OBS1_CHNL193_RDATA0_ADDR A:0x3209018
y.create.l HWIO_PMIC_ARB_OBS1_CHNL194_RDATA0_ADDR A:0x3211018
y.create.l HWIO_PMIC_ARB_OBS1_CHNL195_RDATA0_ADDR A:0x3219018
y.create.l HWIO_PMIC_ARB_OBS1_CHNL196_RDATA0_ADDR A:0x3221018
y.create.l HWIO_PMIC_ARB_OBS1_CHNL197_RDATA0_ADDR A:0x3229018
y.create.l HWIO_PMIC_ARB_OBS1_CHNL198_RDATA0_ADDR A:0x3231018
y.create.l HWIO_PMIC_ARB_OBS1_CHNL199_RDATA0_ADDR A:0x3239018
y.create.l HWIO_PMIC_ARB_OBS1_CHNL200_RDATA0_ADDR A:0x3241018
y.create.l HWIO_PMIC_ARB_OBS1_CHNL201_RDATA0_ADDR A:0x3249018
y.create.l HWIO_PMIC_ARB_OBS1_CHNL202_RDATA0_ADDR A:0x3251018
y.create.l HWIO_PMIC_ARB_OBS1_CHNL203_RDATA0_ADDR A:0x3259018
y.create.l HWIO_PMIC_ARB_OBS1_CHNL204_RDATA0_ADDR A:0x3261018
y.create.l HWIO_PMIC_ARB_OBS1_CHNL205_RDATA0_ADDR A:0x3269018
y.create.l HWIO_PMIC_ARB_OBS1_CHNL206_RDATA0_ADDR A:0x3271018
y.create.l HWIO_PMIC_ARB_OBS1_CHNL207_RDATA0_ADDR A:0x3279018
y.create.l HWIO_PMIC_ARB_OBS1_CHNL208_RDATA0_ADDR A:0x3281018
y.create.l HWIO_PMIC_ARB_OBS1_CHNL209_RDATA0_ADDR A:0x3289018
y.create.l HWIO_PMIC_ARB_OBS1_CHNL210_RDATA0_ADDR A:0x3291018
y.create.l HWIO_PMIC_ARB_OBS1_CHNL211_RDATA0_ADDR A:0x3299018
y.create.l HWIO_PMIC_ARB_OBS1_CHNL212_RDATA0_ADDR A:0x32a1018
y.create.l HWIO_PMIC_ARB_OBS1_CHNL213_RDATA0_ADDR A:0x32a9018
y.create.l HWIO_PMIC_ARB_OBS1_CHNL214_RDATA0_ADDR A:0x32b1018
y.create.l HWIO_PMIC_ARB_OBS1_CHNL215_RDATA0_ADDR A:0x32b9018
y.create.l HWIO_PMIC_ARB_OBS1_CHNL216_RDATA0_ADDR A:0x32c1018
y.create.l HWIO_PMIC_ARB_OBS1_CHNL217_RDATA0_ADDR A:0x32c9018
y.create.l HWIO_PMIC_ARB_OBS1_CHNL218_RDATA0_ADDR A:0x32d1018
y.create.l HWIO_PMIC_ARB_OBS1_CHNL219_RDATA0_ADDR A:0x32d9018
y.create.l HWIO_PMIC_ARB_OBS1_CHNL220_RDATA0_ADDR A:0x32e1018
y.create.l HWIO_PMIC_ARB_OBS1_CHNL221_RDATA0_ADDR A:0x32e9018
y.create.l HWIO_PMIC_ARB_OBS1_CHNL222_RDATA0_ADDR A:0x32f1018
y.create.l HWIO_PMIC_ARB_OBS1_CHNL223_RDATA0_ADDR A:0x32f9018
y.create.l HWIO_PMIC_ARB_OBS1_CHNL224_RDATA0_ADDR A:0x3301018
y.create.l HWIO_PMIC_ARB_OBS1_CHNL225_RDATA0_ADDR A:0x3309018
y.create.l HWIO_PMIC_ARB_OBS1_CHNL226_RDATA0_ADDR A:0x3311018
y.create.l HWIO_PMIC_ARB_OBS1_CHNL227_RDATA0_ADDR A:0x3319018
y.create.l HWIO_PMIC_ARB_OBS1_CHNL228_RDATA0_ADDR A:0x3321018
y.create.l HWIO_PMIC_ARB_OBS1_CHNL229_RDATA0_ADDR A:0x3329018
y.create.l HWIO_PMIC_ARB_OBS1_CHNL230_RDATA0_ADDR A:0x3331018
y.create.l HWIO_PMIC_ARB_OBS1_CHNL231_RDATA0_ADDR A:0x3339018
y.create.l HWIO_PMIC_ARB_OBS1_CHNL232_RDATA0_ADDR A:0x3341018
y.create.l HWIO_PMIC_ARB_OBS1_CHNL233_RDATA0_ADDR A:0x3349018
y.create.l HWIO_PMIC_ARB_OBS1_CHNL234_RDATA0_ADDR A:0x3351018
y.create.l HWIO_PMIC_ARB_OBS1_CHNL235_RDATA0_ADDR A:0x3359018
y.create.l HWIO_PMIC_ARB_OBS1_CHNL236_RDATA0_ADDR A:0x3361018
y.create.l HWIO_PMIC_ARB_OBS1_CHNL237_RDATA0_ADDR A:0x3369018
y.create.l HWIO_PMIC_ARB_OBS1_CHNL238_RDATA0_ADDR A:0x3371018
y.create.l HWIO_PMIC_ARB_OBS1_CHNL239_RDATA0_ADDR A:0x3379018
y.create.l HWIO_PMIC_ARB_OBS1_CHNL240_RDATA0_ADDR A:0x3381018
y.create.l HWIO_PMIC_ARB_OBS1_CHNL241_RDATA0_ADDR A:0x3389018
y.create.l HWIO_PMIC_ARB_OBS1_CHNL242_RDATA0_ADDR A:0x3391018
y.create.l HWIO_PMIC_ARB_OBS1_CHNL243_RDATA0_ADDR A:0x3399018
y.create.l HWIO_PMIC_ARB_OBS1_CHNL244_RDATA0_ADDR A:0x33a1018
y.create.l HWIO_PMIC_ARB_OBS1_CHNL245_RDATA0_ADDR A:0x33a9018
y.create.l HWIO_PMIC_ARB_OBS1_CHNL246_RDATA0_ADDR A:0x33b1018
y.create.l HWIO_PMIC_ARB_OBS1_CHNL247_RDATA0_ADDR A:0x33b9018
y.create.l HWIO_PMIC_ARB_OBS1_CHNL248_RDATA0_ADDR A:0x33c1018
y.create.l HWIO_PMIC_ARB_OBS1_CHNL249_RDATA0_ADDR A:0x33c9018
y.create.l HWIO_PMIC_ARB_OBS1_CHNL250_RDATA0_ADDR A:0x33d1018
y.create.l HWIO_PMIC_ARB_OBS1_CHNL251_RDATA0_ADDR A:0x33d9018
y.create.l HWIO_PMIC_ARB_OBS1_CHNL252_RDATA0_ADDR A:0x33e1018
y.create.l HWIO_PMIC_ARB_OBS1_CHNL253_RDATA0_ADDR A:0x33e9018
y.create.l HWIO_PMIC_ARB_OBS1_CHNL254_RDATA0_ADDR A:0x33f1018
y.create.l HWIO_PMIC_ARB_OBS1_CHNL255_RDATA0_ADDR A:0x33f9018
y.create.l HWIO_PMIC_ARB_OBS2_CHNL0_RDATA0_ADDR A:0x2c02018
y.create.l HWIO_PMIC_ARB_OBS2_CHNL1_RDATA0_ADDR A:0x2c0a018
y.create.l HWIO_PMIC_ARB_OBS2_CHNL2_RDATA0_ADDR A:0x2c12018
y.create.l HWIO_PMIC_ARB_OBS2_CHNL3_RDATA0_ADDR A:0x2c1a018
y.create.l HWIO_PMIC_ARB_OBS2_CHNL4_RDATA0_ADDR A:0x2c22018
y.create.l HWIO_PMIC_ARB_OBS2_CHNL5_RDATA0_ADDR A:0x2c2a018
y.create.l HWIO_PMIC_ARB_OBS2_CHNL6_RDATA0_ADDR A:0x2c32018
y.create.l HWIO_PMIC_ARB_OBS2_CHNL7_RDATA0_ADDR A:0x2c3a018
y.create.l HWIO_PMIC_ARB_OBS2_CHNL8_RDATA0_ADDR A:0x2c42018
y.create.l HWIO_PMIC_ARB_OBS2_CHNL9_RDATA0_ADDR A:0x2c4a018
y.create.l HWIO_PMIC_ARB_OBS2_CHNL10_RDATA0_ADDR A:0x2c52018
y.create.l HWIO_PMIC_ARB_OBS2_CHNL11_RDATA0_ADDR A:0x2c5a018
y.create.l HWIO_PMIC_ARB_OBS2_CHNL12_RDATA0_ADDR A:0x2c62018
y.create.l HWIO_PMIC_ARB_OBS2_CHNL13_RDATA0_ADDR A:0x2c6a018
y.create.l HWIO_PMIC_ARB_OBS2_CHNL14_RDATA0_ADDR A:0x2c72018
y.create.l HWIO_PMIC_ARB_OBS2_CHNL15_RDATA0_ADDR A:0x2c7a018
y.create.l HWIO_PMIC_ARB_OBS2_CHNL16_RDATA0_ADDR A:0x2c82018
y.create.l HWIO_PMIC_ARB_OBS2_CHNL17_RDATA0_ADDR A:0x2c8a018
y.create.l HWIO_PMIC_ARB_OBS2_CHNL18_RDATA0_ADDR A:0x2c92018
y.create.l HWIO_PMIC_ARB_OBS2_CHNL19_RDATA0_ADDR A:0x2c9a018
y.create.l HWIO_PMIC_ARB_OBS2_CHNL20_RDATA0_ADDR A:0x2ca2018
y.create.l HWIO_PMIC_ARB_OBS2_CHNL21_RDATA0_ADDR A:0x2caa018
y.create.l HWIO_PMIC_ARB_OBS2_CHNL22_RDATA0_ADDR A:0x2cb2018
y.create.l HWIO_PMIC_ARB_OBS2_CHNL23_RDATA0_ADDR A:0x2cba018
y.create.l HWIO_PMIC_ARB_OBS2_CHNL24_RDATA0_ADDR A:0x2cc2018
y.create.l HWIO_PMIC_ARB_OBS2_CHNL25_RDATA0_ADDR A:0x2cca018
y.create.l HWIO_PMIC_ARB_OBS2_CHNL26_RDATA0_ADDR A:0x2cd2018
y.create.l HWIO_PMIC_ARB_OBS2_CHNL27_RDATA0_ADDR A:0x2cda018
y.create.l HWIO_PMIC_ARB_OBS2_CHNL28_RDATA0_ADDR A:0x2ce2018
y.create.l HWIO_PMIC_ARB_OBS2_CHNL29_RDATA0_ADDR A:0x2cea018
y.create.l HWIO_PMIC_ARB_OBS2_CHNL30_RDATA0_ADDR A:0x2cf2018
y.create.l HWIO_PMIC_ARB_OBS2_CHNL31_RDATA0_ADDR A:0x2cfa018
y.create.l HWIO_PMIC_ARB_OBS2_CHNL32_RDATA0_ADDR A:0x2d02018
y.create.l HWIO_PMIC_ARB_OBS2_CHNL33_RDATA0_ADDR A:0x2d0a018
y.create.l HWIO_PMIC_ARB_OBS2_CHNL34_RDATA0_ADDR A:0x2d12018
y.create.l HWIO_PMIC_ARB_OBS2_CHNL35_RDATA0_ADDR A:0x2d1a018
y.create.l HWIO_PMIC_ARB_OBS2_CHNL36_RDATA0_ADDR A:0x2d22018
y.create.l HWIO_PMIC_ARB_OBS2_CHNL37_RDATA0_ADDR A:0x2d2a018
y.create.l HWIO_PMIC_ARB_OBS2_CHNL38_RDATA0_ADDR A:0x2d32018
y.create.l HWIO_PMIC_ARB_OBS2_CHNL39_RDATA0_ADDR A:0x2d3a018
y.create.l HWIO_PMIC_ARB_OBS2_CHNL40_RDATA0_ADDR A:0x2d42018
y.create.l HWIO_PMIC_ARB_OBS2_CHNL41_RDATA0_ADDR A:0x2d4a018
y.create.l HWIO_PMIC_ARB_OBS2_CHNL42_RDATA0_ADDR A:0x2d52018
y.create.l HWIO_PMIC_ARB_OBS2_CHNL43_RDATA0_ADDR A:0x2d5a018
y.create.l HWIO_PMIC_ARB_OBS2_CHNL44_RDATA0_ADDR A:0x2d62018
y.create.l HWIO_PMIC_ARB_OBS2_CHNL45_RDATA0_ADDR A:0x2d6a018
y.create.l HWIO_PMIC_ARB_OBS2_CHNL46_RDATA0_ADDR A:0x2d72018
y.create.l HWIO_PMIC_ARB_OBS2_CHNL47_RDATA0_ADDR A:0x2d7a018
y.create.l HWIO_PMIC_ARB_OBS2_CHNL48_RDATA0_ADDR A:0x2d82018
y.create.l HWIO_PMIC_ARB_OBS2_CHNL49_RDATA0_ADDR A:0x2d8a018
y.create.l HWIO_PMIC_ARB_OBS2_CHNL50_RDATA0_ADDR A:0x2d92018
y.create.l HWIO_PMIC_ARB_OBS2_CHNL51_RDATA0_ADDR A:0x2d9a018
y.create.l HWIO_PMIC_ARB_OBS2_CHNL52_RDATA0_ADDR A:0x2da2018
y.create.l HWIO_PMIC_ARB_OBS2_CHNL53_RDATA0_ADDR A:0x2daa018
y.create.l HWIO_PMIC_ARB_OBS2_CHNL54_RDATA0_ADDR A:0x2db2018
y.create.l HWIO_PMIC_ARB_OBS2_CHNL55_RDATA0_ADDR A:0x2dba018
y.create.l HWIO_PMIC_ARB_OBS2_CHNL56_RDATA0_ADDR A:0x2dc2018
y.create.l HWIO_PMIC_ARB_OBS2_CHNL57_RDATA0_ADDR A:0x2dca018
y.create.l HWIO_PMIC_ARB_OBS2_CHNL58_RDATA0_ADDR A:0x2dd2018
y.create.l HWIO_PMIC_ARB_OBS2_CHNL59_RDATA0_ADDR A:0x2dda018
y.create.l HWIO_PMIC_ARB_OBS2_CHNL60_RDATA0_ADDR A:0x2de2018
y.create.l HWIO_PMIC_ARB_OBS2_CHNL61_RDATA0_ADDR A:0x2dea018
y.create.l HWIO_PMIC_ARB_OBS2_CHNL62_RDATA0_ADDR A:0x2df2018
y.create.l HWIO_PMIC_ARB_OBS2_CHNL63_RDATA0_ADDR A:0x2dfa018
y.create.l HWIO_PMIC_ARB_OBS2_CHNL64_RDATA0_ADDR A:0x2e02018
y.create.l HWIO_PMIC_ARB_OBS2_CHNL65_RDATA0_ADDR A:0x2e0a018
y.create.l HWIO_PMIC_ARB_OBS2_CHNL66_RDATA0_ADDR A:0x2e12018
y.create.l HWIO_PMIC_ARB_OBS2_CHNL67_RDATA0_ADDR A:0x2e1a018
y.create.l HWIO_PMIC_ARB_OBS2_CHNL68_RDATA0_ADDR A:0x2e22018
y.create.l HWIO_PMIC_ARB_OBS2_CHNL69_RDATA0_ADDR A:0x2e2a018
y.create.l HWIO_PMIC_ARB_OBS2_CHNL70_RDATA0_ADDR A:0x2e32018
y.create.l HWIO_PMIC_ARB_OBS2_CHNL71_RDATA0_ADDR A:0x2e3a018
y.create.l HWIO_PMIC_ARB_OBS2_CHNL72_RDATA0_ADDR A:0x2e42018
y.create.l HWIO_PMIC_ARB_OBS2_CHNL73_RDATA0_ADDR A:0x2e4a018
y.create.l HWIO_PMIC_ARB_OBS2_CHNL74_RDATA0_ADDR A:0x2e52018
y.create.l HWIO_PMIC_ARB_OBS2_CHNL75_RDATA0_ADDR A:0x2e5a018
y.create.l HWIO_PMIC_ARB_OBS2_CHNL76_RDATA0_ADDR A:0x2e62018
y.create.l HWIO_PMIC_ARB_OBS2_CHNL77_RDATA0_ADDR A:0x2e6a018
y.create.l HWIO_PMIC_ARB_OBS2_CHNL78_RDATA0_ADDR A:0x2e72018
y.create.l HWIO_PMIC_ARB_OBS2_CHNL79_RDATA0_ADDR A:0x2e7a018
y.create.l HWIO_PMIC_ARB_OBS2_CHNL80_RDATA0_ADDR A:0x2e82018
y.create.l HWIO_PMIC_ARB_OBS2_CHNL81_RDATA0_ADDR A:0x2e8a018
y.create.l HWIO_PMIC_ARB_OBS2_CHNL82_RDATA0_ADDR A:0x2e92018
y.create.l HWIO_PMIC_ARB_OBS2_CHNL83_RDATA0_ADDR A:0x2e9a018
y.create.l HWIO_PMIC_ARB_OBS2_CHNL84_RDATA0_ADDR A:0x2ea2018
y.create.l HWIO_PMIC_ARB_OBS2_CHNL85_RDATA0_ADDR A:0x2eaa018
y.create.l HWIO_PMIC_ARB_OBS2_CHNL86_RDATA0_ADDR A:0x2eb2018
y.create.l HWIO_PMIC_ARB_OBS2_CHNL87_RDATA0_ADDR A:0x2eba018
y.create.l HWIO_PMIC_ARB_OBS2_CHNL88_RDATA0_ADDR A:0x2ec2018
y.create.l HWIO_PMIC_ARB_OBS2_CHNL89_RDATA0_ADDR A:0x2eca018
y.create.l HWIO_PMIC_ARB_OBS2_CHNL90_RDATA0_ADDR A:0x2ed2018
y.create.l HWIO_PMIC_ARB_OBS2_CHNL91_RDATA0_ADDR A:0x2eda018
y.create.l HWIO_PMIC_ARB_OBS2_CHNL92_RDATA0_ADDR A:0x2ee2018
y.create.l HWIO_PMIC_ARB_OBS2_CHNL93_RDATA0_ADDR A:0x2eea018
y.create.l HWIO_PMIC_ARB_OBS2_CHNL94_RDATA0_ADDR A:0x2ef2018
y.create.l HWIO_PMIC_ARB_OBS2_CHNL95_RDATA0_ADDR A:0x2efa018
y.create.l HWIO_PMIC_ARB_OBS2_CHNL96_RDATA0_ADDR A:0x2f02018
y.create.l HWIO_PMIC_ARB_OBS2_CHNL97_RDATA0_ADDR A:0x2f0a018
y.create.l HWIO_PMIC_ARB_OBS2_CHNL98_RDATA0_ADDR A:0x2f12018
y.create.l HWIO_PMIC_ARB_OBS2_CHNL99_RDATA0_ADDR A:0x2f1a018
y.create.l HWIO_PMIC_ARB_OBS2_CHNL100_RDATA0_ADDR A:0x2f22018
y.create.l HWIO_PMIC_ARB_OBS2_CHNL101_RDATA0_ADDR A:0x2f2a018
y.create.l HWIO_PMIC_ARB_OBS2_CHNL102_RDATA0_ADDR A:0x2f32018
y.create.l HWIO_PMIC_ARB_OBS2_CHNL103_RDATA0_ADDR A:0x2f3a018
y.create.l HWIO_PMIC_ARB_OBS2_CHNL104_RDATA0_ADDR A:0x2f42018
y.create.l HWIO_PMIC_ARB_OBS2_CHNL105_RDATA0_ADDR A:0x2f4a018
y.create.l HWIO_PMIC_ARB_OBS2_CHNL106_RDATA0_ADDR A:0x2f52018
y.create.l HWIO_PMIC_ARB_OBS2_CHNL107_RDATA0_ADDR A:0x2f5a018
y.create.l HWIO_PMIC_ARB_OBS2_CHNL108_RDATA0_ADDR A:0x2f62018
y.create.l HWIO_PMIC_ARB_OBS2_CHNL109_RDATA0_ADDR A:0x2f6a018
y.create.l HWIO_PMIC_ARB_OBS2_CHNL110_RDATA0_ADDR A:0x2f72018
y.create.l HWIO_PMIC_ARB_OBS2_CHNL111_RDATA0_ADDR A:0x2f7a018
y.create.l HWIO_PMIC_ARB_OBS2_CHNL112_RDATA0_ADDR A:0x2f82018
y.create.l HWIO_PMIC_ARB_OBS2_CHNL113_RDATA0_ADDR A:0x2f8a018
y.create.l HWIO_PMIC_ARB_OBS2_CHNL114_RDATA0_ADDR A:0x2f92018
y.create.l HWIO_PMIC_ARB_OBS2_CHNL115_RDATA0_ADDR A:0x2f9a018
y.create.l HWIO_PMIC_ARB_OBS2_CHNL116_RDATA0_ADDR A:0x2fa2018
y.create.l HWIO_PMIC_ARB_OBS2_CHNL117_RDATA0_ADDR A:0x2faa018
y.create.l HWIO_PMIC_ARB_OBS2_CHNL118_RDATA0_ADDR A:0x2fb2018
y.create.l HWIO_PMIC_ARB_OBS2_CHNL119_RDATA0_ADDR A:0x2fba018
y.create.l HWIO_PMIC_ARB_OBS2_CHNL120_RDATA0_ADDR A:0x2fc2018
y.create.l HWIO_PMIC_ARB_OBS2_CHNL121_RDATA0_ADDR A:0x2fca018
y.create.l HWIO_PMIC_ARB_OBS2_CHNL122_RDATA0_ADDR A:0x2fd2018
y.create.l HWIO_PMIC_ARB_OBS2_CHNL123_RDATA0_ADDR A:0x2fda018
y.create.l HWIO_PMIC_ARB_OBS2_CHNL124_RDATA0_ADDR A:0x2fe2018
y.create.l HWIO_PMIC_ARB_OBS2_CHNL125_RDATA0_ADDR A:0x2fea018
y.create.l HWIO_PMIC_ARB_OBS2_CHNL126_RDATA0_ADDR A:0x2ff2018
y.create.l HWIO_PMIC_ARB_OBS2_CHNL127_RDATA0_ADDR A:0x2ffa018
y.create.l HWIO_PMIC_ARB_OBS2_CHNL128_RDATA0_ADDR A:0x3002018
y.create.l HWIO_PMIC_ARB_OBS2_CHNL129_RDATA0_ADDR A:0x300a018
y.create.l HWIO_PMIC_ARB_OBS2_CHNL130_RDATA0_ADDR A:0x3012018
y.create.l HWIO_PMIC_ARB_OBS2_CHNL131_RDATA0_ADDR A:0x301a018
y.create.l HWIO_PMIC_ARB_OBS2_CHNL132_RDATA0_ADDR A:0x3022018
y.create.l HWIO_PMIC_ARB_OBS2_CHNL133_RDATA0_ADDR A:0x302a018
y.create.l HWIO_PMIC_ARB_OBS2_CHNL134_RDATA0_ADDR A:0x3032018
y.create.l HWIO_PMIC_ARB_OBS2_CHNL135_RDATA0_ADDR A:0x303a018
y.create.l HWIO_PMIC_ARB_OBS2_CHNL136_RDATA0_ADDR A:0x3042018
y.create.l HWIO_PMIC_ARB_OBS2_CHNL137_RDATA0_ADDR A:0x304a018
y.create.l HWIO_PMIC_ARB_OBS2_CHNL138_RDATA0_ADDR A:0x3052018
y.create.l HWIO_PMIC_ARB_OBS2_CHNL139_RDATA0_ADDR A:0x305a018
y.create.l HWIO_PMIC_ARB_OBS2_CHNL140_RDATA0_ADDR A:0x3062018
y.create.l HWIO_PMIC_ARB_OBS2_CHNL141_RDATA0_ADDR A:0x306a018
y.create.l HWIO_PMIC_ARB_OBS2_CHNL142_RDATA0_ADDR A:0x3072018
y.create.l HWIO_PMIC_ARB_OBS2_CHNL143_RDATA0_ADDR A:0x307a018
y.create.l HWIO_PMIC_ARB_OBS2_CHNL144_RDATA0_ADDR A:0x3082018
y.create.l HWIO_PMIC_ARB_OBS2_CHNL145_RDATA0_ADDR A:0x308a018
y.create.l HWIO_PMIC_ARB_OBS2_CHNL146_RDATA0_ADDR A:0x3092018
y.create.l HWIO_PMIC_ARB_OBS2_CHNL147_RDATA0_ADDR A:0x309a018
y.create.l HWIO_PMIC_ARB_OBS2_CHNL148_RDATA0_ADDR A:0x30a2018
y.create.l HWIO_PMIC_ARB_OBS2_CHNL149_RDATA0_ADDR A:0x30aa018
y.create.l HWIO_PMIC_ARB_OBS2_CHNL150_RDATA0_ADDR A:0x30b2018
y.create.l HWIO_PMIC_ARB_OBS2_CHNL151_RDATA0_ADDR A:0x30ba018
y.create.l HWIO_PMIC_ARB_OBS2_CHNL152_RDATA0_ADDR A:0x30c2018
y.create.l HWIO_PMIC_ARB_OBS2_CHNL153_RDATA0_ADDR A:0x30ca018
y.create.l HWIO_PMIC_ARB_OBS2_CHNL154_RDATA0_ADDR A:0x30d2018
y.create.l HWIO_PMIC_ARB_OBS2_CHNL155_RDATA0_ADDR A:0x30da018
y.create.l HWIO_PMIC_ARB_OBS2_CHNL156_RDATA0_ADDR A:0x30e2018
y.create.l HWIO_PMIC_ARB_OBS2_CHNL157_RDATA0_ADDR A:0x30ea018
y.create.l HWIO_PMIC_ARB_OBS2_CHNL158_RDATA0_ADDR A:0x30f2018
y.create.l HWIO_PMIC_ARB_OBS2_CHNL159_RDATA0_ADDR A:0x30fa018
y.create.l HWIO_PMIC_ARB_OBS2_CHNL160_RDATA0_ADDR A:0x3102018
y.create.l HWIO_PMIC_ARB_OBS2_CHNL161_RDATA0_ADDR A:0x310a018
y.create.l HWIO_PMIC_ARB_OBS2_CHNL162_RDATA0_ADDR A:0x3112018
y.create.l HWIO_PMIC_ARB_OBS2_CHNL163_RDATA0_ADDR A:0x311a018
y.create.l HWIO_PMIC_ARB_OBS2_CHNL164_RDATA0_ADDR A:0x3122018
y.create.l HWIO_PMIC_ARB_OBS2_CHNL165_RDATA0_ADDR A:0x312a018
y.create.l HWIO_PMIC_ARB_OBS2_CHNL166_RDATA0_ADDR A:0x3132018
y.create.l HWIO_PMIC_ARB_OBS2_CHNL167_RDATA0_ADDR A:0x313a018
y.create.l HWIO_PMIC_ARB_OBS2_CHNL168_RDATA0_ADDR A:0x3142018
y.create.l HWIO_PMIC_ARB_OBS2_CHNL169_RDATA0_ADDR A:0x314a018
y.create.l HWIO_PMIC_ARB_OBS2_CHNL170_RDATA0_ADDR A:0x3152018
y.create.l HWIO_PMIC_ARB_OBS2_CHNL171_RDATA0_ADDR A:0x315a018
y.create.l HWIO_PMIC_ARB_OBS2_CHNL172_RDATA0_ADDR A:0x3162018
y.create.l HWIO_PMIC_ARB_OBS2_CHNL173_RDATA0_ADDR A:0x316a018
y.create.l HWIO_PMIC_ARB_OBS2_CHNL174_RDATA0_ADDR A:0x3172018
y.create.l HWIO_PMIC_ARB_OBS2_CHNL175_RDATA0_ADDR A:0x317a018
y.create.l HWIO_PMIC_ARB_OBS2_CHNL176_RDATA0_ADDR A:0x3182018
y.create.l HWIO_PMIC_ARB_OBS2_CHNL177_RDATA0_ADDR A:0x318a018
y.create.l HWIO_PMIC_ARB_OBS2_CHNL178_RDATA0_ADDR A:0x3192018
y.create.l HWIO_PMIC_ARB_OBS2_CHNL179_RDATA0_ADDR A:0x319a018
y.create.l HWIO_PMIC_ARB_OBS2_CHNL180_RDATA0_ADDR A:0x31a2018
y.create.l HWIO_PMIC_ARB_OBS2_CHNL181_RDATA0_ADDR A:0x31aa018
y.create.l HWIO_PMIC_ARB_OBS2_CHNL182_RDATA0_ADDR A:0x31b2018
y.create.l HWIO_PMIC_ARB_OBS2_CHNL183_RDATA0_ADDR A:0x31ba018
y.create.l HWIO_PMIC_ARB_OBS2_CHNL184_RDATA0_ADDR A:0x31c2018
y.create.l HWIO_PMIC_ARB_OBS2_CHNL185_RDATA0_ADDR A:0x31ca018
y.create.l HWIO_PMIC_ARB_OBS2_CHNL186_RDATA0_ADDR A:0x31d2018
y.create.l HWIO_PMIC_ARB_OBS2_CHNL187_RDATA0_ADDR A:0x31da018
y.create.l HWIO_PMIC_ARB_OBS2_CHNL188_RDATA0_ADDR A:0x31e2018
y.create.l HWIO_PMIC_ARB_OBS2_CHNL189_RDATA0_ADDR A:0x31ea018
y.create.l HWIO_PMIC_ARB_OBS2_CHNL190_RDATA0_ADDR A:0x31f2018
y.create.l HWIO_PMIC_ARB_OBS2_CHNL191_RDATA0_ADDR A:0x31fa018
y.create.l HWIO_PMIC_ARB_OBS2_CHNL192_RDATA0_ADDR A:0x3202018
y.create.l HWIO_PMIC_ARB_OBS2_CHNL193_RDATA0_ADDR A:0x320a018
y.create.l HWIO_PMIC_ARB_OBS2_CHNL194_RDATA0_ADDR A:0x3212018
y.create.l HWIO_PMIC_ARB_OBS2_CHNL195_RDATA0_ADDR A:0x321a018
y.create.l HWIO_PMIC_ARB_OBS2_CHNL196_RDATA0_ADDR A:0x3222018
y.create.l HWIO_PMIC_ARB_OBS2_CHNL197_RDATA0_ADDR A:0x322a018
y.create.l HWIO_PMIC_ARB_OBS2_CHNL198_RDATA0_ADDR A:0x3232018
y.create.l HWIO_PMIC_ARB_OBS2_CHNL199_RDATA0_ADDR A:0x323a018
y.create.l HWIO_PMIC_ARB_OBS2_CHNL200_RDATA0_ADDR A:0x3242018
y.create.l HWIO_PMIC_ARB_OBS2_CHNL201_RDATA0_ADDR A:0x324a018
y.create.l HWIO_PMIC_ARB_OBS2_CHNL202_RDATA0_ADDR A:0x3252018
y.create.l HWIO_PMIC_ARB_OBS2_CHNL203_RDATA0_ADDR A:0x325a018
y.create.l HWIO_PMIC_ARB_OBS2_CHNL204_RDATA0_ADDR A:0x3262018
y.create.l HWIO_PMIC_ARB_OBS2_CHNL205_RDATA0_ADDR A:0x326a018
y.create.l HWIO_PMIC_ARB_OBS2_CHNL206_RDATA0_ADDR A:0x3272018
y.create.l HWIO_PMIC_ARB_OBS2_CHNL207_RDATA0_ADDR A:0x327a018
y.create.l HWIO_PMIC_ARB_OBS2_CHNL208_RDATA0_ADDR A:0x3282018
y.create.l HWIO_PMIC_ARB_OBS2_CHNL209_RDATA0_ADDR A:0x328a018
y.create.l HWIO_PMIC_ARB_OBS2_CHNL210_RDATA0_ADDR A:0x3292018
y.create.l HWIO_PMIC_ARB_OBS2_CHNL211_RDATA0_ADDR A:0x329a018
y.create.l HWIO_PMIC_ARB_OBS2_CHNL212_RDATA0_ADDR A:0x32a2018
y.create.l HWIO_PMIC_ARB_OBS2_CHNL213_RDATA0_ADDR A:0x32aa018
y.create.l HWIO_PMIC_ARB_OBS2_CHNL214_RDATA0_ADDR A:0x32b2018
y.create.l HWIO_PMIC_ARB_OBS2_CHNL215_RDATA0_ADDR A:0x32ba018
y.create.l HWIO_PMIC_ARB_OBS2_CHNL216_RDATA0_ADDR A:0x32c2018
y.create.l HWIO_PMIC_ARB_OBS2_CHNL217_RDATA0_ADDR A:0x32ca018
y.create.l HWIO_PMIC_ARB_OBS2_CHNL218_RDATA0_ADDR A:0x32d2018
y.create.l HWIO_PMIC_ARB_OBS2_CHNL219_RDATA0_ADDR A:0x32da018
y.create.l HWIO_PMIC_ARB_OBS2_CHNL220_RDATA0_ADDR A:0x32e2018
y.create.l HWIO_PMIC_ARB_OBS2_CHNL221_RDATA0_ADDR A:0x32ea018
y.create.l HWIO_PMIC_ARB_OBS2_CHNL222_RDATA0_ADDR A:0x32f2018
y.create.l HWIO_PMIC_ARB_OBS2_CHNL223_RDATA0_ADDR A:0x32fa018
y.create.l HWIO_PMIC_ARB_OBS2_CHNL224_RDATA0_ADDR A:0x3302018
y.create.l HWIO_PMIC_ARB_OBS2_CHNL225_RDATA0_ADDR A:0x330a018
y.create.l HWIO_PMIC_ARB_OBS2_CHNL226_RDATA0_ADDR A:0x3312018
y.create.l HWIO_PMIC_ARB_OBS2_CHNL227_RDATA0_ADDR A:0x331a018
y.create.l HWIO_PMIC_ARB_OBS2_CHNL228_RDATA0_ADDR A:0x3322018
y.create.l HWIO_PMIC_ARB_OBS2_CHNL229_RDATA0_ADDR A:0x332a018
y.create.l HWIO_PMIC_ARB_OBS2_CHNL230_RDATA0_ADDR A:0x3332018
y.create.l HWIO_PMIC_ARB_OBS2_CHNL231_RDATA0_ADDR A:0x333a018
y.create.l HWIO_PMIC_ARB_OBS2_CHNL232_RDATA0_ADDR A:0x3342018
y.create.l HWIO_PMIC_ARB_OBS2_CHNL233_RDATA0_ADDR A:0x334a018
y.create.l HWIO_PMIC_ARB_OBS2_CHNL234_RDATA0_ADDR A:0x3352018
y.create.l HWIO_PMIC_ARB_OBS2_CHNL235_RDATA0_ADDR A:0x335a018
y.create.l HWIO_PMIC_ARB_OBS2_CHNL236_RDATA0_ADDR A:0x3362018
y.create.l HWIO_PMIC_ARB_OBS2_CHNL237_RDATA0_ADDR A:0x336a018
y.create.l HWIO_PMIC_ARB_OBS2_CHNL238_RDATA0_ADDR A:0x3372018
y.create.l HWIO_PMIC_ARB_OBS2_CHNL239_RDATA0_ADDR A:0x337a018
y.create.l HWIO_PMIC_ARB_OBS2_CHNL240_RDATA0_ADDR A:0x3382018
y.create.l HWIO_PMIC_ARB_OBS2_CHNL241_RDATA0_ADDR A:0x338a018
y.create.l HWIO_PMIC_ARB_OBS2_CHNL242_RDATA0_ADDR A:0x3392018
y.create.l HWIO_PMIC_ARB_OBS2_CHNL243_RDATA0_ADDR A:0x339a018
y.create.l HWIO_PMIC_ARB_OBS2_CHNL244_RDATA0_ADDR A:0x33a2018
y.create.l HWIO_PMIC_ARB_OBS2_CHNL245_RDATA0_ADDR A:0x33aa018
y.create.l HWIO_PMIC_ARB_OBS2_CHNL246_RDATA0_ADDR A:0x33b2018
y.create.l HWIO_PMIC_ARB_OBS2_CHNL247_RDATA0_ADDR A:0x33ba018
y.create.l HWIO_PMIC_ARB_OBS2_CHNL248_RDATA0_ADDR A:0x33c2018
y.create.l HWIO_PMIC_ARB_OBS2_CHNL249_RDATA0_ADDR A:0x33ca018
y.create.l HWIO_PMIC_ARB_OBS2_CHNL250_RDATA0_ADDR A:0x33d2018
y.create.l HWIO_PMIC_ARB_OBS2_CHNL251_RDATA0_ADDR A:0x33da018
y.create.l HWIO_PMIC_ARB_OBS2_CHNL252_RDATA0_ADDR A:0x33e2018
y.create.l HWIO_PMIC_ARB_OBS2_CHNL253_RDATA0_ADDR A:0x33ea018
y.create.l HWIO_PMIC_ARB_OBS2_CHNL254_RDATA0_ADDR A:0x33f2018
y.create.l HWIO_PMIC_ARB_OBS2_CHNL255_RDATA0_ADDR A:0x33fa018
y.create.l HWIO_PMIC_ARB_OBS3_CHNL0_RDATA0_ADDR A:0x2c03018
y.create.l HWIO_PMIC_ARB_OBS3_CHNL1_RDATA0_ADDR A:0x2c0b018
y.create.l HWIO_PMIC_ARB_OBS3_CHNL2_RDATA0_ADDR A:0x2c13018
y.create.l HWIO_PMIC_ARB_OBS3_CHNL3_RDATA0_ADDR A:0x2c1b018
y.create.l HWIO_PMIC_ARB_OBS3_CHNL4_RDATA0_ADDR A:0x2c23018
y.create.l HWIO_PMIC_ARB_OBS3_CHNL5_RDATA0_ADDR A:0x2c2b018
y.create.l HWIO_PMIC_ARB_OBS3_CHNL6_RDATA0_ADDR A:0x2c33018
y.create.l HWIO_PMIC_ARB_OBS3_CHNL7_RDATA0_ADDR A:0x2c3b018
y.create.l HWIO_PMIC_ARB_OBS3_CHNL8_RDATA0_ADDR A:0x2c43018
y.create.l HWIO_PMIC_ARB_OBS3_CHNL9_RDATA0_ADDR A:0x2c4b018
y.create.l HWIO_PMIC_ARB_OBS3_CHNL10_RDATA0_ADDR A:0x2c53018
y.create.l HWIO_PMIC_ARB_OBS3_CHNL11_RDATA0_ADDR A:0x2c5b018
y.create.l HWIO_PMIC_ARB_OBS3_CHNL12_RDATA0_ADDR A:0x2c63018
y.create.l HWIO_PMIC_ARB_OBS3_CHNL13_RDATA0_ADDR A:0x2c6b018
y.create.l HWIO_PMIC_ARB_OBS3_CHNL14_RDATA0_ADDR A:0x2c73018
y.create.l HWIO_PMIC_ARB_OBS3_CHNL15_RDATA0_ADDR A:0x2c7b018
y.create.l HWIO_PMIC_ARB_OBS3_CHNL16_RDATA0_ADDR A:0x2c83018
y.create.l HWIO_PMIC_ARB_OBS3_CHNL17_RDATA0_ADDR A:0x2c8b018
y.create.l HWIO_PMIC_ARB_OBS3_CHNL18_RDATA0_ADDR A:0x2c93018
y.create.l HWIO_PMIC_ARB_OBS3_CHNL19_RDATA0_ADDR A:0x2c9b018
y.create.l HWIO_PMIC_ARB_OBS3_CHNL20_RDATA0_ADDR A:0x2ca3018
y.create.l HWIO_PMIC_ARB_OBS3_CHNL21_RDATA0_ADDR A:0x2cab018
y.create.l HWIO_PMIC_ARB_OBS3_CHNL22_RDATA0_ADDR A:0x2cb3018
y.create.l HWIO_PMIC_ARB_OBS3_CHNL23_RDATA0_ADDR A:0x2cbb018
y.create.l HWIO_PMIC_ARB_OBS3_CHNL24_RDATA0_ADDR A:0x2cc3018
y.create.l HWIO_PMIC_ARB_OBS3_CHNL25_RDATA0_ADDR A:0x2ccb018
y.create.l HWIO_PMIC_ARB_OBS3_CHNL26_RDATA0_ADDR A:0x2cd3018
y.create.l HWIO_PMIC_ARB_OBS3_CHNL27_RDATA0_ADDR A:0x2cdb018
y.create.l HWIO_PMIC_ARB_OBS3_CHNL28_RDATA0_ADDR A:0x2ce3018
y.create.l HWIO_PMIC_ARB_OBS3_CHNL29_RDATA0_ADDR A:0x2ceb018
y.create.l HWIO_PMIC_ARB_OBS3_CHNL30_RDATA0_ADDR A:0x2cf3018
y.create.l HWIO_PMIC_ARB_OBS3_CHNL31_RDATA0_ADDR A:0x2cfb018
y.create.l HWIO_PMIC_ARB_OBS3_CHNL32_RDATA0_ADDR A:0x2d03018
y.create.l HWIO_PMIC_ARB_OBS3_CHNL33_RDATA0_ADDR A:0x2d0b018
y.create.l HWIO_PMIC_ARB_OBS3_CHNL34_RDATA0_ADDR A:0x2d13018
y.create.l HWIO_PMIC_ARB_OBS3_CHNL35_RDATA0_ADDR A:0x2d1b018
y.create.l HWIO_PMIC_ARB_OBS3_CHNL36_RDATA0_ADDR A:0x2d23018
y.create.l HWIO_PMIC_ARB_OBS3_CHNL37_RDATA0_ADDR A:0x2d2b018
y.create.l HWIO_PMIC_ARB_OBS3_CHNL38_RDATA0_ADDR A:0x2d33018
y.create.l HWIO_PMIC_ARB_OBS3_CHNL39_RDATA0_ADDR A:0x2d3b018
y.create.l HWIO_PMIC_ARB_OBS3_CHNL40_RDATA0_ADDR A:0x2d43018
y.create.l HWIO_PMIC_ARB_OBS3_CHNL41_RDATA0_ADDR A:0x2d4b018
y.create.l HWIO_PMIC_ARB_OBS3_CHNL42_RDATA0_ADDR A:0x2d53018
y.create.l HWIO_PMIC_ARB_OBS3_CHNL43_RDATA0_ADDR A:0x2d5b018
y.create.l HWIO_PMIC_ARB_OBS3_CHNL44_RDATA0_ADDR A:0x2d63018
y.create.l HWIO_PMIC_ARB_OBS3_CHNL45_RDATA0_ADDR A:0x2d6b018
y.create.l HWIO_PMIC_ARB_OBS3_CHNL46_RDATA0_ADDR A:0x2d73018
y.create.l HWIO_PMIC_ARB_OBS3_CHNL47_RDATA0_ADDR A:0x2d7b018
y.create.l HWIO_PMIC_ARB_OBS3_CHNL48_RDATA0_ADDR A:0x2d83018
y.create.l HWIO_PMIC_ARB_OBS3_CHNL49_RDATA0_ADDR A:0x2d8b018
y.create.l HWIO_PMIC_ARB_OBS3_CHNL50_RDATA0_ADDR A:0x2d93018
y.create.l HWIO_PMIC_ARB_OBS3_CHNL51_RDATA0_ADDR A:0x2d9b018
y.create.l HWIO_PMIC_ARB_OBS3_CHNL52_RDATA0_ADDR A:0x2da3018
y.create.l HWIO_PMIC_ARB_OBS3_CHNL53_RDATA0_ADDR A:0x2dab018
y.create.l HWIO_PMIC_ARB_OBS3_CHNL54_RDATA0_ADDR A:0x2db3018
y.create.l HWIO_PMIC_ARB_OBS3_CHNL55_RDATA0_ADDR A:0x2dbb018
y.create.l HWIO_PMIC_ARB_OBS3_CHNL56_RDATA0_ADDR A:0x2dc3018
y.create.l HWIO_PMIC_ARB_OBS3_CHNL57_RDATA0_ADDR A:0x2dcb018
y.create.l HWIO_PMIC_ARB_OBS3_CHNL58_RDATA0_ADDR A:0x2dd3018
y.create.l HWIO_PMIC_ARB_OBS3_CHNL59_RDATA0_ADDR A:0x2ddb018
y.create.l HWIO_PMIC_ARB_OBS3_CHNL60_RDATA0_ADDR A:0x2de3018
y.create.l HWIO_PMIC_ARB_OBS3_CHNL61_RDATA0_ADDR A:0x2deb018
y.create.l HWIO_PMIC_ARB_OBS3_CHNL62_RDATA0_ADDR A:0x2df3018
y.create.l HWIO_PMIC_ARB_OBS3_CHNL63_RDATA0_ADDR A:0x2dfb018
y.create.l HWIO_PMIC_ARB_OBS3_CHNL64_RDATA0_ADDR A:0x2e03018
y.create.l HWIO_PMIC_ARB_OBS3_CHNL65_RDATA0_ADDR A:0x2e0b018
y.create.l HWIO_PMIC_ARB_OBS3_CHNL66_RDATA0_ADDR A:0x2e13018
y.create.l HWIO_PMIC_ARB_OBS3_CHNL67_RDATA0_ADDR A:0x2e1b018
y.create.l HWIO_PMIC_ARB_OBS3_CHNL68_RDATA0_ADDR A:0x2e23018
y.create.l HWIO_PMIC_ARB_OBS3_CHNL69_RDATA0_ADDR A:0x2e2b018
y.create.l HWIO_PMIC_ARB_OBS3_CHNL70_RDATA0_ADDR A:0x2e33018
y.create.l HWIO_PMIC_ARB_OBS3_CHNL71_RDATA0_ADDR A:0x2e3b018
y.create.l HWIO_PMIC_ARB_OBS3_CHNL72_RDATA0_ADDR A:0x2e43018
y.create.l HWIO_PMIC_ARB_OBS3_CHNL73_RDATA0_ADDR A:0x2e4b018
y.create.l HWIO_PMIC_ARB_OBS3_CHNL74_RDATA0_ADDR A:0x2e53018
y.create.l HWIO_PMIC_ARB_OBS3_CHNL75_RDATA0_ADDR A:0x2e5b018
y.create.l HWIO_PMIC_ARB_OBS3_CHNL76_RDATA0_ADDR A:0x2e63018
y.create.l HWIO_PMIC_ARB_OBS3_CHNL77_RDATA0_ADDR A:0x2e6b018
y.create.l HWIO_PMIC_ARB_OBS3_CHNL78_RDATA0_ADDR A:0x2e73018
y.create.l HWIO_PMIC_ARB_OBS3_CHNL79_RDATA0_ADDR A:0x2e7b018
y.create.l HWIO_PMIC_ARB_OBS3_CHNL80_RDATA0_ADDR A:0x2e83018
y.create.l HWIO_PMIC_ARB_OBS3_CHNL81_RDATA0_ADDR A:0x2e8b018
y.create.l HWIO_PMIC_ARB_OBS3_CHNL82_RDATA0_ADDR A:0x2e93018
y.create.l HWIO_PMIC_ARB_OBS3_CHNL83_RDATA0_ADDR A:0x2e9b018
y.create.l HWIO_PMIC_ARB_OBS3_CHNL84_RDATA0_ADDR A:0x2ea3018
y.create.l HWIO_PMIC_ARB_OBS3_CHNL85_RDATA0_ADDR A:0x2eab018
y.create.l HWIO_PMIC_ARB_OBS3_CHNL86_RDATA0_ADDR A:0x2eb3018
y.create.l HWIO_PMIC_ARB_OBS3_CHNL87_RDATA0_ADDR A:0x2ebb018
y.create.l HWIO_PMIC_ARB_OBS3_CHNL88_RDATA0_ADDR A:0x2ec3018
y.create.l HWIO_PMIC_ARB_OBS3_CHNL89_RDATA0_ADDR A:0x2ecb018
y.create.l HWIO_PMIC_ARB_OBS3_CHNL90_RDATA0_ADDR A:0x2ed3018
y.create.l HWIO_PMIC_ARB_OBS3_CHNL91_RDATA0_ADDR A:0x2edb018
y.create.l HWIO_PMIC_ARB_OBS3_CHNL92_RDATA0_ADDR A:0x2ee3018
y.create.l HWIO_PMIC_ARB_OBS3_CHNL93_RDATA0_ADDR A:0x2eeb018
y.create.l HWIO_PMIC_ARB_OBS3_CHNL94_RDATA0_ADDR A:0x2ef3018
y.create.l HWIO_PMIC_ARB_OBS3_CHNL95_RDATA0_ADDR A:0x2efb018
y.create.l HWIO_PMIC_ARB_OBS3_CHNL96_RDATA0_ADDR A:0x2f03018
y.create.l HWIO_PMIC_ARB_OBS3_CHNL97_RDATA0_ADDR A:0x2f0b018
y.create.l HWIO_PMIC_ARB_OBS3_CHNL98_RDATA0_ADDR A:0x2f13018
y.create.l HWIO_PMIC_ARB_OBS3_CHNL99_RDATA0_ADDR A:0x2f1b018
y.create.l HWIO_PMIC_ARB_OBS3_CHNL100_RDATA0_ADDR A:0x2f23018
y.create.l HWIO_PMIC_ARB_OBS3_CHNL101_RDATA0_ADDR A:0x2f2b018
y.create.l HWIO_PMIC_ARB_OBS3_CHNL102_RDATA0_ADDR A:0x2f33018
y.create.l HWIO_PMIC_ARB_OBS3_CHNL103_RDATA0_ADDR A:0x2f3b018
y.create.l HWIO_PMIC_ARB_OBS3_CHNL104_RDATA0_ADDR A:0x2f43018
y.create.l HWIO_PMIC_ARB_OBS3_CHNL105_RDATA0_ADDR A:0x2f4b018
y.create.l HWIO_PMIC_ARB_OBS3_CHNL106_RDATA0_ADDR A:0x2f53018
y.create.l HWIO_PMIC_ARB_OBS3_CHNL107_RDATA0_ADDR A:0x2f5b018
y.create.l HWIO_PMIC_ARB_OBS3_CHNL108_RDATA0_ADDR A:0x2f63018
y.create.l HWIO_PMIC_ARB_OBS3_CHNL109_RDATA0_ADDR A:0x2f6b018
y.create.l HWIO_PMIC_ARB_OBS3_CHNL110_RDATA0_ADDR A:0x2f73018
y.create.l HWIO_PMIC_ARB_OBS3_CHNL111_RDATA0_ADDR A:0x2f7b018
y.create.l HWIO_PMIC_ARB_OBS3_CHNL112_RDATA0_ADDR A:0x2f83018
y.create.l HWIO_PMIC_ARB_OBS3_CHNL113_RDATA0_ADDR A:0x2f8b018
y.create.l HWIO_PMIC_ARB_OBS3_CHNL114_RDATA0_ADDR A:0x2f93018
y.create.l HWIO_PMIC_ARB_OBS3_CHNL115_RDATA0_ADDR A:0x2f9b018
y.create.l HWIO_PMIC_ARB_OBS3_CHNL116_RDATA0_ADDR A:0x2fa3018
y.create.l HWIO_PMIC_ARB_OBS3_CHNL117_RDATA0_ADDR A:0x2fab018
y.create.l HWIO_PMIC_ARB_OBS3_CHNL118_RDATA0_ADDR A:0x2fb3018
y.create.l HWIO_PMIC_ARB_OBS3_CHNL119_RDATA0_ADDR A:0x2fbb018
y.create.l HWIO_PMIC_ARB_OBS3_CHNL120_RDATA0_ADDR A:0x2fc3018
y.create.l HWIO_PMIC_ARB_OBS3_CHNL121_RDATA0_ADDR A:0x2fcb018
y.create.l HWIO_PMIC_ARB_OBS3_CHNL122_RDATA0_ADDR A:0x2fd3018
y.create.l HWIO_PMIC_ARB_OBS3_CHNL123_RDATA0_ADDR A:0x2fdb018
y.create.l HWIO_PMIC_ARB_OBS3_CHNL124_RDATA0_ADDR A:0x2fe3018
y.create.l HWIO_PMIC_ARB_OBS3_CHNL125_RDATA0_ADDR A:0x2feb018
y.create.l HWIO_PMIC_ARB_OBS3_CHNL126_RDATA0_ADDR A:0x2ff3018
y.create.l HWIO_PMIC_ARB_OBS3_CHNL127_RDATA0_ADDR A:0x2ffb018
y.create.l HWIO_PMIC_ARB_OBS3_CHNL128_RDATA0_ADDR A:0x3003018
y.create.l HWIO_PMIC_ARB_OBS3_CHNL129_RDATA0_ADDR A:0x300b018
y.create.l HWIO_PMIC_ARB_OBS3_CHNL130_RDATA0_ADDR A:0x3013018
y.create.l HWIO_PMIC_ARB_OBS3_CHNL131_RDATA0_ADDR A:0x301b018
y.create.l HWIO_PMIC_ARB_OBS3_CHNL132_RDATA0_ADDR A:0x3023018
y.create.l HWIO_PMIC_ARB_OBS3_CHNL133_RDATA0_ADDR A:0x302b018
y.create.l HWIO_PMIC_ARB_OBS3_CHNL134_RDATA0_ADDR A:0x3033018
y.create.l HWIO_PMIC_ARB_OBS3_CHNL135_RDATA0_ADDR A:0x303b018
y.create.l HWIO_PMIC_ARB_OBS3_CHNL136_RDATA0_ADDR A:0x3043018
y.create.l HWIO_PMIC_ARB_OBS3_CHNL137_RDATA0_ADDR A:0x304b018
y.create.l HWIO_PMIC_ARB_OBS3_CHNL138_RDATA0_ADDR A:0x3053018
y.create.l HWIO_PMIC_ARB_OBS3_CHNL139_RDATA0_ADDR A:0x305b018
y.create.l HWIO_PMIC_ARB_OBS3_CHNL140_RDATA0_ADDR A:0x3063018
y.create.l HWIO_PMIC_ARB_OBS3_CHNL141_RDATA0_ADDR A:0x306b018
y.create.l HWIO_PMIC_ARB_OBS3_CHNL142_RDATA0_ADDR A:0x3073018
y.create.l HWIO_PMIC_ARB_OBS3_CHNL143_RDATA0_ADDR A:0x307b018
y.create.l HWIO_PMIC_ARB_OBS3_CHNL144_RDATA0_ADDR A:0x3083018
y.create.l HWIO_PMIC_ARB_OBS3_CHNL145_RDATA0_ADDR A:0x308b018
y.create.l HWIO_PMIC_ARB_OBS3_CHNL146_RDATA0_ADDR A:0x3093018
y.create.l HWIO_PMIC_ARB_OBS3_CHNL147_RDATA0_ADDR A:0x309b018
y.create.l HWIO_PMIC_ARB_OBS3_CHNL148_RDATA0_ADDR A:0x30a3018
y.create.l HWIO_PMIC_ARB_OBS3_CHNL149_RDATA0_ADDR A:0x30ab018
y.create.l HWIO_PMIC_ARB_OBS3_CHNL150_RDATA0_ADDR A:0x30b3018
y.create.l HWIO_PMIC_ARB_OBS3_CHNL151_RDATA0_ADDR A:0x30bb018
y.create.l HWIO_PMIC_ARB_OBS3_CHNL152_RDATA0_ADDR A:0x30c3018
y.create.l HWIO_PMIC_ARB_OBS3_CHNL153_RDATA0_ADDR A:0x30cb018
y.create.l HWIO_PMIC_ARB_OBS3_CHNL154_RDATA0_ADDR A:0x30d3018
y.create.l HWIO_PMIC_ARB_OBS3_CHNL155_RDATA0_ADDR A:0x30db018
y.create.l HWIO_PMIC_ARB_OBS3_CHNL156_RDATA0_ADDR A:0x30e3018
y.create.l HWIO_PMIC_ARB_OBS3_CHNL157_RDATA0_ADDR A:0x30eb018
y.create.l HWIO_PMIC_ARB_OBS3_CHNL158_RDATA0_ADDR A:0x30f3018
y.create.l HWIO_PMIC_ARB_OBS3_CHNL159_RDATA0_ADDR A:0x30fb018
y.create.l HWIO_PMIC_ARB_OBS3_CHNL160_RDATA0_ADDR A:0x3103018
y.create.l HWIO_PMIC_ARB_OBS3_CHNL161_RDATA0_ADDR A:0x310b018
y.create.l HWIO_PMIC_ARB_OBS3_CHNL162_RDATA0_ADDR A:0x3113018
y.create.l HWIO_PMIC_ARB_OBS3_CHNL163_RDATA0_ADDR A:0x311b018
y.create.l HWIO_PMIC_ARB_OBS3_CHNL164_RDATA0_ADDR A:0x3123018
y.create.l HWIO_PMIC_ARB_OBS3_CHNL165_RDATA0_ADDR A:0x312b018
y.create.l HWIO_PMIC_ARB_OBS3_CHNL166_RDATA0_ADDR A:0x3133018
y.create.l HWIO_PMIC_ARB_OBS3_CHNL167_RDATA0_ADDR A:0x313b018
y.create.l HWIO_PMIC_ARB_OBS3_CHNL168_RDATA0_ADDR A:0x3143018
y.create.l HWIO_PMIC_ARB_OBS3_CHNL169_RDATA0_ADDR A:0x314b018
y.create.l HWIO_PMIC_ARB_OBS3_CHNL170_RDATA0_ADDR A:0x3153018
y.create.l HWIO_PMIC_ARB_OBS3_CHNL171_RDATA0_ADDR A:0x315b018
y.create.l HWIO_PMIC_ARB_OBS3_CHNL172_RDATA0_ADDR A:0x3163018
y.create.l HWIO_PMIC_ARB_OBS3_CHNL173_RDATA0_ADDR A:0x316b018
y.create.l HWIO_PMIC_ARB_OBS3_CHNL174_RDATA0_ADDR A:0x3173018
y.create.l HWIO_PMIC_ARB_OBS3_CHNL175_RDATA0_ADDR A:0x317b018
y.create.l HWIO_PMIC_ARB_OBS3_CHNL176_RDATA0_ADDR A:0x3183018
y.create.l HWIO_PMIC_ARB_OBS3_CHNL177_RDATA0_ADDR A:0x318b018
y.create.l HWIO_PMIC_ARB_OBS3_CHNL178_RDATA0_ADDR A:0x3193018
y.create.l HWIO_PMIC_ARB_OBS3_CHNL179_RDATA0_ADDR A:0x319b018
y.create.l HWIO_PMIC_ARB_OBS3_CHNL180_RDATA0_ADDR A:0x31a3018
y.create.l HWIO_PMIC_ARB_OBS3_CHNL181_RDATA0_ADDR A:0x31ab018
y.create.l HWIO_PMIC_ARB_OBS3_CHNL182_RDATA0_ADDR A:0x31b3018
y.create.l HWIO_PMIC_ARB_OBS3_CHNL183_RDATA0_ADDR A:0x31bb018
y.create.l HWIO_PMIC_ARB_OBS3_CHNL184_RDATA0_ADDR A:0x31c3018
y.create.l HWIO_PMIC_ARB_OBS3_CHNL185_RDATA0_ADDR A:0x31cb018
y.create.l HWIO_PMIC_ARB_OBS3_CHNL186_RDATA0_ADDR A:0x31d3018
y.create.l HWIO_PMIC_ARB_OBS3_CHNL187_RDATA0_ADDR A:0x31db018
y.create.l HWIO_PMIC_ARB_OBS3_CHNL188_RDATA0_ADDR A:0x31e3018
y.create.l HWIO_PMIC_ARB_OBS3_CHNL189_RDATA0_ADDR A:0x31eb018
y.create.l HWIO_PMIC_ARB_OBS3_CHNL190_RDATA0_ADDR A:0x31f3018
y.create.l HWIO_PMIC_ARB_OBS3_CHNL191_RDATA0_ADDR A:0x31fb018
y.create.l HWIO_PMIC_ARB_OBS3_CHNL192_RDATA0_ADDR A:0x3203018
y.create.l HWIO_PMIC_ARB_OBS3_CHNL193_RDATA0_ADDR A:0x320b018
y.create.l HWIO_PMIC_ARB_OBS3_CHNL194_RDATA0_ADDR A:0x3213018
y.create.l HWIO_PMIC_ARB_OBS3_CHNL195_RDATA0_ADDR A:0x321b018
y.create.l HWIO_PMIC_ARB_OBS3_CHNL196_RDATA0_ADDR A:0x3223018
y.create.l HWIO_PMIC_ARB_OBS3_CHNL197_RDATA0_ADDR A:0x322b018
y.create.l HWIO_PMIC_ARB_OBS3_CHNL198_RDATA0_ADDR A:0x3233018
y.create.l HWIO_PMIC_ARB_OBS3_CHNL199_RDATA0_ADDR A:0x323b018
y.create.l HWIO_PMIC_ARB_OBS3_CHNL200_RDATA0_ADDR A:0x3243018
y.create.l HWIO_PMIC_ARB_OBS3_CHNL201_RDATA0_ADDR A:0x324b018
y.create.l HWIO_PMIC_ARB_OBS3_CHNL202_RDATA0_ADDR A:0x3253018
y.create.l HWIO_PMIC_ARB_OBS3_CHNL203_RDATA0_ADDR A:0x325b018
y.create.l HWIO_PMIC_ARB_OBS3_CHNL204_RDATA0_ADDR A:0x3263018
y.create.l HWIO_PMIC_ARB_OBS3_CHNL205_RDATA0_ADDR A:0x326b018
y.create.l HWIO_PMIC_ARB_OBS3_CHNL206_RDATA0_ADDR A:0x3273018
y.create.l HWIO_PMIC_ARB_OBS3_CHNL207_RDATA0_ADDR A:0x327b018
y.create.l HWIO_PMIC_ARB_OBS3_CHNL208_RDATA0_ADDR A:0x3283018
y.create.l HWIO_PMIC_ARB_OBS3_CHNL209_RDATA0_ADDR A:0x328b018
y.create.l HWIO_PMIC_ARB_OBS3_CHNL210_RDATA0_ADDR A:0x3293018
y.create.l HWIO_PMIC_ARB_OBS3_CHNL211_RDATA0_ADDR A:0x329b018
y.create.l HWIO_PMIC_ARB_OBS3_CHNL212_RDATA0_ADDR A:0x32a3018
y.create.l HWIO_PMIC_ARB_OBS3_CHNL213_RDATA0_ADDR A:0x32ab018
y.create.l HWIO_PMIC_ARB_OBS3_CHNL214_RDATA0_ADDR A:0x32b3018
y.create.l HWIO_PMIC_ARB_OBS3_CHNL215_RDATA0_ADDR A:0x32bb018
y.create.l HWIO_PMIC_ARB_OBS3_CHNL216_RDATA0_ADDR A:0x32c3018
y.create.l HWIO_PMIC_ARB_OBS3_CHNL217_RDATA0_ADDR A:0x32cb018
y.create.l HWIO_PMIC_ARB_OBS3_CHNL218_RDATA0_ADDR A:0x32d3018
y.create.l HWIO_PMIC_ARB_OBS3_CHNL219_RDATA0_ADDR A:0x32db018
y.create.l HWIO_PMIC_ARB_OBS3_CHNL220_RDATA0_ADDR A:0x32e3018
y.create.l HWIO_PMIC_ARB_OBS3_CHNL221_RDATA0_ADDR A:0x32eb018
y.create.l HWIO_PMIC_ARB_OBS3_CHNL222_RDATA0_ADDR A:0x32f3018
y.create.l HWIO_PMIC_ARB_OBS3_CHNL223_RDATA0_ADDR A:0x32fb018
y.create.l HWIO_PMIC_ARB_OBS3_CHNL224_RDATA0_ADDR A:0x3303018
y.create.l HWIO_PMIC_ARB_OBS3_CHNL225_RDATA0_ADDR A:0x330b018
y.create.l HWIO_PMIC_ARB_OBS3_CHNL226_RDATA0_ADDR A:0x3313018
y.create.l HWIO_PMIC_ARB_OBS3_CHNL227_RDATA0_ADDR A:0x331b018
y.create.l HWIO_PMIC_ARB_OBS3_CHNL228_RDATA0_ADDR A:0x3323018
y.create.l HWIO_PMIC_ARB_OBS3_CHNL229_RDATA0_ADDR A:0x332b018
y.create.l HWIO_PMIC_ARB_OBS3_CHNL230_RDATA0_ADDR A:0x3333018
y.create.l HWIO_PMIC_ARB_OBS3_CHNL231_RDATA0_ADDR A:0x333b018
y.create.l HWIO_PMIC_ARB_OBS3_CHNL232_RDATA0_ADDR A:0x3343018
y.create.l HWIO_PMIC_ARB_OBS3_CHNL233_RDATA0_ADDR A:0x334b018
y.create.l HWIO_PMIC_ARB_OBS3_CHNL234_RDATA0_ADDR A:0x3353018
y.create.l HWIO_PMIC_ARB_OBS3_CHNL235_RDATA0_ADDR A:0x335b018
y.create.l HWIO_PMIC_ARB_OBS3_CHNL236_RDATA0_ADDR A:0x3363018
y.create.l HWIO_PMIC_ARB_OBS3_CHNL237_RDATA0_ADDR A:0x336b018
y.create.l HWIO_PMIC_ARB_OBS3_CHNL238_RDATA0_ADDR A:0x3373018
y.create.l HWIO_PMIC_ARB_OBS3_CHNL239_RDATA0_ADDR A:0x337b018
y.create.l HWIO_PMIC_ARB_OBS3_CHNL240_RDATA0_ADDR A:0x3383018
y.create.l HWIO_PMIC_ARB_OBS3_CHNL241_RDATA0_ADDR A:0x338b018
y.create.l HWIO_PMIC_ARB_OBS3_CHNL242_RDATA0_ADDR A:0x3393018
y.create.l HWIO_PMIC_ARB_OBS3_CHNL243_RDATA0_ADDR A:0x339b018
y.create.l HWIO_PMIC_ARB_OBS3_CHNL244_RDATA0_ADDR A:0x33a3018
y.create.l HWIO_PMIC_ARB_OBS3_CHNL245_RDATA0_ADDR A:0x33ab018
y.create.l HWIO_PMIC_ARB_OBS3_CHNL246_RDATA0_ADDR A:0x33b3018
y.create.l HWIO_PMIC_ARB_OBS3_CHNL247_RDATA0_ADDR A:0x33bb018
y.create.l HWIO_PMIC_ARB_OBS3_CHNL248_RDATA0_ADDR A:0x33c3018
y.create.l HWIO_PMIC_ARB_OBS3_CHNL249_RDATA0_ADDR A:0x33cb018
y.create.l HWIO_PMIC_ARB_OBS3_CHNL250_RDATA0_ADDR A:0x33d3018
y.create.l HWIO_PMIC_ARB_OBS3_CHNL251_RDATA0_ADDR A:0x33db018
y.create.l HWIO_PMIC_ARB_OBS3_CHNL252_RDATA0_ADDR A:0x33e3018
y.create.l HWIO_PMIC_ARB_OBS3_CHNL253_RDATA0_ADDR A:0x33eb018
y.create.l HWIO_PMIC_ARB_OBS3_CHNL254_RDATA0_ADDR A:0x33f3018
y.create.l HWIO_PMIC_ARB_OBS3_CHNL255_RDATA0_ADDR A:0x33fb018
y.create.l HWIO_PMIC_ARB_OBS4_CHNL0_RDATA0_ADDR A:0x2c04018
y.create.l HWIO_PMIC_ARB_OBS4_CHNL1_RDATA0_ADDR A:0x2c0c018
y.create.l HWIO_PMIC_ARB_OBS4_CHNL2_RDATA0_ADDR A:0x2c14018
y.create.l HWIO_PMIC_ARB_OBS4_CHNL3_RDATA0_ADDR A:0x2c1c018
y.create.l HWIO_PMIC_ARB_OBS4_CHNL4_RDATA0_ADDR A:0x2c24018
y.create.l HWIO_PMIC_ARB_OBS4_CHNL5_RDATA0_ADDR A:0x2c2c018
y.create.l HWIO_PMIC_ARB_OBS4_CHNL6_RDATA0_ADDR A:0x2c34018
y.create.l HWIO_PMIC_ARB_OBS4_CHNL7_RDATA0_ADDR A:0x2c3c018
y.create.l HWIO_PMIC_ARB_OBS4_CHNL8_RDATA0_ADDR A:0x2c44018
y.create.l HWIO_PMIC_ARB_OBS4_CHNL9_RDATA0_ADDR A:0x2c4c018
y.create.l HWIO_PMIC_ARB_OBS4_CHNL10_RDATA0_ADDR A:0x2c54018
y.create.l HWIO_PMIC_ARB_OBS4_CHNL11_RDATA0_ADDR A:0x2c5c018
y.create.l HWIO_PMIC_ARB_OBS4_CHNL12_RDATA0_ADDR A:0x2c64018
y.create.l HWIO_PMIC_ARB_OBS4_CHNL13_RDATA0_ADDR A:0x2c6c018
y.create.l HWIO_PMIC_ARB_OBS4_CHNL14_RDATA0_ADDR A:0x2c74018
y.create.l HWIO_PMIC_ARB_OBS4_CHNL15_RDATA0_ADDR A:0x2c7c018
y.create.l HWIO_PMIC_ARB_OBS4_CHNL16_RDATA0_ADDR A:0x2c84018
y.create.l HWIO_PMIC_ARB_OBS4_CHNL17_RDATA0_ADDR A:0x2c8c018
y.create.l HWIO_PMIC_ARB_OBS4_CHNL18_RDATA0_ADDR A:0x2c94018
y.create.l HWIO_PMIC_ARB_OBS4_CHNL19_RDATA0_ADDR A:0x2c9c018
y.create.l HWIO_PMIC_ARB_OBS4_CHNL20_RDATA0_ADDR A:0x2ca4018
y.create.l HWIO_PMIC_ARB_OBS4_CHNL21_RDATA0_ADDR A:0x2cac018
y.create.l HWIO_PMIC_ARB_OBS4_CHNL22_RDATA0_ADDR A:0x2cb4018
y.create.l HWIO_PMIC_ARB_OBS4_CHNL23_RDATA0_ADDR A:0x2cbc018
y.create.l HWIO_PMIC_ARB_OBS4_CHNL24_RDATA0_ADDR A:0x2cc4018
y.create.l HWIO_PMIC_ARB_OBS4_CHNL25_RDATA0_ADDR A:0x2ccc018
y.create.l HWIO_PMIC_ARB_OBS4_CHNL26_RDATA0_ADDR A:0x2cd4018
y.create.l HWIO_PMIC_ARB_OBS4_CHNL27_RDATA0_ADDR A:0x2cdc018
y.create.l HWIO_PMIC_ARB_OBS4_CHNL28_RDATA0_ADDR A:0x2ce4018
y.create.l HWIO_PMIC_ARB_OBS4_CHNL29_RDATA0_ADDR A:0x2cec018
y.create.l HWIO_PMIC_ARB_OBS4_CHNL30_RDATA0_ADDR A:0x2cf4018
y.create.l HWIO_PMIC_ARB_OBS4_CHNL31_RDATA0_ADDR A:0x2cfc018
y.create.l HWIO_PMIC_ARB_OBS4_CHNL32_RDATA0_ADDR A:0x2d04018
y.create.l HWIO_PMIC_ARB_OBS4_CHNL33_RDATA0_ADDR A:0x2d0c018
y.create.l HWIO_PMIC_ARB_OBS4_CHNL34_RDATA0_ADDR A:0x2d14018
y.create.l HWIO_PMIC_ARB_OBS4_CHNL35_RDATA0_ADDR A:0x2d1c018
y.create.l HWIO_PMIC_ARB_OBS4_CHNL36_RDATA0_ADDR A:0x2d24018
y.create.l HWIO_PMIC_ARB_OBS4_CHNL37_RDATA0_ADDR A:0x2d2c018
y.create.l HWIO_PMIC_ARB_OBS4_CHNL38_RDATA0_ADDR A:0x2d34018
y.create.l HWIO_PMIC_ARB_OBS4_CHNL39_RDATA0_ADDR A:0x2d3c018
y.create.l HWIO_PMIC_ARB_OBS4_CHNL40_RDATA0_ADDR A:0x2d44018
y.create.l HWIO_PMIC_ARB_OBS4_CHNL41_RDATA0_ADDR A:0x2d4c018
y.create.l HWIO_PMIC_ARB_OBS4_CHNL42_RDATA0_ADDR A:0x2d54018
y.create.l HWIO_PMIC_ARB_OBS4_CHNL43_RDATA0_ADDR A:0x2d5c018
y.create.l HWIO_PMIC_ARB_OBS4_CHNL44_RDATA0_ADDR A:0x2d64018
y.create.l HWIO_PMIC_ARB_OBS4_CHNL45_RDATA0_ADDR A:0x2d6c018
y.create.l HWIO_PMIC_ARB_OBS4_CHNL46_RDATA0_ADDR A:0x2d74018
y.create.l HWIO_PMIC_ARB_OBS4_CHNL47_RDATA0_ADDR A:0x2d7c018
y.create.l HWIO_PMIC_ARB_OBS4_CHNL48_RDATA0_ADDR A:0x2d84018
y.create.l HWIO_PMIC_ARB_OBS4_CHNL49_RDATA0_ADDR A:0x2d8c018
y.create.l HWIO_PMIC_ARB_OBS4_CHNL50_RDATA0_ADDR A:0x2d94018
y.create.l HWIO_PMIC_ARB_OBS4_CHNL51_RDATA0_ADDR A:0x2d9c018
y.create.l HWIO_PMIC_ARB_OBS4_CHNL52_RDATA0_ADDR A:0x2da4018
y.create.l HWIO_PMIC_ARB_OBS4_CHNL53_RDATA0_ADDR A:0x2dac018
y.create.l HWIO_PMIC_ARB_OBS4_CHNL54_RDATA0_ADDR A:0x2db4018
y.create.l HWIO_PMIC_ARB_OBS4_CHNL55_RDATA0_ADDR A:0x2dbc018
y.create.l HWIO_PMIC_ARB_OBS4_CHNL56_RDATA0_ADDR A:0x2dc4018
y.create.l HWIO_PMIC_ARB_OBS4_CHNL57_RDATA0_ADDR A:0x2dcc018
y.create.l HWIO_PMIC_ARB_OBS4_CHNL58_RDATA0_ADDR A:0x2dd4018
y.create.l HWIO_PMIC_ARB_OBS4_CHNL59_RDATA0_ADDR A:0x2ddc018
y.create.l HWIO_PMIC_ARB_OBS4_CHNL60_RDATA0_ADDR A:0x2de4018
y.create.l HWIO_PMIC_ARB_OBS4_CHNL61_RDATA0_ADDR A:0x2dec018
y.create.l HWIO_PMIC_ARB_OBS4_CHNL62_RDATA0_ADDR A:0x2df4018
y.create.l HWIO_PMIC_ARB_OBS4_CHNL63_RDATA0_ADDR A:0x2dfc018
y.create.l HWIO_PMIC_ARB_OBS4_CHNL64_RDATA0_ADDR A:0x2e04018
y.create.l HWIO_PMIC_ARB_OBS4_CHNL65_RDATA0_ADDR A:0x2e0c018
y.create.l HWIO_PMIC_ARB_OBS4_CHNL66_RDATA0_ADDR A:0x2e14018
y.create.l HWIO_PMIC_ARB_OBS4_CHNL67_RDATA0_ADDR A:0x2e1c018
y.create.l HWIO_PMIC_ARB_OBS4_CHNL68_RDATA0_ADDR A:0x2e24018
y.create.l HWIO_PMIC_ARB_OBS4_CHNL69_RDATA0_ADDR A:0x2e2c018
y.create.l HWIO_PMIC_ARB_OBS4_CHNL70_RDATA0_ADDR A:0x2e34018
y.create.l HWIO_PMIC_ARB_OBS4_CHNL71_RDATA0_ADDR A:0x2e3c018
y.create.l HWIO_PMIC_ARB_OBS4_CHNL72_RDATA0_ADDR A:0x2e44018
y.create.l HWIO_PMIC_ARB_OBS4_CHNL73_RDATA0_ADDR A:0x2e4c018
y.create.l HWIO_PMIC_ARB_OBS4_CHNL74_RDATA0_ADDR A:0x2e54018
y.create.l HWIO_PMIC_ARB_OBS4_CHNL75_RDATA0_ADDR A:0x2e5c018
y.create.l HWIO_PMIC_ARB_OBS4_CHNL76_RDATA0_ADDR A:0x2e64018
y.create.l HWIO_PMIC_ARB_OBS4_CHNL77_RDATA0_ADDR A:0x2e6c018
y.create.l HWIO_PMIC_ARB_OBS4_CHNL78_RDATA0_ADDR A:0x2e74018
y.create.l HWIO_PMIC_ARB_OBS4_CHNL79_RDATA0_ADDR A:0x2e7c018
y.create.l HWIO_PMIC_ARB_OBS4_CHNL80_RDATA0_ADDR A:0x2e84018
y.create.l HWIO_PMIC_ARB_OBS4_CHNL81_RDATA0_ADDR A:0x2e8c018
y.create.l HWIO_PMIC_ARB_OBS4_CHNL82_RDATA0_ADDR A:0x2e94018
y.create.l HWIO_PMIC_ARB_OBS4_CHNL83_RDATA0_ADDR A:0x2e9c018
y.create.l HWIO_PMIC_ARB_OBS4_CHNL84_RDATA0_ADDR A:0x2ea4018
y.create.l HWIO_PMIC_ARB_OBS4_CHNL85_RDATA0_ADDR A:0x2eac018
y.create.l HWIO_PMIC_ARB_OBS4_CHNL86_RDATA0_ADDR A:0x2eb4018
y.create.l HWIO_PMIC_ARB_OBS4_CHNL87_RDATA0_ADDR A:0x2ebc018
y.create.l HWIO_PMIC_ARB_OBS4_CHNL88_RDATA0_ADDR A:0x2ec4018
y.create.l HWIO_PMIC_ARB_OBS4_CHNL89_RDATA0_ADDR A:0x2ecc018
y.create.l HWIO_PMIC_ARB_OBS4_CHNL90_RDATA0_ADDR A:0x2ed4018
y.create.l HWIO_PMIC_ARB_OBS4_CHNL91_RDATA0_ADDR A:0x2edc018
y.create.l HWIO_PMIC_ARB_OBS4_CHNL92_RDATA0_ADDR A:0x2ee4018
y.create.l HWIO_PMIC_ARB_OBS4_CHNL93_RDATA0_ADDR A:0x2eec018
y.create.l HWIO_PMIC_ARB_OBS4_CHNL94_RDATA0_ADDR A:0x2ef4018
y.create.l HWIO_PMIC_ARB_OBS4_CHNL95_RDATA0_ADDR A:0x2efc018
y.create.l HWIO_PMIC_ARB_OBS4_CHNL96_RDATA0_ADDR A:0x2f04018
y.create.l HWIO_PMIC_ARB_OBS4_CHNL97_RDATA0_ADDR A:0x2f0c018
y.create.l HWIO_PMIC_ARB_OBS4_CHNL98_RDATA0_ADDR A:0x2f14018
y.create.l HWIO_PMIC_ARB_OBS4_CHNL99_RDATA0_ADDR A:0x2f1c018
y.create.l HWIO_PMIC_ARB_OBS4_CHNL100_RDATA0_ADDR A:0x2f24018
y.create.l HWIO_PMIC_ARB_OBS4_CHNL101_RDATA0_ADDR A:0x2f2c018
y.create.l HWIO_PMIC_ARB_OBS4_CHNL102_RDATA0_ADDR A:0x2f34018
y.create.l HWIO_PMIC_ARB_OBS4_CHNL103_RDATA0_ADDR A:0x2f3c018
y.create.l HWIO_PMIC_ARB_OBS4_CHNL104_RDATA0_ADDR A:0x2f44018
y.create.l HWIO_PMIC_ARB_OBS4_CHNL105_RDATA0_ADDR A:0x2f4c018
y.create.l HWIO_PMIC_ARB_OBS4_CHNL106_RDATA0_ADDR A:0x2f54018
y.create.l HWIO_PMIC_ARB_OBS4_CHNL107_RDATA0_ADDR A:0x2f5c018
y.create.l HWIO_PMIC_ARB_OBS4_CHNL108_RDATA0_ADDR A:0x2f64018
y.create.l HWIO_PMIC_ARB_OBS4_CHNL109_RDATA0_ADDR A:0x2f6c018
y.create.l HWIO_PMIC_ARB_OBS4_CHNL110_RDATA0_ADDR A:0x2f74018
y.create.l HWIO_PMIC_ARB_OBS4_CHNL111_RDATA0_ADDR A:0x2f7c018
y.create.l HWIO_PMIC_ARB_OBS4_CHNL112_RDATA0_ADDR A:0x2f84018
y.create.l HWIO_PMIC_ARB_OBS4_CHNL113_RDATA0_ADDR A:0x2f8c018
y.create.l HWIO_PMIC_ARB_OBS4_CHNL114_RDATA0_ADDR A:0x2f94018
y.create.l HWIO_PMIC_ARB_OBS4_CHNL115_RDATA0_ADDR A:0x2f9c018
y.create.l HWIO_PMIC_ARB_OBS4_CHNL116_RDATA0_ADDR A:0x2fa4018
y.create.l HWIO_PMIC_ARB_OBS4_CHNL117_RDATA0_ADDR A:0x2fac018
y.create.l HWIO_PMIC_ARB_OBS4_CHNL118_RDATA0_ADDR A:0x2fb4018
y.create.l HWIO_PMIC_ARB_OBS4_CHNL119_RDATA0_ADDR A:0x2fbc018
y.create.l HWIO_PMIC_ARB_OBS4_CHNL120_RDATA0_ADDR A:0x2fc4018
y.create.l HWIO_PMIC_ARB_OBS4_CHNL121_RDATA0_ADDR A:0x2fcc018
y.create.l HWIO_PMIC_ARB_OBS4_CHNL122_RDATA0_ADDR A:0x2fd4018
y.create.l HWIO_PMIC_ARB_OBS4_CHNL123_RDATA0_ADDR A:0x2fdc018
y.create.l HWIO_PMIC_ARB_OBS4_CHNL124_RDATA0_ADDR A:0x2fe4018
y.create.l HWIO_PMIC_ARB_OBS4_CHNL125_RDATA0_ADDR A:0x2fec018
y.create.l HWIO_PMIC_ARB_OBS4_CHNL126_RDATA0_ADDR A:0x2ff4018
y.create.l HWIO_PMIC_ARB_OBS4_CHNL127_RDATA0_ADDR A:0x2ffc018
y.create.l HWIO_PMIC_ARB_OBS4_CHNL128_RDATA0_ADDR A:0x3004018
y.create.l HWIO_PMIC_ARB_OBS4_CHNL129_RDATA0_ADDR A:0x300c018
y.create.l HWIO_PMIC_ARB_OBS4_CHNL130_RDATA0_ADDR A:0x3014018
y.create.l HWIO_PMIC_ARB_OBS4_CHNL131_RDATA0_ADDR A:0x301c018
y.create.l HWIO_PMIC_ARB_OBS4_CHNL132_RDATA0_ADDR A:0x3024018
y.create.l HWIO_PMIC_ARB_OBS4_CHNL133_RDATA0_ADDR A:0x302c018
y.create.l HWIO_PMIC_ARB_OBS4_CHNL134_RDATA0_ADDR A:0x3034018
y.create.l HWIO_PMIC_ARB_OBS4_CHNL135_RDATA0_ADDR A:0x303c018
y.create.l HWIO_PMIC_ARB_OBS4_CHNL136_RDATA0_ADDR A:0x3044018
y.create.l HWIO_PMIC_ARB_OBS4_CHNL137_RDATA0_ADDR A:0x304c018
y.create.l HWIO_PMIC_ARB_OBS4_CHNL138_RDATA0_ADDR A:0x3054018
y.create.l HWIO_PMIC_ARB_OBS4_CHNL139_RDATA0_ADDR A:0x305c018
y.create.l HWIO_PMIC_ARB_OBS4_CHNL140_RDATA0_ADDR A:0x3064018
y.create.l HWIO_PMIC_ARB_OBS4_CHNL141_RDATA0_ADDR A:0x306c018
y.create.l HWIO_PMIC_ARB_OBS4_CHNL142_RDATA0_ADDR A:0x3074018
y.create.l HWIO_PMIC_ARB_OBS4_CHNL143_RDATA0_ADDR A:0x307c018
y.create.l HWIO_PMIC_ARB_OBS4_CHNL144_RDATA0_ADDR A:0x3084018
y.create.l HWIO_PMIC_ARB_OBS4_CHNL145_RDATA0_ADDR A:0x308c018
y.create.l HWIO_PMIC_ARB_OBS4_CHNL146_RDATA0_ADDR A:0x3094018
y.create.l HWIO_PMIC_ARB_OBS4_CHNL147_RDATA0_ADDR A:0x309c018
y.create.l HWIO_PMIC_ARB_OBS4_CHNL148_RDATA0_ADDR A:0x30a4018
y.create.l HWIO_PMIC_ARB_OBS4_CHNL149_RDATA0_ADDR A:0x30ac018
y.create.l HWIO_PMIC_ARB_OBS4_CHNL150_RDATA0_ADDR A:0x30b4018
y.create.l HWIO_PMIC_ARB_OBS4_CHNL151_RDATA0_ADDR A:0x30bc018
y.create.l HWIO_PMIC_ARB_OBS4_CHNL152_RDATA0_ADDR A:0x30c4018
y.create.l HWIO_PMIC_ARB_OBS4_CHNL153_RDATA0_ADDR A:0x30cc018
y.create.l HWIO_PMIC_ARB_OBS4_CHNL154_RDATA0_ADDR A:0x30d4018
y.create.l HWIO_PMIC_ARB_OBS4_CHNL155_RDATA0_ADDR A:0x30dc018
y.create.l HWIO_PMIC_ARB_OBS4_CHNL156_RDATA0_ADDR A:0x30e4018
y.create.l HWIO_PMIC_ARB_OBS4_CHNL157_RDATA0_ADDR A:0x30ec018
y.create.l HWIO_PMIC_ARB_OBS4_CHNL158_RDATA0_ADDR A:0x30f4018
y.create.l HWIO_PMIC_ARB_OBS4_CHNL159_RDATA0_ADDR A:0x30fc018
y.create.l HWIO_PMIC_ARB_OBS4_CHNL160_RDATA0_ADDR A:0x3104018
y.create.l HWIO_PMIC_ARB_OBS4_CHNL161_RDATA0_ADDR A:0x310c018
y.create.l HWIO_PMIC_ARB_OBS4_CHNL162_RDATA0_ADDR A:0x3114018
y.create.l HWIO_PMIC_ARB_OBS4_CHNL163_RDATA0_ADDR A:0x311c018
y.create.l HWIO_PMIC_ARB_OBS4_CHNL164_RDATA0_ADDR A:0x3124018
y.create.l HWIO_PMIC_ARB_OBS4_CHNL165_RDATA0_ADDR A:0x312c018
y.create.l HWIO_PMIC_ARB_OBS4_CHNL166_RDATA0_ADDR A:0x3134018
y.create.l HWIO_PMIC_ARB_OBS4_CHNL167_RDATA0_ADDR A:0x313c018
y.create.l HWIO_PMIC_ARB_OBS4_CHNL168_RDATA0_ADDR A:0x3144018
y.create.l HWIO_PMIC_ARB_OBS4_CHNL169_RDATA0_ADDR A:0x314c018
y.create.l HWIO_PMIC_ARB_OBS4_CHNL170_RDATA0_ADDR A:0x3154018
y.create.l HWIO_PMIC_ARB_OBS4_CHNL171_RDATA0_ADDR A:0x315c018
y.create.l HWIO_PMIC_ARB_OBS4_CHNL172_RDATA0_ADDR A:0x3164018
y.create.l HWIO_PMIC_ARB_OBS4_CHNL173_RDATA0_ADDR A:0x316c018
y.create.l HWIO_PMIC_ARB_OBS4_CHNL174_RDATA0_ADDR A:0x3174018
y.create.l HWIO_PMIC_ARB_OBS4_CHNL175_RDATA0_ADDR A:0x317c018
y.create.l HWIO_PMIC_ARB_OBS4_CHNL176_RDATA0_ADDR A:0x3184018
y.create.l HWIO_PMIC_ARB_OBS4_CHNL177_RDATA0_ADDR A:0x318c018
y.create.l HWIO_PMIC_ARB_OBS4_CHNL178_RDATA0_ADDR A:0x3194018
y.create.l HWIO_PMIC_ARB_OBS4_CHNL179_RDATA0_ADDR A:0x319c018
y.create.l HWIO_PMIC_ARB_OBS4_CHNL180_RDATA0_ADDR A:0x31a4018
y.create.l HWIO_PMIC_ARB_OBS4_CHNL181_RDATA0_ADDR A:0x31ac018
y.create.l HWIO_PMIC_ARB_OBS4_CHNL182_RDATA0_ADDR A:0x31b4018
y.create.l HWIO_PMIC_ARB_OBS4_CHNL183_RDATA0_ADDR A:0x31bc018
y.create.l HWIO_PMIC_ARB_OBS4_CHNL184_RDATA0_ADDR A:0x31c4018
y.create.l HWIO_PMIC_ARB_OBS4_CHNL185_RDATA0_ADDR A:0x31cc018
y.create.l HWIO_PMIC_ARB_OBS4_CHNL186_RDATA0_ADDR A:0x31d4018
y.create.l HWIO_PMIC_ARB_OBS4_CHNL187_RDATA0_ADDR A:0x31dc018
y.create.l HWIO_PMIC_ARB_OBS4_CHNL188_RDATA0_ADDR A:0x31e4018
y.create.l HWIO_PMIC_ARB_OBS4_CHNL189_RDATA0_ADDR A:0x31ec018
y.create.l HWIO_PMIC_ARB_OBS4_CHNL190_RDATA0_ADDR A:0x31f4018
y.create.l HWIO_PMIC_ARB_OBS4_CHNL191_RDATA0_ADDR A:0x31fc018
y.create.l HWIO_PMIC_ARB_OBS4_CHNL192_RDATA0_ADDR A:0x3204018
y.create.l HWIO_PMIC_ARB_OBS4_CHNL193_RDATA0_ADDR A:0x320c018
y.create.l HWIO_PMIC_ARB_OBS4_CHNL194_RDATA0_ADDR A:0x3214018
y.create.l HWIO_PMIC_ARB_OBS4_CHNL195_RDATA0_ADDR A:0x321c018
y.create.l HWIO_PMIC_ARB_OBS4_CHNL196_RDATA0_ADDR A:0x3224018
y.create.l HWIO_PMIC_ARB_OBS4_CHNL197_RDATA0_ADDR A:0x322c018
y.create.l HWIO_PMIC_ARB_OBS4_CHNL198_RDATA0_ADDR A:0x3234018
y.create.l HWIO_PMIC_ARB_OBS4_CHNL199_RDATA0_ADDR A:0x323c018
y.create.l HWIO_PMIC_ARB_OBS4_CHNL200_RDATA0_ADDR A:0x3244018
y.create.l HWIO_PMIC_ARB_OBS4_CHNL201_RDATA0_ADDR A:0x324c018
y.create.l HWIO_PMIC_ARB_OBS4_CHNL202_RDATA0_ADDR A:0x3254018
y.create.l HWIO_PMIC_ARB_OBS4_CHNL203_RDATA0_ADDR A:0x325c018
y.create.l HWIO_PMIC_ARB_OBS4_CHNL204_RDATA0_ADDR A:0x3264018
y.create.l HWIO_PMIC_ARB_OBS4_CHNL205_RDATA0_ADDR A:0x326c018
y.create.l HWIO_PMIC_ARB_OBS4_CHNL206_RDATA0_ADDR A:0x3274018
y.create.l HWIO_PMIC_ARB_OBS4_CHNL207_RDATA0_ADDR A:0x327c018
y.create.l HWIO_PMIC_ARB_OBS4_CHNL208_RDATA0_ADDR A:0x3284018
y.create.l HWIO_PMIC_ARB_OBS4_CHNL209_RDATA0_ADDR A:0x328c018
y.create.l HWIO_PMIC_ARB_OBS4_CHNL210_RDATA0_ADDR A:0x3294018
y.create.l HWIO_PMIC_ARB_OBS4_CHNL211_RDATA0_ADDR A:0x329c018
y.create.l HWIO_PMIC_ARB_OBS4_CHNL212_RDATA0_ADDR A:0x32a4018
y.create.l HWIO_PMIC_ARB_OBS4_CHNL213_RDATA0_ADDR A:0x32ac018
y.create.l HWIO_PMIC_ARB_OBS4_CHNL214_RDATA0_ADDR A:0x32b4018
y.create.l HWIO_PMIC_ARB_OBS4_CHNL215_RDATA0_ADDR A:0x32bc018
y.create.l HWIO_PMIC_ARB_OBS4_CHNL216_RDATA0_ADDR A:0x32c4018
y.create.l HWIO_PMIC_ARB_OBS4_CHNL217_RDATA0_ADDR A:0x32cc018
y.create.l HWIO_PMIC_ARB_OBS4_CHNL218_RDATA0_ADDR A:0x32d4018
y.create.l HWIO_PMIC_ARB_OBS4_CHNL219_RDATA0_ADDR A:0x32dc018
y.create.l HWIO_PMIC_ARB_OBS4_CHNL220_RDATA0_ADDR A:0x32e4018
y.create.l HWIO_PMIC_ARB_OBS4_CHNL221_RDATA0_ADDR A:0x32ec018
y.create.l HWIO_PMIC_ARB_OBS4_CHNL222_RDATA0_ADDR A:0x32f4018
y.create.l HWIO_PMIC_ARB_OBS4_CHNL223_RDATA0_ADDR A:0x32fc018
y.create.l HWIO_PMIC_ARB_OBS4_CHNL224_RDATA0_ADDR A:0x3304018
y.create.l HWIO_PMIC_ARB_OBS4_CHNL225_RDATA0_ADDR A:0x330c018
y.create.l HWIO_PMIC_ARB_OBS4_CHNL226_RDATA0_ADDR A:0x3314018
y.create.l HWIO_PMIC_ARB_OBS4_CHNL227_RDATA0_ADDR A:0x331c018
y.create.l HWIO_PMIC_ARB_OBS4_CHNL228_RDATA0_ADDR A:0x3324018
y.create.l HWIO_PMIC_ARB_OBS4_CHNL229_RDATA0_ADDR A:0x332c018
y.create.l HWIO_PMIC_ARB_OBS4_CHNL230_RDATA0_ADDR A:0x3334018
y.create.l HWIO_PMIC_ARB_OBS4_CHNL231_RDATA0_ADDR A:0x333c018
y.create.l HWIO_PMIC_ARB_OBS4_CHNL232_RDATA0_ADDR A:0x3344018
y.create.l HWIO_PMIC_ARB_OBS4_CHNL233_RDATA0_ADDR A:0x334c018
y.create.l HWIO_PMIC_ARB_OBS4_CHNL234_RDATA0_ADDR A:0x3354018
y.create.l HWIO_PMIC_ARB_OBS4_CHNL235_RDATA0_ADDR A:0x335c018
y.create.l HWIO_PMIC_ARB_OBS4_CHNL236_RDATA0_ADDR A:0x3364018
y.create.l HWIO_PMIC_ARB_OBS4_CHNL237_RDATA0_ADDR A:0x336c018
y.create.l HWIO_PMIC_ARB_OBS4_CHNL238_RDATA0_ADDR A:0x3374018
y.create.l HWIO_PMIC_ARB_OBS4_CHNL239_RDATA0_ADDR A:0x337c018
y.create.l HWIO_PMIC_ARB_OBS4_CHNL240_RDATA0_ADDR A:0x3384018
y.create.l HWIO_PMIC_ARB_OBS4_CHNL241_RDATA0_ADDR A:0x338c018
y.create.l HWIO_PMIC_ARB_OBS4_CHNL242_RDATA0_ADDR A:0x3394018
y.create.l HWIO_PMIC_ARB_OBS4_CHNL243_RDATA0_ADDR A:0x339c018
y.create.l HWIO_PMIC_ARB_OBS4_CHNL244_RDATA0_ADDR A:0x33a4018
y.create.l HWIO_PMIC_ARB_OBS4_CHNL245_RDATA0_ADDR A:0x33ac018
y.create.l HWIO_PMIC_ARB_OBS4_CHNL246_RDATA0_ADDR A:0x33b4018
y.create.l HWIO_PMIC_ARB_OBS4_CHNL247_RDATA0_ADDR A:0x33bc018
y.create.l HWIO_PMIC_ARB_OBS4_CHNL248_RDATA0_ADDR A:0x33c4018
y.create.l HWIO_PMIC_ARB_OBS4_CHNL249_RDATA0_ADDR A:0x33cc018
y.create.l HWIO_PMIC_ARB_OBS4_CHNL250_RDATA0_ADDR A:0x33d4018
y.create.l HWIO_PMIC_ARB_OBS4_CHNL251_RDATA0_ADDR A:0x33dc018
y.create.l HWIO_PMIC_ARB_OBS4_CHNL252_RDATA0_ADDR A:0x33e4018
y.create.l HWIO_PMIC_ARB_OBS4_CHNL253_RDATA0_ADDR A:0x33ec018
y.create.l HWIO_PMIC_ARB_OBS4_CHNL254_RDATA0_ADDR A:0x33f4018
y.create.l HWIO_PMIC_ARB_OBS4_CHNL255_RDATA0_ADDR A:0x33fc018
y.create.l HWIO_PMIC_ARB_OBS5_CHNL0_RDATA0_ADDR A:0x2c05018
y.create.l HWIO_PMIC_ARB_OBS5_CHNL1_RDATA0_ADDR A:0x2c0d018
y.create.l HWIO_PMIC_ARB_OBS5_CHNL2_RDATA0_ADDR A:0x2c15018
y.create.l HWIO_PMIC_ARB_OBS5_CHNL3_RDATA0_ADDR A:0x2c1d018
y.create.l HWIO_PMIC_ARB_OBS5_CHNL4_RDATA0_ADDR A:0x2c25018
y.create.l HWIO_PMIC_ARB_OBS5_CHNL5_RDATA0_ADDR A:0x2c2d018
y.create.l HWIO_PMIC_ARB_OBS5_CHNL6_RDATA0_ADDR A:0x2c35018
y.create.l HWIO_PMIC_ARB_OBS5_CHNL7_RDATA0_ADDR A:0x2c3d018
y.create.l HWIO_PMIC_ARB_OBS5_CHNL8_RDATA0_ADDR A:0x2c45018
y.create.l HWIO_PMIC_ARB_OBS5_CHNL9_RDATA0_ADDR A:0x2c4d018
y.create.l HWIO_PMIC_ARB_OBS5_CHNL10_RDATA0_ADDR A:0x2c55018
y.create.l HWIO_PMIC_ARB_OBS5_CHNL11_RDATA0_ADDR A:0x2c5d018
y.create.l HWIO_PMIC_ARB_OBS5_CHNL12_RDATA0_ADDR A:0x2c65018
y.create.l HWIO_PMIC_ARB_OBS5_CHNL13_RDATA0_ADDR A:0x2c6d018
y.create.l HWIO_PMIC_ARB_OBS5_CHNL14_RDATA0_ADDR A:0x2c75018
y.create.l HWIO_PMIC_ARB_OBS5_CHNL15_RDATA0_ADDR A:0x2c7d018
y.create.l HWIO_PMIC_ARB_OBS5_CHNL16_RDATA0_ADDR A:0x2c85018
y.create.l HWIO_PMIC_ARB_OBS5_CHNL17_RDATA0_ADDR A:0x2c8d018
y.create.l HWIO_PMIC_ARB_OBS5_CHNL18_RDATA0_ADDR A:0x2c95018
y.create.l HWIO_PMIC_ARB_OBS5_CHNL19_RDATA0_ADDR A:0x2c9d018
y.create.l HWIO_PMIC_ARB_OBS5_CHNL20_RDATA0_ADDR A:0x2ca5018
y.create.l HWIO_PMIC_ARB_OBS5_CHNL21_RDATA0_ADDR A:0x2cad018
y.create.l HWIO_PMIC_ARB_OBS5_CHNL22_RDATA0_ADDR A:0x2cb5018
y.create.l HWIO_PMIC_ARB_OBS5_CHNL23_RDATA0_ADDR A:0x2cbd018
y.create.l HWIO_PMIC_ARB_OBS5_CHNL24_RDATA0_ADDR A:0x2cc5018
y.create.l HWIO_PMIC_ARB_OBS5_CHNL25_RDATA0_ADDR A:0x2ccd018
y.create.l HWIO_PMIC_ARB_OBS5_CHNL26_RDATA0_ADDR A:0x2cd5018
y.create.l HWIO_PMIC_ARB_OBS5_CHNL27_RDATA0_ADDR A:0x2cdd018
y.create.l HWIO_PMIC_ARB_OBS5_CHNL28_RDATA0_ADDR A:0x2ce5018
y.create.l HWIO_PMIC_ARB_OBS5_CHNL29_RDATA0_ADDR A:0x2ced018
y.create.l HWIO_PMIC_ARB_OBS5_CHNL30_RDATA0_ADDR A:0x2cf5018
y.create.l HWIO_PMIC_ARB_OBS5_CHNL31_RDATA0_ADDR A:0x2cfd018
y.create.l HWIO_PMIC_ARB_OBS5_CHNL32_RDATA0_ADDR A:0x2d05018
y.create.l HWIO_PMIC_ARB_OBS5_CHNL33_RDATA0_ADDR A:0x2d0d018
y.create.l HWIO_PMIC_ARB_OBS5_CHNL34_RDATA0_ADDR A:0x2d15018
y.create.l HWIO_PMIC_ARB_OBS5_CHNL35_RDATA0_ADDR A:0x2d1d018
y.create.l HWIO_PMIC_ARB_OBS5_CHNL36_RDATA0_ADDR A:0x2d25018
y.create.l HWIO_PMIC_ARB_OBS5_CHNL37_RDATA0_ADDR A:0x2d2d018
y.create.l HWIO_PMIC_ARB_OBS5_CHNL38_RDATA0_ADDR A:0x2d35018
y.create.l HWIO_PMIC_ARB_OBS5_CHNL39_RDATA0_ADDR A:0x2d3d018
y.create.l HWIO_PMIC_ARB_OBS5_CHNL40_RDATA0_ADDR A:0x2d45018
y.create.l HWIO_PMIC_ARB_OBS5_CHNL41_RDATA0_ADDR A:0x2d4d018
y.create.l HWIO_PMIC_ARB_OBS5_CHNL42_RDATA0_ADDR A:0x2d55018
y.create.l HWIO_PMIC_ARB_OBS5_CHNL43_RDATA0_ADDR A:0x2d5d018
y.create.l HWIO_PMIC_ARB_OBS5_CHNL44_RDATA0_ADDR A:0x2d65018
y.create.l HWIO_PMIC_ARB_OBS5_CHNL45_RDATA0_ADDR A:0x2d6d018
y.create.l HWIO_PMIC_ARB_OBS5_CHNL46_RDATA0_ADDR A:0x2d75018
y.create.l HWIO_PMIC_ARB_OBS5_CHNL47_RDATA0_ADDR A:0x2d7d018
y.create.l HWIO_PMIC_ARB_OBS5_CHNL48_RDATA0_ADDR A:0x2d85018
y.create.l HWIO_PMIC_ARB_OBS5_CHNL49_RDATA0_ADDR A:0x2d8d018
y.create.l HWIO_PMIC_ARB_OBS5_CHNL50_RDATA0_ADDR A:0x2d95018
y.create.l HWIO_PMIC_ARB_OBS5_CHNL51_RDATA0_ADDR A:0x2d9d018
y.create.l HWIO_PMIC_ARB_OBS5_CHNL52_RDATA0_ADDR A:0x2da5018
y.create.l HWIO_PMIC_ARB_OBS5_CHNL53_RDATA0_ADDR A:0x2dad018
y.create.l HWIO_PMIC_ARB_OBS5_CHNL54_RDATA0_ADDR A:0x2db5018
y.create.l HWIO_PMIC_ARB_OBS5_CHNL55_RDATA0_ADDR A:0x2dbd018
y.create.l HWIO_PMIC_ARB_OBS5_CHNL56_RDATA0_ADDR A:0x2dc5018
y.create.l HWIO_PMIC_ARB_OBS5_CHNL57_RDATA0_ADDR A:0x2dcd018
y.create.l HWIO_PMIC_ARB_OBS5_CHNL58_RDATA0_ADDR A:0x2dd5018
y.create.l HWIO_PMIC_ARB_OBS5_CHNL59_RDATA0_ADDR A:0x2ddd018
y.create.l HWIO_PMIC_ARB_OBS5_CHNL60_RDATA0_ADDR A:0x2de5018
y.create.l HWIO_PMIC_ARB_OBS5_CHNL61_RDATA0_ADDR A:0x2ded018
y.create.l HWIO_PMIC_ARB_OBS5_CHNL62_RDATA0_ADDR A:0x2df5018
y.create.l HWIO_PMIC_ARB_OBS5_CHNL63_RDATA0_ADDR A:0x2dfd018
y.create.l HWIO_PMIC_ARB_OBS5_CHNL64_RDATA0_ADDR A:0x2e05018
y.create.l HWIO_PMIC_ARB_OBS5_CHNL65_RDATA0_ADDR A:0x2e0d018
y.create.l HWIO_PMIC_ARB_OBS5_CHNL66_RDATA0_ADDR A:0x2e15018
y.create.l HWIO_PMIC_ARB_OBS5_CHNL67_RDATA0_ADDR A:0x2e1d018
y.create.l HWIO_PMIC_ARB_OBS5_CHNL68_RDATA0_ADDR A:0x2e25018
y.create.l HWIO_PMIC_ARB_OBS5_CHNL69_RDATA0_ADDR A:0x2e2d018
y.create.l HWIO_PMIC_ARB_OBS5_CHNL70_RDATA0_ADDR A:0x2e35018
y.create.l HWIO_PMIC_ARB_OBS5_CHNL71_RDATA0_ADDR A:0x2e3d018
y.create.l HWIO_PMIC_ARB_OBS5_CHNL72_RDATA0_ADDR A:0x2e45018
y.create.l HWIO_PMIC_ARB_OBS5_CHNL73_RDATA0_ADDR A:0x2e4d018
y.create.l HWIO_PMIC_ARB_OBS5_CHNL74_RDATA0_ADDR A:0x2e55018
y.create.l HWIO_PMIC_ARB_OBS5_CHNL75_RDATA0_ADDR A:0x2e5d018
y.create.l HWIO_PMIC_ARB_OBS5_CHNL76_RDATA0_ADDR A:0x2e65018
y.create.l HWIO_PMIC_ARB_OBS5_CHNL77_RDATA0_ADDR A:0x2e6d018
y.create.l HWIO_PMIC_ARB_OBS5_CHNL78_RDATA0_ADDR A:0x2e75018
y.create.l HWIO_PMIC_ARB_OBS5_CHNL79_RDATA0_ADDR A:0x2e7d018
y.create.l HWIO_PMIC_ARB_OBS5_CHNL80_RDATA0_ADDR A:0x2e85018
y.create.l HWIO_PMIC_ARB_OBS5_CHNL81_RDATA0_ADDR A:0x2e8d018
y.create.l HWIO_PMIC_ARB_OBS5_CHNL82_RDATA0_ADDR A:0x2e95018
y.create.l HWIO_PMIC_ARB_OBS5_CHNL83_RDATA0_ADDR A:0x2e9d018
y.create.l HWIO_PMIC_ARB_OBS5_CHNL84_RDATA0_ADDR A:0x2ea5018
y.create.l HWIO_PMIC_ARB_OBS5_CHNL85_RDATA0_ADDR A:0x2ead018
y.create.l HWIO_PMIC_ARB_OBS5_CHNL86_RDATA0_ADDR A:0x2eb5018
y.create.l HWIO_PMIC_ARB_OBS5_CHNL87_RDATA0_ADDR A:0x2ebd018
y.create.l HWIO_PMIC_ARB_OBS5_CHNL88_RDATA0_ADDR A:0x2ec5018
y.create.l HWIO_PMIC_ARB_OBS5_CHNL89_RDATA0_ADDR A:0x2ecd018
y.create.l HWIO_PMIC_ARB_OBS5_CHNL90_RDATA0_ADDR A:0x2ed5018
y.create.l HWIO_PMIC_ARB_OBS5_CHNL91_RDATA0_ADDR A:0x2edd018
y.create.l HWIO_PMIC_ARB_OBS5_CHNL92_RDATA0_ADDR A:0x2ee5018
y.create.l HWIO_PMIC_ARB_OBS5_CHNL93_RDATA0_ADDR A:0x2eed018
y.create.l HWIO_PMIC_ARB_OBS5_CHNL94_RDATA0_ADDR A:0x2ef5018
y.create.l HWIO_PMIC_ARB_OBS5_CHNL95_RDATA0_ADDR A:0x2efd018
y.create.l HWIO_PMIC_ARB_OBS5_CHNL96_RDATA0_ADDR A:0x2f05018
y.create.l HWIO_PMIC_ARB_OBS5_CHNL97_RDATA0_ADDR A:0x2f0d018
y.create.l HWIO_PMIC_ARB_OBS5_CHNL98_RDATA0_ADDR A:0x2f15018
y.create.l HWIO_PMIC_ARB_OBS5_CHNL99_RDATA0_ADDR A:0x2f1d018
y.create.l HWIO_PMIC_ARB_OBS5_CHNL100_RDATA0_ADDR A:0x2f25018
y.create.l HWIO_PMIC_ARB_OBS5_CHNL101_RDATA0_ADDR A:0x2f2d018
y.create.l HWIO_PMIC_ARB_OBS5_CHNL102_RDATA0_ADDR A:0x2f35018
y.create.l HWIO_PMIC_ARB_OBS5_CHNL103_RDATA0_ADDR A:0x2f3d018
y.create.l HWIO_PMIC_ARB_OBS5_CHNL104_RDATA0_ADDR A:0x2f45018
y.create.l HWIO_PMIC_ARB_OBS5_CHNL105_RDATA0_ADDR A:0x2f4d018
y.create.l HWIO_PMIC_ARB_OBS5_CHNL106_RDATA0_ADDR A:0x2f55018
y.create.l HWIO_PMIC_ARB_OBS5_CHNL107_RDATA0_ADDR A:0x2f5d018
y.create.l HWIO_PMIC_ARB_OBS5_CHNL108_RDATA0_ADDR A:0x2f65018
y.create.l HWIO_PMIC_ARB_OBS5_CHNL109_RDATA0_ADDR A:0x2f6d018
y.create.l HWIO_PMIC_ARB_OBS5_CHNL110_RDATA0_ADDR A:0x2f75018
y.create.l HWIO_PMIC_ARB_OBS5_CHNL111_RDATA0_ADDR A:0x2f7d018
y.create.l HWIO_PMIC_ARB_OBS5_CHNL112_RDATA0_ADDR A:0x2f85018
y.create.l HWIO_PMIC_ARB_OBS5_CHNL113_RDATA0_ADDR A:0x2f8d018
y.create.l HWIO_PMIC_ARB_OBS5_CHNL114_RDATA0_ADDR A:0x2f95018
y.create.l HWIO_PMIC_ARB_OBS5_CHNL115_RDATA0_ADDR A:0x2f9d018
y.create.l HWIO_PMIC_ARB_OBS5_CHNL116_RDATA0_ADDR A:0x2fa5018
y.create.l HWIO_PMIC_ARB_OBS5_CHNL117_RDATA0_ADDR A:0x2fad018
y.create.l HWIO_PMIC_ARB_OBS5_CHNL118_RDATA0_ADDR A:0x2fb5018
y.create.l HWIO_PMIC_ARB_OBS5_CHNL119_RDATA0_ADDR A:0x2fbd018
y.create.l HWIO_PMIC_ARB_OBS5_CHNL120_RDATA0_ADDR A:0x2fc5018
y.create.l HWIO_PMIC_ARB_OBS5_CHNL121_RDATA0_ADDR A:0x2fcd018
y.create.l HWIO_PMIC_ARB_OBS5_CHNL122_RDATA0_ADDR A:0x2fd5018
y.create.l HWIO_PMIC_ARB_OBS5_CHNL123_RDATA0_ADDR A:0x2fdd018
y.create.l HWIO_PMIC_ARB_OBS5_CHNL124_RDATA0_ADDR A:0x2fe5018
y.create.l HWIO_PMIC_ARB_OBS5_CHNL125_RDATA0_ADDR A:0x2fed018
y.create.l HWIO_PMIC_ARB_OBS5_CHNL126_RDATA0_ADDR A:0x2ff5018
y.create.l HWIO_PMIC_ARB_OBS5_CHNL127_RDATA0_ADDR A:0x2ffd018
y.create.l HWIO_PMIC_ARB_OBS5_CHNL128_RDATA0_ADDR A:0x3005018
y.create.l HWIO_PMIC_ARB_OBS5_CHNL129_RDATA0_ADDR A:0x300d018
y.create.l HWIO_PMIC_ARB_OBS5_CHNL130_RDATA0_ADDR A:0x3015018
y.create.l HWIO_PMIC_ARB_OBS5_CHNL131_RDATA0_ADDR A:0x301d018
y.create.l HWIO_PMIC_ARB_OBS5_CHNL132_RDATA0_ADDR A:0x3025018
y.create.l HWIO_PMIC_ARB_OBS5_CHNL133_RDATA0_ADDR A:0x302d018
y.create.l HWIO_PMIC_ARB_OBS5_CHNL134_RDATA0_ADDR A:0x3035018
y.create.l HWIO_PMIC_ARB_OBS5_CHNL135_RDATA0_ADDR A:0x303d018
y.create.l HWIO_PMIC_ARB_OBS5_CHNL136_RDATA0_ADDR A:0x3045018
y.create.l HWIO_PMIC_ARB_OBS5_CHNL137_RDATA0_ADDR A:0x304d018
y.create.l HWIO_PMIC_ARB_OBS5_CHNL138_RDATA0_ADDR A:0x3055018
y.create.l HWIO_PMIC_ARB_OBS5_CHNL139_RDATA0_ADDR A:0x305d018
y.create.l HWIO_PMIC_ARB_OBS5_CHNL140_RDATA0_ADDR A:0x3065018
y.create.l HWIO_PMIC_ARB_OBS5_CHNL141_RDATA0_ADDR A:0x306d018
y.create.l HWIO_PMIC_ARB_OBS5_CHNL142_RDATA0_ADDR A:0x3075018
y.create.l HWIO_PMIC_ARB_OBS5_CHNL143_RDATA0_ADDR A:0x307d018
y.create.l HWIO_PMIC_ARB_OBS5_CHNL144_RDATA0_ADDR A:0x3085018
y.create.l HWIO_PMIC_ARB_OBS5_CHNL145_RDATA0_ADDR A:0x308d018
y.create.l HWIO_PMIC_ARB_OBS5_CHNL146_RDATA0_ADDR A:0x3095018
y.create.l HWIO_PMIC_ARB_OBS5_CHNL147_RDATA0_ADDR A:0x309d018
y.create.l HWIO_PMIC_ARB_OBS5_CHNL148_RDATA0_ADDR A:0x30a5018
y.create.l HWIO_PMIC_ARB_OBS5_CHNL149_RDATA0_ADDR A:0x30ad018
y.create.l HWIO_PMIC_ARB_OBS5_CHNL150_RDATA0_ADDR A:0x30b5018
y.create.l HWIO_PMIC_ARB_OBS5_CHNL151_RDATA0_ADDR A:0x30bd018
y.create.l HWIO_PMIC_ARB_OBS5_CHNL152_RDATA0_ADDR A:0x30c5018
y.create.l HWIO_PMIC_ARB_OBS5_CHNL153_RDATA0_ADDR A:0x30cd018
y.create.l HWIO_PMIC_ARB_OBS5_CHNL154_RDATA0_ADDR A:0x30d5018
y.create.l HWIO_PMIC_ARB_OBS5_CHNL155_RDATA0_ADDR A:0x30dd018
y.create.l HWIO_PMIC_ARB_OBS5_CHNL156_RDATA0_ADDR A:0x30e5018
y.create.l HWIO_PMIC_ARB_OBS5_CHNL157_RDATA0_ADDR A:0x30ed018
y.create.l HWIO_PMIC_ARB_OBS5_CHNL158_RDATA0_ADDR A:0x30f5018
y.create.l HWIO_PMIC_ARB_OBS5_CHNL159_RDATA0_ADDR A:0x30fd018
y.create.l HWIO_PMIC_ARB_OBS5_CHNL160_RDATA0_ADDR A:0x3105018
y.create.l HWIO_PMIC_ARB_OBS5_CHNL161_RDATA0_ADDR A:0x310d018
y.create.l HWIO_PMIC_ARB_OBS5_CHNL162_RDATA0_ADDR A:0x3115018
y.create.l HWIO_PMIC_ARB_OBS5_CHNL163_RDATA0_ADDR A:0x311d018
y.create.l HWIO_PMIC_ARB_OBS5_CHNL164_RDATA0_ADDR A:0x3125018
y.create.l HWIO_PMIC_ARB_OBS5_CHNL165_RDATA0_ADDR A:0x312d018
y.create.l HWIO_PMIC_ARB_OBS5_CHNL166_RDATA0_ADDR A:0x3135018
y.create.l HWIO_PMIC_ARB_OBS5_CHNL167_RDATA0_ADDR A:0x313d018
y.create.l HWIO_PMIC_ARB_OBS5_CHNL168_RDATA0_ADDR A:0x3145018
y.create.l HWIO_PMIC_ARB_OBS5_CHNL169_RDATA0_ADDR A:0x314d018
y.create.l HWIO_PMIC_ARB_OBS5_CHNL170_RDATA0_ADDR A:0x3155018
y.create.l HWIO_PMIC_ARB_OBS5_CHNL171_RDATA0_ADDR A:0x315d018
y.create.l HWIO_PMIC_ARB_OBS5_CHNL172_RDATA0_ADDR A:0x3165018
y.create.l HWIO_PMIC_ARB_OBS5_CHNL173_RDATA0_ADDR A:0x316d018
y.create.l HWIO_PMIC_ARB_OBS5_CHNL174_RDATA0_ADDR A:0x3175018
y.create.l HWIO_PMIC_ARB_OBS5_CHNL175_RDATA0_ADDR A:0x317d018
y.create.l HWIO_PMIC_ARB_OBS5_CHNL176_RDATA0_ADDR A:0x3185018
y.create.l HWIO_PMIC_ARB_OBS5_CHNL177_RDATA0_ADDR A:0x318d018
y.create.l HWIO_PMIC_ARB_OBS5_CHNL178_RDATA0_ADDR A:0x3195018
y.create.l HWIO_PMIC_ARB_OBS5_CHNL179_RDATA0_ADDR A:0x319d018
y.create.l HWIO_PMIC_ARB_OBS5_CHNL180_RDATA0_ADDR A:0x31a5018
y.create.l HWIO_PMIC_ARB_OBS5_CHNL181_RDATA0_ADDR A:0x31ad018
y.create.l HWIO_PMIC_ARB_OBS5_CHNL182_RDATA0_ADDR A:0x31b5018
y.create.l HWIO_PMIC_ARB_OBS5_CHNL183_RDATA0_ADDR A:0x31bd018
y.create.l HWIO_PMIC_ARB_OBS5_CHNL184_RDATA0_ADDR A:0x31c5018
y.create.l HWIO_PMIC_ARB_OBS5_CHNL185_RDATA0_ADDR A:0x31cd018
y.create.l HWIO_PMIC_ARB_OBS5_CHNL186_RDATA0_ADDR A:0x31d5018
y.create.l HWIO_PMIC_ARB_OBS5_CHNL187_RDATA0_ADDR A:0x31dd018
y.create.l HWIO_PMIC_ARB_OBS5_CHNL188_RDATA0_ADDR A:0x31e5018
y.create.l HWIO_PMIC_ARB_OBS5_CHNL189_RDATA0_ADDR A:0x31ed018
y.create.l HWIO_PMIC_ARB_OBS5_CHNL190_RDATA0_ADDR A:0x31f5018
y.create.l HWIO_PMIC_ARB_OBS5_CHNL191_RDATA0_ADDR A:0x31fd018
y.create.l HWIO_PMIC_ARB_OBS5_CHNL192_RDATA0_ADDR A:0x3205018
y.create.l HWIO_PMIC_ARB_OBS5_CHNL193_RDATA0_ADDR A:0x320d018
y.create.l HWIO_PMIC_ARB_OBS5_CHNL194_RDATA0_ADDR A:0x3215018
y.create.l HWIO_PMIC_ARB_OBS5_CHNL195_RDATA0_ADDR A:0x321d018
y.create.l HWIO_PMIC_ARB_OBS5_CHNL196_RDATA0_ADDR A:0x3225018
y.create.l HWIO_PMIC_ARB_OBS5_CHNL197_RDATA0_ADDR A:0x322d018
y.create.l HWIO_PMIC_ARB_OBS5_CHNL198_RDATA0_ADDR A:0x3235018
y.create.l HWIO_PMIC_ARB_OBS5_CHNL199_RDATA0_ADDR A:0x323d018
y.create.l HWIO_PMIC_ARB_OBS5_CHNL200_RDATA0_ADDR A:0x3245018
y.create.l HWIO_PMIC_ARB_OBS5_CHNL201_RDATA0_ADDR A:0x324d018
y.create.l HWIO_PMIC_ARB_OBS5_CHNL202_RDATA0_ADDR A:0x3255018
y.create.l HWIO_PMIC_ARB_OBS5_CHNL203_RDATA0_ADDR A:0x325d018
y.create.l HWIO_PMIC_ARB_OBS5_CHNL204_RDATA0_ADDR A:0x3265018
y.create.l HWIO_PMIC_ARB_OBS5_CHNL205_RDATA0_ADDR A:0x326d018
y.create.l HWIO_PMIC_ARB_OBS5_CHNL206_RDATA0_ADDR A:0x3275018
y.create.l HWIO_PMIC_ARB_OBS5_CHNL207_RDATA0_ADDR A:0x327d018
y.create.l HWIO_PMIC_ARB_OBS5_CHNL208_RDATA0_ADDR A:0x3285018
y.create.l HWIO_PMIC_ARB_OBS5_CHNL209_RDATA0_ADDR A:0x328d018
y.create.l HWIO_PMIC_ARB_OBS5_CHNL210_RDATA0_ADDR A:0x3295018
y.create.l HWIO_PMIC_ARB_OBS5_CHNL211_RDATA0_ADDR A:0x329d018
y.create.l HWIO_PMIC_ARB_OBS5_CHNL212_RDATA0_ADDR A:0x32a5018
y.create.l HWIO_PMIC_ARB_OBS5_CHNL213_RDATA0_ADDR A:0x32ad018
y.create.l HWIO_PMIC_ARB_OBS5_CHNL214_RDATA0_ADDR A:0x32b5018
y.create.l HWIO_PMIC_ARB_OBS5_CHNL215_RDATA0_ADDR A:0x32bd018
y.create.l HWIO_PMIC_ARB_OBS5_CHNL216_RDATA0_ADDR A:0x32c5018
y.create.l HWIO_PMIC_ARB_OBS5_CHNL217_RDATA0_ADDR A:0x32cd018
y.create.l HWIO_PMIC_ARB_OBS5_CHNL218_RDATA0_ADDR A:0x32d5018
y.create.l HWIO_PMIC_ARB_OBS5_CHNL219_RDATA0_ADDR A:0x32dd018
y.create.l HWIO_PMIC_ARB_OBS5_CHNL220_RDATA0_ADDR A:0x32e5018
y.create.l HWIO_PMIC_ARB_OBS5_CHNL221_RDATA0_ADDR A:0x32ed018
y.create.l HWIO_PMIC_ARB_OBS5_CHNL222_RDATA0_ADDR A:0x32f5018
y.create.l HWIO_PMIC_ARB_OBS5_CHNL223_RDATA0_ADDR A:0x32fd018
y.create.l HWIO_PMIC_ARB_OBS5_CHNL224_RDATA0_ADDR A:0x3305018
y.create.l HWIO_PMIC_ARB_OBS5_CHNL225_RDATA0_ADDR A:0x330d018
y.create.l HWIO_PMIC_ARB_OBS5_CHNL226_RDATA0_ADDR A:0x3315018
y.create.l HWIO_PMIC_ARB_OBS5_CHNL227_RDATA0_ADDR A:0x331d018
y.create.l HWIO_PMIC_ARB_OBS5_CHNL228_RDATA0_ADDR A:0x3325018
y.create.l HWIO_PMIC_ARB_OBS5_CHNL229_RDATA0_ADDR A:0x332d018
y.create.l HWIO_PMIC_ARB_OBS5_CHNL230_RDATA0_ADDR A:0x3335018
y.create.l HWIO_PMIC_ARB_OBS5_CHNL231_RDATA0_ADDR A:0x333d018
y.create.l HWIO_PMIC_ARB_OBS5_CHNL232_RDATA0_ADDR A:0x3345018
y.create.l HWIO_PMIC_ARB_OBS5_CHNL233_RDATA0_ADDR A:0x334d018
y.create.l HWIO_PMIC_ARB_OBS5_CHNL234_RDATA0_ADDR A:0x3355018
y.create.l HWIO_PMIC_ARB_OBS5_CHNL235_RDATA0_ADDR A:0x335d018
y.create.l HWIO_PMIC_ARB_OBS5_CHNL236_RDATA0_ADDR A:0x3365018
y.create.l HWIO_PMIC_ARB_OBS5_CHNL237_RDATA0_ADDR A:0x336d018
y.create.l HWIO_PMIC_ARB_OBS5_CHNL238_RDATA0_ADDR A:0x3375018
y.create.l HWIO_PMIC_ARB_OBS5_CHNL239_RDATA0_ADDR A:0x337d018
y.create.l HWIO_PMIC_ARB_OBS5_CHNL240_RDATA0_ADDR A:0x3385018
y.create.l HWIO_PMIC_ARB_OBS5_CHNL241_RDATA0_ADDR A:0x338d018
y.create.l HWIO_PMIC_ARB_OBS5_CHNL242_RDATA0_ADDR A:0x3395018
y.create.l HWIO_PMIC_ARB_OBS5_CHNL243_RDATA0_ADDR A:0x339d018
y.create.l HWIO_PMIC_ARB_OBS5_CHNL244_RDATA0_ADDR A:0x33a5018
y.create.l HWIO_PMIC_ARB_OBS5_CHNL245_RDATA0_ADDR A:0x33ad018
y.create.l HWIO_PMIC_ARB_OBS5_CHNL246_RDATA0_ADDR A:0x33b5018
y.create.l HWIO_PMIC_ARB_OBS5_CHNL247_RDATA0_ADDR A:0x33bd018
y.create.l HWIO_PMIC_ARB_OBS5_CHNL248_RDATA0_ADDR A:0x33c5018
y.create.l HWIO_PMIC_ARB_OBS5_CHNL249_RDATA0_ADDR A:0x33cd018
y.create.l HWIO_PMIC_ARB_OBS5_CHNL250_RDATA0_ADDR A:0x33d5018
y.create.l HWIO_PMIC_ARB_OBS5_CHNL251_RDATA0_ADDR A:0x33dd018
y.create.l HWIO_PMIC_ARB_OBS5_CHNL252_RDATA0_ADDR A:0x33e5018
y.create.l HWIO_PMIC_ARB_OBS5_CHNL253_RDATA0_ADDR A:0x33ed018
y.create.l HWIO_PMIC_ARB_OBS5_CHNL254_RDATA0_ADDR A:0x33f5018
y.create.l HWIO_PMIC_ARB_OBS5_CHNL255_RDATA0_ADDR A:0x33fd018
y.create.l HWIO_PMIC_ARB_OBS6_CHNL0_RDATA0_ADDR A:0x2c06018
y.create.l HWIO_PMIC_ARB_OBS6_CHNL1_RDATA0_ADDR A:0x2c0e018
y.create.l HWIO_PMIC_ARB_OBS6_CHNL2_RDATA0_ADDR A:0x2c16018
y.create.l HWIO_PMIC_ARB_OBS6_CHNL3_RDATA0_ADDR A:0x2c1e018
y.create.l HWIO_PMIC_ARB_OBS6_CHNL4_RDATA0_ADDR A:0x2c26018
y.create.l HWIO_PMIC_ARB_OBS6_CHNL5_RDATA0_ADDR A:0x2c2e018
y.create.l HWIO_PMIC_ARB_OBS6_CHNL6_RDATA0_ADDR A:0x2c36018
y.create.l HWIO_PMIC_ARB_OBS6_CHNL7_RDATA0_ADDR A:0x2c3e018
y.create.l HWIO_PMIC_ARB_OBS6_CHNL8_RDATA0_ADDR A:0x2c46018
y.create.l HWIO_PMIC_ARB_OBS6_CHNL9_RDATA0_ADDR A:0x2c4e018
y.create.l HWIO_PMIC_ARB_OBS6_CHNL10_RDATA0_ADDR A:0x2c56018
y.create.l HWIO_PMIC_ARB_OBS6_CHNL11_RDATA0_ADDR A:0x2c5e018
y.create.l HWIO_PMIC_ARB_OBS6_CHNL12_RDATA0_ADDR A:0x2c66018
y.create.l HWIO_PMIC_ARB_OBS6_CHNL13_RDATA0_ADDR A:0x2c6e018
y.create.l HWIO_PMIC_ARB_OBS6_CHNL14_RDATA0_ADDR A:0x2c76018
y.create.l HWIO_PMIC_ARB_OBS6_CHNL15_RDATA0_ADDR A:0x2c7e018
y.create.l HWIO_PMIC_ARB_OBS6_CHNL16_RDATA0_ADDR A:0x2c86018
y.create.l HWIO_PMIC_ARB_OBS6_CHNL17_RDATA0_ADDR A:0x2c8e018
y.create.l HWIO_PMIC_ARB_OBS6_CHNL18_RDATA0_ADDR A:0x2c96018
y.create.l HWIO_PMIC_ARB_OBS6_CHNL19_RDATA0_ADDR A:0x2c9e018
y.create.l HWIO_PMIC_ARB_OBS6_CHNL20_RDATA0_ADDR A:0x2ca6018
y.create.l HWIO_PMIC_ARB_OBS6_CHNL21_RDATA0_ADDR A:0x2cae018
y.create.l HWIO_PMIC_ARB_OBS6_CHNL22_RDATA0_ADDR A:0x2cb6018
y.create.l HWIO_PMIC_ARB_OBS6_CHNL23_RDATA0_ADDR A:0x2cbe018
y.create.l HWIO_PMIC_ARB_OBS6_CHNL24_RDATA0_ADDR A:0x2cc6018
y.create.l HWIO_PMIC_ARB_OBS6_CHNL25_RDATA0_ADDR A:0x2cce018
y.create.l HWIO_PMIC_ARB_OBS6_CHNL26_RDATA0_ADDR A:0x2cd6018
y.create.l HWIO_PMIC_ARB_OBS6_CHNL27_RDATA0_ADDR A:0x2cde018
y.create.l HWIO_PMIC_ARB_OBS6_CHNL28_RDATA0_ADDR A:0x2ce6018
y.create.l HWIO_PMIC_ARB_OBS6_CHNL29_RDATA0_ADDR A:0x2cee018
y.create.l HWIO_PMIC_ARB_OBS6_CHNL30_RDATA0_ADDR A:0x2cf6018
y.create.l HWIO_PMIC_ARB_OBS6_CHNL31_RDATA0_ADDR A:0x2cfe018
y.create.l HWIO_PMIC_ARB_OBS6_CHNL32_RDATA0_ADDR A:0x2d06018
y.create.l HWIO_PMIC_ARB_OBS6_CHNL33_RDATA0_ADDR A:0x2d0e018
y.create.l HWIO_PMIC_ARB_OBS6_CHNL34_RDATA0_ADDR A:0x2d16018
y.create.l HWIO_PMIC_ARB_OBS6_CHNL35_RDATA0_ADDR A:0x2d1e018
y.create.l HWIO_PMIC_ARB_OBS6_CHNL36_RDATA0_ADDR A:0x2d26018
y.create.l HWIO_PMIC_ARB_OBS6_CHNL37_RDATA0_ADDR A:0x2d2e018
y.create.l HWIO_PMIC_ARB_OBS6_CHNL38_RDATA0_ADDR A:0x2d36018
y.create.l HWIO_PMIC_ARB_OBS6_CHNL39_RDATA0_ADDR A:0x2d3e018
y.create.l HWIO_PMIC_ARB_OBS6_CHNL40_RDATA0_ADDR A:0x2d46018
y.create.l HWIO_PMIC_ARB_OBS6_CHNL41_RDATA0_ADDR A:0x2d4e018
y.create.l HWIO_PMIC_ARB_OBS6_CHNL42_RDATA0_ADDR A:0x2d56018
y.create.l HWIO_PMIC_ARB_OBS6_CHNL43_RDATA0_ADDR A:0x2d5e018
y.create.l HWIO_PMIC_ARB_OBS6_CHNL44_RDATA0_ADDR A:0x2d66018
y.create.l HWIO_PMIC_ARB_OBS6_CHNL45_RDATA0_ADDR A:0x2d6e018
y.create.l HWIO_PMIC_ARB_OBS6_CHNL46_RDATA0_ADDR A:0x2d76018
y.create.l HWIO_PMIC_ARB_OBS6_CHNL47_RDATA0_ADDR A:0x2d7e018
y.create.l HWIO_PMIC_ARB_OBS6_CHNL48_RDATA0_ADDR A:0x2d86018
y.create.l HWIO_PMIC_ARB_OBS6_CHNL49_RDATA0_ADDR A:0x2d8e018
y.create.l HWIO_PMIC_ARB_OBS6_CHNL50_RDATA0_ADDR A:0x2d96018
y.create.l HWIO_PMIC_ARB_OBS6_CHNL51_RDATA0_ADDR A:0x2d9e018
y.create.l HWIO_PMIC_ARB_OBS6_CHNL52_RDATA0_ADDR A:0x2da6018
y.create.l HWIO_PMIC_ARB_OBS6_CHNL53_RDATA0_ADDR A:0x2dae018
y.create.l HWIO_PMIC_ARB_OBS6_CHNL54_RDATA0_ADDR A:0x2db6018
y.create.l HWIO_PMIC_ARB_OBS6_CHNL55_RDATA0_ADDR A:0x2dbe018
y.create.l HWIO_PMIC_ARB_OBS6_CHNL56_RDATA0_ADDR A:0x2dc6018
y.create.l HWIO_PMIC_ARB_OBS6_CHNL57_RDATA0_ADDR A:0x2dce018
y.create.l HWIO_PMIC_ARB_OBS6_CHNL58_RDATA0_ADDR A:0x2dd6018
y.create.l HWIO_PMIC_ARB_OBS6_CHNL59_RDATA0_ADDR A:0x2dde018
y.create.l HWIO_PMIC_ARB_OBS6_CHNL60_RDATA0_ADDR A:0x2de6018
y.create.l HWIO_PMIC_ARB_OBS6_CHNL61_RDATA0_ADDR A:0x2dee018
y.create.l HWIO_PMIC_ARB_OBS6_CHNL62_RDATA0_ADDR A:0x2df6018
y.create.l HWIO_PMIC_ARB_OBS6_CHNL63_RDATA0_ADDR A:0x2dfe018
y.create.l HWIO_PMIC_ARB_OBS6_CHNL64_RDATA0_ADDR A:0x2e06018
y.create.l HWIO_PMIC_ARB_OBS6_CHNL65_RDATA0_ADDR A:0x2e0e018
y.create.l HWIO_PMIC_ARB_OBS6_CHNL66_RDATA0_ADDR A:0x2e16018
y.create.l HWIO_PMIC_ARB_OBS6_CHNL67_RDATA0_ADDR A:0x2e1e018
y.create.l HWIO_PMIC_ARB_OBS6_CHNL68_RDATA0_ADDR A:0x2e26018
y.create.l HWIO_PMIC_ARB_OBS6_CHNL69_RDATA0_ADDR A:0x2e2e018
y.create.l HWIO_PMIC_ARB_OBS6_CHNL70_RDATA0_ADDR A:0x2e36018
y.create.l HWIO_PMIC_ARB_OBS6_CHNL71_RDATA0_ADDR A:0x2e3e018
y.create.l HWIO_PMIC_ARB_OBS6_CHNL72_RDATA0_ADDR A:0x2e46018
y.create.l HWIO_PMIC_ARB_OBS6_CHNL73_RDATA0_ADDR A:0x2e4e018
y.create.l HWIO_PMIC_ARB_OBS6_CHNL74_RDATA0_ADDR A:0x2e56018
y.create.l HWIO_PMIC_ARB_OBS6_CHNL75_RDATA0_ADDR A:0x2e5e018
y.create.l HWIO_PMIC_ARB_OBS6_CHNL76_RDATA0_ADDR A:0x2e66018
y.create.l HWIO_PMIC_ARB_OBS6_CHNL77_RDATA0_ADDR A:0x2e6e018
y.create.l HWIO_PMIC_ARB_OBS6_CHNL78_RDATA0_ADDR A:0x2e76018
y.create.l HWIO_PMIC_ARB_OBS6_CHNL79_RDATA0_ADDR A:0x2e7e018
y.create.l HWIO_PMIC_ARB_OBS6_CHNL80_RDATA0_ADDR A:0x2e86018
y.create.l HWIO_PMIC_ARB_OBS6_CHNL81_RDATA0_ADDR A:0x2e8e018
y.create.l HWIO_PMIC_ARB_OBS6_CHNL82_RDATA0_ADDR A:0x2e96018
y.create.l HWIO_PMIC_ARB_OBS6_CHNL83_RDATA0_ADDR A:0x2e9e018
y.create.l HWIO_PMIC_ARB_OBS6_CHNL84_RDATA0_ADDR A:0x2ea6018
y.create.l HWIO_PMIC_ARB_OBS6_CHNL85_RDATA0_ADDR A:0x2eae018
y.create.l HWIO_PMIC_ARB_OBS6_CHNL86_RDATA0_ADDR A:0x2eb6018
y.create.l HWIO_PMIC_ARB_OBS6_CHNL87_RDATA0_ADDR A:0x2ebe018
y.create.l HWIO_PMIC_ARB_OBS6_CHNL88_RDATA0_ADDR A:0x2ec6018
y.create.l HWIO_PMIC_ARB_OBS6_CHNL89_RDATA0_ADDR A:0x2ece018
y.create.l HWIO_PMIC_ARB_OBS6_CHNL90_RDATA0_ADDR A:0x2ed6018
y.create.l HWIO_PMIC_ARB_OBS6_CHNL91_RDATA0_ADDR A:0x2ede018
y.create.l HWIO_PMIC_ARB_OBS6_CHNL92_RDATA0_ADDR A:0x2ee6018
y.create.l HWIO_PMIC_ARB_OBS6_CHNL93_RDATA0_ADDR A:0x2eee018
y.create.l HWIO_PMIC_ARB_OBS6_CHNL94_RDATA0_ADDR A:0x2ef6018
y.create.l HWIO_PMIC_ARB_OBS6_CHNL95_RDATA0_ADDR A:0x2efe018
y.create.l HWIO_PMIC_ARB_OBS6_CHNL96_RDATA0_ADDR A:0x2f06018
y.create.l HWIO_PMIC_ARB_OBS6_CHNL97_RDATA0_ADDR A:0x2f0e018
y.create.l HWIO_PMIC_ARB_OBS6_CHNL98_RDATA0_ADDR A:0x2f16018
y.create.l HWIO_PMIC_ARB_OBS6_CHNL99_RDATA0_ADDR A:0x2f1e018
y.create.l HWIO_PMIC_ARB_OBS6_CHNL100_RDATA0_ADDR A:0x2f26018
y.create.l HWIO_PMIC_ARB_OBS6_CHNL101_RDATA0_ADDR A:0x2f2e018
y.create.l HWIO_PMIC_ARB_OBS6_CHNL102_RDATA0_ADDR A:0x2f36018
y.create.l HWIO_PMIC_ARB_OBS6_CHNL103_RDATA0_ADDR A:0x2f3e018
y.create.l HWIO_PMIC_ARB_OBS6_CHNL104_RDATA0_ADDR A:0x2f46018
y.create.l HWIO_PMIC_ARB_OBS6_CHNL105_RDATA0_ADDR A:0x2f4e018
y.create.l HWIO_PMIC_ARB_OBS6_CHNL106_RDATA0_ADDR A:0x2f56018
y.create.l HWIO_PMIC_ARB_OBS6_CHNL107_RDATA0_ADDR A:0x2f5e018
y.create.l HWIO_PMIC_ARB_OBS6_CHNL108_RDATA0_ADDR A:0x2f66018
y.create.l HWIO_PMIC_ARB_OBS6_CHNL109_RDATA0_ADDR A:0x2f6e018
y.create.l HWIO_PMIC_ARB_OBS6_CHNL110_RDATA0_ADDR A:0x2f76018
y.create.l HWIO_PMIC_ARB_OBS6_CHNL111_RDATA0_ADDR A:0x2f7e018
y.create.l HWIO_PMIC_ARB_OBS6_CHNL112_RDATA0_ADDR A:0x2f86018
y.create.l HWIO_PMIC_ARB_OBS6_CHNL113_RDATA0_ADDR A:0x2f8e018
y.create.l HWIO_PMIC_ARB_OBS6_CHNL114_RDATA0_ADDR A:0x2f96018
y.create.l HWIO_PMIC_ARB_OBS6_CHNL115_RDATA0_ADDR A:0x2f9e018
y.create.l HWIO_PMIC_ARB_OBS6_CHNL116_RDATA0_ADDR A:0x2fa6018
y.create.l HWIO_PMIC_ARB_OBS6_CHNL117_RDATA0_ADDR A:0x2fae018
y.create.l HWIO_PMIC_ARB_OBS6_CHNL118_RDATA0_ADDR A:0x2fb6018
y.create.l HWIO_PMIC_ARB_OBS6_CHNL119_RDATA0_ADDR A:0x2fbe018
y.create.l HWIO_PMIC_ARB_OBS6_CHNL120_RDATA0_ADDR A:0x2fc6018
y.create.l HWIO_PMIC_ARB_OBS6_CHNL121_RDATA0_ADDR A:0x2fce018
y.create.l HWIO_PMIC_ARB_OBS6_CHNL122_RDATA0_ADDR A:0x2fd6018
y.create.l HWIO_PMIC_ARB_OBS6_CHNL123_RDATA0_ADDR A:0x2fde018
y.create.l HWIO_PMIC_ARB_OBS6_CHNL124_RDATA0_ADDR A:0x2fe6018
y.create.l HWIO_PMIC_ARB_OBS6_CHNL125_RDATA0_ADDR A:0x2fee018
y.create.l HWIO_PMIC_ARB_OBS6_CHNL126_RDATA0_ADDR A:0x2ff6018
y.create.l HWIO_PMIC_ARB_OBS6_CHNL127_RDATA0_ADDR A:0x2ffe018
y.create.l HWIO_PMIC_ARB_OBS6_CHNL128_RDATA0_ADDR A:0x3006018
y.create.l HWIO_PMIC_ARB_OBS6_CHNL129_RDATA0_ADDR A:0x300e018
y.create.l HWIO_PMIC_ARB_OBS6_CHNL130_RDATA0_ADDR A:0x3016018
y.create.l HWIO_PMIC_ARB_OBS6_CHNL131_RDATA0_ADDR A:0x301e018
y.create.l HWIO_PMIC_ARB_OBS6_CHNL132_RDATA0_ADDR A:0x3026018
y.create.l HWIO_PMIC_ARB_OBS6_CHNL133_RDATA0_ADDR A:0x302e018
y.create.l HWIO_PMIC_ARB_OBS6_CHNL134_RDATA0_ADDR A:0x3036018
y.create.l HWIO_PMIC_ARB_OBS6_CHNL135_RDATA0_ADDR A:0x303e018
y.create.l HWIO_PMIC_ARB_OBS6_CHNL136_RDATA0_ADDR A:0x3046018
y.create.l HWIO_PMIC_ARB_OBS6_CHNL137_RDATA0_ADDR A:0x304e018
y.create.l HWIO_PMIC_ARB_OBS6_CHNL138_RDATA0_ADDR A:0x3056018
y.create.l HWIO_PMIC_ARB_OBS6_CHNL139_RDATA0_ADDR A:0x305e018
y.create.l HWIO_PMIC_ARB_OBS6_CHNL140_RDATA0_ADDR A:0x3066018
y.create.l HWIO_PMIC_ARB_OBS6_CHNL141_RDATA0_ADDR A:0x306e018
y.create.l HWIO_PMIC_ARB_OBS6_CHNL142_RDATA0_ADDR A:0x3076018
y.create.l HWIO_PMIC_ARB_OBS6_CHNL143_RDATA0_ADDR A:0x307e018
y.create.l HWIO_PMIC_ARB_OBS6_CHNL144_RDATA0_ADDR A:0x3086018
y.create.l HWIO_PMIC_ARB_OBS6_CHNL145_RDATA0_ADDR A:0x308e018
y.create.l HWIO_PMIC_ARB_OBS6_CHNL146_RDATA0_ADDR A:0x3096018
y.create.l HWIO_PMIC_ARB_OBS6_CHNL147_RDATA0_ADDR A:0x309e018
y.create.l HWIO_PMIC_ARB_OBS6_CHNL148_RDATA0_ADDR A:0x30a6018
y.create.l HWIO_PMIC_ARB_OBS6_CHNL149_RDATA0_ADDR A:0x30ae018
y.create.l HWIO_PMIC_ARB_OBS6_CHNL150_RDATA0_ADDR A:0x30b6018
y.create.l HWIO_PMIC_ARB_OBS6_CHNL151_RDATA0_ADDR A:0x30be018
y.create.l HWIO_PMIC_ARB_OBS6_CHNL152_RDATA0_ADDR A:0x30c6018
y.create.l HWIO_PMIC_ARB_OBS6_CHNL153_RDATA0_ADDR A:0x30ce018
y.create.l HWIO_PMIC_ARB_OBS6_CHNL154_RDATA0_ADDR A:0x30d6018
y.create.l HWIO_PMIC_ARB_OBS6_CHNL155_RDATA0_ADDR A:0x30de018
y.create.l HWIO_PMIC_ARB_OBS6_CHNL156_RDATA0_ADDR A:0x30e6018
y.create.l HWIO_PMIC_ARB_OBS6_CHNL157_RDATA0_ADDR A:0x30ee018
y.create.l HWIO_PMIC_ARB_OBS6_CHNL158_RDATA0_ADDR A:0x30f6018
y.create.l HWIO_PMIC_ARB_OBS6_CHNL159_RDATA0_ADDR A:0x30fe018
y.create.l HWIO_PMIC_ARB_OBS6_CHNL160_RDATA0_ADDR A:0x3106018
y.create.l HWIO_PMIC_ARB_OBS6_CHNL161_RDATA0_ADDR A:0x310e018
y.create.l HWIO_PMIC_ARB_OBS6_CHNL162_RDATA0_ADDR A:0x3116018
y.create.l HWIO_PMIC_ARB_OBS6_CHNL163_RDATA0_ADDR A:0x311e018
y.create.l HWIO_PMIC_ARB_OBS6_CHNL164_RDATA0_ADDR A:0x3126018
y.create.l HWIO_PMIC_ARB_OBS6_CHNL165_RDATA0_ADDR A:0x312e018
y.create.l HWIO_PMIC_ARB_OBS6_CHNL166_RDATA0_ADDR A:0x3136018
y.create.l HWIO_PMIC_ARB_OBS6_CHNL167_RDATA0_ADDR A:0x313e018
y.create.l HWIO_PMIC_ARB_OBS6_CHNL168_RDATA0_ADDR A:0x3146018
y.create.l HWIO_PMIC_ARB_OBS6_CHNL169_RDATA0_ADDR A:0x314e018
y.create.l HWIO_PMIC_ARB_OBS6_CHNL170_RDATA0_ADDR A:0x3156018
y.create.l HWIO_PMIC_ARB_OBS6_CHNL171_RDATA0_ADDR A:0x315e018
y.create.l HWIO_PMIC_ARB_OBS6_CHNL172_RDATA0_ADDR A:0x3166018
y.create.l HWIO_PMIC_ARB_OBS6_CHNL173_RDATA0_ADDR A:0x316e018
y.create.l HWIO_PMIC_ARB_OBS6_CHNL174_RDATA0_ADDR A:0x3176018
y.create.l HWIO_PMIC_ARB_OBS6_CHNL175_RDATA0_ADDR A:0x317e018
y.create.l HWIO_PMIC_ARB_OBS6_CHNL176_RDATA0_ADDR A:0x3186018
y.create.l HWIO_PMIC_ARB_OBS6_CHNL177_RDATA0_ADDR A:0x318e018
y.create.l HWIO_PMIC_ARB_OBS6_CHNL178_RDATA0_ADDR A:0x3196018
y.create.l HWIO_PMIC_ARB_OBS6_CHNL179_RDATA0_ADDR A:0x319e018
y.create.l HWIO_PMIC_ARB_OBS6_CHNL180_RDATA0_ADDR A:0x31a6018
y.create.l HWIO_PMIC_ARB_OBS6_CHNL181_RDATA0_ADDR A:0x31ae018
y.create.l HWIO_PMIC_ARB_OBS6_CHNL182_RDATA0_ADDR A:0x31b6018
y.create.l HWIO_PMIC_ARB_OBS6_CHNL183_RDATA0_ADDR A:0x31be018
y.create.l HWIO_PMIC_ARB_OBS6_CHNL184_RDATA0_ADDR A:0x31c6018
y.create.l HWIO_PMIC_ARB_OBS6_CHNL185_RDATA0_ADDR A:0x31ce018
y.create.l HWIO_PMIC_ARB_OBS6_CHNL186_RDATA0_ADDR A:0x31d6018
y.create.l HWIO_PMIC_ARB_OBS6_CHNL187_RDATA0_ADDR A:0x31de018
y.create.l HWIO_PMIC_ARB_OBS6_CHNL188_RDATA0_ADDR A:0x31e6018
y.create.l HWIO_PMIC_ARB_OBS6_CHNL189_RDATA0_ADDR A:0x31ee018
y.create.l HWIO_PMIC_ARB_OBS6_CHNL190_RDATA0_ADDR A:0x31f6018
y.create.l HWIO_PMIC_ARB_OBS6_CHNL191_RDATA0_ADDR A:0x31fe018
y.create.l HWIO_PMIC_ARB_OBS6_CHNL192_RDATA0_ADDR A:0x3206018
y.create.l HWIO_PMIC_ARB_OBS6_CHNL193_RDATA0_ADDR A:0x320e018
y.create.l HWIO_PMIC_ARB_OBS6_CHNL194_RDATA0_ADDR A:0x3216018
y.create.l HWIO_PMIC_ARB_OBS6_CHNL195_RDATA0_ADDR A:0x321e018
y.create.l HWIO_PMIC_ARB_OBS6_CHNL196_RDATA0_ADDR A:0x3226018
y.create.l HWIO_PMIC_ARB_OBS6_CHNL197_RDATA0_ADDR A:0x322e018
y.create.l HWIO_PMIC_ARB_OBS6_CHNL198_RDATA0_ADDR A:0x3236018
y.create.l HWIO_PMIC_ARB_OBS6_CHNL199_RDATA0_ADDR A:0x323e018
y.create.l HWIO_PMIC_ARB_OBS6_CHNL200_RDATA0_ADDR A:0x3246018
y.create.l HWIO_PMIC_ARB_OBS6_CHNL201_RDATA0_ADDR A:0x324e018
y.create.l HWIO_PMIC_ARB_OBS6_CHNL202_RDATA0_ADDR A:0x3256018
y.create.l HWIO_PMIC_ARB_OBS6_CHNL203_RDATA0_ADDR A:0x325e018
y.create.l HWIO_PMIC_ARB_OBS6_CHNL204_RDATA0_ADDR A:0x3266018
y.create.l HWIO_PMIC_ARB_OBS6_CHNL205_RDATA0_ADDR A:0x326e018
y.create.l HWIO_PMIC_ARB_OBS6_CHNL206_RDATA0_ADDR A:0x3276018
y.create.l HWIO_PMIC_ARB_OBS6_CHNL207_RDATA0_ADDR A:0x327e018
y.create.l HWIO_PMIC_ARB_OBS6_CHNL208_RDATA0_ADDR A:0x3286018
y.create.l HWIO_PMIC_ARB_OBS6_CHNL209_RDATA0_ADDR A:0x328e018
y.create.l HWIO_PMIC_ARB_OBS6_CHNL210_RDATA0_ADDR A:0x3296018
y.create.l HWIO_PMIC_ARB_OBS6_CHNL211_RDATA0_ADDR A:0x329e018
y.create.l HWIO_PMIC_ARB_OBS6_CHNL212_RDATA0_ADDR A:0x32a6018
y.create.l HWIO_PMIC_ARB_OBS6_CHNL213_RDATA0_ADDR A:0x32ae018
y.create.l HWIO_PMIC_ARB_OBS6_CHNL214_RDATA0_ADDR A:0x32b6018
y.create.l HWIO_PMIC_ARB_OBS6_CHNL215_RDATA0_ADDR A:0x32be018
y.create.l HWIO_PMIC_ARB_OBS6_CHNL216_RDATA0_ADDR A:0x32c6018
y.create.l HWIO_PMIC_ARB_OBS6_CHNL217_RDATA0_ADDR A:0x32ce018
y.create.l HWIO_PMIC_ARB_OBS6_CHNL218_RDATA0_ADDR A:0x32d6018
y.create.l HWIO_PMIC_ARB_OBS6_CHNL219_RDATA0_ADDR A:0x32de018
y.create.l HWIO_PMIC_ARB_OBS6_CHNL220_RDATA0_ADDR A:0x32e6018
y.create.l HWIO_PMIC_ARB_OBS6_CHNL221_RDATA0_ADDR A:0x32ee018
y.create.l HWIO_PMIC_ARB_OBS6_CHNL222_RDATA0_ADDR A:0x32f6018
y.create.l HWIO_PMIC_ARB_OBS6_CHNL223_RDATA0_ADDR A:0x32fe018
y.create.l HWIO_PMIC_ARB_OBS6_CHNL224_RDATA0_ADDR A:0x3306018
y.create.l HWIO_PMIC_ARB_OBS6_CHNL225_RDATA0_ADDR A:0x330e018
y.create.l HWIO_PMIC_ARB_OBS6_CHNL226_RDATA0_ADDR A:0x3316018
y.create.l HWIO_PMIC_ARB_OBS6_CHNL227_RDATA0_ADDR A:0x331e018
y.create.l HWIO_PMIC_ARB_OBS6_CHNL228_RDATA0_ADDR A:0x3326018
y.create.l HWIO_PMIC_ARB_OBS6_CHNL229_RDATA0_ADDR A:0x332e018
y.create.l HWIO_PMIC_ARB_OBS6_CHNL230_RDATA0_ADDR A:0x3336018
y.create.l HWIO_PMIC_ARB_OBS6_CHNL231_RDATA0_ADDR A:0x333e018
y.create.l HWIO_PMIC_ARB_OBS6_CHNL232_RDATA0_ADDR A:0x3346018
y.create.l HWIO_PMIC_ARB_OBS6_CHNL233_RDATA0_ADDR A:0x334e018
y.create.l HWIO_PMIC_ARB_OBS6_CHNL234_RDATA0_ADDR A:0x3356018
y.create.l HWIO_PMIC_ARB_OBS6_CHNL235_RDATA0_ADDR A:0x335e018
y.create.l HWIO_PMIC_ARB_OBS6_CHNL236_RDATA0_ADDR A:0x3366018
y.create.l HWIO_PMIC_ARB_OBS6_CHNL237_RDATA0_ADDR A:0x336e018
y.create.l HWIO_PMIC_ARB_OBS6_CHNL238_RDATA0_ADDR A:0x3376018
y.create.l HWIO_PMIC_ARB_OBS6_CHNL239_RDATA0_ADDR A:0x337e018
y.create.l HWIO_PMIC_ARB_OBS6_CHNL240_RDATA0_ADDR A:0x3386018
y.create.l HWIO_PMIC_ARB_OBS6_CHNL241_RDATA0_ADDR A:0x338e018
y.create.l HWIO_PMIC_ARB_OBS6_CHNL242_RDATA0_ADDR A:0x3396018
y.create.l HWIO_PMIC_ARB_OBS6_CHNL243_RDATA0_ADDR A:0x339e018
y.create.l HWIO_PMIC_ARB_OBS6_CHNL244_RDATA0_ADDR A:0x33a6018
y.create.l HWIO_PMIC_ARB_OBS6_CHNL245_RDATA0_ADDR A:0x33ae018
y.create.l HWIO_PMIC_ARB_OBS6_CHNL246_RDATA0_ADDR A:0x33b6018
y.create.l HWIO_PMIC_ARB_OBS6_CHNL247_RDATA0_ADDR A:0x33be018
y.create.l HWIO_PMIC_ARB_OBS6_CHNL248_RDATA0_ADDR A:0x33c6018
y.create.l HWIO_PMIC_ARB_OBS6_CHNL249_RDATA0_ADDR A:0x33ce018
y.create.l HWIO_PMIC_ARB_OBS6_CHNL250_RDATA0_ADDR A:0x33d6018
y.create.l HWIO_PMIC_ARB_OBS6_CHNL251_RDATA0_ADDR A:0x33de018
y.create.l HWIO_PMIC_ARB_OBS6_CHNL252_RDATA0_ADDR A:0x33e6018
y.create.l HWIO_PMIC_ARB_OBS6_CHNL253_RDATA0_ADDR A:0x33ee018
y.create.l HWIO_PMIC_ARB_OBS6_CHNL254_RDATA0_ADDR A:0x33f6018
y.create.l HWIO_PMIC_ARB_OBS6_CHNL255_RDATA0_ADDR A:0x33fe018
y.create.l HWIO_PMIC_ARB_OBS0_CHNL0_RDATA1_ADDR A:0x2c0001c
y.create.l HWIO_PMIC_ARB_OBS0_CHNL1_RDATA1_ADDR A:0x2c0801c
y.create.l HWIO_PMIC_ARB_OBS0_CHNL2_RDATA1_ADDR A:0x2c1001c
y.create.l HWIO_PMIC_ARB_OBS0_CHNL3_RDATA1_ADDR A:0x2c1801c
y.create.l HWIO_PMIC_ARB_OBS0_CHNL4_RDATA1_ADDR A:0x2c2001c
y.create.l HWIO_PMIC_ARB_OBS0_CHNL5_RDATA1_ADDR A:0x2c2801c
y.create.l HWIO_PMIC_ARB_OBS0_CHNL6_RDATA1_ADDR A:0x2c3001c
y.create.l HWIO_PMIC_ARB_OBS0_CHNL7_RDATA1_ADDR A:0x2c3801c
y.create.l HWIO_PMIC_ARB_OBS0_CHNL8_RDATA1_ADDR A:0x2c4001c
y.create.l HWIO_PMIC_ARB_OBS0_CHNL9_RDATA1_ADDR A:0x2c4801c
y.create.l HWIO_PMIC_ARB_OBS0_CHNL10_RDATA1_ADDR A:0x2c5001c
y.create.l HWIO_PMIC_ARB_OBS0_CHNL11_RDATA1_ADDR A:0x2c5801c
y.create.l HWIO_PMIC_ARB_OBS0_CHNL12_RDATA1_ADDR A:0x2c6001c
y.create.l HWIO_PMIC_ARB_OBS0_CHNL13_RDATA1_ADDR A:0x2c6801c
y.create.l HWIO_PMIC_ARB_OBS0_CHNL14_RDATA1_ADDR A:0x2c7001c
y.create.l HWIO_PMIC_ARB_OBS0_CHNL15_RDATA1_ADDR A:0x2c7801c
y.create.l HWIO_PMIC_ARB_OBS0_CHNL16_RDATA1_ADDR A:0x2c8001c
y.create.l HWIO_PMIC_ARB_OBS0_CHNL17_RDATA1_ADDR A:0x2c8801c
y.create.l HWIO_PMIC_ARB_OBS0_CHNL18_RDATA1_ADDR A:0x2c9001c
y.create.l HWIO_PMIC_ARB_OBS0_CHNL19_RDATA1_ADDR A:0x2c9801c
y.create.l HWIO_PMIC_ARB_OBS0_CHNL20_RDATA1_ADDR A:0x2ca001c
y.create.l HWIO_PMIC_ARB_OBS0_CHNL21_RDATA1_ADDR A:0x2ca801c
y.create.l HWIO_PMIC_ARB_OBS0_CHNL22_RDATA1_ADDR A:0x2cb001c
y.create.l HWIO_PMIC_ARB_OBS0_CHNL23_RDATA1_ADDR A:0x2cb801c
y.create.l HWIO_PMIC_ARB_OBS0_CHNL24_RDATA1_ADDR A:0x2cc001c
y.create.l HWIO_PMIC_ARB_OBS0_CHNL25_RDATA1_ADDR A:0x2cc801c
y.create.l HWIO_PMIC_ARB_OBS0_CHNL26_RDATA1_ADDR A:0x2cd001c
y.create.l HWIO_PMIC_ARB_OBS0_CHNL27_RDATA1_ADDR A:0x2cd801c
y.create.l HWIO_PMIC_ARB_OBS0_CHNL28_RDATA1_ADDR A:0x2ce001c
y.create.l HWIO_PMIC_ARB_OBS0_CHNL29_RDATA1_ADDR A:0x2ce801c
y.create.l HWIO_PMIC_ARB_OBS0_CHNL30_RDATA1_ADDR A:0x2cf001c
y.create.l HWIO_PMIC_ARB_OBS0_CHNL31_RDATA1_ADDR A:0x2cf801c
y.create.l HWIO_PMIC_ARB_OBS0_CHNL32_RDATA1_ADDR A:0x2d0001c
y.create.l HWIO_PMIC_ARB_OBS0_CHNL33_RDATA1_ADDR A:0x2d0801c
y.create.l HWIO_PMIC_ARB_OBS0_CHNL34_RDATA1_ADDR A:0x2d1001c
y.create.l HWIO_PMIC_ARB_OBS0_CHNL35_RDATA1_ADDR A:0x2d1801c
y.create.l HWIO_PMIC_ARB_OBS0_CHNL36_RDATA1_ADDR A:0x2d2001c
y.create.l HWIO_PMIC_ARB_OBS0_CHNL37_RDATA1_ADDR A:0x2d2801c
y.create.l HWIO_PMIC_ARB_OBS0_CHNL38_RDATA1_ADDR A:0x2d3001c
y.create.l HWIO_PMIC_ARB_OBS0_CHNL39_RDATA1_ADDR A:0x2d3801c
y.create.l HWIO_PMIC_ARB_OBS0_CHNL40_RDATA1_ADDR A:0x2d4001c
y.create.l HWIO_PMIC_ARB_OBS0_CHNL41_RDATA1_ADDR A:0x2d4801c
y.create.l HWIO_PMIC_ARB_OBS0_CHNL42_RDATA1_ADDR A:0x2d5001c
y.create.l HWIO_PMIC_ARB_OBS0_CHNL43_RDATA1_ADDR A:0x2d5801c
y.create.l HWIO_PMIC_ARB_OBS0_CHNL44_RDATA1_ADDR A:0x2d6001c
y.create.l HWIO_PMIC_ARB_OBS0_CHNL45_RDATA1_ADDR A:0x2d6801c
y.create.l HWIO_PMIC_ARB_OBS0_CHNL46_RDATA1_ADDR A:0x2d7001c
y.create.l HWIO_PMIC_ARB_OBS0_CHNL47_RDATA1_ADDR A:0x2d7801c
y.create.l HWIO_PMIC_ARB_OBS0_CHNL48_RDATA1_ADDR A:0x2d8001c
y.create.l HWIO_PMIC_ARB_OBS0_CHNL49_RDATA1_ADDR A:0x2d8801c
y.create.l HWIO_PMIC_ARB_OBS0_CHNL50_RDATA1_ADDR A:0x2d9001c
y.create.l HWIO_PMIC_ARB_OBS0_CHNL51_RDATA1_ADDR A:0x2d9801c
y.create.l HWIO_PMIC_ARB_OBS0_CHNL52_RDATA1_ADDR A:0x2da001c
y.create.l HWIO_PMIC_ARB_OBS0_CHNL53_RDATA1_ADDR A:0x2da801c
y.create.l HWIO_PMIC_ARB_OBS0_CHNL54_RDATA1_ADDR A:0x2db001c
y.create.l HWIO_PMIC_ARB_OBS0_CHNL55_RDATA1_ADDR A:0x2db801c
y.create.l HWIO_PMIC_ARB_OBS0_CHNL56_RDATA1_ADDR A:0x2dc001c
y.create.l HWIO_PMIC_ARB_OBS0_CHNL57_RDATA1_ADDR A:0x2dc801c
y.create.l HWIO_PMIC_ARB_OBS0_CHNL58_RDATA1_ADDR A:0x2dd001c
y.create.l HWIO_PMIC_ARB_OBS0_CHNL59_RDATA1_ADDR A:0x2dd801c
y.create.l HWIO_PMIC_ARB_OBS0_CHNL60_RDATA1_ADDR A:0x2de001c
y.create.l HWIO_PMIC_ARB_OBS0_CHNL61_RDATA1_ADDR A:0x2de801c
y.create.l HWIO_PMIC_ARB_OBS0_CHNL62_RDATA1_ADDR A:0x2df001c
y.create.l HWIO_PMIC_ARB_OBS0_CHNL63_RDATA1_ADDR A:0x2df801c
y.create.l HWIO_PMIC_ARB_OBS0_CHNL64_RDATA1_ADDR A:0x2e0001c
y.create.l HWIO_PMIC_ARB_OBS0_CHNL65_RDATA1_ADDR A:0x2e0801c
y.create.l HWIO_PMIC_ARB_OBS0_CHNL66_RDATA1_ADDR A:0x2e1001c
y.create.l HWIO_PMIC_ARB_OBS0_CHNL67_RDATA1_ADDR A:0x2e1801c
y.create.l HWIO_PMIC_ARB_OBS0_CHNL68_RDATA1_ADDR A:0x2e2001c
y.create.l HWIO_PMIC_ARB_OBS0_CHNL69_RDATA1_ADDR A:0x2e2801c
y.create.l HWIO_PMIC_ARB_OBS0_CHNL70_RDATA1_ADDR A:0x2e3001c
y.create.l HWIO_PMIC_ARB_OBS0_CHNL71_RDATA1_ADDR A:0x2e3801c
y.create.l HWIO_PMIC_ARB_OBS0_CHNL72_RDATA1_ADDR A:0x2e4001c
y.create.l HWIO_PMIC_ARB_OBS0_CHNL73_RDATA1_ADDR A:0x2e4801c
y.create.l HWIO_PMIC_ARB_OBS0_CHNL74_RDATA1_ADDR A:0x2e5001c
y.create.l HWIO_PMIC_ARB_OBS0_CHNL75_RDATA1_ADDR A:0x2e5801c
y.create.l HWIO_PMIC_ARB_OBS0_CHNL76_RDATA1_ADDR A:0x2e6001c
y.create.l HWIO_PMIC_ARB_OBS0_CHNL77_RDATA1_ADDR A:0x2e6801c
y.create.l HWIO_PMIC_ARB_OBS0_CHNL78_RDATA1_ADDR A:0x2e7001c
y.create.l HWIO_PMIC_ARB_OBS0_CHNL79_RDATA1_ADDR A:0x2e7801c
y.create.l HWIO_PMIC_ARB_OBS0_CHNL80_RDATA1_ADDR A:0x2e8001c
y.create.l HWIO_PMIC_ARB_OBS0_CHNL81_RDATA1_ADDR A:0x2e8801c
y.create.l HWIO_PMIC_ARB_OBS0_CHNL82_RDATA1_ADDR A:0x2e9001c
y.create.l HWIO_PMIC_ARB_OBS0_CHNL83_RDATA1_ADDR A:0x2e9801c
y.create.l HWIO_PMIC_ARB_OBS0_CHNL84_RDATA1_ADDR A:0x2ea001c
y.create.l HWIO_PMIC_ARB_OBS0_CHNL85_RDATA1_ADDR A:0x2ea801c
y.create.l HWIO_PMIC_ARB_OBS0_CHNL86_RDATA1_ADDR A:0x2eb001c
y.create.l HWIO_PMIC_ARB_OBS0_CHNL87_RDATA1_ADDR A:0x2eb801c
y.create.l HWIO_PMIC_ARB_OBS0_CHNL88_RDATA1_ADDR A:0x2ec001c
y.create.l HWIO_PMIC_ARB_OBS0_CHNL89_RDATA1_ADDR A:0x2ec801c
y.create.l HWIO_PMIC_ARB_OBS0_CHNL90_RDATA1_ADDR A:0x2ed001c
y.create.l HWIO_PMIC_ARB_OBS0_CHNL91_RDATA1_ADDR A:0x2ed801c
y.create.l HWIO_PMIC_ARB_OBS0_CHNL92_RDATA1_ADDR A:0x2ee001c
y.create.l HWIO_PMIC_ARB_OBS0_CHNL93_RDATA1_ADDR A:0x2ee801c
y.create.l HWIO_PMIC_ARB_OBS0_CHNL94_RDATA1_ADDR A:0x2ef001c
y.create.l HWIO_PMIC_ARB_OBS0_CHNL95_RDATA1_ADDR A:0x2ef801c
y.create.l HWIO_PMIC_ARB_OBS0_CHNL96_RDATA1_ADDR A:0x2f0001c
y.create.l HWIO_PMIC_ARB_OBS0_CHNL97_RDATA1_ADDR A:0x2f0801c
y.create.l HWIO_PMIC_ARB_OBS0_CHNL98_RDATA1_ADDR A:0x2f1001c
y.create.l HWIO_PMIC_ARB_OBS0_CHNL99_RDATA1_ADDR A:0x2f1801c
y.create.l HWIO_PMIC_ARB_OBS0_CHNL100_RDATA1_ADDR A:0x2f2001c
y.create.l HWIO_PMIC_ARB_OBS0_CHNL101_RDATA1_ADDR A:0x2f2801c
y.create.l HWIO_PMIC_ARB_OBS0_CHNL102_RDATA1_ADDR A:0x2f3001c
y.create.l HWIO_PMIC_ARB_OBS0_CHNL103_RDATA1_ADDR A:0x2f3801c
y.create.l HWIO_PMIC_ARB_OBS0_CHNL104_RDATA1_ADDR A:0x2f4001c
y.create.l HWIO_PMIC_ARB_OBS0_CHNL105_RDATA1_ADDR A:0x2f4801c
y.create.l HWIO_PMIC_ARB_OBS0_CHNL106_RDATA1_ADDR A:0x2f5001c
y.create.l HWIO_PMIC_ARB_OBS0_CHNL107_RDATA1_ADDR A:0x2f5801c
y.create.l HWIO_PMIC_ARB_OBS0_CHNL108_RDATA1_ADDR A:0x2f6001c
y.create.l HWIO_PMIC_ARB_OBS0_CHNL109_RDATA1_ADDR A:0x2f6801c
y.create.l HWIO_PMIC_ARB_OBS0_CHNL110_RDATA1_ADDR A:0x2f7001c
y.create.l HWIO_PMIC_ARB_OBS0_CHNL111_RDATA1_ADDR A:0x2f7801c
y.create.l HWIO_PMIC_ARB_OBS0_CHNL112_RDATA1_ADDR A:0x2f8001c
y.create.l HWIO_PMIC_ARB_OBS0_CHNL113_RDATA1_ADDR A:0x2f8801c
y.create.l HWIO_PMIC_ARB_OBS0_CHNL114_RDATA1_ADDR A:0x2f9001c
y.create.l HWIO_PMIC_ARB_OBS0_CHNL115_RDATA1_ADDR A:0x2f9801c
y.create.l HWIO_PMIC_ARB_OBS0_CHNL116_RDATA1_ADDR A:0x2fa001c
y.create.l HWIO_PMIC_ARB_OBS0_CHNL117_RDATA1_ADDR A:0x2fa801c
y.create.l HWIO_PMIC_ARB_OBS0_CHNL118_RDATA1_ADDR A:0x2fb001c
y.create.l HWIO_PMIC_ARB_OBS0_CHNL119_RDATA1_ADDR A:0x2fb801c
y.create.l HWIO_PMIC_ARB_OBS0_CHNL120_RDATA1_ADDR A:0x2fc001c
y.create.l HWIO_PMIC_ARB_OBS0_CHNL121_RDATA1_ADDR A:0x2fc801c
y.create.l HWIO_PMIC_ARB_OBS0_CHNL122_RDATA1_ADDR A:0x2fd001c
y.create.l HWIO_PMIC_ARB_OBS0_CHNL123_RDATA1_ADDR A:0x2fd801c
y.create.l HWIO_PMIC_ARB_OBS0_CHNL124_RDATA1_ADDR A:0x2fe001c
y.create.l HWIO_PMIC_ARB_OBS0_CHNL125_RDATA1_ADDR A:0x2fe801c
y.create.l HWIO_PMIC_ARB_OBS0_CHNL126_RDATA1_ADDR A:0x2ff001c
y.create.l HWIO_PMIC_ARB_OBS0_CHNL127_RDATA1_ADDR A:0x2ff801c
y.create.l HWIO_PMIC_ARB_OBS0_CHNL128_RDATA1_ADDR A:0x300001c
y.create.l HWIO_PMIC_ARB_OBS0_CHNL129_RDATA1_ADDR A:0x300801c
y.create.l HWIO_PMIC_ARB_OBS0_CHNL130_RDATA1_ADDR A:0x301001c
y.create.l HWIO_PMIC_ARB_OBS0_CHNL131_RDATA1_ADDR A:0x301801c
y.create.l HWIO_PMIC_ARB_OBS0_CHNL132_RDATA1_ADDR A:0x302001c
y.create.l HWIO_PMIC_ARB_OBS0_CHNL133_RDATA1_ADDR A:0x302801c
y.create.l HWIO_PMIC_ARB_OBS0_CHNL134_RDATA1_ADDR A:0x303001c
y.create.l HWIO_PMIC_ARB_OBS0_CHNL135_RDATA1_ADDR A:0x303801c
y.create.l HWIO_PMIC_ARB_OBS0_CHNL136_RDATA1_ADDR A:0x304001c
y.create.l HWIO_PMIC_ARB_OBS0_CHNL137_RDATA1_ADDR A:0x304801c
y.create.l HWIO_PMIC_ARB_OBS0_CHNL138_RDATA1_ADDR A:0x305001c
y.create.l HWIO_PMIC_ARB_OBS0_CHNL139_RDATA1_ADDR A:0x305801c
y.create.l HWIO_PMIC_ARB_OBS0_CHNL140_RDATA1_ADDR A:0x306001c
y.create.l HWIO_PMIC_ARB_OBS0_CHNL141_RDATA1_ADDR A:0x306801c
y.create.l HWIO_PMIC_ARB_OBS0_CHNL142_RDATA1_ADDR A:0x307001c
y.create.l HWIO_PMIC_ARB_OBS0_CHNL143_RDATA1_ADDR A:0x307801c
y.create.l HWIO_PMIC_ARB_OBS0_CHNL144_RDATA1_ADDR A:0x308001c
y.create.l HWIO_PMIC_ARB_OBS0_CHNL145_RDATA1_ADDR A:0x308801c
y.create.l HWIO_PMIC_ARB_OBS0_CHNL146_RDATA1_ADDR A:0x309001c
y.create.l HWIO_PMIC_ARB_OBS0_CHNL147_RDATA1_ADDR A:0x309801c
y.create.l HWIO_PMIC_ARB_OBS0_CHNL148_RDATA1_ADDR A:0x30a001c
y.create.l HWIO_PMIC_ARB_OBS0_CHNL149_RDATA1_ADDR A:0x30a801c
y.create.l HWIO_PMIC_ARB_OBS0_CHNL150_RDATA1_ADDR A:0x30b001c
y.create.l HWIO_PMIC_ARB_OBS0_CHNL151_RDATA1_ADDR A:0x30b801c
y.create.l HWIO_PMIC_ARB_OBS0_CHNL152_RDATA1_ADDR A:0x30c001c
y.create.l HWIO_PMIC_ARB_OBS0_CHNL153_RDATA1_ADDR A:0x30c801c
y.create.l HWIO_PMIC_ARB_OBS0_CHNL154_RDATA1_ADDR A:0x30d001c
y.create.l HWIO_PMIC_ARB_OBS0_CHNL155_RDATA1_ADDR A:0x30d801c
y.create.l HWIO_PMIC_ARB_OBS0_CHNL156_RDATA1_ADDR A:0x30e001c
y.create.l HWIO_PMIC_ARB_OBS0_CHNL157_RDATA1_ADDR A:0x30e801c
y.create.l HWIO_PMIC_ARB_OBS0_CHNL158_RDATA1_ADDR A:0x30f001c
y.create.l HWIO_PMIC_ARB_OBS0_CHNL159_RDATA1_ADDR A:0x30f801c
y.create.l HWIO_PMIC_ARB_OBS0_CHNL160_RDATA1_ADDR A:0x310001c
y.create.l HWIO_PMIC_ARB_OBS0_CHNL161_RDATA1_ADDR A:0x310801c
y.create.l HWIO_PMIC_ARB_OBS0_CHNL162_RDATA1_ADDR A:0x311001c
y.create.l HWIO_PMIC_ARB_OBS0_CHNL163_RDATA1_ADDR A:0x311801c
y.create.l HWIO_PMIC_ARB_OBS0_CHNL164_RDATA1_ADDR A:0x312001c
y.create.l HWIO_PMIC_ARB_OBS0_CHNL165_RDATA1_ADDR A:0x312801c
y.create.l HWIO_PMIC_ARB_OBS0_CHNL166_RDATA1_ADDR A:0x313001c
y.create.l HWIO_PMIC_ARB_OBS0_CHNL167_RDATA1_ADDR A:0x313801c
y.create.l HWIO_PMIC_ARB_OBS0_CHNL168_RDATA1_ADDR A:0x314001c
y.create.l HWIO_PMIC_ARB_OBS0_CHNL169_RDATA1_ADDR A:0x314801c
y.create.l HWIO_PMIC_ARB_OBS0_CHNL170_RDATA1_ADDR A:0x315001c
y.create.l HWIO_PMIC_ARB_OBS0_CHNL171_RDATA1_ADDR A:0x315801c
y.create.l HWIO_PMIC_ARB_OBS0_CHNL172_RDATA1_ADDR A:0x316001c
y.create.l HWIO_PMIC_ARB_OBS0_CHNL173_RDATA1_ADDR A:0x316801c
y.create.l HWIO_PMIC_ARB_OBS0_CHNL174_RDATA1_ADDR A:0x317001c
y.create.l HWIO_PMIC_ARB_OBS0_CHNL175_RDATA1_ADDR A:0x317801c
y.create.l HWIO_PMIC_ARB_OBS0_CHNL176_RDATA1_ADDR A:0x318001c
y.create.l HWIO_PMIC_ARB_OBS0_CHNL177_RDATA1_ADDR A:0x318801c
y.create.l HWIO_PMIC_ARB_OBS0_CHNL178_RDATA1_ADDR A:0x319001c
y.create.l HWIO_PMIC_ARB_OBS0_CHNL179_RDATA1_ADDR A:0x319801c
y.create.l HWIO_PMIC_ARB_OBS0_CHNL180_RDATA1_ADDR A:0x31a001c
y.create.l HWIO_PMIC_ARB_OBS0_CHNL181_RDATA1_ADDR A:0x31a801c
y.create.l HWIO_PMIC_ARB_OBS0_CHNL182_RDATA1_ADDR A:0x31b001c
y.create.l HWIO_PMIC_ARB_OBS0_CHNL183_RDATA1_ADDR A:0x31b801c
y.create.l HWIO_PMIC_ARB_OBS0_CHNL184_RDATA1_ADDR A:0x31c001c
y.create.l HWIO_PMIC_ARB_OBS0_CHNL185_RDATA1_ADDR A:0x31c801c
y.create.l HWIO_PMIC_ARB_OBS0_CHNL186_RDATA1_ADDR A:0x31d001c
y.create.l HWIO_PMIC_ARB_OBS0_CHNL187_RDATA1_ADDR A:0x31d801c
y.create.l HWIO_PMIC_ARB_OBS0_CHNL188_RDATA1_ADDR A:0x31e001c
y.create.l HWIO_PMIC_ARB_OBS0_CHNL189_RDATA1_ADDR A:0x31e801c
y.create.l HWIO_PMIC_ARB_OBS0_CHNL190_RDATA1_ADDR A:0x31f001c
y.create.l HWIO_PMIC_ARB_OBS0_CHNL191_RDATA1_ADDR A:0x31f801c
y.create.l HWIO_PMIC_ARB_OBS0_CHNL192_RDATA1_ADDR A:0x320001c
y.create.l HWIO_PMIC_ARB_OBS0_CHNL193_RDATA1_ADDR A:0x320801c
y.create.l HWIO_PMIC_ARB_OBS0_CHNL194_RDATA1_ADDR A:0x321001c
y.create.l HWIO_PMIC_ARB_OBS0_CHNL195_RDATA1_ADDR A:0x321801c
y.create.l HWIO_PMIC_ARB_OBS0_CHNL196_RDATA1_ADDR A:0x322001c
y.create.l HWIO_PMIC_ARB_OBS0_CHNL197_RDATA1_ADDR A:0x322801c
y.create.l HWIO_PMIC_ARB_OBS0_CHNL198_RDATA1_ADDR A:0x323001c
y.create.l HWIO_PMIC_ARB_OBS0_CHNL199_RDATA1_ADDR A:0x323801c
y.create.l HWIO_PMIC_ARB_OBS0_CHNL200_RDATA1_ADDR A:0x324001c
y.create.l HWIO_PMIC_ARB_OBS0_CHNL201_RDATA1_ADDR A:0x324801c
y.create.l HWIO_PMIC_ARB_OBS0_CHNL202_RDATA1_ADDR A:0x325001c
y.create.l HWIO_PMIC_ARB_OBS0_CHNL203_RDATA1_ADDR A:0x325801c
y.create.l HWIO_PMIC_ARB_OBS0_CHNL204_RDATA1_ADDR A:0x326001c
y.create.l HWIO_PMIC_ARB_OBS0_CHNL205_RDATA1_ADDR A:0x326801c
y.create.l HWIO_PMIC_ARB_OBS0_CHNL206_RDATA1_ADDR A:0x327001c
y.create.l HWIO_PMIC_ARB_OBS0_CHNL207_RDATA1_ADDR A:0x327801c
y.create.l HWIO_PMIC_ARB_OBS0_CHNL208_RDATA1_ADDR A:0x328001c
y.create.l HWIO_PMIC_ARB_OBS0_CHNL209_RDATA1_ADDR A:0x328801c
y.create.l HWIO_PMIC_ARB_OBS0_CHNL210_RDATA1_ADDR A:0x329001c
y.create.l HWIO_PMIC_ARB_OBS0_CHNL211_RDATA1_ADDR A:0x329801c
y.create.l HWIO_PMIC_ARB_OBS0_CHNL212_RDATA1_ADDR A:0x32a001c
y.create.l HWIO_PMIC_ARB_OBS0_CHNL213_RDATA1_ADDR A:0x32a801c
y.create.l HWIO_PMIC_ARB_OBS0_CHNL214_RDATA1_ADDR A:0x32b001c
y.create.l HWIO_PMIC_ARB_OBS0_CHNL215_RDATA1_ADDR A:0x32b801c
y.create.l HWIO_PMIC_ARB_OBS0_CHNL216_RDATA1_ADDR A:0x32c001c
y.create.l HWIO_PMIC_ARB_OBS0_CHNL217_RDATA1_ADDR A:0x32c801c
y.create.l HWIO_PMIC_ARB_OBS0_CHNL218_RDATA1_ADDR A:0x32d001c
y.create.l HWIO_PMIC_ARB_OBS0_CHNL219_RDATA1_ADDR A:0x32d801c
y.create.l HWIO_PMIC_ARB_OBS0_CHNL220_RDATA1_ADDR A:0x32e001c
y.create.l HWIO_PMIC_ARB_OBS0_CHNL221_RDATA1_ADDR A:0x32e801c
y.create.l HWIO_PMIC_ARB_OBS0_CHNL222_RDATA1_ADDR A:0x32f001c
y.create.l HWIO_PMIC_ARB_OBS0_CHNL223_RDATA1_ADDR A:0x32f801c
y.create.l HWIO_PMIC_ARB_OBS0_CHNL224_RDATA1_ADDR A:0x330001c
y.create.l HWIO_PMIC_ARB_OBS0_CHNL225_RDATA1_ADDR A:0x330801c
y.create.l HWIO_PMIC_ARB_OBS0_CHNL226_RDATA1_ADDR A:0x331001c
y.create.l HWIO_PMIC_ARB_OBS0_CHNL227_RDATA1_ADDR A:0x331801c
y.create.l HWIO_PMIC_ARB_OBS0_CHNL228_RDATA1_ADDR A:0x332001c
y.create.l HWIO_PMIC_ARB_OBS0_CHNL229_RDATA1_ADDR A:0x332801c
y.create.l HWIO_PMIC_ARB_OBS0_CHNL230_RDATA1_ADDR A:0x333001c
y.create.l HWIO_PMIC_ARB_OBS0_CHNL231_RDATA1_ADDR A:0x333801c
y.create.l HWIO_PMIC_ARB_OBS0_CHNL232_RDATA1_ADDR A:0x334001c
y.create.l HWIO_PMIC_ARB_OBS0_CHNL233_RDATA1_ADDR A:0x334801c
y.create.l HWIO_PMIC_ARB_OBS0_CHNL234_RDATA1_ADDR A:0x335001c
y.create.l HWIO_PMIC_ARB_OBS0_CHNL235_RDATA1_ADDR A:0x335801c
y.create.l HWIO_PMIC_ARB_OBS0_CHNL236_RDATA1_ADDR A:0x336001c
y.create.l HWIO_PMIC_ARB_OBS0_CHNL237_RDATA1_ADDR A:0x336801c
y.create.l HWIO_PMIC_ARB_OBS0_CHNL238_RDATA1_ADDR A:0x337001c
y.create.l HWIO_PMIC_ARB_OBS0_CHNL239_RDATA1_ADDR A:0x337801c
y.create.l HWIO_PMIC_ARB_OBS0_CHNL240_RDATA1_ADDR A:0x338001c
y.create.l HWIO_PMIC_ARB_OBS0_CHNL241_RDATA1_ADDR A:0x338801c
y.create.l HWIO_PMIC_ARB_OBS0_CHNL242_RDATA1_ADDR A:0x339001c
y.create.l HWIO_PMIC_ARB_OBS0_CHNL243_RDATA1_ADDR A:0x339801c
y.create.l HWIO_PMIC_ARB_OBS0_CHNL244_RDATA1_ADDR A:0x33a001c
y.create.l HWIO_PMIC_ARB_OBS0_CHNL245_RDATA1_ADDR A:0x33a801c
y.create.l HWIO_PMIC_ARB_OBS0_CHNL246_RDATA1_ADDR A:0x33b001c
y.create.l HWIO_PMIC_ARB_OBS0_CHNL247_RDATA1_ADDR A:0x33b801c
y.create.l HWIO_PMIC_ARB_OBS0_CHNL248_RDATA1_ADDR A:0x33c001c
y.create.l HWIO_PMIC_ARB_OBS0_CHNL249_RDATA1_ADDR A:0x33c801c
y.create.l HWIO_PMIC_ARB_OBS0_CHNL250_RDATA1_ADDR A:0x33d001c
y.create.l HWIO_PMIC_ARB_OBS0_CHNL251_RDATA1_ADDR A:0x33d801c
y.create.l HWIO_PMIC_ARB_OBS0_CHNL252_RDATA1_ADDR A:0x33e001c
y.create.l HWIO_PMIC_ARB_OBS0_CHNL253_RDATA1_ADDR A:0x33e801c
y.create.l HWIO_PMIC_ARB_OBS0_CHNL254_RDATA1_ADDR A:0x33f001c
y.create.l HWIO_PMIC_ARB_OBS0_CHNL255_RDATA1_ADDR A:0x33f801c
y.create.l HWIO_PMIC_ARB_OBS1_CHNL0_RDATA1_ADDR A:0x2c0101c
y.create.l HWIO_PMIC_ARB_OBS1_CHNL1_RDATA1_ADDR A:0x2c0901c
y.create.l HWIO_PMIC_ARB_OBS1_CHNL2_RDATA1_ADDR A:0x2c1101c
y.create.l HWIO_PMIC_ARB_OBS1_CHNL3_RDATA1_ADDR A:0x2c1901c
y.create.l HWIO_PMIC_ARB_OBS1_CHNL4_RDATA1_ADDR A:0x2c2101c
y.create.l HWIO_PMIC_ARB_OBS1_CHNL5_RDATA1_ADDR A:0x2c2901c
y.create.l HWIO_PMIC_ARB_OBS1_CHNL6_RDATA1_ADDR A:0x2c3101c
y.create.l HWIO_PMIC_ARB_OBS1_CHNL7_RDATA1_ADDR A:0x2c3901c
y.create.l HWIO_PMIC_ARB_OBS1_CHNL8_RDATA1_ADDR A:0x2c4101c
y.create.l HWIO_PMIC_ARB_OBS1_CHNL9_RDATA1_ADDR A:0x2c4901c
y.create.l HWIO_PMIC_ARB_OBS1_CHNL10_RDATA1_ADDR A:0x2c5101c
y.create.l HWIO_PMIC_ARB_OBS1_CHNL11_RDATA1_ADDR A:0x2c5901c
y.create.l HWIO_PMIC_ARB_OBS1_CHNL12_RDATA1_ADDR A:0x2c6101c
y.create.l HWIO_PMIC_ARB_OBS1_CHNL13_RDATA1_ADDR A:0x2c6901c
y.create.l HWIO_PMIC_ARB_OBS1_CHNL14_RDATA1_ADDR A:0x2c7101c
y.create.l HWIO_PMIC_ARB_OBS1_CHNL15_RDATA1_ADDR A:0x2c7901c
y.create.l HWIO_PMIC_ARB_OBS1_CHNL16_RDATA1_ADDR A:0x2c8101c
y.create.l HWIO_PMIC_ARB_OBS1_CHNL17_RDATA1_ADDR A:0x2c8901c
y.create.l HWIO_PMIC_ARB_OBS1_CHNL18_RDATA1_ADDR A:0x2c9101c
y.create.l HWIO_PMIC_ARB_OBS1_CHNL19_RDATA1_ADDR A:0x2c9901c
y.create.l HWIO_PMIC_ARB_OBS1_CHNL20_RDATA1_ADDR A:0x2ca101c
y.create.l HWIO_PMIC_ARB_OBS1_CHNL21_RDATA1_ADDR A:0x2ca901c
y.create.l HWIO_PMIC_ARB_OBS1_CHNL22_RDATA1_ADDR A:0x2cb101c
y.create.l HWIO_PMIC_ARB_OBS1_CHNL23_RDATA1_ADDR A:0x2cb901c
y.create.l HWIO_PMIC_ARB_OBS1_CHNL24_RDATA1_ADDR A:0x2cc101c
y.create.l HWIO_PMIC_ARB_OBS1_CHNL25_RDATA1_ADDR A:0x2cc901c
y.create.l HWIO_PMIC_ARB_OBS1_CHNL26_RDATA1_ADDR A:0x2cd101c
y.create.l HWIO_PMIC_ARB_OBS1_CHNL27_RDATA1_ADDR A:0x2cd901c
y.create.l HWIO_PMIC_ARB_OBS1_CHNL28_RDATA1_ADDR A:0x2ce101c
y.create.l HWIO_PMIC_ARB_OBS1_CHNL29_RDATA1_ADDR A:0x2ce901c
y.create.l HWIO_PMIC_ARB_OBS1_CHNL30_RDATA1_ADDR A:0x2cf101c
y.create.l HWIO_PMIC_ARB_OBS1_CHNL31_RDATA1_ADDR A:0x2cf901c
y.create.l HWIO_PMIC_ARB_OBS1_CHNL32_RDATA1_ADDR A:0x2d0101c
y.create.l HWIO_PMIC_ARB_OBS1_CHNL33_RDATA1_ADDR A:0x2d0901c
y.create.l HWIO_PMIC_ARB_OBS1_CHNL34_RDATA1_ADDR A:0x2d1101c
y.create.l HWIO_PMIC_ARB_OBS1_CHNL35_RDATA1_ADDR A:0x2d1901c
y.create.l HWIO_PMIC_ARB_OBS1_CHNL36_RDATA1_ADDR A:0x2d2101c
y.create.l HWIO_PMIC_ARB_OBS1_CHNL37_RDATA1_ADDR A:0x2d2901c
y.create.l HWIO_PMIC_ARB_OBS1_CHNL38_RDATA1_ADDR A:0x2d3101c
y.create.l HWIO_PMIC_ARB_OBS1_CHNL39_RDATA1_ADDR A:0x2d3901c
y.create.l HWIO_PMIC_ARB_OBS1_CHNL40_RDATA1_ADDR A:0x2d4101c
y.create.l HWIO_PMIC_ARB_OBS1_CHNL41_RDATA1_ADDR A:0x2d4901c
y.create.l HWIO_PMIC_ARB_OBS1_CHNL42_RDATA1_ADDR A:0x2d5101c
y.create.l HWIO_PMIC_ARB_OBS1_CHNL43_RDATA1_ADDR A:0x2d5901c
y.create.l HWIO_PMIC_ARB_OBS1_CHNL44_RDATA1_ADDR A:0x2d6101c
y.create.l HWIO_PMIC_ARB_OBS1_CHNL45_RDATA1_ADDR A:0x2d6901c
y.create.l HWIO_PMIC_ARB_OBS1_CHNL46_RDATA1_ADDR A:0x2d7101c
y.create.l HWIO_PMIC_ARB_OBS1_CHNL47_RDATA1_ADDR A:0x2d7901c
y.create.l HWIO_PMIC_ARB_OBS1_CHNL48_RDATA1_ADDR A:0x2d8101c
y.create.l HWIO_PMIC_ARB_OBS1_CHNL49_RDATA1_ADDR A:0x2d8901c
y.create.l HWIO_PMIC_ARB_OBS1_CHNL50_RDATA1_ADDR A:0x2d9101c
y.create.l HWIO_PMIC_ARB_OBS1_CHNL51_RDATA1_ADDR A:0x2d9901c
y.create.l HWIO_PMIC_ARB_OBS1_CHNL52_RDATA1_ADDR A:0x2da101c
y.create.l HWIO_PMIC_ARB_OBS1_CHNL53_RDATA1_ADDR A:0x2da901c
y.create.l HWIO_PMIC_ARB_OBS1_CHNL54_RDATA1_ADDR A:0x2db101c
y.create.l HWIO_PMIC_ARB_OBS1_CHNL55_RDATA1_ADDR A:0x2db901c
y.create.l HWIO_PMIC_ARB_OBS1_CHNL56_RDATA1_ADDR A:0x2dc101c
y.create.l HWIO_PMIC_ARB_OBS1_CHNL57_RDATA1_ADDR A:0x2dc901c
y.create.l HWIO_PMIC_ARB_OBS1_CHNL58_RDATA1_ADDR A:0x2dd101c
y.create.l HWIO_PMIC_ARB_OBS1_CHNL59_RDATA1_ADDR A:0x2dd901c
y.create.l HWIO_PMIC_ARB_OBS1_CHNL60_RDATA1_ADDR A:0x2de101c
y.create.l HWIO_PMIC_ARB_OBS1_CHNL61_RDATA1_ADDR A:0x2de901c
y.create.l HWIO_PMIC_ARB_OBS1_CHNL62_RDATA1_ADDR A:0x2df101c
y.create.l HWIO_PMIC_ARB_OBS1_CHNL63_RDATA1_ADDR A:0x2df901c
y.create.l HWIO_PMIC_ARB_OBS1_CHNL64_RDATA1_ADDR A:0x2e0101c
y.create.l HWIO_PMIC_ARB_OBS1_CHNL65_RDATA1_ADDR A:0x2e0901c
y.create.l HWIO_PMIC_ARB_OBS1_CHNL66_RDATA1_ADDR A:0x2e1101c
y.create.l HWIO_PMIC_ARB_OBS1_CHNL67_RDATA1_ADDR A:0x2e1901c
y.create.l HWIO_PMIC_ARB_OBS1_CHNL68_RDATA1_ADDR A:0x2e2101c
y.create.l HWIO_PMIC_ARB_OBS1_CHNL69_RDATA1_ADDR A:0x2e2901c
y.create.l HWIO_PMIC_ARB_OBS1_CHNL70_RDATA1_ADDR A:0x2e3101c
y.create.l HWIO_PMIC_ARB_OBS1_CHNL71_RDATA1_ADDR A:0x2e3901c
y.create.l HWIO_PMIC_ARB_OBS1_CHNL72_RDATA1_ADDR A:0x2e4101c
y.create.l HWIO_PMIC_ARB_OBS1_CHNL73_RDATA1_ADDR A:0x2e4901c
y.create.l HWIO_PMIC_ARB_OBS1_CHNL74_RDATA1_ADDR A:0x2e5101c
y.create.l HWIO_PMIC_ARB_OBS1_CHNL75_RDATA1_ADDR A:0x2e5901c
y.create.l HWIO_PMIC_ARB_OBS1_CHNL76_RDATA1_ADDR A:0x2e6101c
y.create.l HWIO_PMIC_ARB_OBS1_CHNL77_RDATA1_ADDR A:0x2e6901c
y.create.l HWIO_PMIC_ARB_OBS1_CHNL78_RDATA1_ADDR A:0x2e7101c
y.create.l HWIO_PMIC_ARB_OBS1_CHNL79_RDATA1_ADDR A:0x2e7901c
y.create.l HWIO_PMIC_ARB_OBS1_CHNL80_RDATA1_ADDR A:0x2e8101c
y.create.l HWIO_PMIC_ARB_OBS1_CHNL81_RDATA1_ADDR A:0x2e8901c
y.create.l HWIO_PMIC_ARB_OBS1_CHNL82_RDATA1_ADDR A:0x2e9101c
y.create.l HWIO_PMIC_ARB_OBS1_CHNL83_RDATA1_ADDR A:0x2e9901c
y.create.l HWIO_PMIC_ARB_OBS1_CHNL84_RDATA1_ADDR A:0x2ea101c
y.create.l HWIO_PMIC_ARB_OBS1_CHNL85_RDATA1_ADDR A:0x2ea901c
y.create.l HWIO_PMIC_ARB_OBS1_CHNL86_RDATA1_ADDR A:0x2eb101c
y.create.l HWIO_PMIC_ARB_OBS1_CHNL87_RDATA1_ADDR A:0x2eb901c
y.create.l HWIO_PMIC_ARB_OBS1_CHNL88_RDATA1_ADDR A:0x2ec101c
y.create.l HWIO_PMIC_ARB_OBS1_CHNL89_RDATA1_ADDR A:0x2ec901c
y.create.l HWIO_PMIC_ARB_OBS1_CHNL90_RDATA1_ADDR A:0x2ed101c
y.create.l HWIO_PMIC_ARB_OBS1_CHNL91_RDATA1_ADDR A:0x2ed901c
y.create.l HWIO_PMIC_ARB_OBS1_CHNL92_RDATA1_ADDR A:0x2ee101c
y.create.l HWIO_PMIC_ARB_OBS1_CHNL93_RDATA1_ADDR A:0x2ee901c
y.create.l HWIO_PMIC_ARB_OBS1_CHNL94_RDATA1_ADDR A:0x2ef101c
y.create.l HWIO_PMIC_ARB_OBS1_CHNL95_RDATA1_ADDR A:0x2ef901c
y.create.l HWIO_PMIC_ARB_OBS1_CHNL96_RDATA1_ADDR A:0x2f0101c
y.create.l HWIO_PMIC_ARB_OBS1_CHNL97_RDATA1_ADDR A:0x2f0901c
y.create.l HWIO_PMIC_ARB_OBS1_CHNL98_RDATA1_ADDR A:0x2f1101c
y.create.l HWIO_PMIC_ARB_OBS1_CHNL99_RDATA1_ADDR A:0x2f1901c
y.create.l HWIO_PMIC_ARB_OBS1_CHNL100_RDATA1_ADDR A:0x2f2101c
y.create.l HWIO_PMIC_ARB_OBS1_CHNL101_RDATA1_ADDR A:0x2f2901c
y.create.l HWIO_PMIC_ARB_OBS1_CHNL102_RDATA1_ADDR A:0x2f3101c
y.create.l HWIO_PMIC_ARB_OBS1_CHNL103_RDATA1_ADDR A:0x2f3901c
y.create.l HWIO_PMIC_ARB_OBS1_CHNL104_RDATA1_ADDR A:0x2f4101c
y.create.l HWIO_PMIC_ARB_OBS1_CHNL105_RDATA1_ADDR A:0x2f4901c
y.create.l HWIO_PMIC_ARB_OBS1_CHNL106_RDATA1_ADDR A:0x2f5101c
y.create.l HWIO_PMIC_ARB_OBS1_CHNL107_RDATA1_ADDR A:0x2f5901c
y.create.l HWIO_PMIC_ARB_OBS1_CHNL108_RDATA1_ADDR A:0x2f6101c
y.create.l HWIO_PMIC_ARB_OBS1_CHNL109_RDATA1_ADDR A:0x2f6901c
y.create.l HWIO_PMIC_ARB_OBS1_CHNL110_RDATA1_ADDR A:0x2f7101c
y.create.l HWIO_PMIC_ARB_OBS1_CHNL111_RDATA1_ADDR A:0x2f7901c
y.create.l HWIO_PMIC_ARB_OBS1_CHNL112_RDATA1_ADDR A:0x2f8101c
y.create.l HWIO_PMIC_ARB_OBS1_CHNL113_RDATA1_ADDR A:0x2f8901c
y.create.l HWIO_PMIC_ARB_OBS1_CHNL114_RDATA1_ADDR A:0x2f9101c
y.create.l HWIO_PMIC_ARB_OBS1_CHNL115_RDATA1_ADDR A:0x2f9901c
y.create.l HWIO_PMIC_ARB_OBS1_CHNL116_RDATA1_ADDR A:0x2fa101c
y.create.l HWIO_PMIC_ARB_OBS1_CHNL117_RDATA1_ADDR A:0x2fa901c
y.create.l HWIO_PMIC_ARB_OBS1_CHNL118_RDATA1_ADDR A:0x2fb101c
y.create.l HWIO_PMIC_ARB_OBS1_CHNL119_RDATA1_ADDR A:0x2fb901c
y.create.l HWIO_PMIC_ARB_OBS1_CHNL120_RDATA1_ADDR A:0x2fc101c
y.create.l HWIO_PMIC_ARB_OBS1_CHNL121_RDATA1_ADDR A:0x2fc901c
y.create.l HWIO_PMIC_ARB_OBS1_CHNL122_RDATA1_ADDR A:0x2fd101c
y.create.l HWIO_PMIC_ARB_OBS1_CHNL123_RDATA1_ADDR A:0x2fd901c
y.create.l HWIO_PMIC_ARB_OBS1_CHNL124_RDATA1_ADDR A:0x2fe101c
y.create.l HWIO_PMIC_ARB_OBS1_CHNL125_RDATA1_ADDR A:0x2fe901c
y.create.l HWIO_PMIC_ARB_OBS1_CHNL126_RDATA1_ADDR A:0x2ff101c
y.create.l HWIO_PMIC_ARB_OBS1_CHNL127_RDATA1_ADDR A:0x2ff901c
y.create.l HWIO_PMIC_ARB_OBS1_CHNL128_RDATA1_ADDR A:0x300101c
y.create.l HWIO_PMIC_ARB_OBS1_CHNL129_RDATA1_ADDR A:0x300901c
y.create.l HWIO_PMIC_ARB_OBS1_CHNL130_RDATA1_ADDR A:0x301101c
y.create.l HWIO_PMIC_ARB_OBS1_CHNL131_RDATA1_ADDR A:0x301901c
y.create.l HWIO_PMIC_ARB_OBS1_CHNL132_RDATA1_ADDR A:0x302101c
y.create.l HWIO_PMIC_ARB_OBS1_CHNL133_RDATA1_ADDR A:0x302901c
y.create.l HWIO_PMIC_ARB_OBS1_CHNL134_RDATA1_ADDR A:0x303101c
y.create.l HWIO_PMIC_ARB_OBS1_CHNL135_RDATA1_ADDR A:0x303901c
y.create.l HWIO_PMIC_ARB_OBS1_CHNL136_RDATA1_ADDR A:0x304101c
y.create.l HWIO_PMIC_ARB_OBS1_CHNL137_RDATA1_ADDR A:0x304901c
y.create.l HWIO_PMIC_ARB_OBS1_CHNL138_RDATA1_ADDR A:0x305101c
y.create.l HWIO_PMIC_ARB_OBS1_CHNL139_RDATA1_ADDR A:0x305901c
y.create.l HWIO_PMIC_ARB_OBS1_CHNL140_RDATA1_ADDR A:0x306101c
y.create.l HWIO_PMIC_ARB_OBS1_CHNL141_RDATA1_ADDR A:0x306901c
y.create.l HWIO_PMIC_ARB_OBS1_CHNL142_RDATA1_ADDR A:0x307101c
y.create.l HWIO_PMIC_ARB_OBS1_CHNL143_RDATA1_ADDR A:0x307901c
y.create.l HWIO_PMIC_ARB_OBS1_CHNL144_RDATA1_ADDR A:0x308101c
y.create.l HWIO_PMIC_ARB_OBS1_CHNL145_RDATA1_ADDR A:0x308901c
y.create.l HWIO_PMIC_ARB_OBS1_CHNL146_RDATA1_ADDR A:0x309101c
y.create.l HWIO_PMIC_ARB_OBS1_CHNL147_RDATA1_ADDR A:0x309901c
y.create.l HWIO_PMIC_ARB_OBS1_CHNL148_RDATA1_ADDR A:0x30a101c
y.create.l HWIO_PMIC_ARB_OBS1_CHNL149_RDATA1_ADDR A:0x30a901c
y.create.l HWIO_PMIC_ARB_OBS1_CHNL150_RDATA1_ADDR A:0x30b101c
y.create.l HWIO_PMIC_ARB_OBS1_CHNL151_RDATA1_ADDR A:0x30b901c
y.create.l HWIO_PMIC_ARB_OBS1_CHNL152_RDATA1_ADDR A:0x30c101c
y.create.l HWIO_PMIC_ARB_OBS1_CHNL153_RDATA1_ADDR A:0x30c901c
y.create.l HWIO_PMIC_ARB_OBS1_CHNL154_RDATA1_ADDR A:0x30d101c
y.create.l HWIO_PMIC_ARB_OBS1_CHNL155_RDATA1_ADDR A:0x30d901c
y.create.l HWIO_PMIC_ARB_OBS1_CHNL156_RDATA1_ADDR A:0x30e101c
y.create.l HWIO_PMIC_ARB_OBS1_CHNL157_RDATA1_ADDR A:0x30e901c
y.create.l HWIO_PMIC_ARB_OBS1_CHNL158_RDATA1_ADDR A:0x30f101c
y.create.l HWIO_PMIC_ARB_OBS1_CHNL159_RDATA1_ADDR A:0x30f901c
y.create.l HWIO_PMIC_ARB_OBS1_CHNL160_RDATA1_ADDR A:0x310101c
y.create.l HWIO_PMIC_ARB_OBS1_CHNL161_RDATA1_ADDR A:0x310901c
y.create.l HWIO_PMIC_ARB_OBS1_CHNL162_RDATA1_ADDR A:0x311101c
y.create.l HWIO_PMIC_ARB_OBS1_CHNL163_RDATA1_ADDR A:0x311901c
y.create.l HWIO_PMIC_ARB_OBS1_CHNL164_RDATA1_ADDR A:0x312101c
y.create.l HWIO_PMIC_ARB_OBS1_CHNL165_RDATA1_ADDR A:0x312901c
y.create.l HWIO_PMIC_ARB_OBS1_CHNL166_RDATA1_ADDR A:0x313101c
y.create.l HWIO_PMIC_ARB_OBS1_CHNL167_RDATA1_ADDR A:0x313901c
y.create.l HWIO_PMIC_ARB_OBS1_CHNL168_RDATA1_ADDR A:0x314101c
y.create.l HWIO_PMIC_ARB_OBS1_CHNL169_RDATA1_ADDR A:0x314901c
y.create.l HWIO_PMIC_ARB_OBS1_CHNL170_RDATA1_ADDR A:0x315101c
y.create.l HWIO_PMIC_ARB_OBS1_CHNL171_RDATA1_ADDR A:0x315901c
y.create.l HWIO_PMIC_ARB_OBS1_CHNL172_RDATA1_ADDR A:0x316101c
y.create.l HWIO_PMIC_ARB_OBS1_CHNL173_RDATA1_ADDR A:0x316901c
y.create.l HWIO_PMIC_ARB_OBS1_CHNL174_RDATA1_ADDR A:0x317101c
y.create.l HWIO_PMIC_ARB_OBS1_CHNL175_RDATA1_ADDR A:0x317901c
y.create.l HWIO_PMIC_ARB_OBS1_CHNL176_RDATA1_ADDR A:0x318101c
y.create.l HWIO_PMIC_ARB_OBS1_CHNL177_RDATA1_ADDR A:0x318901c
y.create.l HWIO_PMIC_ARB_OBS1_CHNL178_RDATA1_ADDR A:0x319101c
y.create.l HWIO_PMIC_ARB_OBS1_CHNL179_RDATA1_ADDR A:0x319901c
y.create.l HWIO_PMIC_ARB_OBS1_CHNL180_RDATA1_ADDR A:0x31a101c
y.create.l HWIO_PMIC_ARB_OBS1_CHNL181_RDATA1_ADDR A:0x31a901c
y.create.l HWIO_PMIC_ARB_OBS1_CHNL182_RDATA1_ADDR A:0x31b101c
y.create.l HWIO_PMIC_ARB_OBS1_CHNL183_RDATA1_ADDR A:0x31b901c
y.create.l HWIO_PMIC_ARB_OBS1_CHNL184_RDATA1_ADDR A:0x31c101c
y.create.l HWIO_PMIC_ARB_OBS1_CHNL185_RDATA1_ADDR A:0x31c901c
y.create.l HWIO_PMIC_ARB_OBS1_CHNL186_RDATA1_ADDR A:0x31d101c
y.create.l HWIO_PMIC_ARB_OBS1_CHNL187_RDATA1_ADDR A:0x31d901c
y.create.l HWIO_PMIC_ARB_OBS1_CHNL188_RDATA1_ADDR A:0x31e101c
y.create.l HWIO_PMIC_ARB_OBS1_CHNL189_RDATA1_ADDR A:0x31e901c
y.create.l HWIO_PMIC_ARB_OBS1_CHNL190_RDATA1_ADDR A:0x31f101c
y.create.l HWIO_PMIC_ARB_OBS1_CHNL191_RDATA1_ADDR A:0x31f901c
y.create.l HWIO_PMIC_ARB_OBS1_CHNL192_RDATA1_ADDR A:0x320101c
y.create.l HWIO_PMIC_ARB_OBS1_CHNL193_RDATA1_ADDR A:0x320901c
y.create.l HWIO_PMIC_ARB_OBS1_CHNL194_RDATA1_ADDR A:0x321101c
y.create.l HWIO_PMIC_ARB_OBS1_CHNL195_RDATA1_ADDR A:0x321901c
y.create.l HWIO_PMIC_ARB_OBS1_CHNL196_RDATA1_ADDR A:0x322101c
y.create.l HWIO_PMIC_ARB_OBS1_CHNL197_RDATA1_ADDR A:0x322901c
y.create.l HWIO_PMIC_ARB_OBS1_CHNL198_RDATA1_ADDR A:0x323101c
y.create.l HWIO_PMIC_ARB_OBS1_CHNL199_RDATA1_ADDR A:0x323901c
y.create.l HWIO_PMIC_ARB_OBS1_CHNL200_RDATA1_ADDR A:0x324101c
y.create.l HWIO_PMIC_ARB_OBS1_CHNL201_RDATA1_ADDR A:0x324901c
y.create.l HWIO_PMIC_ARB_OBS1_CHNL202_RDATA1_ADDR A:0x325101c
y.create.l HWIO_PMIC_ARB_OBS1_CHNL203_RDATA1_ADDR A:0x325901c
y.create.l HWIO_PMIC_ARB_OBS1_CHNL204_RDATA1_ADDR A:0x326101c
y.create.l HWIO_PMIC_ARB_OBS1_CHNL205_RDATA1_ADDR A:0x326901c
y.create.l HWIO_PMIC_ARB_OBS1_CHNL206_RDATA1_ADDR A:0x327101c
y.create.l HWIO_PMIC_ARB_OBS1_CHNL207_RDATA1_ADDR A:0x327901c
y.create.l HWIO_PMIC_ARB_OBS1_CHNL208_RDATA1_ADDR A:0x328101c
y.create.l HWIO_PMIC_ARB_OBS1_CHNL209_RDATA1_ADDR A:0x328901c
y.create.l HWIO_PMIC_ARB_OBS1_CHNL210_RDATA1_ADDR A:0x329101c
y.create.l HWIO_PMIC_ARB_OBS1_CHNL211_RDATA1_ADDR A:0x329901c
y.create.l HWIO_PMIC_ARB_OBS1_CHNL212_RDATA1_ADDR A:0x32a101c
y.create.l HWIO_PMIC_ARB_OBS1_CHNL213_RDATA1_ADDR A:0x32a901c
y.create.l HWIO_PMIC_ARB_OBS1_CHNL214_RDATA1_ADDR A:0x32b101c
y.create.l HWIO_PMIC_ARB_OBS1_CHNL215_RDATA1_ADDR A:0x32b901c
y.create.l HWIO_PMIC_ARB_OBS1_CHNL216_RDATA1_ADDR A:0x32c101c
y.create.l HWIO_PMIC_ARB_OBS1_CHNL217_RDATA1_ADDR A:0x32c901c
y.create.l HWIO_PMIC_ARB_OBS1_CHNL218_RDATA1_ADDR A:0x32d101c
y.create.l HWIO_PMIC_ARB_OBS1_CHNL219_RDATA1_ADDR A:0x32d901c
y.create.l HWIO_PMIC_ARB_OBS1_CHNL220_RDATA1_ADDR A:0x32e101c
y.create.l HWIO_PMIC_ARB_OBS1_CHNL221_RDATA1_ADDR A:0x32e901c
y.create.l HWIO_PMIC_ARB_OBS1_CHNL222_RDATA1_ADDR A:0x32f101c
y.create.l HWIO_PMIC_ARB_OBS1_CHNL223_RDATA1_ADDR A:0x32f901c
y.create.l HWIO_PMIC_ARB_OBS1_CHNL224_RDATA1_ADDR A:0x330101c
y.create.l HWIO_PMIC_ARB_OBS1_CHNL225_RDATA1_ADDR A:0x330901c
y.create.l HWIO_PMIC_ARB_OBS1_CHNL226_RDATA1_ADDR A:0x331101c
y.create.l HWIO_PMIC_ARB_OBS1_CHNL227_RDATA1_ADDR A:0x331901c
y.create.l HWIO_PMIC_ARB_OBS1_CHNL228_RDATA1_ADDR A:0x332101c
y.create.l HWIO_PMIC_ARB_OBS1_CHNL229_RDATA1_ADDR A:0x332901c
y.create.l HWIO_PMIC_ARB_OBS1_CHNL230_RDATA1_ADDR A:0x333101c
y.create.l HWIO_PMIC_ARB_OBS1_CHNL231_RDATA1_ADDR A:0x333901c
y.create.l HWIO_PMIC_ARB_OBS1_CHNL232_RDATA1_ADDR A:0x334101c
y.create.l HWIO_PMIC_ARB_OBS1_CHNL233_RDATA1_ADDR A:0x334901c
y.create.l HWIO_PMIC_ARB_OBS1_CHNL234_RDATA1_ADDR A:0x335101c
y.create.l HWIO_PMIC_ARB_OBS1_CHNL235_RDATA1_ADDR A:0x335901c
y.create.l HWIO_PMIC_ARB_OBS1_CHNL236_RDATA1_ADDR A:0x336101c
y.create.l HWIO_PMIC_ARB_OBS1_CHNL237_RDATA1_ADDR A:0x336901c
y.create.l HWIO_PMIC_ARB_OBS1_CHNL238_RDATA1_ADDR A:0x337101c
y.create.l HWIO_PMIC_ARB_OBS1_CHNL239_RDATA1_ADDR A:0x337901c
y.create.l HWIO_PMIC_ARB_OBS1_CHNL240_RDATA1_ADDR A:0x338101c
y.create.l HWIO_PMIC_ARB_OBS1_CHNL241_RDATA1_ADDR A:0x338901c
y.create.l HWIO_PMIC_ARB_OBS1_CHNL242_RDATA1_ADDR A:0x339101c
y.create.l HWIO_PMIC_ARB_OBS1_CHNL243_RDATA1_ADDR A:0x339901c
y.create.l HWIO_PMIC_ARB_OBS1_CHNL244_RDATA1_ADDR A:0x33a101c
y.create.l HWIO_PMIC_ARB_OBS1_CHNL245_RDATA1_ADDR A:0x33a901c
y.create.l HWIO_PMIC_ARB_OBS1_CHNL246_RDATA1_ADDR A:0x33b101c
y.create.l HWIO_PMIC_ARB_OBS1_CHNL247_RDATA1_ADDR A:0x33b901c
y.create.l HWIO_PMIC_ARB_OBS1_CHNL248_RDATA1_ADDR A:0x33c101c
y.create.l HWIO_PMIC_ARB_OBS1_CHNL249_RDATA1_ADDR A:0x33c901c
y.create.l HWIO_PMIC_ARB_OBS1_CHNL250_RDATA1_ADDR A:0x33d101c
y.create.l HWIO_PMIC_ARB_OBS1_CHNL251_RDATA1_ADDR A:0x33d901c
y.create.l HWIO_PMIC_ARB_OBS1_CHNL252_RDATA1_ADDR A:0x33e101c
y.create.l HWIO_PMIC_ARB_OBS1_CHNL253_RDATA1_ADDR A:0x33e901c
y.create.l HWIO_PMIC_ARB_OBS1_CHNL254_RDATA1_ADDR A:0x33f101c
y.create.l HWIO_PMIC_ARB_OBS1_CHNL255_RDATA1_ADDR A:0x33f901c
y.create.l HWIO_PMIC_ARB_OBS2_CHNL0_RDATA1_ADDR A:0x2c0201c
y.create.l HWIO_PMIC_ARB_OBS2_CHNL1_RDATA1_ADDR A:0x2c0a01c
y.create.l HWIO_PMIC_ARB_OBS2_CHNL2_RDATA1_ADDR A:0x2c1201c
y.create.l HWIO_PMIC_ARB_OBS2_CHNL3_RDATA1_ADDR A:0x2c1a01c
y.create.l HWIO_PMIC_ARB_OBS2_CHNL4_RDATA1_ADDR A:0x2c2201c
y.create.l HWIO_PMIC_ARB_OBS2_CHNL5_RDATA1_ADDR A:0x2c2a01c
y.create.l HWIO_PMIC_ARB_OBS2_CHNL6_RDATA1_ADDR A:0x2c3201c
y.create.l HWIO_PMIC_ARB_OBS2_CHNL7_RDATA1_ADDR A:0x2c3a01c
y.create.l HWIO_PMIC_ARB_OBS2_CHNL8_RDATA1_ADDR A:0x2c4201c
y.create.l HWIO_PMIC_ARB_OBS2_CHNL9_RDATA1_ADDR A:0x2c4a01c
y.create.l HWIO_PMIC_ARB_OBS2_CHNL10_RDATA1_ADDR A:0x2c5201c
y.create.l HWIO_PMIC_ARB_OBS2_CHNL11_RDATA1_ADDR A:0x2c5a01c
y.create.l HWIO_PMIC_ARB_OBS2_CHNL12_RDATA1_ADDR A:0x2c6201c
y.create.l HWIO_PMIC_ARB_OBS2_CHNL13_RDATA1_ADDR A:0x2c6a01c
y.create.l HWIO_PMIC_ARB_OBS2_CHNL14_RDATA1_ADDR A:0x2c7201c
y.create.l HWIO_PMIC_ARB_OBS2_CHNL15_RDATA1_ADDR A:0x2c7a01c
y.create.l HWIO_PMIC_ARB_OBS2_CHNL16_RDATA1_ADDR A:0x2c8201c
y.create.l HWIO_PMIC_ARB_OBS2_CHNL17_RDATA1_ADDR A:0x2c8a01c
y.create.l HWIO_PMIC_ARB_OBS2_CHNL18_RDATA1_ADDR A:0x2c9201c
y.create.l HWIO_PMIC_ARB_OBS2_CHNL19_RDATA1_ADDR A:0x2c9a01c
y.create.l HWIO_PMIC_ARB_OBS2_CHNL20_RDATA1_ADDR A:0x2ca201c
y.create.l HWIO_PMIC_ARB_OBS2_CHNL21_RDATA1_ADDR A:0x2caa01c
y.create.l HWIO_PMIC_ARB_OBS2_CHNL22_RDATA1_ADDR A:0x2cb201c
y.create.l HWIO_PMIC_ARB_OBS2_CHNL23_RDATA1_ADDR A:0x2cba01c
y.create.l HWIO_PMIC_ARB_OBS2_CHNL24_RDATA1_ADDR A:0x2cc201c
y.create.l HWIO_PMIC_ARB_OBS2_CHNL25_RDATA1_ADDR A:0x2cca01c
y.create.l HWIO_PMIC_ARB_OBS2_CHNL26_RDATA1_ADDR A:0x2cd201c
y.create.l HWIO_PMIC_ARB_OBS2_CHNL27_RDATA1_ADDR A:0x2cda01c
y.create.l HWIO_PMIC_ARB_OBS2_CHNL28_RDATA1_ADDR A:0x2ce201c
y.create.l HWIO_PMIC_ARB_OBS2_CHNL29_RDATA1_ADDR A:0x2cea01c
y.create.l HWIO_PMIC_ARB_OBS2_CHNL30_RDATA1_ADDR A:0x2cf201c
y.create.l HWIO_PMIC_ARB_OBS2_CHNL31_RDATA1_ADDR A:0x2cfa01c
y.create.l HWIO_PMIC_ARB_OBS2_CHNL32_RDATA1_ADDR A:0x2d0201c
y.create.l HWIO_PMIC_ARB_OBS2_CHNL33_RDATA1_ADDR A:0x2d0a01c
y.create.l HWIO_PMIC_ARB_OBS2_CHNL34_RDATA1_ADDR A:0x2d1201c
y.create.l HWIO_PMIC_ARB_OBS2_CHNL35_RDATA1_ADDR A:0x2d1a01c
y.create.l HWIO_PMIC_ARB_OBS2_CHNL36_RDATA1_ADDR A:0x2d2201c
y.create.l HWIO_PMIC_ARB_OBS2_CHNL37_RDATA1_ADDR A:0x2d2a01c
y.create.l HWIO_PMIC_ARB_OBS2_CHNL38_RDATA1_ADDR A:0x2d3201c
y.create.l HWIO_PMIC_ARB_OBS2_CHNL39_RDATA1_ADDR A:0x2d3a01c
y.create.l HWIO_PMIC_ARB_OBS2_CHNL40_RDATA1_ADDR A:0x2d4201c
y.create.l HWIO_PMIC_ARB_OBS2_CHNL41_RDATA1_ADDR A:0x2d4a01c
y.create.l HWIO_PMIC_ARB_OBS2_CHNL42_RDATA1_ADDR A:0x2d5201c
y.create.l HWIO_PMIC_ARB_OBS2_CHNL43_RDATA1_ADDR A:0x2d5a01c
y.create.l HWIO_PMIC_ARB_OBS2_CHNL44_RDATA1_ADDR A:0x2d6201c
y.create.l HWIO_PMIC_ARB_OBS2_CHNL45_RDATA1_ADDR A:0x2d6a01c
y.create.l HWIO_PMIC_ARB_OBS2_CHNL46_RDATA1_ADDR A:0x2d7201c
y.create.l HWIO_PMIC_ARB_OBS2_CHNL47_RDATA1_ADDR A:0x2d7a01c
y.create.l HWIO_PMIC_ARB_OBS2_CHNL48_RDATA1_ADDR A:0x2d8201c
y.create.l HWIO_PMIC_ARB_OBS2_CHNL49_RDATA1_ADDR A:0x2d8a01c
y.create.l HWIO_PMIC_ARB_OBS2_CHNL50_RDATA1_ADDR A:0x2d9201c
y.create.l HWIO_PMIC_ARB_OBS2_CHNL51_RDATA1_ADDR A:0x2d9a01c
y.create.l HWIO_PMIC_ARB_OBS2_CHNL52_RDATA1_ADDR A:0x2da201c
y.create.l HWIO_PMIC_ARB_OBS2_CHNL53_RDATA1_ADDR A:0x2daa01c
y.create.l HWIO_PMIC_ARB_OBS2_CHNL54_RDATA1_ADDR A:0x2db201c
y.create.l HWIO_PMIC_ARB_OBS2_CHNL55_RDATA1_ADDR A:0x2dba01c
y.create.l HWIO_PMIC_ARB_OBS2_CHNL56_RDATA1_ADDR A:0x2dc201c
y.create.l HWIO_PMIC_ARB_OBS2_CHNL57_RDATA1_ADDR A:0x2dca01c
y.create.l HWIO_PMIC_ARB_OBS2_CHNL58_RDATA1_ADDR A:0x2dd201c
y.create.l HWIO_PMIC_ARB_OBS2_CHNL59_RDATA1_ADDR A:0x2dda01c
y.create.l HWIO_PMIC_ARB_OBS2_CHNL60_RDATA1_ADDR A:0x2de201c
y.create.l HWIO_PMIC_ARB_OBS2_CHNL61_RDATA1_ADDR A:0x2dea01c
y.create.l HWIO_PMIC_ARB_OBS2_CHNL62_RDATA1_ADDR A:0x2df201c
y.create.l HWIO_PMIC_ARB_OBS2_CHNL63_RDATA1_ADDR A:0x2dfa01c
y.create.l HWIO_PMIC_ARB_OBS2_CHNL64_RDATA1_ADDR A:0x2e0201c
y.create.l HWIO_PMIC_ARB_OBS2_CHNL65_RDATA1_ADDR A:0x2e0a01c
y.create.l HWIO_PMIC_ARB_OBS2_CHNL66_RDATA1_ADDR A:0x2e1201c
y.create.l HWIO_PMIC_ARB_OBS2_CHNL67_RDATA1_ADDR A:0x2e1a01c
y.create.l HWIO_PMIC_ARB_OBS2_CHNL68_RDATA1_ADDR A:0x2e2201c
y.create.l HWIO_PMIC_ARB_OBS2_CHNL69_RDATA1_ADDR A:0x2e2a01c
y.create.l HWIO_PMIC_ARB_OBS2_CHNL70_RDATA1_ADDR A:0x2e3201c
y.create.l HWIO_PMIC_ARB_OBS2_CHNL71_RDATA1_ADDR A:0x2e3a01c
y.create.l HWIO_PMIC_ARB_OBS2_CHNL72_RDATA1_ADDR A:0x2e4201c
y.create.l HWIO_PMIC_ARB_OBS2_CHNL73_RDATA1_ADDR A:0x2e4a01c
y.create.l HWIO_PMIC_ARB_OBS2_CHNL74_RDATA1_ADDR A:0x2e5201c
y.create.l HWIO_PMIC_ARB_OBS2_CHNL75_RDATA1_ADDR A:0x2e5a01c
y.create.l HWIO_PMIC_ARB_OBS2_CHNL76_RDATA1_ADDR A:0x2e6201c
y.create.l HWIO_PMIC_ARB_OBS2_CHNL77_RDATA1_ADDR A:0x2e6a01c
y.create.l HWIO_PMIC_ARB_OBS2_CHNL78_RDATA1_ADDR A:0x2e7201c
y.create.l HWIO_PMIC_ARB_OBS2_CHNL79_RDATA1_ADDR A:0x2e7a01c
y.create.l HWIO_PMIC_ARB_OBS2_CHNL80_RDATA1_ADDR A:0x2e8201c
y.create.l HWIO_PMIC_ARB_OBS2_CHNL81_RDATA1_ADDR A:0x2e8a01c
y.create.l HWIO_PMIC_ARB_OBS2_CHNL82_RDATA1_ADDR A:0x2e9201c
y.create.l HWIO_PMIC_ARB_OBS2_CHNL83_RDATA1_ADDR A:0x2e9a01c
y.create.l HWIO_PMIC_ARB_OBS2_CHNL84_RDATA1_ADDR A:0x2ea201c
y.create.l HWIO_PMIC_ARB_OBS2_CHNL85_RDATA1_ADDR A:0x2eaa01c
y.create.l HWIO_PMIC_ARB_OBS2_CHNL86_RDATA1_ADDR A:0x2eb201c
y.create.l HWIO_PMIC_ARB_OBS2_CHNL87_RDATA1_ADDR A:0x2eba01c
y.create.l HWIO_PMIC_ARB_OBS2_CHNL88_RDATA1_ADDR A:0x2ec201c
y.create.l HWIO_PMIC_ARB_OBS2_CHNL89_RDATA1_ADDR A:0x2eca01c
y.create.l HWIO_PMIC_ARB_OBS2_CHNL90_RDATA1_ADDR A:0x2ed201c
y.create.l HWIO_PMIC_ARB_OBS2_CHNL91_RDATA1_ADDR A:0x2eda01c
y.create.l HWIO_PMIC_ARB_OBS2_CHNL92_RDATA1_ADDR A:0x2ee201c
y.create.l HWIO_PMIC_ARB_OBS2_CHNL93_RDATA1_ADDR A:0x2eea01c
y.create.l HWIO_PMIC_ARB_OBS2_CHNL94_RDATA1_ADDR A:0x2ef201c
y.create.l HWIO_PMIC_ARB_OBS2_CHNL95_RDATA1_ADDR A:0x2efa01c
y.create.l HWIO_PMIC_ARB_OBS2_CHNL96_RDATA1_ADDR A:0x2f0201c
y.create.l HWIO_PMIC_ARB_OBS2_CHNL97_RDATA1_ADDR A:0x2f0a01c
y.create.l HWIO_PMIC_ARB_OBS2_CHNL98_RDATA1_ADDR A:0x2f1201c
y.create.l HWIO_PMIC_ARB_OBS2_CHNL99_RDATA1_ADDR A:0x2f1a01c
y.create.l HWIO_PMIC_ARB_OBS2_CHNL100_RDATA1_ADDR A:0x2f2201c
y.create.l HWIO_PMIC_ARB_OBS2_CHNL101_RDATA1_ADDR A:0x2f2a01c
y.create.l HWIO_PMIC_ARB_OBS2_CHNL102_RDATA1_ADDR A:0x2f3201c
y.create.l HWIO_PMIC_ARB_OBS2_CHNL103_RDATA1_ADDR A:0x2f3a01c
y.create.l HWIO_PMIC_ARB_OBS2_CHNL104_RDATA1_ADDR A:0x2f4201c
y.create.l HWIO_PMIC_ARB_OBS2_CHNL105_RDATA1_ADDR A:0x2f4a01c
y.create.l HWIO_PMIC_ARB_OBS2_CHNL106_RDATA1_ADDR A:0x2f5201c
y.create.l HWIO_PMIC_ARB_OBS2_CHNL107_RDATA1_ADDR A:0x2f5a01c
y.create.l HWIO_PMIC_ARB_OBS2_CHNL108_RDATA1_ADDR A:0x2f6201c
y.create.l HWIO_PMIC_ARB_OBS2_CHNL109_RDATA1_ADDR A:0x2f6a01c
y.create.l HWIO_PMIC_ARB_OBS2_CHNL110_RDATA1_ADDR A:0x2f7201c
y.create.l HWIO_PMIC_ARB_OBS2_CHNL111_RDATA1_ADDR A:0x2f7a01c
y.create.l HWIO_PMIC_ARB_OBS2_CHNL112_RDATA1_ADDR A:0x2f8201c
y.create.l HWIO_PMIC_ARB_OBS2_CHNL113_RDATA1_ADDR A:0x2f8a01c
y.create.l HWIO_PMIC_ARB_OBS2_CHNL114_RDATA1_ADDR A:0x2f9201c
y.create.l HWIO_PMIC_ARB_OBS2_CHNL115_RDATA1_ADDR A:0x2f9a01c
y.create.l HWIO_PMIC_ARB_OBS2_CHNL116_RDATA1_ADDR A:0x2fa201c
y.create.l HWIO_PMIC_ARB_OBS2_CHNL117_RDATA1_ADDR A:0x2faa01c
y.create.l HWIO_PMIC_ARB_OBS2_CHNL118_RDATA1_ADDR A:0x2fb201c
y.create.l HWIO_PMIC_ARB_OBS2_CHNL119_RDATA1_ADDR A:0x2fba01c
y.create.l HWIO_PMIC_ARB_OBS2_CHNL120_RDATA1_ADDR A:0x2fc201c
y.create.l HWIO_PMIC_ARB_OBS2_CHNL121_RDATA1_ADDR A:0x2fca01c
y.create.l HWIO_PMIC_ARB_OBS2_CHNL122_RDATA1_ADDR A:0x2fd201c
y.create.l HWIO_PMIC_ARB_OBS2_CHNL123_RDATA1_ADDR A:0x2fda01c
y.create.l HWIO_PMIC_ARB_OBS2_CHNL124_RDATA1_ADDR A:0x2fe201c
y.create.l HWIO_PMIC_ARB_OBS2_CHNL125_RDATA1_ADDR A:0x2fea01c
y.create.l HWIO_PMIC_ARB_OBS2_CHNL126_RDATA1_ADDR A:0x2ff201c
y.create.l HWIO_PMIC_ARB_OBS2_CHNL127_RDATA1_ADDR A:0x2ffa01c
y.create.l HWIO_PMIC_ARB_OBS2_CHNL128_RDATA1_ADDR A:0x300201c
y.create.l HWIO_PMIC_ARB_OBS2_CHNL129_RDATA1_ADDR A:0x300a01c
y.create.l HWIO_PMIC_ARB_OBS2_CHNL130_RDATA1_ADDR A:0x301201c
y.create.l HWIO_PMIC_ARB_OBS2_CHNL131_RDATA1_ADDR A:0x301a01c
y.create.l HWIO_PMIC_ARB_OBS2_CHNL132_RDATA1_ADDR A:0x302201c
y.create.l HWIO_PMIC_ARB_OBS2_CHNL133_RDATA1_ADDR A:0x302a01c
y.create.l HWIO_PMIC_ARB_OBS2_CHNL134_RDATA1_ADDR A:0x303201c
y.create.l HWIO_PMIC_ARB_OBS2_CHNL135_RDATA1_ADDR A:0x303a01c
y.create.l HWIO_PMIC_ARB_OBS2_CHNL136_RDATA1_ADDR A:0x304201c
y.create.l HWIO_PMIC_ARB_OBS2_CHNL137_RDATA1_ADDR A:0x304a01c
y.create.l HWIO_PMIC_ARB_OBS2_CHNL138_RDATA1_ADDR A:0x305201c
y.create.l HWIO_PMIC_ARB_OBS2_CHNL139_RDATA1_ADDR A:0x305a01c
y.create.l HWIO_PMIC_ARB_OBS2_CHNL140_RDATA1_ADDR A:0x306201c
y.create.l HWIO_PMIC_ARB_OBS2_CHNL141_RDATA1_ADDR A:0x306a01c
y.create.l HWIO_PMIC_ARB_OBS2_CHNL142_RDATA1_ADDR A:0x307201c
y.create.l HWIO_PMIC_ARB_OBS2_CHNL143_RDATA1_ADDR A:0x307a01c
y.create.l HWIO_PMIC_ARB_OBS2_CHNL144_RDATA1_ADDR A:0x308201c
y.create.l HWIO_PMIC_ARB_OBS2_CHNL145_RDATA1_ADDR A:0x308a01c
y.create.l HWIO_PMIC_ARB_OBS2_CHNL146_RDATA1_ADDR A:0x309201c
y.create.l HWIO_PMIC_ARB_OBS2_CHNL147_RDATA1_ADDR A:0x309a01c
y.create.l HWIO_PMIC_ARB_OBS2_CHNL148_RDATA1_ADDR A:0x30a201c
y.create.l HWIO_PMIC_ARB_OBS2_CHNL149_RDATA1_ADDR A:0x30aa01c
y.create.l HWIO_PMIC_ARB_OBS2_CHNL150_RDATA1_ADDR A:0x30b201c
y.create.l HWIO_PMIC_ARB_OBS2_CHNL151_RDATA1_ADDR A:0x30ba01c
y.create.l HWIO_PMIC_ARB_OBS2_CHNL152_RDATA1_ADDR A:0x30c201c
y.create.l HWIO_PMIC_ARB_OBS2_CHNL153_RDATA1_ADDR A:0x30ca01c
y.create.l HWIO_PMIC_ARB_OBS2_CHNL154_RDATA1_ADDR A:0x30d201c
y.create.l HWIO_PMIC_ARB_OBS2_CHNL155_RDATA1_ADDR A:0x30da01c
y.create.l HWIO_PMIC_ARB_OBS2_CHNL156_RDATA1_ADDR A:0x30e201c
y.create.l HWIO_PMIC_ARB_OBS2_CHNL157_RDATA1_ADDR A:0x30ea01c
y.create.l HWIO_PMIC_ARB_OBS2_CHNL158_RDATA1_ADDR A:0x30f201c
y.create.l HWIO_PMIC_ARB_OBS2_CHNL159_RDATA1_ADDR A:0x30fa01c
y.create.l HWIO_PMIC_ARB_OBS2_CHNL160_RDATA1_ADDR A:0x310201c
y.create.l HWIO_PMIC_ARB_OBS2_CHNL161_RDATA1_ADDR A:0x310a01c
y.create.l HWIO_PMIC_ARB_OBS2_CHNL162_RDATA1_ADDR A:0x311201c
y.create.l HWIO_PMIC_ARB_OBS2_CHNL163_RDATA1_ADDR A:0x311a01c
y.create.l HWIO_PMIC_ARB_OBS2_CHNL164_RDATA1_ADDR A:0x312201c
y.create.l HWIO_PMIC_ARB_OBS2_CHNL165_RDATA1_ADDR A:0x312a01c
y.create.l HWIO_PMIC_ARB_OBS2_CHNL166_RDATA1_ADDR A:0x313201c
y.create.l HWIO_PMIC_ARB_OBS2_CHNL167_RDATA1_ADDR A:0x313a01c
y.create.l HWIO_PMIC_ARB_OBS2_CHNL168_RDATA1_ADDR A:0x314201c
y.create.l HWIO_PMIC_ARB_OBS2_CHNL169_RDATA1_ADDR A:0x314a01c
y.create.l HWIO_PMIC_ARB_OBS2_CHNL170_RDATA1_ADDR A:0x315201c
y.create.l HWIO_PMIC_ARB_OBS2_CHNL171_RDATA1_ADDR A:0x315a01c
y.create.l HWIO_PMIC_ARB_OBS2_CHNL172_RDATA1_ADDR A:0x316201c
y.create.l HWIO_PMIC_ARB_OBS2_CHNL173_RDATA1_ADDR A:0x316a01c
y.create.l HWIO_PMIC_ARB_OBS2_CHNL174_RDATA1_ADDR A:0x317201c
y.create.l HWIO_PMIC_ARB_OBS2_CHNL175_RDATA1_ADDR A:0x317a01c
y.create.l HWIO_PMIC_ARB_OBS2_CHNL176_RDATA1_ADDR A:0x318201c
y.create.l HWIO_PMIC_ARB_OBS2_CHNL177_RDATA1_ADDR A:0x318a01c
y.create.l HWIO_PMIC_ARB_OBS2_CHNL178_RDATA1_ADDR A:0x319201c
y.create.l HWIO_PMIC_ARB_OBS2_CHNL179_RDATA1_ADDR A:0x319a01c
y.create.l HWIO_PMIC_ARB_OBS2_CHNL180_RDATA1_ADDR A:0x31a201c
y.create.l HWIO_PMIC_ARB_OBS2_CHNL181_RDATA1_ADDR A:0x31aa01c
y.create.l HWIO_PMIC_ARB_OBS2_CHNL182_RDATA1_ADDR A:0x31b201c
y.create.l HWIO_PMIC_ARB_OBS2_CHNL183_RDATA1_ADDR A:0x31ba01c
y.create.l HWIO_PMIC_ARB_OBS2_CHNL184_RDATA1_ADDR A:0x31c201c
y.create.l HWIO_PMIC_ARB_OBS2_CHNL185_RDATA1_ADDR A:0x31ca01c
y.create.l HWIO_PMIC_ARB_OBS2_CHNL186_RDATA1_ADDR A:0x31d201c
y.create.l HWIO_PMIC_ARB_OBS2_CHNL187_RDATA1_ADDR A:0x31da01c
y.create.l HWIO_PMIC_ARB_OBS2_CHNL188_RDATA1_ADDR A:0x31e201c
y.create.l HWIO_PMIC_ARB_OBS2_CHNL189_RDATA1_ADDR A:0x31ea01c
y.create.l HWIO_PMIC_ARB_OBS2_CHNL190_RDATA1_ADDR A:0x31f201c
y.create.l HWIO_PMIC_ARB_OBS2_CHNL191_RDATA1_ADDR A:0x31fa01c
y.create.l HWIO_PMIC_ARB_OBS2_CHNL192_RDATA1_ADDR A:0x320201c
y.create.l HWIO_PMIC_ARB_OBS2_CHNL193_RDATA1_ADDR A:0x320a01c
y.create.l HWIO_PMIC_ARB_OBS2_CHNL194_RDATA1_ADDR A:0x321201c
y.create.l HWIO_PMIC_ARB_OBS2_CHNL195_RDATA1_ADDR A:0x321a01c
y.create.l HWIO_PMIC_ARB_OBS2_CHNL196_RDATA1_ADDR A:0x322201c
y.create.l HWIO_PMIC_ARB_OBS2_CHNL197_RDATA1_ADDR A:0x322a01c
y.create.l HWIO_PMIC_ARB_OBS2_CHNL198_RDATA1_ADDR A:0x323201c
y.create.l HWIO_PMIC_ARB_OBS2_CHNL199_RDATA1_ADDR A:0x323a01c
y.create.l HWIO_PMIC_ARB_OBS2_CHNL200_RDATA1_ADDR A:0x324201c
y.create.l HWIO_PMIC_ARB_OBS2_CHNL201_RDATA1_ADDR A:0x324a01c
y.create.l HWIO_PMIC_ARB_OBS2_CHNL202_RDATA1_ADDR A:0x325201c
y.create.l HWIO_PMIC_ARB_OBS2_CHNL203_RDATA1_ADDR A:0x325a01c
y.create.l HWIO_PMIC_ARB_OBS2_CHNL204_RDATA1_ADDR A:0x326201c
y.create.l HWIO_PMIC_ARB_OBS2_CHNL205_RDATA1_ADDR A:0x326a01c
y.create.l HWIO_PMIC_ARB_OBS2_CHNL206_RDATA1_ADDR A:0x327201c
y.create.l HWIO_PMIC_ARB_OBS2_CHNL207_RDATA1_ADDR A:0x327a01c
y.create.l HWIO_PMIC_ARB_OBS2_CHNL208_RDATA1_ADDR A:0x328201c
y.create.l HWIO_PMIC_ARB_OBS2_CHNL209_RDATA1_ADDR A:0x328a01c
y.create.l HWIO_PMIC_ARB_OBS2_CHNL210_RDATA1_ADDR A:0x329201c
y.create.l HWIO_PMIC_ARB_OBS2_CHNL211_RDATA1_ADDR A:0x329a01c
y.create.l HWIO_PMIC_ARB_OBS2_CHNL212_RDATA1_ADDR A:0x32a201c
y.create.l HWIO_PMIC_ARB_OBS2_CHNL213_RDATA1_ADDR A:0x32aa01c
y.create.l HWIO_PMIC_ARB_OBS2_CHNL214_RDATA1_ADDR A:0x32b201c
y.create.l HWIO_PMIC_ARB_OBS2_CHNL215_RDATA1_ADDR A:0x32ba01c
y.create.l HWIO_PMIC_ARB_OBS2_CHNL216_RDATA1_ADDR A:0x32c201c
y.create.l HWIO_PMIC_ARB_OBS2_CHNL217_RDATA1_ADDR A:0x32ca01c
y.create.l HWIO_PMIC_ARB_OBS2_CHNL218_RDATA1_ADDR A:0x32d201c
y.create.l HWIO_PMIC_ARB_OBS2_CHNL219_RDATA1_ADDR A:0x32da01c
y.create.l HWIO_PMIC_ARB_OBS2_CHNL220_RDATA1_ADDR A:0x32e201c
y.create.l HWIO_PMIC_ARB_OBS2_CHNL221_RDATA1_ADDR A:0x32ea01c
y.create.l HWIO_PMIC_ARB_OBS2_CHNL222_RDATA1_ADDR A:0x32f201c
y.create.l HWIO_PMIC_ARB_OBS2_CHNL223_RDATA1_ADDR A:0x32fa01c
y.create.l HWIO_PMIC_ARB_OBS2_CHNL224_RDATA1_ADDR A:0x330201c
y.create.l HWIO_PMIC_ARB_OBS2_CHNL225_RDATA1_ADDR A:0x330a01c
y.create.l HWIO_PMIC_ARB_OBS2_CHNL226_RDATA1_ADDR A:0x331201c
y.create.l HWIO_PMIC_ARB_OBS2_CHNL227_RDATA1_ADDR A:0x331a01c
y.create.l HWIO_PMIC_ARB_OBS2_CHNL228_RDATA1_ADDR A:0x332201c
y.create.l HWIO_PMIC_ARB_OBS2_CHNL229_RDATA1_ADDR A:0x332a01c
y.create.l HWIO_PMIC_ARB_OBS2_CHNL230_RDATA1_ADDR A:0x333201c
y.create.l HWIO_PMIC_ARB_OBS2_CHNL231_RDATA1_ADDR A:0x333a01c
y.create.l HWIO_PMIC_ARB_OBS2_CHNL232_RDATA1_ADDR A:0x334201c
y.create.l HWIO_PMIC_ARB_OBS2_CHNL233_RDATA1_ADDR A:0x334a01c
y.create.l HWIO_PMIC_ARB_OBS2_CHNL234_RDATA1_ADDR A:0x335201c
y.create.l HWIO_PMIC_ARB_OBS2_CHNL235_RDATA1_ADDR A:0x335a01c
y.create.l HWIO_PMIC_ARB_OBS2_CHNL236_RDATA1_ADDR A:0x336201c
y.create.l HWIO_PMIC_ARB_OBS2_CHNL237_RDATA1_ADDR A:0x336a01c
y.create.l HWIO_PMIC_ARB_OBS2_CHNL238_RDATA1_ADDR A:0x337201c
y.create.l HWIO_PMIC_ARB_OBS2_CHNL239_RDATA1_ADDR A:0x337a01c
y.create.l HWIO_PMIC_ARB_OBS2_CHNL240_RDATA1_ADDR A:0x338201c
y.create.l HWIO_PMIC_ARB_OBS2_CHNL241_RDATA1_ADDR A:0x338a01c
y.create.l HWIO_PMIC_ARB_OBS2_CHNL242_RDATA1_ADDR A:0x339201c
y.create.l HWIO_PMIC_ARB_OBS2_CHNL243_RDATA1_ADDR A:0x339a01c
y.create.l HWIO_PMIC_ARB_OBS2_CHNL244_RDATA1_ADDR A:0x33a201c
y.create.l HWIO_PMIC_ARB_OBS2_CHNL245_RDATA1_ADDR A:0x33aa01c
y.create.l HWIO_PMIC_ARB_OBS2_CHNL246_RDATA1_ADDR A:0x33b201c
y.create.l HWIO_PMIC_ARB_OBS2_CHNL247_RDATA1_ADDR A:0x33ba01c
y.create.l HWIO_PMIC_ARB_OBS2_CHNL248_RDATA1_ADDR A:0x33c201c
y.create.l HWIO_PMIC_ARB_OBS2_CHNL249_RDATA1_ADDR A:0x33ca01c
y.create.l HWIO_PMIC_ARB_OBS2_CHNL250_RDATA1_ADDR A:0x33d201c
y.create.l HWIO_PMIC_ARB_OBS2_CHNL251_RDATA1_ADDR A:0x33da01c
y.create.l HWIO_PMIC_ARB_OBS2_CHNL252_RDATA1_ADDR A:0x33e201c
y.create.l HWIO_PMIC_ARB_OBS2_CHNL253_RDATA1_ADDR A:0x33ea01c
y.create.l HWIO_PMIC_ARB_OBS2_CHNL254_RDATA1_ADDR A:0x33f201c
y.create.l HWIO_PMIC_ARB_OBS2_CHNL255_RDATA1_ADDR A:0x33fa01c
y.create.l HWIO_PMIC_ARB_OBS3_CHNL0_RDATA1_ADDR A:0x2c0301c
y.create.l HWIO_PMIC_ARB_OBS3_CHNL1_RDATA1_ADDR A:0x2c0b01c
y.create.l HWIO_PMIC_ARB_OBS3_CHNL2_RDATA1_ADDR A:0x2c1301c
y.create.l HWIO_PMIC_ARB_OBS3_CHNL3_RDATA1_ADDR A:0x2c1b01c
y.create.l HWIO_PMIC_ARB_OBS3_CHNL4_RDATA1_ADDR A:0x2c2301c
y.create.l HWIO_PMIC_ARB_OBS3_CHNL5_RDATA1_ADDR A:0x2c2b01c
y.create.l HWIO_PMIC_ARB_OBS3_CHNL6_RDATA1_ADDR A:0x2c3301c
y.create.l HWIO_PMIC_ARB_OBS3_CHNL7_RDATA1_ADDR A:0x2c3b01c
y.create.l HWIO_PMIC_ARB_OBS3_CHNL8_RDATA1_ADDR A:0x2c4301c
y.create.l HWIO_PMIC_ARB_OBS3_CHNL9_RDATA1_ADDR A:0x2c4b01c
y.create.l HWIO_PMIC_ARB_OBS3_CHNL10_RDATA1_ADDR A:0x2c5301c
y.create.l HWIO_PMIC_ARB_OBS3_CHNL11_RDATA1_ADDR A:0x2c5b01c
y.create.l HWIO_PMIC_ARB_OBS3_CHNL12_RDATA1_ADDR A:0x2c6301c
y.create.l HWIO_PMIC_ARB_OBS3_CHNL13_RDATA1_ADDR A:0x2c6b01c
y.create.l HWIO_PMIC_ARB_OBS3_CHNL14_RDATA1_ADDR A:0x2c7301c
y.create.l HWIO_PMIC_ARB_OBS3_CHNL15_RDATA1_ADDR A:0x2c7b01c
y.create.l HWIO_PMIC_ARB_OBS3_CHNL16_RDATA1_ADDR A:0x2c8301c
y.create.l HWIO_PMIC_ARB_OBS3_CHNL17_RDATA1_ADDR A:0x2c8b01c
y.create.l HWIO_PMIC_ARB_OBS3_CHNL18_RDATA1_ADDR A:0x2c9301c
y.create.l HWIO_PMIC_ARB_OBS3_CHNL19_RDATA1_ADDR A:0x2c9b01c
y.create.l HWIO_PMIC_ARB_OBS3_CHNL20_RDATA1_ADDR A:0x2ca301c
y.create.l HWIO_PMIC_ARB_OBS3_CHNL21_RDATA1_ADDR A:0x2cab01c
y.create.l HWIO_PMIC_ARB_OBS3_CHNL22_RDATA1_ADDR A:0x2cb301c
y.create.l HWIO_PMIC_ARB_OBS3_CHNL23_RDATA1_ADDR A:0x2cbb01c
y.create.l HWIO_PMIC_ARB_OBS3_CHNL24_RDATA1_ADDR A:0x2cc301c
y.create.l HWIO_PMIC_ARB_OBS3_CHNL25_RDATA1_ADDR A:0x2ccb01c
y.create.l HWIO_PMIC_ARB_OBS3_CHNL26_RDATA1_ADDR A:0x2cd301c
y.create.l HWIO_PMIC_ARB_OBS3_CHNL27_RDATA1_ADDR A:0x2cdb01c
y.create.l HWIO_PMIC_ARB_OBS3_CHNL28_RDATA1_ADDR A:0x2ce301c
y.create.l HWIO_PMIC_ARB_OBS3_CHNL29_RDATA1_ADDR A:0x2ceb01c
y.create.l HWIO_PMIC_ARB_OBS3_CHNL30_RDATA1_ADDR A:0x2cf301c
y.create.l HWIO_PMIC_ARB_OBS3_CHNL31_RDATA1_ADDR A:0x2cfb01c
y.create.l HWIO_PMIC_ARB_OBS3_CHNL32_RDATA1_ADDR A:0x2d0301c
y.create.l HWIO_PMIC_ARB_OBS3_CHNL33_RDATA1_ADDR A:0x2d0b01c
y.create.l HWIO_PMIC_ARB_OBS3_CHNL34_RDATA1_ADDR A:0x2d1301c
y.create.l HWIO_PMIC_ARB_OBS3_CHNL35_RDATA1_ADDR A:0x2d1b01c
y.create.l HWIO_PMIC_ARB_OBS3_CHNL36_RDATA1_ADDR A:0x2d2301c
y.create.l HWIO_PMIC_ARB_OBS3_CHNL37_RDATA1_ADDR A:0x2d2b01c
y.create.l HWIO_PMIC_ARB_OBS3_CHNL38_RDATA1_ADDR A:0x2d3301c
y.create.l HWIO_PMIC_ARB_OBS3_CHNL39_RDATA1_ADDR A:0x2d3b01c
y.create.l HWIO_PMIC_ARB_OBS3_CHNL40_RDATA1_ADDR A:0x2d4301c
y.create.l HWIO_PMIC_ARB_OBS3_CHNL41_RDATA1_ADDR A:0x2d4b01c
y.create.l HWIO_PMIC_ARB_OBS3_CHNL42_RDATA1_ADDR A:0x2d5301c
y.create.l HWIO_PMIC_ARB_OBS3_CHNL43_RDATA1_ADDR A:0x2d5b01c
y.create.l HWIO_PMIC_ARB_OBS3_CHNL44_RDATA1_ADDR A:0x2d6301c
y.create.l HWIO_PMIC_ARB_OBS3_CHNL45_RDATA1_ADDR A:0x2d6b01c
y.create.l HWIO_PMIC_ARB_OBS3_CHNL46_RDATA1_ADDR A:0x2d7301c
y.create.l HWIO_PMIC_ARB_OBS3_CHNL47_RDATA1_ADDR A:0x2d7b01c
y.create.l HWIO_PMIC_ARB_OBS3_CHNL48_RDATA1_ADDR A:0x2d8301c
y.create.l HWIO_PMIC_ARB_OBS3_CHNL49_RDATA1_ADDR A:0x2d8b01c
y.create.l HWIO_PMIC_ARB_OBS3_CHNL50_RDATA1_ADDR A:0x2d9301c
y.create.l HWIO_PMIC_ARB_OBS3_CHNL51_RDATA1_ADDR A:0x2d9b01c
y.create.l HWIO_PMIC_ARB_OBS3_CHNL52_RDATA1_ADDR A:0x2da301c
y.create.l HWIO_PMIC_ARB_OBS3_CHNL53_RDATA1_ADDR A:0x2dab01c
y.create.l HWIO_PMIC_ARB_OBS3_CHNL54_RDATA1_ADDR A:0x2db301c
y.create.l HWIO_PMIC_ARB_OBS3_CHNL55_RDATA1_ADDR A:0x2dbb01c
y.create.l HWIO_PMIC_ARB_OBS3_CHNL56_RDATA1_ADDR A:0x2dc301c
y.create.l HWIO_PMIC_ARB_OBS3_CHNL57_RDATA1_ADDR A:0x2dcb01c
y.create.l HWIO_PMIC_ARB_OBS3_CHNL58_RDATA1_ADDR A:0x2dd301c
y.create.l HWIO_PMIC_ARB_OBS3_CHNL59_RDATA1_ADDR A:0x2ddb01c
y.create.l HWIO_PMIC_ARB_OBS3_CHNL60_RDATA1_ADDR A:0x2de301c
y.create.l HWIO_PMIC_ARB_OBS3_CHNL61_RDATA1_ADDR A:0x2deb01c
y.create.l HWIO_PMIC_ARB_OBS3_CHNL62_RDATA1_ADDR A:0x2df301c
y.create.l HWIO_PMIC_ARB_OBS3_CHNL63_RDATA1_ADDR A:0x2dfb01c
y.create.l HWIO_PMIC_ARB_OBS3_CHNL64_RDATA1_ADDR A:0x2e0301c
y.create.l HWIO_PMIC_ARB_OBS3_CHNL65_RDATA1_ADDR A:0x2e0b01c
y.create.l HWIO_PMIC_ARB_OBS3_CHNL66_RDATA1_ADDR A:0x2e1301c
y.create.l HWIO_PMIC_ARB_OBS3_CHNL67_RDATA1_ADDR A:0x2e1b01c
y.create.l HWIO_PMIC_ARB_OBS3_CHNL68_RDATA1_ADDR A:0x2e2301c
y.create.l HWIO_PMIC_ARB_OBS3_CHNL69_RDATA1_ADDR A:0x2e2b01c
y.create.l HWIO_PMIC_ARB_OBS3_CHNL70_RDATA1_ADDR A:0x2e3301c
y.create.l HWIO_PMIC_ARB_OBS3_CHNL71_RDATA1_ADDR A:0x2e3b01c
y.create.l HWIO_PMIC_ARB_OBS3_CHNL72_RDATA1_ADDR A:0x2e4301c
y.create.l HWIO_PMIC_ARB_OBS3_CHNL73_RDATA1_ADDR A:0x2e4b01c
y.create.l HWIO_PMIC_ARB_OBS3_CHNL74_RDATA1_ADDR A:0x2e5301c
y.create.l HWIO_PMIC_ARB_OBS3_CHNL75_RDATA1_ADDR A:0x2e5b01c
y.create.l HWIO_PMIC_ARB_OBS3_CHNL76_RDATA1_ADDR A:0x2e6301c
y.create.l HWIO_PMIC_ARB_OBS3_CHNL77_RDATA1_ADDR A:0x2e6b01c
y.create.l HWIO_PMIC_ARB_OBS3_CHNL78_RDATA1_ADDR A:0x2e7301c
y.create.l HWIO_PMIC_ARB_OBS3_CHNL79_RDATA1_ADDR A:0x2e7b01c
y.create.l HWIO_PMIC_ARB_OBS3_CHNL80_RDATA1_ADDR A:0x2e8301c
y.create.l HWIO_PMIC_ARB_OBS3_CHNL81_RDATA1_ADDR A:0x2e8b01c
y.create.l HWIO_PMIC_ARB_OBS3_CHNL82_RDATA1_ADDR A:0x2e9301c
y.create.l HWIO_PMIC_ARB_OBS3_CHNL83_RDATA1_ADDR A:0x2e9b01c
y.create.l HWIO_PMIC_ARB_OBS3_CHNL84_RDATA1_ADDR A:0x2ea301c
y.create.l HWIO_PMIC_ARB_OBS3_CHNL85_RDATA1_ADDR A:0x2eab01c
y.create.l HWIO_PMIC_ARB_OBS3_CHNL86_RDATA1_ADDR A:0x2eb301c
y.create.l HWIO_PMIC_ARB_OBS3_CHNL87_RDATA1_ADDR A:0x2ebb01c
y.create.l HWIO_PMIC_ARB_OBS3_CHNL88_RDATA1_ADDR A:0x2ec301c
y.create.l HWIO_PMIC_ARB_OBS3_CHNL89_RDATA1_ADDR A:0x2ecb01c
y.create.l HWIO_PMIC_ARB_OBS3_CHNL90_RDATA1_ADDR A:0x2ed301c
y.create.l HWIO_PMIC_ARB_OBS3_CHNL91_RDATA1_ADDR A:0x2edb01c
y.create.l HWIO_PMIC_ARB_OBS3_CHNL92_RDATA1_ADDR A:0x2ee301c
y.create.l HWIO_PMIC_ARB_OBS3_CHNL93_RDATA1_ADDR A:0x2eeb01c
y.create.l HWIO_PMIC_ARB_OBS3_CHNL94_RDATA1_ADDR A:0x2ef301c
y.create.l HWIO_PMIC_ARB_OBS3_CHNL95_RDATA1_ADDR A:0x2efb01c
y.create.l HWIO_PMIC_ARB_OBS3_CHNL96_RDATA1_ADDR A:0x2f0301c
y.create.l HWIO_PMIC_ARB_OBS3_CHNL97_RDATA1_ADDR A:0x2f0b01c
y.create.l HWIO_PMIC_ARB_OBS3_CHNL98_RDATA1_ADDR A:0x2f1301c
y.create.l HWIO_PMIC_ARB_OBS3_CHNL99_RDATA1_ADDR A:0x2f1b01c
y.create.l HWIO_PMIC_ARB_OBS3_CHNL100_RDATA1_ADDR A:0x2f2301c
y.create.l HWIO_PMIC_ARB_OBS3_CHNL101_RDATA1_ADDR A:0x2f2b01c
y.create.l HWIO_PMIC_ARB_OBS3_CHNL102_RDATA1_ADDR A:0x2f3301c
y.create.l HWIO_PMIC_ARB_OBS3_CHNL103_RDATA1_ADDR A:0x2f3b01c
y.create.l HWIO_PMIC_ARB_OBS3_CHNL104_RDATA1_ADDR A:0x2f4301c
y.create.l HWIO_PMIC_ARB_OBS3_CHNL105_RDATA1_ADDR A:0x2f4b01c
y.create.l HWIO_PMIC_ARB_OBS3_CHNL106_RDATA1_ADDR A:0x2f5301c
y.create.l HWIO_PMIC_ARB_OBS3_CHNL107_RDATA1_ADDR A:0x2f5b01c
y.create.l HWIO_PMIC_ARB_OBS3_CHNL108_RDATA1_ADDR A:0x2f6301c
y.create.l HWIO_PMIC_ARB_OBS3_CHNL109_RDATA1_ADDR A:0x2f6b01c
y.create.l HWIO_PMIC_ARB_OBS3_CHNL110_RDATA1_ADDR A:0x2f7301c
y.create.l HWIO_PMIC_ARB_OBS3_CHNL111_RDATA1_ADDR A:0x2f7b01c
y.create.l HWIO_PMIC_ARB_OBS3_CHNL112_RDATA1_ADDR A:0x2f8301c
y.create.l HWIO_PMIC_ARB_OBS3_CHNL113_RDATA1_ADDR A:0x2f8b01c
y.create.l HWIO_PMIC_ARB_OBS3_CHNL114_RDATA1_ADDR A:0x2f9301c
y.create.l HWIO_PMIC_ARB_OBS3_CHNL115_RDATA1_ADDR A:0x2f9b01c
y.create.l HWIO_PMIC_ARB_OBS3_CHNL116_RDATA1_ADDR A:0x2fa301c
y.create.l HWIO_PMIC_ARB_OBS3_CHNL117_RDATA1_ADDR A:0x2fab01c
y.create.l HWIO_PMIC_ARB_OBS3_CHNL118_RDATA1_ADDR A:0x2fb301c
y.create.l HWIO_PMIC_ARB_OBS3_CHNL119_RDATA1_ADDR A:0x2fbb01c
y.create.l HWIO_PMIC_ARB_OBS3_CHNL120_RDATA1_ADDR A:0x2fc301c
y.create.l HWIO_PMIC_ARB_OBS3_CHNL121_RDATA1_ADDR A:0x2fcb01c
y.create.l HWIO_PMIC_ARB_OBS3_CHNL122_RDATA1_ADDR A:0x2fd301c
y.create.l HWIO_PMIC_ARB_OBS3_CHNL123_RDATA1_ADDR A:0x2fdb01c
y.create.l HWIO_PMIC_ARB_OBS3_CHNL124_RDATA1_ADDR A:0x2fe301c
y.create.l HWIO_PMIC_ARB_OBS3_CHNL125_RDATA1_ADDR A:0x2feb01c
y.create.l HWIO_PMIC_ARB_OBS3_CHNL126_RDATA1_ADDR A:0x2ff301c
y.create.l HWIO_PMIC_ARB_OBS3_CHNL127_RDATA1_ADDR A:0x2ffb01c
y.create.l HWIO_PMIC_ARB_OBS3_CHNL128_RDATA1_ADDR A:0x300301c
y.create.l HWIO_PMIC_ARB_OBS3_CHNL129_RDATA1_ADDR A:0x300b01c
y.create.l HWIO_PMIC_ARB_OBS3_CHNL130_RDATA1_ADDR A:0x301301c
y.create.l HWIO_PMIC_ARB_OBS3_CHNL131_RDATA1_ADDR A:0x301b01c
y.create.l HWIO_PMIC_ARB_OBS3_CHNL132_RDATA1_ADDR A:0x302301c
y.create.l HWIO_PMIC_ARB_OBS3_CHNL133_RDATA1_ADDR A:0x302b01c
y.create.l HWIO_PMIC_ARB_OBS3_CHNL134_RDATA1_ADDR A:0x303301c
y.create.l HWIO_PMIC_ARB_OBS3_CHNL135_RDATA1_ADDR A:0x303b01c
y.create.l HWIO_PMIC_ARB_OBS3_CHNL136_RDATA1_ADDR A:0x304301c
y.create.l HWIO_PMIC_ARB_OBS3_CHNL137_RDATA1_ADDR A:0x304b01c
y.create.l HWIO_PMIC_ARB_OBS3_CHNL138_RDATA1_ADDR A:0x305301c
y.create.l HWIO_PMIC_ARB_OBS3_CHNL139_RDATA1_ADDR A:0x305b01c
y.create.l HWIO_PMIC_ARB_OBS3_CHNL140_RDATA1_ADDR A:0x306301c
y.create.l HWIO_PMIC_ARB_OBS3_CHNL141_RDATA1_ADDR A:0x306b01c
y.create.l HWIO_PMIC_ARB_OBS3_CHNL142_RDATA1_ADDR A:0x307301c
y.create.l HWIO_PMIC_ARB_OBS3_CHNL143_RDATA1_ADDR A:0x307b01c
y.create.l HWIO_PMIC_ARB_OBS3_CHNL144_RDATA1_ADDR A:0x308301c
y.create.l HWIO_PMIC_ARB_OBS3_CHNL145_RDATA1_ADDR A:0x308b01c
y.create.l HWIO_PMIC_ARB_OBS3_CHNL146_RDATA1_ADDR A:0x309301c
y.create.l HWIO_PMIC_ARB_OBS3_CHNL147_RDATA1_ADDR A:0x309b01c
y.create.l HWIO_PMIC_ARB_OBS3_CHNL148_RDATA1_ADDR A:0x30a301c
y.create.l HWIO_PMIC_ARB_OBS3_CHNL149_RDATA1_ADDR A:0x30ab01c
y.create.l HWIO_PMIC_ARB_OBS3_CHNL150_RDATA1_ADDR A:0x30b301c
y.create.l HWIO_PMIC_ARB_OBS3_CHNL151_RDATA1_ADDR A:0x30bb01c
y.create.l HWIO_PMIC_ARB_OBS3_CHNL152_RDATA1_ADDR A:0x30c301c
y.create.l HWIO_PMIC_ARB_OBS3_CHNL153_RDATA1_ADDR A:0x30cb01c
y.create.l HWIO_PMIC_ARB_OBS3_CHNL154_RDATA1_ADDR A:0x30d301c
y.create.l HWIO_PMIC_ARB_OBS3_CHNL155_RDATA1_ADDR A:0x30db01c
y.create.l HWIO_PMIC_ARB_OBS3_CHNL156_RDATA1_ADDR A:0x30e301c
y.create.l HWIO_PMIC_ARB_OBS3_CHNL157_RDATA1_ADDR A:0x30eb01c
y.create.l HWIO_PMIC_ARB_OBS3_CHNL158_RDATA1_ADDR A:0x30f301c
y.create.l HWIO_PMIC_ARB_OBS3_CHNL159_RDATA1_ADDR A:0x30fb01c
y.create.l HWIO_PMIC_ARB_OBS3_CHNL160_RDATA1_ADDR A:0x310301c
y.create.l HWIO_PMIC_ARB_OBS3_CHNL161_RDATA1_ADDR A:0x310b01c
y.create.l HWIO_PMIC_ARB_OBS3_CHNL162_RDATA1_ADDR A:0x311301c
y.create.l HWIO_PMIC_ARB_OBS3_CHNL163_RDATA1_ADDR A:0x311b01c
y.create.l HWIO_PMIC_ARB_OBS3_CHNL164_RDATA1_ADDR A:0x312301c
y.create.l HWIO_PMIC_ARB_OBS3_CHNL165_RDATA1_ADDR A:0x312b01c
y.create.l HWIO_PMIC_ARB_OBS3_CHNL166_RDATA1_ADDR A:0x313301c
y.create.l HWIO_PMIC_ARB_OBS3_CHNL167_RDATA1_ADDR A:0x313b01c
y.create.l HWIO_PMIC_ARB_OBS3_CHNL168_RDATA1_ADDR A:0x314301c
y.create.l HWIO_PMIC_ARB_OBS3_CHNL169_RDATA1_ADDR A:0x314b01c
y.create.l HWIO_PMIC_ARB_OBS3_CHNL170_RDATA1_ADDR A:0x315301c
y.create.l HWIO_PMIC_ARB_OBS3_CHNL171_RDATA1_ADDR A:0x315b01c
y.create.l HWIO_PMIC_ARB_OBS3_CHNL172_RDATA1_ADDR A:0x316301c
y.create.l HWIO_PMIC_ARB_OBS3_CHNL173_RDATA1_ADDR A:0x316b01c
y.create.l HWIO_PMIC_ARB_OBS3_CHNL174_RDATA1_ADDR A:0x317301c
y.create.l HWIO_PMIC_ARB_OBS3_CHNL175_RDATA1_ADDR A:0x317b01c
y.create.l HWIO_PMIC_ARB_OBS3_CHNL176_RDATA1_ADDR A:0x318301c
y.create.l HWIO_PMIC_ARB_OBS3_CHNL177_RDATA1_ADDR A:0x318b01c
y.create.l HWIO_PMIC_ARB_OBS3_CHNL178_RDATA1_ADDR A:0x319301c
y.create.l HWIO_PMIC_ARB_OBS3_CHNL179_RDATA1_ADDR A:0x319b01c
y.create.l HWIO_PMIC_ARB_OBS3_CHNL180_RDATA1_ADDR A:0x31a301c
y.create.l HWIO_PMIC_ARB_OBS3_CHNL181_RDATA1_ADDR A:0x31ab01c
y.create.l HWIO_PMIC_ARB_OBS3_CHNL182_RDATA1_ADDR A:0x31b301c
y.create.l HWIO_PMIC_ARB_OBS3_CHNL183_RDATA1_ADDR A:0x31bb01c
y.create.l HWIO_PMIC_ARB_OBS3_CHNL184_RDATA1_ADDR A:0x31c301c
y.create.l HWIO_PMIC_ARB_OBS3_CHNL185_RDATA1_ADDR A:0x31cb01c
y.create.l HWIO_PMIC_ARB_OBS3_CHNL186_RDATA1_ADDR A:0x31d301c
y.create.l HWIO_PMIC_ARB_OBS3_CHNL187_RDATA1_ADDR A:0x31db01c
y.create.l HWIO_PMIC_ARB_OBS3_CHNL188_RDATA1_ADDR A:0x31e301c
y.create.l HWIO_PMIC_ARB_OBS3_CHNL189_RDATA1_ADDR A:0x31eb01c
y.create.l HWIO_PMIC_ARB_OBS3_CHNL190_RDATA1_ADDR A:0x31f301c
y.create.l HWIO_PMIC_ARB_OBS3_CHNL191_RDATA1_ADDR A:0x31fb01c
y.create.l HWIO_PMIC_ARB_OBS3_CHNL192_RDATA1_ADDR A:0x320301c
y.create.l HWIO_PMIC_ARB_OBS3_CHNL193_RDATA1_ADDR A:0x320b01c
y.create.l HWIO_PMIC_ARB_OBS3_CHNL194_RDATA1_ADDR A:0x321301c
y.create.l HWIO_PMIC_ARB_OBS3_CHNL195_RDATA1_ADDR A:0x321b01c
y.create.l HWIO_PMIC_ARB_OBS3_CHNL196_RDATA1_ADDR A:0x322301c
y.create.l HWIO_PMIC_ARB_OBS3_CHNL197_RDATA1_ADDR A:0x322b01c
y.create.l HWIO_PMIC_ARB_OBS3_CHNL198_RDATA1_ADDR A:0x323301c
y.create.l HWIO_PMIC_ARB_OBS3_CHNL199_RDATA1_ADDR A:0x323b01c
y.create.l HWIO_PMIC_ARB_OBS3_CHNL200_RDATA1_ADDR A:0x324301c
y.create.l HWIO_PMIC_ARB_OBS3_CHNL201_RDATA1_ADDR A:0x324b01c
y.create.l HWIO_PMIC_ARB_OBS3_CHNL202_RDATA1_ADDR A:0x325301c
y.create.l HWIO_PMIC_ARB_OBS3_CHNL203_RDATA1_ADDR A:0x325b01c
y.create.l HWIO_PMIC_ARB_OBS3_CHNL204_RDATA1_ADDR A:0x326301c
y.create.l HWIO_PMIC_ARB_OBS3_CHNL205_RDATA1_ADDR A:0x326b01c
y.create.l HWIO_PMIC_ARB_OBS3_CHNL206_RDATA1_ADDR A:0x327301c
y.create.l HWIO_PMIC_ARB_OBS3_CHNL207_RDATA1_ADDR A:0x327b01c
y.create.l HWIO_PMIC_ARB_OBS3_CHNL208_RDATA1_ADDR A:0x328301c
y.create.l HWIO_PMIC_ARB_OBS3_CHNL209_RDATA1_ADDR A:0x328b01c
y.create.l HWIO_PMIC_ARB_OBS3_CHNL210_RDATA1_ADDR A:0x329301c
y.create.l HWIO_PMIC_ARB_OBS3_CHNL211_RDATA1_ADDR A:0x329b01c
y.create.l HWIO_PMIC_ARB_OBS3_CHNL212_RDATA1_ADDR A:0x32a301c
y.create.l HWIO_PMIC_ARB_OBS3_CHNL213_RDATA1_ADDR A:0x32ab01c
y.create.l HWIO_PMIC_ARB_OBS3_CHNL214_RDATA1_ADDR A:0x32b301c
y.create.l HWIO_PMIC_ARB_OBS3_CHNL215_RDATA1_ADDR A:0x32bb01c
y.create.l HWIO_PMIC_ARB_OBS3_CHNL216_RDATA1_ADDR A:0x32c301c
y.create.l HWIO_PMIC_ARB_OBS3_CHNL217_RDATA1_ADDR A:0x32cb01c
y.create.l HWIO_PMIC_ARB_OBS3_CHNL218_RDATA1_ADDR A:0x32d301c
y.create.l HWIO_PMIC_ARB_OBS3_CHNL219_RDATA1_ADDR A:0x32db01c
y.create.l HWIO_PMIC_ARB_OBS3_CHNL220_RDATA1_ADDR A:0x32e301c
y.create.l HWIO_PMIC_ARB_OBS3_CHNL221_RDATA1_ADDR A:0x32eb01c
y.create.l HWIO_PMIC_ARB_OBS3_CHNL222_RDATA1_ADDR A:0x32f301c
y.create.l HWIO_PMIC_ARB_OBS3_CHNL223_RDATA1_ADDR A:0x32fb01c
y.create.l HWIO_PMIC_ARB_OBS3_CHNL224_RDATA1_ADDR A:0x330301c
y.create.l HWIO_PMIC_ARB_OBS3_CHNL225_RDATA1_ADDR A:0x330b01c
y.create.l HWIO_PMIC_ARB_OBS3_CHNL226_RDATA1_ADDR A:0x331301c
y.create.l HWIO_PMIC_ARB_OBS3_CHNL227_RDATA1_ADDR A:0x331b01c
y.create.l HWIO_PMIC_ARB_OBS3_CHNL228_RDATA1_ADDR A:0x332301c
y.create.l HWIO_PMIC_ARB_OBS3_CHNL229_RDATA1_ADDR A:0x332b01c
y.create.l HWIO_PMIC_ARB_OBS3_CHNL230_RDATA1_ADDR A:0x333301c
y.create.l HWIO_PMIC_ARB_OBS3_CHNL231_RDATA1_ADDR A:0x333b01c
y.create.l HWIO_PMIC_ARB_OBS3_CHNL232_RDATA1_ADDR A:0x334301c
y.create.l HWIO_PMIC_ARB_OBS3_CHNL233_RDATA1_ADDR A:0x334b01c
y.create.l HWIO_PMIC_ARB_OBS3_CHNL234_RDATA1_ADDR A:0x335301c
y.create.l HWIO_PMIC_ARB_OBS3_CHNL235_RDATA1_ADDR A:0x335b01c
y.create.l HWIO_PMIC_ARB_OBS3_CHNL236_RDATA1_ADDR A:0x336301c
y.create.l HWIO_PMIC_ARB_OBS3_CHNL237_RDATA1_ADDR A:0x336b01c
y.create.l HWIO_PMIC_ARB_OBS3_CHNL238_RDATA1_ADDR A:0x337301c
y.create.l HWIO_PMIC_ARB_OBS3_CHNL239_RDATA1_ADDR A:0x337b01c
y.create.l HWIO_PMIC_ARB_OBS3_CHNL240_RDATA1_ADDR A:0x338301c
y.create.l HWIO_PMIC_ARB_OBS3_CHNL241_RDATA1_ADDR A:0x338b01c
y.create.l HWIO_PMIC_ARB_OBS3_CHNL242_RDATA1_ADDR A:0x339301c
y.create.l HWIO_PMIC_ARB_OBS3_CHNL243_RDATA1_ADDR A:0x339b01c
y.create.l HWIO_PMIC_ARB_OBS3_CHNL244_RDATA1_ADDR A:0x33a301c
y.create.l HWIO_PMIC_ARB_OBS3_CHNL245_RDATA1_ADDR A:0x33ab01c
y.create.l HWIO_PMIC_ARB_OBS3_CHNL246_RDATA1_ADDR A:0x33b301c
y.create.l HWIO_PMIC_ARB_OBS3_CHNL247_RDATA1_ADDR A:0x33bb01c
y.create.l HWIO_PMIC_ARB_OBS3_CHNL248_RDATA1_ADDR A:0x33c301c
y.create.l HWIO_PMIC_ARB_OBS3_CHNL249_RDATA1_ADDR A:0x33cb01c
y.create.l HWIO_PMIC_ARB_OBS3_CHNL250_RDATA1_ADDR A:0x33d301c
y.create.l HWIO_PMIC_ARB_OBS3_CHNL251_RDATA1_ADDR A:0x33db01c
y.create.l HWIO_PMIC_ARB_OBS3_CHNL252_RDATA1_ADDR A:0x33e301c
y.create.l HWIO_PMIC_ARB_OBS3_CHNL253_RDATA1_ADDR A:0x33eb01c
y.create.l HWIO_PMIC_ARB_OBS3_CHNL254_RDATA1_ADDR A:0x33f301c
y.create.l HWIO_PMIC_ARB_OBS3_CHNL255_RDATA1_ADDR A:0x33fb01c
y.create.l HWIO_PMIC_ARB_OBS4_CHNL0_RDATA1_ADDR A:0x2c0401c
y.create.l HWIO_PMIC_ARB_OBS4_CHNL1_RDATA1_ADDR A:0x2c0c01c
y.create.l HWIO_PMIC_ARB_OBS4_CHNL2_RDATA1_ADDR A:0x2c1401c
y.create.l HWIO_PMIC_ARB_OBS4_CHNL3_RDATA1_ADDR A:0x2c1c01c
y.create.l HWIO_PMIC_ARB_OBS4_CHNL4_RDATA1_ADDR A:0x2c2401c
y.create.l HWIO_PMIC_ARB_OBS4_CHNL5_RDATA1_ADDR A:0x2c2c01c
y.create.l HWIO_PMIC_ARB_OBS4_CHNL6_RDATA1_ADDR A:0x2c3401c
y.create.l HWIO_PMIC_ARB_OBS4_CHNL7_RDATA1_ADDR A:0x2c3c01c
y.create.l HWIO_PMIC_ARB_OBS4_CHNL8_RDATA1_ADDR A:0x2c4401c
y.create.l HWIO_PMIC_ARB_OBS4_CHNL9_RDATA1_ADDR A:0x2c4c01c
y.create.l HWIO_PMIC_ARB_OBS4_CHNL10_RDATA1_ADDR A:0x2c5401c
y.create.l HWIO_PMIC_ARB_OBS4_CHNL11_RDATA1_ADDR A:0x2c5c01c
y.create.l HWIO_PMIC_ARB_OBS4_CHNL12_RDATA1_ADDR A:0x2c6401c
y.create.l HWIO_PMIC_ARB_OBS4_CHNL13_RDATA1_ADDR A:0x2c6c01c
y.create.l HWIO_PMIC_ARB_OBS4_CHNL14_RDATA1_ADDR A:0x2c7401c
y.create.l HWIO_PMIC_ARB_OBS4_CHNL15_RDATA1_ADDR A:0x2c7c01c
y.create.l HWIO_PMIC_ARB_OBS4_CHNL16_RDATA1_ADDR A:0x2c8401c
y.create.l HWIO_PMIC_ARB_OBS4_CHNL17_RDATA1_ADDR A:0x2c8c01c
y.create.l HWIO_PMIC_ARB_OBS4_CHNL18_RDATA1_ADDR A:0x2c9401c
y.create.l HWIO_PMIC_ARB_OBS4_CHNL19_RDATA1_ADDR A:0x2c9c01c
y.create.l HWIO_PMIC_ARB_OBS4_CHNL20_RDATA1_ADDR A:0x2ca401c
y.create.l HWIO_PMIC_ARB_OBS4_CHNL21_RDATA1_ADDR A:0x2cac01c
y.create.l HWIO_PMIC_ARB_OBS4_CHNL22_RDATA1_ADDR A:0x2cb401c
y.create.l HWIO_PMIC_ARB_OBS4_CHNL23_RDATA1_ADDR A:0x2cbc01c
y.create.l HWIO_PMIC_ARB_OBS4_CHNL24_RDATA1_ADDR A:0x2cc401c
y.create.l HWIO_PMIC_ARB_OBS4_CHNL25_RDATA1_ADDR A:0x2ccc01c
y.create.l HWIO_PMIC_ARB_OBS4_CHNL26_RDATA1_ADDR A:0x2cd401c
y.create.l HWIO_PMIC_ARB_OBS4_CHNL27_RDATA1_ADDR A:0x2cdc01c
y.create.l HWIO_PMIC_ARB_OBS4_CHNL28_RDATA1_ADDR A:0x2ce401c
y.create.l HWIO_PMIC_ARB_OBS4_CHNL29_RDATA1_ADDR A:0x2cec01c
y.create.l HWIO_PMIC_ARB_OBS4_CHNL30_RDATA1_ADDR A:0x2cf401c
y.create.l HWIO_PMIC_ARB_OBS4_CHNL31_RDATA1_ADDR A:0x2cfc01c
y.create.l HWIO_PMIC_ARB_OBS4_CHNL32_RDATA1_ADDR A:0x2d0401c
y.create.l HWIO_PMIC_ARB_OBS4_CHNL33_RDATA1_ADDR A:0x2d0c01c
y.create.l HWIO_PMIC_ARB_OBS4_CHNL34_RDATA1_ADDR A:0x2d1401c
y.create.l HWIO_PMIC_ARB_OBS4_CHNL35_RDATA1_ADDR A:0x2d1c01c
y.create.l HWIO_PMIC_ARB_OBS4_CHNL36_RDATA1_ADDR A:0x2d2401c
y.create.l HWIO_PMIC_ARB_OBS4_CHNL37_RDATA1_ADDR A:0x2d2c01c
y.create.l HWIO_PMIC_ARB_OBS4_CHNL38_RDATA1_ADDR A:0x2d3401c
y.create.l HWIO_PMIC_ARB_OBS4_CHNL39_RDATA1_ADDR A:0x2d3c01c
y.create.l HWIO_PMIC_ARB_OBS4_CHNL40_RDATA1_ADDR A:0x2d4401c
y.create.l HWIO_PMIC_ARB_OBS4_CHNL41_RDATA1_ADDR A:0x2d4c01c
y.create.l HWIO_PMIC_ARB_OBS4_CHNL42_RDATA1_ADDR A:0x2d5401c
y.create.l HWIO_PMIC_ARB_OBS4_CHNL43_RDATA1_ADDR A:0x2d5c01c
y.create.l HWIO_PMIC_ARB_OBS4_CHNL44_RDATA1_ADDR A:0x2d6401c
y.create.l HWIO_PMIC_ARB_OBS4_CHNL45_RDATA1_ADDR A:0x2d6c01c
y.create.l HWIO_PMIC_ARB_OBS4_CHNL46_RDATA1_ADDR A:0x2d7401c
y.create.l HWIO_PMIC_ARB_OBS4_CHNL47_RDATA1_ADDR A:0x2d7c01c
y.create.l HWIO_PMIC_ARB_OBS4_CHNL48_RDATA1_ADDR A:0x2d8401c
y.create.l HWIO_PMIC_ARB_OBS4_CHNL49_RDATA1_ADDR A:0x2d8c01c
y.create.l HWIO_PMIC_ARB_OBS4_CHNL50_RDATA1_ADDR A:0x2d9401c
y.create.l HWIO_PMIC_ARB_OBS4_CHNL51_RDATA1_ADDR A:0x2d9c01c
y.create.l HWIO_PMIC_ARB_OBS4_CHNL52_RDATA1_ADDR A:0x2da401c
y.create.l HWIO_PMIC_ARB_OBS4_CHNL53_RDATA1_ADDR A:0x2dac01c
y.create.l HWIO_PMIC_ARB_OBS4_CHNL54_RDATA1_ADDR A:0x2db401c
y.create.l HWIO_PMIC_ARB_OBS4_CHNL55_RDATA1_ADDR A:0x2dbc01c
y.create.l HWIO_PMIC_ARB_OBS4_CHNL56_RDATA1_ADDR A:0x2dc401c
y.create.l HWIO_PMIC_ARB_OBS4_CHNL57_RDATA1_ADDR A:0x2dcc01c
y.create.l HWIO_PMIC_ARB_OBS4_CHNL58_RDATA1_ADDR A:0x2dd401c
y.create.l HWIO_PMIC_ARB_OBS4_CHNL59_RDATA1_ADDR A:0x2ddc01c
y.create.l HWIO_PMIC_ARB_OBS4_CHNL60_RDATA1_ADDR A:0x2de401c
y.create.l HWIO_PMIC_ARB_OBS4_CHNL61_RDATA1_ADDR A:0x2dec01c
y.create.l HWIO_PMIC_ARB_OBS4_CHNL62_RDATA1_ADDR A:0x2df401c
y.create.l HWIO_PMIC_ARB_OBS4_CHNL63_RDATA1_ADDR A:0x2dfc01c
y.create.l HWIO_PMIC_ARB_OBS4_CHNL64_RDATA1_ADDR A:0x2e0401c
y.create.l HWIO_PMIC_ARB_OBS4_CHNL65_RDATA1_ADDR A:0x2e0c01c
y.create.l HWIO_PMIC_ARB_OBS4_CHNL66_RDATA1_ADDR A:0x2e1401c
y.create.l HWIO_PMIC_ARB_OBS4_CHNL67_RDATA1_ADDR A:0x2e1c01c
y.create.l HWIO_PMIC_ARB_OBS4_CHNL68_RDATA1_ADDR A:0x2e2401c
y.create.l HWIO_PMIC_ARB_OBS4_CHNL69_RDATA1_ADDR A:0x2e2c01c
y.create.l HWIO_PMIC_ARB_OBS4_CHNL70_RDATA1_ADDR A:0x2e3401c
y.create.l HWIO_PMIC_ARB_OBS4_CHNL71_RDATA1_ADDR A:0x2e3c01c
y.create.l HWIO_PMIC_ARB_OBS4_CHNL72_RDATA1_ADDR A:0x2e4401c
y.create.l HWIO_PMIC_ARB_OBS4_CHNL73_RDATA1_ADDR A:0x2e4c01c
y.create.l HWIO_PMIC_ARB_OBS4_CHNL74_RDATA1_ADDR A:0x2e5401c
y.create.l HWIO_PMIC_ARB_OBS4_CHNL75_RDATA1_ADDR A:0x2e5c01c
y.create.l HWIO_PMIC_ARB_OBS4_CHNL76_RDATA1_ADDR A:0x2e6401c
y.create.l HWIO_PMIC_ARB_OBS4_CHNL77_RDATA1_ADDR A:0x2e6c01c
y.create.l HWIO_PMIC_ARB_OBS4_CHNL78_RDATA1_ADDR A:0x2e7401c
y.create.l HWIO_PMIC_ARB_OBS4_CHNL79_RDATA1_ADDR A:0x2e7c01c
y.create.l HWIO_PMIC_ARB_OBS4_CHNL80_RDATA1_ADDR A:0x2e8401c
y.create.l HWIO_PMIC_ARB_OBS4_CHNL81_RDATA1_ADDR A:0x2e8c01c
y.create.l HWIO_PMIC_ARB_OBS4_CHNL82_RDATA1_ADDR A:0x2e9401c
y.create.l HWIO_PMIC_ARB_OBS4_CHNL83_RDATA1_ADDR A:0x2e9c01c
y.create.l HWIO_PMIC_ARB_OBS4_CHNL84_RDATA1_ADDR A:0x2ea401c
y.create.l HWIO_PMIC_ARB_OBS4_CHNL85_RDATA1_ADDR A:0x2eac01c
y.create.l HWIO_PMIC_ARB_OBS4_CHNL86_RDATA1_ADDR A:0x2eb401c
y.create.l HWIO_PMIC_ARB_OBS4_CHNL87_RDATA1_ADDR A:0x2ebc01c
y.create.l HWIO_PMIC_ARB_OBS4_CHNL88_RDATA1_ADDR A:0x2ec401c
y.create.l HWIO_PMIC_ARB_OBS4_CHNL89_RDATA1_ADDR A:0x2ecc01c
y.create.l HWIO_PMIC_ARB_OBS4_CHNL90_RDATA1_ADDR A:0x2ed401c
y.create.l HWIO_PMIC_ARB_OBS4_CHNL91_RDATA1_ADDR A:0x2edc01c
y.create.l HWIO_PMIC_ARB_OBS4_CHNL92_RDATA1_ADDR A:0x2ee401c
y.create.l HWIO_PMIC_ARB_OBS4_CHNL93_RDATA1_ADDR A:0x2eec01c
y.create.l HWIO_PMIC_ARB_OBS4_CHNL94_RDATA1_ADDR A:0x2ef401c
y.create.l HWIO_PMIC_ARB_OBS4_CHNL95_RDATA1_ADDR A:0x2efc01c
y.create.l HWIO_PMIC_ARB_OBS4_CHNL96_RDATA1_ADDR A:0x2f0401c
y.create.l HWIO_PMIC_ARB_OBS4_CHNL97_RDATA1_ADDR A:0x2f0c01c
y.create.l HWIO_PMIC_ARB_OBS4_CHNL98_RDATA1_ADDR A:0x2f1401c
y.create.l HWIO_PMIC_ARB_OBS4_CHNL99_RDATA1_ADDR A:0x2f1c01c
y.create.l HWIO_PMIC_ARB_OBS4_CHNL100_RDATA1_ADDR A:0x2f2401c
y.create.l HWIO_PMIC_ARB_OBS4_CHNL101_RDATA1_ADDR A:0x2f2c01c
y.create.l HWIO_PMIC_ARB_OBS4_CHNL102_RDATA1_ADDR A:0x2f3401c
y.create.l HWIO_PMIC_ARB_OBS4_CHNL103_RDATA1_ADDR A:0x2f3c01c
y.create.l HWIO_PMIC_ARB_OBS4_CHNL104_RDATA1_ADDR A:0x2f4401c
y.create.l HWIO_PMIC_ARB_OBS4_CHNL105_RDATA1_ADDR A:0x2f4c01c
y.create.l HWIO_PMIC_ARB_OBS4_CHNL106_RDATA1_ADDR A:0x2f5401c
y.create.l HWIO_PMIC_ARB_OBS4_CHNL107_RDATA1_ADDR A:0x2f5c01c
y.create.l HWIO_PMIC_ARB_OBS4_CHNL108_RDATA1_ADDR A:0x2f6401c
y.create.l HWIO_PMIC_ARB_OBS4_CHNL109_RDATA1_ADDR A:0x2f6c01c
y.create.l HWIO_PMIC_ARB_OBS4_CHNL110_RDATA1_ADDR A:0x2f7401c
y.create.l HWIO_PMIC_ARB_OBS4_CHNL111_RDATA1_ADDR A:0x2f7c01c
y.create.l HWIO_PMIC_ARB_OBS4_CHNL112_RDATA1_ADDR A:0x2f8401c
y.create.l HWIO_PMIC_ARB_OBS4_CHNL113_RDATA1_ADDR A:0x2f8c01c
y.create.l HWIO_PMIC_ARB_OBS4_CHNL114_RDATA1_ADDR A:0x2f9401c
y.create.l HWIO_PMIC_ARB_OBS4_CHNL115_RDATA1_ADDR A:0x2f9c01c
y.create.l HWIO_PMIC_ARB_OBS4_CHNL116_RDATA1_ADDR A:0x2fa401c
y.create.l HWIO_PMIC_ARB_OBS4_CHNL117_RDATA1_ADDR A:0x2fac01c
y.create.l HWIO_PMIC_ARB_OBS4_CHNL118_RDATA1_ADDR A:0x2fb401c
y.create.l HWIO_PMIC_ARB_OBS4_CHNL119_RDATA1_ADDR A:0x2fbc01c
y.create.l HWIO_PMIC_ARB_OBS4_CHNL120_RDATA1_ADDR A:0x2fc401c
y.create.l HWIO_PMIC_ARB_OBS4_CHNL121_RDATA1_ADDR A:0x2fcc01c
y.create.l HWIO_PMIC_ARB_OBS4_CHNL122_RDATA1_ADDR A:0x2fd401c
y.create.l HWIO_PMIC_ARB_OBS4_CHNL123_RDATA1_ADDR A:0x2fdc01c
y.create.l HWIO_PMIC_ARB_OBS4_CHNL124_RDATA1_ADDR A:0x2fe401c
y.create.l HWIO_PMIC_ARB_OBS4_CHNL125_RDATA1_ADDR A:0x2fec01c
y.create.l HWIO_PMIC_ARB_OBS4_CHNL126_RDATA1_ADDR A:0x2ff401c
y.create.l HWIO_PMIC_ARB_OBS4_CHNL127_RDATA1_ADDR A:0x2ffc01c
y.create.l HWIO_PMIC_ARB_OBS4_CHNL128_RDATA1_ADDR A:0x300401c
y.create.l HWIO_PMIC_ARB_OBS4_CHNL129_RDATA1_ADDR A:0x300c01c
y.create.l HWIO_PMIC_ARB_OBS4_CHNL130_RDATA1_ADDR A:0x301401c
y.create.l HWIO_PMIC_ARB_OBS4_CHNL131_RDATA1_ADDR A:0x301c01c
y.create.l HWIO_PMIC_ARB_OBS4_CHNL132_RDATA1_ADDR A:0x302401c
y.create.l HWIO_PMIC_ARB_OBS4_CHNL133_RDATA1_ADDR A:0x302c01c
y.create.l HWIO_PMIC_ARB_OBS4_CHNL134_RDATA1_ADDR A:0x303401c
y.create.l HWIO_PMIC_ARB_OBS4_CHNL135_RDATA1_ADDR A:0x303c01c
y.create.l HWIO_PMIC_ARB_OBS4_CHNL136_RDATA1_ADDR A:0x304401c
y.create.l HWIO_PMIC_ARB_OBS4_CHNL137_RDATA1_ADDR A:0x304c01c
y.create.l HWIO_PMIC_ARB_OBS4_CHNL138_RDATA1_ADDR A:0x305401c
y.create.l HWIO_PMIC_ARB_OBS4_CHNL139_RDATA1_ADDR A:0x305c01c
y.create.l HWIO_PMIC_ARB_OBS4_CHNL140_RDATA1_ADDR A:0x306401c
y.create.l HWIO_PMIC_ARB_OBS4_CHNL141_RDATA1_ADDR A:0x306c01c
y.create.l HWIO_PMIC_ARB_OBS4_CHNL142_RDATA1_ADDR A:0x307401c
y.create.l HWIO_PMIC_ARB_OBS4_CHNL143_RDATA1_ADDR A:0x307c01c
y.create.l HWIO_PMIC_ARB_OBS4_CHNL144_RDATA1_ADDR A:0x308401c
y.create.l HWIO_PMIC_ARB_OBS4_CHNL145_RDATA1_ADDR A:0x308c01c
y.create.l HWIO_PMIC_ARB_OBS4_CHNL146_RDATA1_ADDR A:0x309401c
y.create.l HWIO_PMIC_ARB_OBS4_CHNL147_RDATA1_ADDR A:0x309c01c
y.create.l HWIO_PMIC_ARB_OBS4_CHNL148_RDATA1_ADDR A:0x30a401c
y.create.l HWIO_PMIC_ARB_OBS4_CHNL149_RDATA1_ADDR A:0x30ac01c
y.create.l HWIO_PMIC_ARB_OBS4_CHNL150_RDATA1_ADDR A:0x30b401c
y.create.l HWIO_PMIC_ARB_OBS4_CHNL151_RDATA1_ADDR A:0x30bc01c
y.create.l HWIO_PMIC_ARB_OBS4_CHNL152_RDATA1_ADDR A:0x30c401c
y.create.l HWIO_PMIC_ARB_OBS4_CHNL153_RDATA1_ADDR A:0x30cc01c
y.create.l HWIO_PMIC_ARB_OBS4_CHNL154_RDATA1_ADDR A:0x30d401c
y.create.l HWIO_PMIC_ARB_OBS4_CHNL155_RDATA1_ADDR A:0x30dc01c
y.create.l HWIO_PMIC_ARB_OBS4_CHNL156_RDATA1_ADDR A:0x30e401c
y.create.l HWIO_PMIC_ARB_OBS4_CHNL157_RDATA1_ADDR A:0x30ec01c
y.create.l HWIO_PMIC_ARB_OBS4_CHNL158_RDATA1_ADDR A:0x30f401c
y.create.l HWIO_PMIC_ARB_OBS4_CHNL159_RDATA1_ADDR A:0x30fc01c
y.create.l HWIO_PMIC_ARB_OBS4_CHNL160_RDATA1_ADDR A:0x310401c
y.create.l HWIO_PMIC_ARB_OBS4_CHNL161_RDATA1_ADDR A:0x310c01c
y.create.l HWIO_PMIC_ARB_OBS4_CHNL162_RDATA1_ADDR A:0x311401c
y.create.l HWIO_PMIC_ARB_OBS4_CHNL163_RDATA1_ADDR A:0x311c01c
y.create.l HWIO_PMIC_ARB_OBS4_CHNL164_RDATA1_ADDR A:0x312401c
y.create.l HWIO_PMIC_ARB_OBS4_CHNL165_RDATA1_ADDR A:0x312c01c
y.create.l HWIO_PMIC_ARB_OBS4_CHNL166_RDATA1_ADDR A:0x313401c
y.create.l HWIO_PMIC_ARB_OBS4_CHNL167_RDATA1_ADDR A:0x313c01c
y.create.l HWIO_PMIC_ARB_OBS4_CHNL168_RDATA1_ADDR A:0x314401c
y.create.l HWIO_PMIC_ARB_OBS4_CHNL169_RDATA1_ADDR A:0x314c01c
y.create.l HWIO_PMIC_ARB_OBS4_CHNL170_RDATA1_ADDR A:0x315401c
y.create.l HWIO_PMIC_ARB_OBS4_CHNL171_RDATA1_ADDR A:0x315c01c
y.create.l HWIO_PMIC_ARB_OBS4_CHNL172_RDATA1_ADDR A:0x316401c
y.create.l HWIO_PMIC_ARB_OBS4_CHNL173_RDATA1_ADDR A:0x316c01c
y.create.l HWIO_PMIC_ARB_OBS4_CHNL174_RDATA1_ADDR A:0x317401c
y.create.l HWIO_PMIC_ARB_OBS4_CHNL175_RDATA1_ADDR A:0x317c01c
y.create.l HWIO_PMIC_ARB_OBS4_CHNL176_RDATA1_ADDR A:0x318401c
y.create.l HWIO_PMIC_ARB_OBS4_CHNL177_RDATA1_ADDR A:0x318c01c
y.create.l HWIO_PMIC_ARB_OBS4_CHNL178_RDATA1_ADDR A:0x319401c
y.create.l HWIO_PMIC_ARB_OBS4_CHNL179_RDATA1_ADDR A:0x319c01c
y.create.l HWIO_PMIC_ARB_OBS4_CHNL180_RDATA1_ADDR A:0x31a401c
y.create.l HWIO_PMIC_ARB_OBS4_CHNL181_RDATA1_ADDR A:0x31ac01c
y.create.l HWIO_PMIC_ARB_OBS4_CHNL182_RDATA1_ADDR A:0x31b401c
y.create.l HWIO_PMIC_ARB_OBS4_CHNL183_RDATA1_ADDR A:0x31bc01c
y.create.l HWIO_PMIC_ARB_OBS4_CHNL184_RDATA1_ADDR A:0x31c401c
y.create.l HWIO_PMIC_ARB_OBS4_CHNL185_RDATA1_ADDR A:0x31cc01c
y.create.l HWIO_PMIC_ARB_OBS4_CHNL186_RDATA1_ADDR A:0x31d401c
y.create.l HWIO_PMIC_ARB_OBS4_CHNL187_RDATA1_ADDR A:0x31dc01c
y.create.l HWIO_PMIC_ARB_OBS4_CHNL188_RDATA1_ADDR A:0x31e401c
y.create.l HWIO_PMIC_ARB_OBS4_CHNL189_RDATA1_ADDR A:0x31ec01c
y.create.l HWIO_PMIC_ARB_OBS4_CHNL190_RDATA1_ADDR A:0x31f401c
y.create.l HWIO_PMIC_ARB_OBS4_CHNL191_RDATA1_ADDR A:0x31fc01c
y.create.l HWIO_PMIC_ARB_OBS4_CHNL192_RDATA1_ADDR A:0x320401c
y.create.l HWIO_PMIC_ARB_OBS4_CHNL193_RDATA1_ADDR A:0x320c01c
y.create.l HWIO_PMIC_ARB_OBS4_CHNL194_RDATA1_ADDR A:0x321401c
y.create.l HWIO_PMIC_ARB_OBS4_CHNL195_RDATA1_ADDR A:0x321c01c
y.create.l HWIO_PMIC_ARB_OBS4_CHNL196_RDATA1_ADDR A:0x322401c
y.create.l HWIO_PMIC_ARB_OBS4_CHNL197_RDATA1_ADDR A:0x322c01c
y.create.l HWIO_PMIC_ARB_OBS4_CHNL198_RDATA1_ADDR A:0x323401c
y.create.l HWIO_PMIC_ARB_OBS4_CHNL199_RDATA1_ADDR A:0x323c01c
y.create.l HWIO_PMIC_ARB_OBS4_CHNL200_RDATA1_ADDR A:0x324401c
y.create.l HWIO_PMIC_ARB_OBS4_CHNL201_RDATA1_ADDR A:0x324c01c
y.create.l HWIO_PMIC_ARB_OBS4_CHNL202_RDATA1_ADDR A:0x325401c
y.create.l HWIO_PMIC_ARB_OBS4_CHNL203_RDATA1_ADDR A:0x325c01c
y.create.l HWIO_PMIC_ARB_OBS4_CHNL204_RDATA1_ADDR A:0x326401c
y.create.l HWIO_PMIC_ARB_OBS4_CHNL205_RDATA1_ADDR A:0x326c01c
y.create.l HWIO_PMIC_ARB_OBS4_CHNL206_RDATA1_ADDR A:0x327401c
y.create.l HWIO_PMIC_ARB_OBS4_CHNL207_RDATA1_ADDR A:0x327c01c
y.create.l HWIO_PMIC_ARB_OBS4_CHNL208_RDATA1_ADDR A:0x328401c
y.create.l HWIO_PMIC_ARB_OBS4_CHNL209_RDATA1_ADDR A:0x328c01c
y.create.l HWIO_PMIC_ARB_OBS4_CHNL210_RDATA1_ADDR A:0x329401c
y.create.l HWIO_PMIC_ARB_OBS4_CHNL211_RDATA1_ADDR A:0x329c01c
y.create.l HWIO_PMIC_ARB_OBS4_CHNL212_RDATA1_ADDR A:0x32a401c
y.create.l HWIO_PMIC_ARB_OBS4_CHNL213_RDATA1_ADDR A:0x32ac01c
y.create.l HWIO_PMIC_ARB_OBS4_CHNL214_RDATA1_ADDR A:0x32b401c
y.create.l HWIO_PMIC_ARB_OBS4_CHNL215_RDATA1_ADDR A:0x32bc01c
y.create.l HWIO_PMIC_ARB_OBS4_CHNL216_RDATA1_ADDR A:0x32c401c
y.create.l HWIO_PMIC_ARB_OBS4_CHNL217_RDATA1_ADDR A:0x32cc01c
y.create.l HWIO_PMIC_ARB_OBS4_CHNL218_RDATA1_ADDR A:0x32d401c
y.create.l HWIO_PMIC_ARB_OBS4_CHNL219_RDATA1_ADDR A:0x32dc01c
y.create.l HWIO_PMIC_ARB_OBS4_CHNL220_RDATA1_ADDR A:0x32e401c
y.create.l HWIO_PMIC_ARB_OBS4_CHNL221_RDATA1_ADDR A:0x32ec01c
y.create.l HWIO_PMIC_ARB_OBS4_CHNL222_RDATA1_ADDR A:0x32f401c
y.create.l HWIO_PMIC_ARB_OBS4_CHNL223_RDATA1_ADDR A:0x32fc01c
y.create.l HWIO_PMIC_ARB_OBS4_CHNL224_RDATA1_ADDR A:0x330401c
y.create.l HWIO_PMIC_ARB_OBS4_CHNL225_RDATA1_ADDR A:0x330c01c
y.create.l HWIO_PMIC_ARB_OBS4_CHNL226_RDATA1_ADDR A:0x331401c
y.create.l HWIO_PMIC_ARB_OBS4_CHNL227_RDATA1_ADDR A:0x331c01c
y.create.l HWIO_PMIC_ARB_OBS4_CHNL228_RDATA1_ADDR A:0x332401c
y.create.l HWIO_PMIC_ARB_OBS4_CHNL229_RDATA1_ADDR A:0x332c01c
y.create.l HWIO_PMIC_ARB_OBS4_CHNL230_RDATA1_ADDR A:0x333401c
y.create.l HWIO_PMIC_ARB_OBS4_CHNL231_RDATA1_ADDR A:0x333c01c
y.create.l HWIO_PMIC_ARB_OBS4_CHNL232_RDATA1_ADDR A:0x334401c
y.create.l HWIO_PMIC_ARB_OBS4_CHNL233_RDATA1_ADDR A:0x334c01c
y.create.l HWIO_PMIC_ARB_OBS4_CHNL234_RDATA1_ADDR A:0x335401c
y.create.l HWIO_PMIC_ARB_OBS4_CHNL235_RDATA1_ADDR A:0x335c01c
y.create.l HWIO_PMIC_ARB_OBS4_CHNL236_RDATA1_ADDR A:0x336401c
y.create.l HWIO_PMIC_ARB_OBS4_CHNL237_RDATA1_ADDR A:0x336c01c
y.create.l HWIO_PMIC_ARB_OBS4_CHNL238_RDATA1_ADDR A:0x337401c
y.create.l HWIO_PMIC_ARB_OBS4_CHNL239_RDATA1_ADDR A:0x337c01c
y.create.l HWIO_PMIC_ARB_OBS4_CHNL240_RDATA1_ADDR A:0x338401c
y.create.l HWIO_PMIC_ARB_OBS4_CHNL241_RDATA1_ADDR A:0x338c01c
y.create.l HWIO_PMIC_ARB_OBS4_CHNL242_RDATA1_ADDR A:0x339401c
y.create.l HWIO_PMIC_ARB_OBS4_CHNL243_RDATA1_ADDR A:0x339c01c
y.create.l HWIO_PMIC_ARB_OBS4_CHNL244_RDATA1_ADDR A:0x33a401c
y.create.l HWIO_PMIC_ARB_OBS4_CHNL245_RDATA1_ADDR A:0x33ac01c
y.create.l HWIO_PMIC_ARB_OBS4_CHNL246_RDATA1_ADDR A:0x33b401c
y.create.l HWIO_PMIC_ARB_OBS4_CHNL247_RDATA1_ADDR A:0x33bc01c
y.create.l HWIO_PMIC_ARB_OBS4_CHNL248_RDATA1_ADDR A:0x33c401c
y.create.l HWIO_PMIC_ARB_OBS4_CHNL249_RDATA1_ADDR A:0x33cc01c
y.create.l HWIO_PMIC_ARB_OBS4_CHNL250_RDATA1_ADDR A:0x33d401c
y.create.l HWIO_PMIC_ARB_OBS4_CHNL251_RDATA1_ADDR A:0x33dc01c
y.create.l HWIO_PMIC_ARB_OBS4_CHNL252_RDATA1_ADDR A:0x33e401c
y.create.l HWIO_PMIC_ARB_OBS4_CHNL253_RDATA1_ADDR A:0x33ec01c
y.create.l HWIO_PMIC_ARB_OBS4_CHNL254_RDATA1_ADDR A:0x33f401c
y.create.l HWIO_PMIC_ARB_OBS4_CHNL255_RDATA1_ADDR A:0x33fc01c
y.create.l HWIO_PMIC_ARB_OBS5_CHNL0_RDATA1_ADDR A:0x2c0501c
y.create.l HWIO_PMIC_ARB_OBS5_CHNL1_RDATA1_ADDR A:0x2c0d01c
y.create.l HWIO_PMIC_ARB_OBS5_CHNL2_RDATA1_ADDR A:0x2c1501c
y.create.l HWIO_PMIC_ARB_OBS5_CHNL3_RDATA1_ADDR A:0x2c1d01c
y.create.l HWIO_PMIC_ARB_OBS5_CHNL4_RDATA1_ADDR A:0x2c2501c
y.create.l HWIO_PMIC_ARB_OBS5_CHNL5_RDATA1_ADDR A:0x2c2d01c
y.create.l HWIO_PMIC_ARB_OBS5_CHNL6_RDATA1_ADDR A:0x2c3501c
y.create.l HWIO_PMIC_ARB_OBS5_CHNL7_RDATA1_ADDR A:0x2c3d01c
y.create.l HWIO_PMIC_ARB_OBS5_CHNL8_RDATA1_ADDR A:0x2c4501c
y.create.l HWIO_PMIC_ARB_OBS5_CHNL9_RDATA1_ADDR A:0x2c4d01c
y.create.l HWIO_PMIC_ARB_OBS5_CHNL10_RDATA1_ADDR A:0x2c5501c
y.create.l HWIO_PMIC_ARB_OBS5_CHNL11_RDATA1_ADDR A:0x2c5d01c
y.create.l HWIO_PMIC_ARB_OBS5_CHNL12_RDATA1_ADDR A:0x2c6501c
y.create.l HWIO_PMIC_ARB_OBS5_CHNL13_RDATA1_ADDR A:0x2c6d01c
y.create.l HWIO_PMIC_ARB_OBS5_CHNL14_RDATA1_ADDR A:0x2c7501c
y.create.l HWIO_PMIC_ARB_OBS5_CHNL15_RDATA1_ADDR A:0x2c7d01c
y.create.l HWIO_PMIC_ARB_OBS5_CHNL16_RDATA1_ADDR A:0x2c8501c
y.create.l HWIO_PMIC_ARB_OBS5_CHNL17_RDATA1_ADDR A:0x2c8d01c
y.create.l HWIO_PMIC_ARB_OBS5_CHNL18_RDATA1_ADDR A:0x2c9501c
y.create.l HWIO_PMIC_ARB_OBS5_CHNL19_RDATA1_ADDR A:0x2c9d01c
y.create.l HWIO_PMIC_ARB_OBS5_CHNL20_RDATA1_ADDR A:0x2ca501c
y.create.l HWIO_PMIC_ARB_OBS5_CHNL21_RDATA1_ADDR A:0x2cad01c
y.create.l HWIO_PMIC_ARB_OBS5_CHNL22_RDATA1_ADDR A:0x2cb501c
y.create.l HWIO_PMIC_ARB_OBS5_CHNL23_RDATA1_ADDR A:0x2cbd01c
y.create.l HWIO_PMIC_ARB_OBS5_CHNL24_RDATA1_ADDR A:0x2cc501c
y.create.l HWIO_PMIC_ARB_OBS5_CHNL25_RDATA1_ADDR A:0x2ccd01c
y.create.l HWIO_PMIC_ARB_OBS5_CHNL26_RDATA1_ADDR A:0x2cd501c
y.create.l HWIO_PMIC_ARB_OBS5_CHNL27_RDATA1_ADDR A:0x2cdd01c
y.create.l HWIO_PMIC_ARB_OBS5_CHNL28_RDATA1_ADDR A:0x2ce501c
y.create.l HWIO_PMIC_ARB_OBS5_CHNL29_RDATA1_ADDR A:0x2ced01c
y.create.l HWIO_PMIC_ARB_OBS5_CHNL30_RDATA1_ADDR A:0x2cf501c
y.create.l HWIO_PMIC_ARB_OBS5_CHNL31_RDATA1_ADDR A:0x2cfd01c
y.create.l HWIO_PMIC_ARB_OBS5_CHNL32_RDATA1_ADDR A:0x2d0501c
y.create.l HWIO_PMIC_ARB_OBS5_CHNL33_RDATA1_ADDR A:0x2d0d01c
y.create.l HWIO_PMIC_ARB_OBS5_CHNL34_RDATA1_ADDR A:0x2d1501c
y.create.l HWIO_PMIC_ARB_OBS5_CHNL35_RDATA1_ADDR A:0x2d1d01c
y.create.l HWIO_PMIC_ARB_OBS5_CHNL36_RDATA1_ADDR A:0x2d2501c
y.create.l HWIO_PMIC_ARB_OBS5_CHNL37_RDATA1_ADDR A:0x2d2d01c
y.create.l HWIO_PMIC_ARB_OBS5_CHNL38_RDATA1_ADDR A:0x2d3501c
y.create.l HWIO_PMIC_ARB_OBS5_CHNL39_RDATA1_ADDR A:0x2d3d01c
y.create.l HWIO_PMIC_ARB_OBS5_CHNL40_RDATA1_ADDR A:0x2d4501c
y.create.l HWIO_PMIC_ARB_OBS5_CHNL41_RDATA1_ADDR A:0x2d4d01c
y.create.l HWIO_PMIC_ARB_OBS5_CHNL42_RDATA1_ADDR A:0x2d5501c
y.create.l HWIO_PMIC_ARB_OBS5_CHNL43_RDATA1_ADDR A:0x2d5d01c
y.create.l HWIO_PMIC_ARB_OBS5_CHNL44_RDATA1_ADDR A:0x2d6501c
y.create.l HWIO_PMIC_ARB_OBS5_CHNL45_RDATA1_ADDR A:0x2d6d01c
y.create.l HWIO_PMIC_ARB_OBS5_CHNL46_RDATA1_ADDR A:0x2d7501c
y.create.l HWIO_PMIC_ARB_OBS5_CHNL47_RDATA1_ADDR A:0x2d7d01c
y.create.l HWIO_PMIC_ARB_OBS5_CHNL48_RDATA1_ADDR A:0x2d8501c
y.create.l HWIO_PMIC_ARB_OBS5_CHNL49_RDATA1_ADDR A:0x2d8d01c
y.create.l HWIO_PMIC_ARB_OBS5_CHNL50_RDATA1_ADDR A:0x2d9501c
y.create.l HWIO_PMIC_ARB_OBS5_CHNL51_RDATA1_ADDR A:0x2d9d01c
y.create.l HWIO_PMIC_ARB_OBS5_CHNL52_RDATA1_ADDR A:0x2da501c
y.create.l HWIO_PMIC_ARB_OBS5_CHNL53_RDATA1_ADDR A:0x2dad01c
y.create.l HWIO_PMIC_ARB_OBS5_CHNL54_RDATA1_ADDR A:0x2db501c
y.create.l HWIO_PMIC_ARB_OBS5_CHNL55_RDATA1_ADDR A:0x2dbd01c
y.create.l HWIO_PMIC_ARB_OBS5_CHNL56_RDATA1_ADDR A:0x2dc501c
y.create.l HWIO_PMIC_ARB_OBS5_CHNL57_RDATA1_ADDR A:0x2dcd01c
y.create.l HWIO_PMIC_ARB_OBS5_CHNL58_RDATA1_ADDR A:0x2dd501c
y.create.l HWIO_PMIC_ARB_OBS5_CHNL59_RDATA1_ADDR A:0x2ddd01c
y.create.l HWIO_PMIC_ARB_OBS5_CHNL60_RDATA1_ADDR A:0x2de501c
y.create.l HWIO_PMIC_ARB_OBS5_CHNL61_RDATA1_ADDR A:0x2ded01c
y.create.l HWIO_PMIC_ARB_OBS5_CHNL62_RDATA1_ADDR A:0x2df501c
y.create.l HWIO_PMIC_ARB_OBS5_CHNL63_RDATA1_ADDR A:0x2dfd01c
y.create.l HWIO_PMIC_ARB_OBS5_CHNL64_RDATA1_ADDR A:0x2e0501c
y.create.l HWIO_PMIC_ARB_OBS5_CHNL65_RDATA1_ADDR A:0x2e0d01c
y.create.l HWIO_PMIC_ARB_OBS5_CHNL66_RDATA1_ADDR A:0x2e1501c
y.create.l HWIO_PMIC_ARB_OBS5_CHNL67_RDATA1_ADDR A:0x2e1d01c
y.create.l HWIO_PMIC_ARB_OBS5_CHNL68_RDATA1_ADDR A:0x2e2501c
y.create.l HWIO_PMIC_ARB_OBS5_CHNL69_RDATA1_ADDR A:0x2e2d01c
y.create.l HWIO_PMIC_ARB_OBS5_CHNL70_RDATA1_ADDR A:0x2e3501c
y.create.l HWIO_PMIC_ARB_OBS5_CHNL71_RDATA1_ADDR A:0x2e3d01c
y.create.l HWIO_PMIC_ARB_OBS5_CHNL72_RDATA1_ADDR A:0x2e4501c
y.create.l HWIO_PMIC_ARB_OBS5_CHNL73_RDATA1_ADDR A:0x2e4d01c
y.create.l HWIO_PMIC_ARB_OBS5_CHNL74_RDATA1_ADDR A:0x2e5501c
y.create.l HWIO_PMIC_ARB_OBS5_CHNL75_RDATA1_ADDR A:0x2e5d01c
y.create.l HWIO_PMIC_ARB_OBS5_CHNL76_RDATA1_ADDR A:0x2e6501c
y.create.l HWIO_PMIC_ARB_OBS5_CHNL77_RDATA1_ADDR A:0x2e6d01c
y.create.l HWIO_PMIC_ARB_OBS5_CHNL78_RDATA1_ADDR A:0x2e7501c
y.create.l HWIO_PMIC_ARB_OBS5_CHNL79_RDATA1_ADDR A:0x2e7d01c
y.create.l HWIO_PMIC_ARB_OBS5_CHNL80_RDATA1_ADDR A:0x2e8501c
y.create.l HWIO_PMIC_ARB_OBS5_CHNL81_RDATA1_ADDR A:0x2e8d01c
y.create.l HWIO_PMIC_ARB_OBS5_CHNL82_RDATA1_ADDR A:0x2e9501c
y.create.l HWIO_PMIC_ARB_OBS5_CHNL83_RDATA1_ADDR A:0x2e9d01c
y.create.l HWIO_PMIC_ARB_OBS5_CHNL84_RDATA1_ADDR A:0x2ea501c
y.create.l HWIO_PMIC_ARB_OBS5_CHNL85_RDATA1_ADDR A:0x2ead01c
y.create.l HWIO_PMIC_ARB_OBS5_CHNL86_RDATA1_ADDR A:0x2eb501c
y.create.l HWIO_PMIC_ARB_OBS5_CHNL87_RDATA1_ADDR A:0x2ebd01c
y.create.l HWIO_PMIC_ARB_OBS5_CHNL88_RDATA1_ADDR A:0x2ec501c
y.create.l HWIO_PMIC_ARB_OBS5_CHNL89_RDATA1_ADDR A:0x2ecd01c
y.create.l HWIO_PMIC_ARB_OBS5_CHNL90_RDATA1_ADDR A:0x2ed501c
y.create.l HWIO_PMIC_ARB_OBS5_CHNL91_RDATA1_ADDR A:0x2edd01c
y.create.l HWIO_PMIC_ARB_OBS5_CHNL92_RDATA1_ADDR A:0x2ee501c
y.create.l HWIO_PMIC_ARB_OBS5_CHNL93_RDATA1_ADDR A:0x2eed01c
y.create.l HWIO_PMIC_ARB_OBS5_CHNL94_RDATA1_ADDR A:0x2ef501c
y.create.l HWIO_PMIC_ARB_OBS5_CHNL95_RDATA1_ADDR A:0x2efd01c
y.create.l HWIO_PMIC_ARB_OBS5_CHNL96_RDATA1_ADDR A:0x2f0501c
y.create.l HWIO_PMIC_ARB_OBS5_CHNL97_RDATA1_ADDR A:0x2f0d01c
y.create.l HWIO_PMIC_ARB_OBS5_CHNL98_RDATA1_ADDR A:0x2f1501c
y.create.l HWIO_PMIC_ARB_OBS5_CHNL99_RDATA1_ADDR A:0x2f1d01c
y.create.l HWIO_PMIC_ARB_OBS5_CHNL100_RDATA1_ADDR A:0x2f2501c
y.create.l HWIO_PMIC_ARB_OBS5_CHNL101_RDATA1_ADDR A:0x2f2d01c
y.create.l HWIO_PMIC_ARB_OBS5_CHNL102_RDATA1_ADDR A:0x2f3501c
y.create.l HWIO_PMIC_ARB_OBS5_CHNL103_RDATA1_ADDR A:0x2f3d01c
y.create.l HWIO_PMIC_ARB_OBS5_CHNL104_RDATA1_ADDR A:0x2f4501c
y.create.l HWIO_PMIC_ARB_OBS5_CHNL105_RDATA1_ADDR A:0x2f4d01c
y.create.l HWIO_PMIC_ARB_OBS5_CHNL106_RDATA1_ADDR A:0x2f5501c
y.create.l HWIO_PMIC_ARB_OBS5_CHNL107_RDATA1_ADDR A:0x2f5d01c
y.create.l HWIO_PMIC_ARB_OBS5_CHNL108_RDATA1_ADDR A:0x2f6501c
y.create.l HWIO_PMIC_ARB_OBS5_CHNL109_RDATA1_ADDR A:0x2f6d01c
y.create.l HWIO_PMIC_ARB_OBS5_CHNL110_RDATA1_ADDR A:0x2f7501c
y.create.l HWIO_PMIC_ARB_OBS5_CHNL111_RDATA1_ADDR A:0x2f7d01c
y.create.l HWIO_PMIC_ARB_OBS5_CHNL112_RDATA1_ADDR A:0x2f8501c
y.create.l HWIO_PMIC_ARB_OBS5_CHNL113_RDATA1_ADDR A:0x2f8d01c
y.create.l HWIO_PMIC_ARB_OBS5_CHNL114_RDATA1_ADDR A:0x2f9501c
y.create.l HWIO_PMIC_ARB_OBS5_CHNL115_RDATA1_ADDR A:0x2f9d01c
y.create.l HWIO_PMIC_ARB_OBS5_CHNL116_RDATA1_ADDR A:0x2fa501c
y.create.l HWIO_PMIC_ARB_OBS5_CHNL117_RDATA1_ADDR A:0x2fad01c
y.create.l HWIO_PMIC_ARB_OBS5_CHNL118_RDATA1_ADDR A:0x2fb501c
y.create.l HWIO_PMIC_ARB_OBS5_CHNL119_RDATA1_ADDR A:0x2fbd01c
y.create.l HWIO_PMIC_ARB_OBS5_CHNL120_RDATA1_ADDR A:0x2fc501c
y.create.l HWIO_PMIC_ARB_OBS5_CHNL121_RDATA1_ADDR A:0x2fcd01c
y.create.l HWIO_PMIC_ARB_OBS5_CHNL122_RDATA1_ADDR A:0x2fd501c
y.create.l HWIO_PMIC_ARB_OBS5_CHNL123_RDATA1_ADDR A:0x2fdd01c
y.create.l HWIO_PMIC_ARB_OBS5_CHNL124_RDATA1_ADDR A:0x2fe501c
y.create.l HWIO_PMIC_ARB_OBS5_CHNL125_RDATA1_ADDR A:0x2fed01c
y.create.l HWIO_PMIC_ARB_OBS5_CHNL126_RDATA1_ADDR A:0x2ff501c
y.create.l HWIO_PMIC_ARB_OBS5_CHNL127_RDATA1_ADDR A:0x2ffd01c
y.create.l HWIO_PMIC_ARB_OBS5_CHNL128_RDATA1_ADDR A:0x300501c
y.create.l HWIO_PMIC_ARB_OBS5_CHNL129_RDATA1_ADDR A:0x300d01c
y.create.l HWIO_PMIC_ARB_OBS5_CHNL130_RDATA1_ADDR A:0x301501c
y.create.l HWIO_PMIC_ARB_OBS5_CHNL131_RDATA1_ADDR A:0x301d01c
y.create.l HWIO_PMIC_ARB_OBS5_CHNL132_RDATA1_ADDR A:0x302501c
y.create.l HWIO_PMIC_ARB_OBS5_CHNL133_RDATA1_ADDR A:0x302d01c
y.create.l HWIO_PMIC_ARB_OBS5_CHNL134_RDATA1_ADDR A:0x303501c
y.create.l HWIO_PMIC_ARB_OBS5_CHNL135_RDATA1_ADDR A:0x303d01c
y.create.l HWIO_PMIC_ARB_OBS5_CHNL136_RDATA1_ADDR A:0x304501c
y.create.l HWIO_PMIC_ARB_OBS5_CHNL137_RDATA1_ADDR A:0x304d01c
y.create.l HWIO_PMIC_ARB_OBS5_CHNL138_RDATA1_ADDR A:0x305501c
y.create.l HWIO_PMIC_ARB_OBS5_CHNL139_RDATA1_ADDR A:0x305d01c
y.create.l HWIO_PMIC_ARB_OBS5_CHNL140_RDATA1_ADDR A:0x306501c
y.create.l HWIO_PMIC_ARB_OBS5_CHNL141_RDATA1_ADDR A:0x306d01c
y.create.l HWIO_PMIC_ARB_OBS5_CHNL142_RDATA1_ADDR A:0x307501c
y.create.l HWIO_PMIC_ARB_OBS5_CHNL143_RDATA1_ADDR A:0x307d01c
y.create.l HWIO_PMIC_ARB_OBS5_CHNL144_RDATA1_ADDR A:0x308501c
y.create.l HWIO_PMIC_ARB_OBS5_CHNL145_RDATA1_ADDR A:0x308d01c
y.create.l HWIO_PMIC_ARB_OBS5_CHNL146_RDATA1_ADDR A:0x309501c
y.create.l HWIO_PMIC_ARB_OBS5_CHNL147_RDATA1_ADDR A:0x309d01c
y.create.l HWIO_PMIC_ARB_OBS5_CHNL148_RDATA1_ADDR A:0x30a501c
y.create.l HWIO_PMIC_ARB_OBS5_CHNL149_RDATA1_ADDR A:0x30ad01c
y.create.l HWIO_PMIC_ARB_OBS5_CHNL150_RDATA1_ADDR A:0x30b501c
y.create.l HWIO_PMIC_ARB_OBS5_CHNL151_RDATA1_ADDR A:0x30bd01c
y.create.l HWIO_PMIC_ARB_OBS5_CHNL152_RDATA1_ADDR A:0x30c501c
y.create.l HWIO_PMIC_ARB_OBS5_CHNL153_RDATA1_ADDR A:0x30cd01c
y.create.l HWIO_PMIC_ARB_OBS5_CHNL154_RDATA1_ADDR A:0x30d501c
y.create.l HWIO_PMIC_ARB_OBS5_CHNL155_RDATA1_ADDR A:0x30dd01c
y.create.l HWIO_PMIC_ARB_OBS5_CHNL156_RDATA1_ADDR A:0x30e501c
y.create.l HWIO_PMIC_ARB_OBS5_CHNL157_RDATA1_ADDR A:0x30ed01c
y.create.l HWIO_PMIC_ARB_OBS5_CHNL158_RDATA1_ADDR A:0x30f501c
y.create.l HWIO_PMIC_ARB_OBS5_CHNL159_RDATA1_ADDR A:0x30fd01c
y.create.l HWIO_PMIC_ARB_OBS5_CHNL160_RDATA1_ADDR A:0x310501c
y.create.l HWIO_PMIC_ARB_OBS5_CHNL161_RDATA1_ADDR A:0x310d01c
y.create.l HWIO_PMIC_ARB_OBS5_CHNL162_RDATA1_ADDR A:0x311501c
y.create.l HWIO_PMIC_ARB_OBS5_CHNL163_RDATA1_ADDR A:0x311d01c
y.create.l HWIO_PMIC_ARB_OBS5_CHNL164_RDATA1_ADDR A:0x312501c
y.create.l HWIO_PMIC_ARB_OBS5_CHNL165_RDATA1_ADDR A:0x312d01c
y.create.l HWIO_PMIC_ARB_OBS5_CHNL166_RDATA1_ADDR A:0x313501c
y.create.l HWIO_PMIC_ARB_OBS5_CHNL167_RDATA1_ADDR A:0x313d01c
y.create.l HWIO_PMIC_ARB_OBS5_CHNL168_RDATA1_ADDR A:0x314501c
y.create.l HWIO_PMIC_ARB_OBS5_CHNL169_RDATA1_ADDR A:0x314d01c
y.create.l HWIO_PMIC_ARB_OBS5_CHNL170_RDATA1_ADDR A:0x315501c
y.create.l HWIO_PMIC_ARB_OBS5_CHNL171_RDATA1_ADDR A:0x315d01c
y.create.l HWIO_PMIC_ARB_OBS5_CHNL172_RDATA1_ADDR A:0x316501c
y.create.l HWIO_PMIC_ARB_OBS5_CHNL173_RDATA1_ADDR A:0x316d01c
y.create.l HWIO_PMIC_ARB_OBS5_CHNL174_RDATA1_ADDR A:0x317501c
y.create.l HWIO_PMIC_ARB_OBS5_CHNL175_RDATA1_ADDR A:0x317d01c
y.create.l HWIO_PMIC_ARB_OBS5_CHNL176_RDATA1_ADDR A:0x318501c
y.create.l HWIO_PMIC_ARB_OBS5_CHNL177_RDATA1_ADDR A:0x318d01c
y.create.l HWIO_PMIC_ARB_OBS5_CHNL178_RDATA1_ADDR A:0x319501c
y.create.l HWIO_PMIC_ARB_OBS5_CHNL179_RDATA1_ADDR A:0x319d01c
y.create.l HWIO_PMIC_ARB_OBS5_CHNL180_RDATA1_ADDR A:0x31a501c
y.create.l HWIO_PMIC_ARB_OBS5_CHNL181_RDATA1_ADDR A:0x31ad01c
y.create.l HWIO_PMIC_ARB_OBS5_CHNL182_RDATA1_ADDR A:0x31b501c
y.create.l HWIO_PMIC_ARB_OBS5_CHNL183_RDATA1_ADDR A:0x31bd01c
y.create.l HWIO_PMIC_ARB_OBS5_CHNL184_RDATA1_ADDR A:0x31c501c
y.create.l HWIO_PMIC_ARB_OBS5_CHNL185_RDATA1_ADDR A:0x31cd01c
y.create.l HWIO_PMIC_ARB_OBS5_CHNL186_RDATA1_ADDR A:0x31d501c
y.create.l HWIO_PMIC_ARB_OBS5_CHNL187_RDATA1_ADDR A:0x31dd01c
y.create.l HWIO_PMIC_ARB_OBS5_CHNL188_RDATA1_ADDR A:0x31e501c
y.create.l HWIO_PMIC_ARB_OBS5_CHNL189_RDATA1_ADDR A:0x31ed01c
y.create.l HWIO_PMIC_ARB_OBS5_CHNL190_RDATA1_ADDR A:0x31f501c
y.create.l HWIO_PMIC_ARB_OBS5_CHNL191_RDATA1_ADDR A:0x31fd01c
y.create.l HWIO_PMIC_ARB_OBS5_CHNL192_RDATA1_ADDR A:0x320501c
y.create.l HWIO_PMIC_ARB_OBS5_CHNL193_RDATA1_ADDR A:0x320d01c
y.create.l HWIO_PMIC_ARB_OBS5_CHNL194_RDATA1_ADDR A:0x321501c
y.create.l HWIO_PMIC_ARB_OBS5_CHNL195_RDATA1_ADDR A:0x321d01c
y.create.l HWIO_PMIC_ARB_OBS5_CHNL196_RDATA1_ADDR A:0x322501c
y.create.l HWIO_PMIC_ARB_OBS5_CHNL197_RDATA1_ADDR A:0x322d01c
y.create.l HWIO_PMIC_ARB_OBS5_CHNL198_RDATA1_ADDR A:0x323501c
y.create.l HWIO_PMIC_ARB_OBS5_CHNL199_RDATA1_ADDR A:0x323d01c
y.create.l HWIO_PMIC_ARB_OBS5_CHNL200_RDATA1_ADDR A:0x324501c
y.create.l HWIO_PMIC_ARB_OBS5_CHNL201_RDATA1_ADDR A:0x324d01c
y.create.l HWIO_PMIC_ARB_OBS5_CHNL202_RDATA1_ADDR A:0x325501c
y.create.l HWIO_PMIC_ARB_OBS5_CHNL203_RDATA1_ADDR A:0x325d01c
y.create.l HWIO_PMIC_ARB_OBS5_CHNL204_RDATA1_ADDR A:0x326501c
y.create.l HWIO_PMIC_ARB_OBS5_CHNL205_RDATA1_ADDR A:0x326d01c
y.create.l HWIO_PMIC_ARB_OBS5_CHNL206_RDATA1_ADDR A:0x327501c
y.create.l HWIO_PMIC_ARB_OBS5_CHNL207_RDATA1_ADDR A:0x327d01c
y.create.l HWIO_PMIC_ARB_OBS5_CHNL208_RDATA1_ADDR A:0x328501c
y.create.l HWIO_PMIC_ARB_OBS5_CHNL209_RDATA1_ADDR A:0x328d01c
y.create.l HWIO_PMIC_ARB_OBS5_CHNL210_RDATA1_ADDR A:0x329501c
y.create.l HWIO_PMIC_ARB_OBS5_CHNL211_RDATA1_ADDR A:0x329d01c
y.create.l HWIO_PMIC_ARB_OBS5_CHNL212_RDATA1_ADDR A:0x32a501c
y.create.l HWIO_PMIC_ARB_OBS5_CHNL213_RDATA1_ADDR A:0x32ad01c
y.create.l HWIO_PMIC_ARB_OBS5_CHNL214_RDATA1_ADDR A:0x32b501c
y.create.l HWIO_PMIC_ARB_OBS5_CHNL215_RDATA1_ADDR A:0x32bd01c
y.create.l HWIO_PMIC_ARB_OBS5_CHNL216_RDATA1_ADDR A:0x32c501c
y.create.l HWIO_PMIC_ARB_OBS5_CHNL217_RDATA1_ADDR A:0x32cd01c
y.create.l HWIO_PMIC_ARB_OBS5_CHNL218_RDATA1_ADDR A:0x32d501c
y.create.l HWIO_PMIC_ARB_OBS5_CHNL219_RDATA1_ADDR A:0x32dd01c
y.create.l HWIO_PMIC_ARB_OBS5_CHNL220_RDATA1_ADDR A:0x32e501c
y.create.l HWIO_PMIC_ARB_OBS5_CHNL221_RDATA1_ADDR A:0x32ed01c
y.create.l HWIO_PMIC_ARB_OBS5_CHNL222_RDATA1_ADDR A:0x32f501c
y.create.l HWIO_PMIC_ARB_OBS5_CHNL223_RDATA1_ADDR A:0x32fd01c
y.create.l HWIO_PMIC_ARB_OBS5_CHNL224_RDATA1_ADDR A:0x330501c
y.create.l HWIO_PMIC_ARB_OBS5_CHNL225_RDATA1_ADDR A:0x330d01c
y.create.l HWIO_PMIC_ARB_OBS5_CHNL226_RDATA1_ADDR A:0x331501c
y.create.l HWIO_PMIC_ARB_OBS5_CHNL227_RDATA1_ADDR A:0x331d01c
y.create.l HWIO_PMIC_ARB_OBS5_CHNL228_RDATA1_ADDR A:0x332501c
y.create.l HWIO_PMIC_ARB_OBS5_CHNL229_RDATA1_ADDR A:0x332d01c
y.create.l HWIO_PMIC_ARB_OBS5_CHNL230_RDATA1_ADDR A:0x333501c
y.create.l HWIO_PMIC_ARB_OBS5_CHNL231_RDATA1_ADDR A:0x333d01c
y.create.l HWIO_PMIC_ARB_OBS5_CHNL232_RDATA1_ADDR A:0x334501c
y.create.l HWIO_PMIC_ARB_OBS5_CHNL233_RDATA1_ADDR A:0x334d01c
y.create.l HWIO_PMIC_ARB_OBS5_CHNL234_RDATA1_ADDR A:0x335501c
y.create.l HWIO_PMIC_ARB_OBS5_CHNL235_RDATA1_ADDR A:0x335d01c
y.create.l HWIO_PMIC_ARB_OBS5_CHNL236_RDATA1_ADDR A:0x336501c
y.create.l HWIO_PMIC_ARB_OBS5_CHNL237_RDATA1_ADDR A:0x336d01c
y.create.l HWIO_PMIC_ARB_OBS5_CHNL238_RDATA1_ADDR A:0x337501c
y.create.l HWIO_PMIC_ARB_OBS5_CHNL239_RDATA1_ADDR A:0x337d01c
y.create.l HWIO_PMIC_ARB_OBS5_CHNL240_RDATA1_ADDR A:0x338501c
y.create.l HWIO_PMIC_ARB_OBS5_CHNL241_RDATA1_ADDR A:0x338d01c
y.create.l HWIO_PMIC_ARB_OBS5_CHNL242_RDATA1_ADDR A:0x339501c
y.create.l HWIO_PMIC_ARB_OBS5_CHNL243_RDATA1_ADDR A:0x339d01c
y.create.l HWIO_PMIC_ARB_OBS5_CHNL244_RDATA1_ADDR A:0x33a501c
y.create.l HWIO_PMIC_ARB_OBS5_CHNL245_RDATA1_ADDR A:0x33ad01c
y.create.l HWIO_PMIC_ARB_OBS5_CHNL246_RDATA1_ADDR A:0x33b501c
y.create.l HWIO_PMIC_ARB_OBS5_CHNL247_RDATA1_ADDR A:0x33bd01c
y.create.l HWIO_PMIC_ARB_OBS5_CHNL248_RDATA1_ADDR A:0x33c501c
y.create.l HWIO_PMIC_ARB_OBS5_CHNL249_RDATA1_ADDR A:0x33cd01c
y.create.l HWIO_PMIC_ARB_OBS5_CHNL250_RDATA1_ADDR A:0x33d501c
y.create.l HWIO_PMIC_ARB_OBS5_CHNL251_RDATA1_ADDR A:0x33dd01c
y.create.l HWIO_PMIC_ARB_OBS5_CHNL252_RDATA1_ADDR A:0x33e501c
y.create.l HWIO_PMIC_ARB_OBS5_CHNL253_RDATA1_ADDR A:0x33ed01c
y.create.l HWIO_PMIC_ARB_OBS5_CHNL254_RDATA1_ADDR A:0x33f501c
y.create.l HWIO_PMIC_ARB_OBS5_CHNL255_RDATA1_ADDR A:0x33fd01c
y.create.l HWIO_PMIC_ARB_OBS6_CHNL0_RDATA1_ADDR A:0x2c0601c
y.create.l HWIO_PMIC_ARB_OBS6_CHNL1_RDATA1_ADDR A:0x2c0e01c
y.create.l HWIO_PMIC_ARB_OBS6_CHNL2_RDATA1_ADDR A:0x2c1601c
y.create.l HWIO_PMIC_ARB_OBS6_CHNL3_RDATA1_ADDR A:0x2c1e01c
y.create.l HWIO_PMIC_ARB_OBS6_CHNL4_RDATA1_ADDR A:0x2c2601c
y.create.l HWIO_PMIC_ARB_OBS6_CHNL5_RDATA1_ADDR A:0x2c2e01c
y.create.l HWIO_PMIC_ARB_OBS6_CHNL6_RDATA1_ADDR A:0x2c3601c
y.create.l HWIO_PMIC_ARB_OBS6_CHNL7_RDATA1_ADDR A:0x2c3e01c
y.create.l HWIO_PMIC_ARB_OBS6_CHNL8_RDATA1_ADDR A:0x2c4601c
y.create.l HWIO_PMIC_ARB_OBS6_CHNL9_RDATA1_ADDR A:0x2c4e01c
y.create.l HWIO_PMIC_ARB_OBS6_CHNL10_RDATA1_ADDR A:0x2c5601c
y.create.l HWIO_PMIC_ARB_OBS6_CHNL11_RDATA1_ADDR A:0x2c5e01c
y.create.l HWIO_PMIC_ARB_OBS6_CHNL12_RDATA1_ADDR A:0x2c6601c
y.create.l HWIO_PMIC_ARB_OBS6_CHNL13_RDATA1_ADDR A:0x2c6e01c
y.create.l HWIO_PMIC_ARB_OBS6_CHNL14_RDATA1_ADDR A:0x2c7601c
y.create.l HWIO_PMIC_ARB_OBS6_CHNL15_RDATA1_ADDR A:0x2c7e01c
y.create.l HWIO_PMIC_ARB_OBS6_CHNL16_RDATA1_ADDR A:0x2c8601c
y.create.l HWIO_PMIC_ARB_OBS6_CHNL17_RDATA1_ADDR A:0x2c8e01c
y.create.l HWIO_PMIC_ARB_OBS6_CHNL18_RDATA1_ADDR A:0x2c9601c
y.create.l HWIO_PMIC_ARB_OBS6_CHNL19_RDATA1_ADDR A:0x2c9e01c
y.create.l HWIO_PMIC_ARB_OBS6_CHNL20_RDATA1_ADDR A:0x2ca601c
y.create.l HWIO_PMIC_ARB_OBS6_CHNL21_RDATA1_ADDR A:0x2cae01c
y.create.l HWIO_PMIC_ARB_OBS6_CHNL22_RDATA1_ADDR A:0x2cb601c
y.create.l HWIO_PMIC_ARB_OBS6_CHNL23_RDATA1_ADDR A:0x2cbe01c
y.create.l HWIO_PMIC_ARB_OBS6_CHNL24_RDATA1_ADDR A:0x2cc601c
y.create.l HWIO_PMIC_ARB_OBS6_CHNL25_RDATA1_ADDR A:0x2cce01c
y.create.l HWIO_PMIC_ARB_OBS6_CHNL26_RDATA1_ADDR A:0x2cd601c
y.create.l HWIO_PMIC_ARB_OBS6_CHNL27_RDATA1_ADDR A:0x2cde01c
y.create.l HWIO_PMIC_ARB_OBS6_CHNL28_RDATA1_ADDR A:0x2ce601c
y.create.l HWIO_PMIC_ARB_OBS6_CHNL29_RDATA1_ADDR A:0x2cee01c
y.create.l HWIO_PMIC_ARB_OBS6_CHNL30_RDATA1_ADDR A:0x2cf601c
y.create.l HWIO_PMIC_ARB_OBS6_CHNL31_RDATA1_ADDR A:0x2cfe01c
y.create.l HWIO_PMIC_ARB_OBS6_CHNL32_RDATA1_ADDR A:0x2d0601c
y.create.l HWIO_PMIC_ARB_OBS6_CHNL33_RDATA1_ADDR A:0x2d0e01c
y.create.l HWIO_PMIC_ARB_OBS6_CHNL34_RDATA1_ADDR A:0x2d1601c
y.create.l HWIO_PMIC_ARB_OBS6_CHNL35_RDATA1_ADDR A:0x2d1e01c
y.create.l HWIO_PMIC_ARB_OBS6_CHNL36_RDATA1_ADDR A:0x2d2601c
y.create.l HWIO_PMIC_ARB_OBS6_CHNL37_RDATA1_ADDR A:0x2d2e01c
y.create.l HWIO_PMIC_ARB_OBS6_CHNL38_RDATA1_ADDR A:0x2d3601c
y.create.l HWIO_PMIC_ARB_OBS6_CHNL39_RDATA1_ADDR A:0x2d3e01c
y.create.l HWIO_PMIC_ARB_OBS6_CHNL40_RDATA1_ADDR A:0x2d4601c
y.create.l HWIO_PMIC_ARB_OBS6_CHNL41_RDATA1_ADDR A:0x2d4e01c
y.create.l HWIO_PMIC_ARB_OBS6_CHNL42_RDATA1_ADDR A:0x2d5601c
y.create.l HWIO_PMIC_ARB_OBS6_CHNL43_RDATA1_ADDR A:0x2d5e01c
y.create.l HWIO_PMIC_ARB_OBS6_CHNL44_RDATA1_ADDR A:0x2d6601c
y.create.l HWIO_PMIC_ARB_OBS6_CHNL45_RDATA1_ADDR A:0x2d6e01c
y.create.l HWIO_PMIC_ARB_OBS6_CHNL46_RDATA1_ADDR A:0x2d7601c
y.create.l HWIO_PMIC_ARB_OBS6_CHNL47_RDATA1_ADDR A:0x2d7e01c
y.create.l HWIO_PMIC_ARB_OBS6_CHNL48_RDATA1_ADDR A:0x2d8601c
y.create.l HWIO_PMIC_ARB_OBS6_CHNL49_RDATA1_ADDR A:0x2d8e01c
y.create.l HWIO_PMIC_ARB_OBS6_CHNL50_RDATA1_ADDR A:0x2d9601c
y.create.l HWIO_PMIC_ARB_OBS6_CHNL51_RDATA1_ADDR A:0x2d9e01c
y.create.l HWIO_PMIC_ARB_OBS6_CHNL52_RDATA1_ADDR A:0x2da601c
y.create.l HWIO_PMIC_ARB_OBS6_CHNL53_RDATA1_ADDR A:0x2dae01c
y.create.l HWIO_PMIC_ARB_OBS6_CHNL54_RDATA1_ADDR A:0x2db601c
y.create.l HWIO_PMIC_ARB_OBS6_CHNL55_RDATA1_ADDR A:0x2dbe01c
y.create.l HWIO_PMIC_ARB_OBS6_CHNL56_RDATA1_ADDR A:0x2dc601c
y.create.l HWIO_PMIC_ARB_OBS6_CHNL57_RDATA1_ADDR A:0x2dce01c
y.create.l HWIO_PMIC_ARB_OBS6_CHNL58_RDATA1_ADDR A:0x2dd601c
y.create.l HWIO_PMIC_ARB_OBS6_CHNL59_RDATA1_ADDR A:0x2dde01c
y.create.l HWIO_PMIC_ARB_OBS6_CHNL60_RDATA1_ADDR A:0x2de601c
y.create.l HWIO_PMIC_ARB_OBS6_CHNL61_RDATA1_ADDR A:0x2dee01c
y.create.l HWIO_PMIC_ARB_OBS6_CHNL62_RDATA1_ADDR A:0x2df601c
y.create.l HWIO_PMIC_ARB_OBS6_CHNL63_RDATA1_ADDR A:0x2dfe01c
y.create.l HWIO_PMIC_ARB_OBS6_CHNL64_RDATA1_ADDR A:0x2e0601c
y.create.l HWIO_PMIC_ARB_OBS6_CHNL65_RDATA1_ADDR A:0x2e0e01c
y.create.l HWIO_PMIC_ARB_OBS6_CHNL66_RDATA1_ADDR A:0x2e1601c
y.create.l HWIO_PMIC_ARB_OBS6_CHNL67_RDATA1_ADDR A:0x2e1e01c
y.create.l HWIO_PMIC_ARB_OBS6_CHNL68_RDATA1_ADDR A:0x2e2601c
y.create.l HWIO_PMIC_ARB_OBS6_CHNL69_RDATA1_ADDR A:0x2e2e01c
y.create.l HWIO_PMIC_ARB_OBS6_CHNL70_RDATA1_ADDR A:0x2e3601c
y.create.l HWIO_PMIC_ARB_OBS6_CHNL71_RDATA1_ADDR A:0x2e3e01c
y.create.l HWIO_PMIC_ARB_OBS6_CHNL72_RDATA1_ADDR A:0x2e4601c
y.create.l HWIO_PMIC_ARB_OBS6_CHNL73_RDATA1_ADDR A:0x2e4e01c
y.create.l HWIO_PMIC_ARB_OBS6_CHNL74_RDATA1_ADDR A:0x2e5601c
y.create.l HWIO_PMIC_ARB_OBS6_CHNL75_RDATA1_ADDR A:0x2e5e01c
y.create.l HWIO_PMIC_ARB_OBS6_CHNL76_RDATA1_ADDR A:0x2e6601c
y.create.l HWIO_PMIC_ARB_OBS6_CHNL77_RDATA1_ADDR A:0x2e6e01c
y.create.l HWIO_PMIC_ARB_OBS6_CHNL78_RDATA1_ADDR A:0x2e7601c
y.create.l HWIO_PMIC_ARB_OBS6_CHNL79_RDATA1_ADDR A:0x2e7e01c
y.create.l HWIO_PMIC_ARB_OBS6_CHNL80_RDATA1_ADDR A:0x2e8601c
y.create.l HWIO_PMIC_ARB_OBS6_CHNL81_RDATA1_ADDR A:0x2e8e01c
y.create.l HWIO_PMIC_ARB_OBS6_CHNL82_RDATA1_ADDR A:0x2e9601c
y.create.l HWIO_PMIC_ARB_OBS6_CHNL83_RDATA1_ADDR A:0x2e9e01c
y.create.l HWIO_PMIC_ARB_OBS6_CHNL84_RDATA1_ADDR A:0x2ea601c
y.create.l HWIO_PMIC_ARB_OBS6_CHNL85_RDATA1_ADDR A:0x2eae01c
y.create.l HWIO_PMIC_ARB_OBS6_CHNL86_RDATA1_ADDR A:0x2eb601c
y.create.l HWIO_PMIC_ARB_OBS6_CHNL87_RDATA1_ADDR A:0x2ebe01c
y.create.l HWIO_PMIC_ARB_OBS6_CHNL88_RDATA1_ADDR A:0x2ec601c
y.create.l HWIO_PMIC_ARB_OBS6_CHNL89_RDATA1_ADDR A:0x2ece01c
y.create.l HWIO_PMIC_ARB_OBS6_CHNL90_RDATA1_ADDR A:0x2ed601c
y.create.l HWIO_PMIC_ARB_OBS6_CHNL91_RDATA1_ADDR A:0x2ede01c
y.create.l HWIO_PMIC_ARB_OBS6_CHNL92_RDATA1_ADDR A:0x2ee601c
y.create.l HWIO_PMIC_ARB_OBS6_CHNL93_RDATA1_ADDR A:0x2eee01c
y.create.l HWIO_PMIC_ARB_OBS6_CHNL94_RDATA1_ADDR A:0x2ef601c
y.create.l HWIO_PMIC_ARB_OBS6_CHNL95_RDATA1_ADDR A:0x2efe01c
y.create.l HWIO_PMIC_ARB_OBS6_CHNL96_RDATA1_ADDR A:0x2f0601c
y.create.l HWIO_PMIC_ARB_OBS6_CHNL97_RDATA1_ADDR A:0x2f0e01c
y.create.l HWIO_PMIC_ARB_OBS6_CHNL98_RDATA1_ADDR A:0x2f1601c
y.create.l HWIO_PMIC_ARB_OBS6_CHNL99_RDATA1_ADDR A:0x2f1e01c
y.create.l HWIO_PMIC_ARB_OBS6_CHNL100_RDATA1_ADDR A:0x2f2601c
y.create.l HWIO_PMIC_ARB_OBS6_CHNL101_RDATA1_ADDR A:0x2f2e01c
y.create.l HWIO_PMIC_ARB_OBS6_CHNL102_RDATA1_ADDR A:0x2f3601c
y.create.l HWIO_PMIC_ARB_OBS6_CHNL103_RDATA1_ADDR A:0x2f3e01c
y.create.l HWIO_PMIC_ARB_OBS6_CHNL104_RDATA1_ADDR A:0x2f4601c
y.create.l HWIO_PMIC_ARB_OBS6_CHNL105_RDATA1_ADDR A:0x2f4e01c
y.create.l HWIO_PMIC_ARB_OBS6_CHNL106_RDATA1_ADDR A:0x2f5601c
y.create.l HWIO_PMIC_ARB_OBS6_CHNL107_RDATA1_ADDR A:0x2f5e01c
y.create.l HWIO_PMIC_ARB_OBS6_CHNL108_RDATA1_ADDR A:0x2f6601c
y.create.l HWIO_PMIC_ARB_OBS6_CHNL109_RDATA1_ADDR A:0x2f6e01c
y.create.l HWIO_PMIC_ARB_OBS6_CHNL110_RDATA1_ADDR A:0x2f7601c
y.create.l HWIO_PMIC_ARB_OBS6_CHNL111_RDATA1_ADDR A:0x2f7e01c
y.create.l HWIO_PMIC_ARB_OBS6_CHNL112_RDATA1_ADDR A:0x2f8601c
y.create.l HWIO_PMIC_ARB_OBS6_CHNL113_RDATA1_ADDR A:0x2f8e01c
y.create.l HWIO_PMIC_ARB_OBS6_CHNL114_RDATA1_ADDR A:0x2f9601c
y.create.l HWIO_PMIC_ARB_OBS6_CHNL115_RDATA1_ADDR A:0x2f9e01c
y.create.l HWIO_PMIC_ARB_OBS6_CHNL116_RDATA1_ADDR A:0x2fa601c
y.create.l HWIO_PMIC_ARB_OBS6_CHNL117_RDATA1_ADDR A:0x2fae01c
y.create.l HWIO_PMIC_ARB_OBS6_CHNL118_RDATA1_ADDR A:0x2fb601c
y.create.l HWIO_PMIC_ARB_OBS6_CHNL119_RDATA1_ADDR A:0x2fbe01c
y.create.l HWIO_PMIC_ARB_OBS6_CHNL120_RDATA1_ADDR A:0x2fc601c
y.create.l HWIO_PMIC_ARB_OBS6_CHNL121_RDATA1_ADDR A:0x2fce01c
y.create.l HWIO_PMIC_ARB_OBS6_CHNL122_RDATA1_ADDR A:0x2fd601c
y.create.l HWIO_PMIC_ARB_OBS6_CHNL123_RDATA1_ADDR A:0x2fde01c
y.create.l HWIO_PMIC_ARB_OBS6_CHNL124_RDATA1_ADDR A:0x2fe601c
y.create.l HWIO_PMIC_ARB_OBS6_CHNL125_RDATA1_ADDR A:0x2fee01c
y.create.l HWIO_PMIC_ARB_OBS6_CHNL126_RDATA1_ADDR A:0x2ff601c
y.create.l HWIO_PMIC_ARB_OBS6_CHNL127_RDATA1_ADDR A:0x2ffe01c
y.create.l HWIO_PMIC_ARB_OBS6_CHNL128_RDATA1_ADDR A:0x300601c
y.create.l HWIO_PMIC_ARB_OBS6_CHNL129_RDATA1_ADDR A:0x300e01c
y.create.l HWIO_PMIC_ARB_OBS6_CHNL130_RDATA1_ADDR A:0x301601c
y.create.l HWIO_PMIC_ARB_OBS6_CHNL131_RDATA1_ADDR A:0x301e01c
y.create.l HWIO_PMIC_ARB_OBS6_CHNL132_RDATA1_ADDR A:0x302601c
y.create.l HWIO_PMIC_ARB_OBS6_CHNL133_RDATA1_ADDR A:0x302e01c
y.create.l HWIO_PMIC_ARB_OBS6_CHNL134_RDATA1_ADDR A:0x303601c
y.create.l HWIO_PMIC_ARB_OBS6_CHNL135_RDATA1_ADDR A:0x303e01c
y.create.l HWIO_PMIC_ARB_OBS6_CHNL136_RDATA1_ADDR A:0x304601c
y.create.l HWIO_PMIC_ARB_OBS6_CHNL137_RDATA1_ADDR A:0x304e01c
y.create.l HWIO_PMIC_ARB_OBS6_CHNL138_RDATA1_ADDR A:0x305601c
y.create.l HWIO_PMIC_ARB_OBS6_CHNL139_RDATA1_ADDR A:0x305e01c
y.create.l HWIO_PMIC_ARB_OBS6_CHNL140_RDATA1_ADDR A:0x306601c
y.create.l HWIO_PMIC_ARB_OBS6_CHNL141_RDATA1_ADDR A:0x306e01c
y.create.l HWIO_PMIC_ARB_OBS6_CHNL142_RDATA1_ADDR A:0x307601c
y.create.l HWIO_PMIC_ARB_OBS6_CHNL143_RDATA1_ADDR A:0x307e01c
y.create.l HWIO_PMIC_ARB_OBS6_CHNL144_RDATA1_ADDR A:0x308601c
y.create.l HWIO_PMIC_ARB_OBS6_CHNL145_RDATA1_ADDR A:0x308e01c
y.create.l HWIO_PMIC_ARB_OBS6_CHNL146_RDATA1_ADDR A:0x309601c
y.create.l HWIO_PMIC_ARB_OBS6_CHNL147_RDATA1_ADDR A:0x309e01c
y.create.l HWIO_PMIC_ARB_OBS6_CHNL148_RDATA1_ADDR A:0x30a601c
y.create.l HWIO_PMIC_ARB_OBS6_CHNL149_RDATA1_ADDR A:0x30ae01c
y.create.l HWIO_PMIC_ARB_OBS6_CHNL150_RDATA1_ADDR A:0x30b601c
y.create.l HWIO_PMIC_ARB_OBS6_CHNL151_RDATA1_ADDR A:0x30be01c
y.create.l HWIO_PMIC_ARB_OBS6_CHNL152_RDATA1_ADDR A:0x30c601c
y.create.l HWIO_PMIC_ARB_OBS6_CHNL153_RDATA1_ADDR A:0x30ce01c
y.create.l HWIO_PMIC_ARB_OBS6_CHNL154_RDATA1_ADDR A:0x30d601c
y.create.l HWIO_PMIC_ARB_OBS6_CHNL155_RDATA1_ADDR A:0x30de01c
y.create.l HWIO_PMIC_ARB_OBS6_CHNL156_RDATA1_ADDR A:0x30e601c
y.create.l HWIO_PMIC_ARB_OBS6_CHNL157_RDATA1_ADDR A:0x30ee01c
y.create.l HWIO_PMIC_ARB_OBS6_CHNL158_RDATA1_ADDR A:0x30f601c
y.create.l HWIO_PMIC_ARB_OBS6_CHNL159_RDATA1_ADDR A:0x30fe01c
y.create.l HWIO_PMIC_ARB_OBS6_CHNL160_RDATA1_ADDR A:0x310601c
y.create.l HWIO_PMIC_ARB_OBS6_CHNL161_RDATA1_ADDR A:0x310e01c
y.create.l HWIO_PMIC_ARB_OBS6_CHNL162_RDATA1_ADDR A:0x311601c
y.create.l HWIO_PMIC_ARB_OBS6_CHNL163_RDATA1_ADDR A:0x311e01c
y.create.l HWIO_PMIC_ARB_OBS6_CHNL164_RDATA1_ADDR A:0x312601c
y.create.l HWIO_PMIC_ARB_OBS6_CHNL165_RDATA1_ADDR A:0x312e01c
y.create.l HWIO_PMIC_ARB_OBS6_CHNL166_RDATA1_ADDR A:0x313601c
y.create.l HWIO_PMIC_ARB_OBS6_CHNL167_RDATA1_ADDR A:0x313e01c
y.create.l HWIO_PMIC_ARB_OBS6_CHNL168_RDATA1_ADDR A:0x314601c
y.create.l HWIO_PMIC_ARB_OBS6_CHNL169_RDATA1_ADDR A:0x314e01c
y.create.l HWIO_PMIC_ARB_OBS6_CHNL170_RDATA1_ADDR A:0x315601c
y.create.l HWIO_PMIC_ARB_OBS6_CHNL171_RDATA1_ADDR A:0x315e01c
y.create.l HWIO_PMIC_ARB_OBS6_CHNL172_RDATA1_ADDR A:0x316601c
y.create.l HWIO_PMIC_ARB_OBS6_CHNL173_RDATA1_ADDR A:0x316e01c
y.create.l HWIO_PMIC_ARB_OBS6_CHNL174_RDATA1_ADDR A:0x317601c
y.create.l HWIO_PMIC_ARB_OBS6_CHNL175_RDATA1_ADDR A:0x317e01c
y.create.l HWIO_PMIC_ARB_OBS6_CHNL176_RDATA1_ADDR A:0x318601c
y.create.l HWIO_PMIC_ARB_OBS6_CHNL177_RDATA1_ADDR A:0x318e01c
y.create.l HWIO_PMIC_ARB_OBS6_CHNL178_RDATA1_ADDR A:0x319601c
y.create.l HWIO_PMIC_ARB_OBS6_CHNL179_RDATA1_ADDR A:0x319e01c
y.create.l HWIO_PMIC_ARB_OBS6_CHNL180_RDATA1_ADDR A:0x31a601c
y.create.l HWIO_PMIC_ARB_OBS6_CHNL181_RDATA1_ADDR A:0x31ae01c
y.create.l HWIO_PMIC_ARB_OBS6_CHNL182_RDATA1_ADDR A:0x31b601c
y.create.l HWIO_PMIC_ARB_OBS6_CHNL183_RDATA1_ADDR A:0x31be01c
y.create.l HWIO_PMIC_ARB_OBS6_CHNL184_RDATA1_ADDR A:0x31c601c
y.create.l HWIO_PMIC_ARB_OBS6_CHNL185_RDATA1_ADDR A:0x31ce01c
y.create.l HWIO_PMIC_ARB_OBS6_CHNL186_RDATA1_ADDR A:0x31d601c
y.create.l HWIO_PMIC_ARB_OBS6_CHNL187_RDATA1_ADDR A:0x31de01c
y.create.l HWIO_PMIC_ARB_OBS6_CHNL188_RDATA1_ADDR A:0x31e601c
y.create.l HWIO_PMIC_ARB_OBS6_CHNL189_RDATA1_ADDR A:0x31ee01c
y.create.l HWIO_PMIC_ARB_OBS6_CHNL190_RDATA1_ADDR A:0x31f601c
y.create.l HWIO_PMIC_ARB_OBS6_CHNL191_RDATA1_ADDR A:0x31fe01c
y.create.l HWIO_PMIC_ARB_OBS6_CHNL192_RDATA1_ADDR A:0x320601c
y.create.l HWIO_PMIC_ARB_OBS6_CHNL193_RDATA1_ADDR A:0x320e01c
y.create.l HWIO_PMIC_ARB_OBS6_CHNL194_RDATA1_ADDR A:0x321601c
y.create.l HWIO_PMIC_ARB_OBS6_CHNL195_RDATA1_ADDR A:0x321e01c
y.create.l HWIO_PMIC_ARB_OBS6_CHNL196_RDATA1_ADDR A:0x322601c
y.create.l HWIO_PMIC_ARB_OBS6_CHNL197_RDATA1_ADDR A:0x322e01c
y.create.l HWIO_PMIC_ARB_OBS6_CHNL198_RDATA1_ADDR A:0x323601c
y.create.l HWIO_PMIC_ARB_OBS6_CHNL199_RDATA1_ADDR A:0x323e01c
y.create.l HWIO_PMIC_ARB_OBS6_CHNL200_RDATA1_ADDR A:0x324601c
y.create.l HWIO_PMIC_ARB_OBS6_CHNL201_RDATA1_ADDR A:0x324e01c
y.create.l HWIO_PMIC_ARB_OBS6_CHNL202_RDATA1_ADDR A:0x325601c
y.create.l HWIO_PMIC_ARB_OBS6_CHNL203_RDATA1_ADDR A:0x325e01c
y.create.l HWIO_PMIC_ARB_OBS6_CHNL204_RDATA1_ADDR A:0x326601c
y.create.l HWIO_PMIC_ARB_OBS6_CHNL205_RDATA1_ADDR A:0x326e01c
y.create.l HWIO_PMIC_ARB_OBS6_CHNL206_RDATA1_ADDR A:0x327601c
y.create.l HWIO_PMIC_ARB_OBS6_CHNL207_RDATA1_ADDR A:0x327e01c
y.create.l HWIO_PMIC_ARB_OBS6_CHNL208_RDATA1_ADDR A:0x328601c
y.create.l HWIO_PMIC_ARB_OBS6_CHNL209_RDATA1_ADDR A:0x328e01c
y.create.l HWIO_PMIC_ARB_OBS6_CHNL210_RDATA1_ADDR A:0x329601c
y.create.l HWIO_PMIC_ARB_OBS6_CHNL211_RDATA1_ADDR A:0x329e01c
y.create.l HWIO_PMIC_ARB_OBS6_CHNL212_RDATA1_ADDR A:0x32a601c
y.create.l HWIO_PMIC_ARB_OBS6_CHNL213_RDATA1_ADDR A:0x32ae01c
y.create.l HWIO_PMIC_ARB_OBS6_CHNL214_RDATA1_ADDR A:0x32b601c
y.create.l HWIO_PMIC_ARB_OBS6_CHNL215_RDATA1_ADDR A:0x32be01c
y.create.l HWIO_PMIC_ARB_OBS6_CHNL216_RDATA1_ADDR A:0x32c601c
y.create.l HWIO_PMIC_ARB_OBS6_CHNL217_RDATA1_ADDR A:0x32ce01c
y.create.l HWIO_PMIC_ARB_OBS6_CHNL218_RDATA1_ADDR A:0x32d601c
y.create.l HWIO_PMIC_ARB_OBS6_CHNL219_RDATA1_ADDR A:0x32de01c
y.create.l HWIO_PMIC_ARB_OBS6_CHNL220_RDATA1_ADDR A:0x32e601c
y.create.l HWIO_PMIC_ARB_OBS6_CHNL221_RDATA1_ADDR A:0x32ee01c
y.create.l HWIO_PMIC_ARB_OBS6_CHNL222_RDATA1_ADDR A:0x32f601c
y.create.l HWIO_PMIC_ARB_OBS6_CHNL223_RDATA1_ADDR A:0x32fe01c
y.create.l HWIO_PMIC_ARB_OBS6_CHNL224_RDATA1_ADDR A:0x330601c
y.create.l HWIO_PMIC_ARB_OBS6_CHNL225_RDATA1_ADDR A:0x330e01c
y.create.l HWIO_PMIC_ARB_OBS6_CHNL226_RDATA1_ADDR A:0x331601c
y.create.l HWIO_PMIC_ARB_OBS6_CHNL227_RDATA1_ADDR A:0x331e01c
y.create.l HWIO_PMIC_ARB_OBS6_CHNL228_RDATA1_ADDR A:0x332601c
y.create.l HWIO_PMIC_ARB_OBS6_CHNL229_RDATA1_ADDR A:0x332e01c
y.create.l HWIO_PMIC_ARB_OBS6_CHNL230_RDATA1_ADDR A:0x333601c
y.create.l HWIO_PMIC_ARB_OBS6_CHNL231_RDATA1_ADDR A:0x333e01c
y.create.l HWIO_PMIC_ARB_OBS6_CHNL232_RDATA1_ADDR A:0x334601c
y.create.l HWIO_PMIC_ARB_OBS6_CHNL233_RDATA1_ADDR A:0x334e01c
y.create.l HWIO_PMIC_ARB_OBS6_CHNL234_RDATA1_ADDR A:0x335601c
y.create.l HWIO_PMIC_ARB_OBS6_CHNL235_RDATA1_ADDR A:0x335e01c
y.create.l HWIO_PMIC_ARB_OBS6_CHNL236_RDATA1_ADDR A:0x336601c
y.create.l HWIO_PMIC_ARB_OBS6_CHNL237_RDATA1_ADDR A:0x336e01c
y.create.l HWIO_PMIC_ARB_OBS6_CHNL238_RDATA1_ADDR A:0x337601c
y.create.l HWIO_PMIC_ARB_OBS6_CHNL239_RDATA1_ADDR A:0x337e01c
y.create.l HWIO_PMIC_ARB_OBS6_CHNL240_RDATA1_ADDR A:0x338601c
y.create.l HWIO_PMIC_ARB_OBS6_CHNL241_RDATA1_ADDR A:0x338e01c
y.create.l HWIO_PMIC_ARB_OBS6_CHNL242_RDATA1_ADDR A:0x339601c
y.create.l HWIO_PMIC_ARB_OBS6_CHNL243_RDATA1_ADDR A:0x339e01c
y.create.l HWIO_PMIC_ARB_OBS6_CHNL244_RDATA1_ADDR A:0x33a601c
y.create.l HWIO_PMIC_ARB_OBS6_CHNL245_RDATA1_ADDR A:0x33ae01c
y.create.l HWIO_PMIC_ARB_OBS6_CHNL246_RDATA1_ADDR A:0x33b601c
y.create.l HWIO_PMIC_ARB_OBS6_CHNL247_RDATA1_ADDR A:0x33be01c
y.create.l HWIO_PMIC_ARB_OBS6_CHNL248_RDATA1_ADDR A:0x33c601c
y.create.l HWIO_PMIC_ARB_OBS6_CHNL249_RDATA1_ADDR A:0x33ce01c
y.create.l HWIO_PMIC_ARB_OBS6_CHNL250_RDATA1_ADDR A:0x33d601c
y.create.l HWIO_PMIC_ARB_OBS6_CHNL251_RDATA1_ADDR A:0x33de01c
y.create.l HWIO_PMIC_ARB_OBS6_CHNL252_RDATA1_ADDR A:0x33e601c
y.create.l HWIO_PMIC_ARB_OBS6_CHNL253_RDATA1_ADDR A:0x33ee01c
y.create.l HWIO_PMIC_ARB_OBS6_CHNL254_RDATA1_ADDR A:0x33f601c
y.create.l HWIO_PMIC_ARB_OBS6_CHNL255_RDATA1_ADDR A:0x33fe01c
y.create.done
