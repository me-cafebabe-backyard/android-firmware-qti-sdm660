////////////////////////////////////////////////////////////////////
//                                                                //
//  File: std_rootcmm_menu_APPS-CORTEXA5-LE_internal.cmm     
//  Contains T32 script set-up for APPS-CORTEXA5-LE subsystem      
//  Autogenerated - Do not edit!                                  //
//  Created: 30-03-2020,01.16.57                                  //
//                                                                //
////////////////////////////////////////////////////////////////////

//###################Arguments passed #####################            
LOCAL &ArgumentLine                                                    
ENTRY %LINE &ArgumentLine                                              
LOCAL &UTILITY &therest                                                
ENTRY &UTILITY %LINE &therest                                          
                                                                       
                                                                       
//#####################Select Subroutine###################            
// Name of the utility we are calling                                  
// Input Argument 0 is the name of the utility                         
LOCAL &SUBROUTINE                                                      
&SUBROUTINE="&UTILITY"                                                 
IF !(("&SUBROUTINE"=="CREATEMENU")||("&SUBROUTINE"=="ADDMENUBUTTONS")||("&SUBROUTINE"=="HELP")||("&SUBROUTINE"=="help")) 
(                                                                      
    &SUBROUTINE="MAIN"                                                 
    GOSUB MAIN &ArgumentLine                                           
)                                                                      
ELSE                                                                   
(                                                                      
    // Call the required utility                                       
    GOSUB &SUBROUTINE &therest                                         
)                                                                      
                                                                       
    LOCAL &rvalue                                                      
    ENTRY %LINE &rvalue                                                
                                                                       
    //Remove error handler if it was set                               
    ON ERROR                                                           
                                                                       
    GOSUB EXIT &rvalue                                                 
                                                                       
////////////////////////////////////////                               
//                                                                     
//            MAIN                                                     
//            Main std_rootcmm_menu_APPS-CORTEXA5-LE_internal.cmm logic                                  
//                                                                     
/////////////////////////////////////////                              
MAIN:                                                                  
     LOCAL &arg0 &therest                                               
     ENTRY &arg0 %LINE &therest                                       
                                                                       
     ON ERROR GOSUB HELP                                                
     GOSUB &arg0 &therest                                                
     ON ERROR                                                          
     LOCAL &rvalue                                                     
     ENTRY &rvalue                                                      
     IF ("&rvalue"=="")                                             
     (                                                                  
         &rvalue="SUCCESS"                                           
     )                                                                 
     RETURN &rvalue                                                    
                                                                       
 
 
////////////////////////////////////////                               
//                                                                     
//            CREATEMENU                                                     
//            Creates dropdown menu for Qualcomm Scripts                  
//                                                                     
/////////////////////////////////////////                              
CREATEMENU:                                                            
 
		MENU.REPROGRAM
		(
			ADD 
			MENU 
			( 
				POPUP "[:CORRELATE]&Qualcomm Scripts" 
				( 
					POPUP "[:PSTEP]&general" 
					( 
						POPUP "[:PSTEP]&general" 
						( 
							MENUITEM "[:FLASH]&Attach And Break Processor " 
							( 
ATTACHMANAGER-BREAK:
								LOCAL &invocationtype
								ENTRY &invocationtype
								do std_utils EXECUTESCRIPT ERRORHANDLE &METATOOLSDIR/general/attachmanager.cmm break MDM9655 

								IF ("&invocationtype"=="BUTTONPROMPT")
								(
									RETURN
								)

							)
							MENUITEM "[:FLASH]&Load Symbols " 
							( 
SYMBOLMANAGER-LOADSYMS:
								LOCAL &invocationtype
								ENTRY &invocationtype
								do std_utils EXECUTESCRIPT ERRORHANDLE &METATOOLSDIR/general/symbolmanager.cmm APPS-CORTEXA5-LE all 

								IF ("&invocationtype"=="BUTTONPROMPT")
								(
									RETURN
								)

							)
							MENUITEM "[:FLASH]&Debug Menu " 
							( 
STDDEBUG:
								LOCAL &invocationtype
								ENTRY &invocationtype
								do std_utils EXECUTESCRIPT ERRORHANDLE &METATOOLSDIR/../cmm/common/std_debug.cmm 

								IF ("&invocationtype"=="BUTTONPROMPT")
								(
									RETURN
								)

							)
							MENUITEM "[:FLASH]&Load HWIO Symbols " 
							( 
MAINHWIOSCRIPT:
								LOCAL &invocationtype
								ENTRY &invocationtype
								do std_utils EXECUTESCRIPT ERRORHANDLE &METATOOLSDIR/../cmm/common/MDM9655/hwio.cmm 

								IF ("&invocationtype"=="BUTTONPROMPT")
								(
									RETURN
								)

							)
							MENUITEM "[:FLASH]&Build Options " 
							( 
STDLOADBUILD:
								LOCAL &invocationtype
								ENTRY &invocationtype
								do std_utils EXECUTESCRIPT ERRORHANDLE &METATOOLSDIR/../cmm/common/MDM9655/std_buildoptions.cmm 

								IF ("&invocationtype"=="BUTTONPROMPT")
								(
									RETURN
								)

							)
							MENUITEM "[:FLASH]&Attach to Processor " 
							( 
ATTACHMANAGER-ATTACH:
								LOCAL &invocationtype
								ENTRY &invocationtype
								do std_utils EXECUTESCRIPT ERRORHANDLE &METATOOLSDIR/general/attachmanager.cmm attach MDM9655 

								IF ("&invocationtype"=="BUTTONPROMPT")
								(
									RETURN
								)

							)
						) 
					) 
					POPUP "[:PSTEP]&hwengines" 
					( 
						POPUP "[:PSTEP]&epm" 
						( 
							MENUITEM "[:ACONFIG]&ALPACA GUI " 
							( 
ALPACA_GUI:
								LOCAL &invocationtype
								ENTRY &invocationtype
								do std_utils EXECUTESCRIPT ERRORHANDLE &METATOOLSDIR/hwengines/epm/alpaca.exe 

								IF ("&invocationtype"=="BUTTONPROMPT")
								(
									RETURN
								)

							)
						) 
					) 
					POPUP "[:PSTEP]&qdss" 
					( 
						POPUP "[:PSTEP]&qdss" 
						( 
							MENUITEM "[:FLASH]&Dump ETB " 
							( 
DUMP_ETB:
								LOCAL &invocationtype
								ENTRY &invocationtype
								do std_utils EXECUTESCRIPT ERRORHANDLE &METATOOLSDIR/general/attachmanager.cmm attach MDM9655 
								do std_utils EXECUTESCRIPT ERRORHANDLE &METATOOLSDIR/qdss/MDM9655/dump_etb.cmm &TEMP/etb_dump.bin 

								IF ("&invocationtype"=="BUTTONPROMPT")
								(
									RETURN
								)

							)
						) 
					) 
					POPUP "[:PSTEP]&sve" 
					( 
						POPUP "[:PSTEP]&DragonLink" 
						( 
						) 
					) 
					POPUP "[:PSTEP]&systemdrivers" 
					( 
						POPUP "[:PSTEP]&vcs" 
						( 
							MENUITEM "[:FLASH]&VCS " 
							( 
VCS:
								LOCAL &invocationtype
								ENTRY &invocationtype
								do std_utils EXECUTESCRIPT ERRORHANDLE &METATOOLSDIR/systemdrivers/vcs/vcs.cmm 

								IF ("&invocationtype"=="BUTTONPROMPT")
								(
									RETURN
								)

							)
						) 
						POPUP "[:PSTEP]&pmic" 
						( 
							MENUITEM "[:FLASH]&PMIC Dump " 
							( 
PMIC_DUMP:
								LOCAL &invocationtype
								ENTRY &invocationtype
								do std_utils EXECUTESCRIPT ERRORHANDLE &METATOOLSDIR/general/attachmanager.cmm attach MDM9655 
								do std_utils EXECUTESCRIPT ERRORHANDLE &METATOOLSDIR/systemdrivers/pmic/bear/PMICDump.cmm 

								IF ("&invocationtype"=="BUTTONPROMPT")
								(
									RETURN
								)

							)
							MENUITEM "[:FLASH]&PMIC Registers " 
							( 
PMIC_REGISTERS:
								LOCAL &invocationtype
								ENTRY &invocationtype
								do std_utils EXECUTESCRIPT ERRORHANDLE &METATOOLSDIR/general/attachmanager.cmm attach MDM9655 
								do std_utils EXECUTESCRIPT ERRORHANDLE &METATOOLSDIR/systemdrivers/pmic/bear/PMICRegisters.cmm  

								IF ("&invocationtype"=="BUTTONPROMPT")
								(
									RETURN
								)

							)
							MENUITEM "[:FLASH]&PMIC Dashboard " 
							( 
PMIC_DASHBOARD:
								LOCAL &invocationtype
								ENTRY &invocationtype
								do std_utils EXECUTESCRIPT ERRORHANDLE &METATOOLSDIR/general/attachmanager.cmm attach MDM9655 
								do std_utils EXECUTESCRIPT ERRORHANDLE &METATOOLSDIR/systemdrivers/pmic/bear/PMICDashBoard.cmm 

								IF ("&invocationtype"=="BUTTONPROMPT")
								(
									RETURN
								)

							)
							MENUITEM "[:FLASH]&PMIC Warm Reset " 
							( 
PMIC_WARM_RESET:
								LOCAL &invocationtype
								ENTRY &invocationtype
								do std_utils EXECUTESCRIPT ERRORHANDLE &METATOOLSDIR/general/attachmanager.cmm attach MDM9655 
								do std_utils EXECUTESCRIPT ERRORHANDLE &METATOOLSDIR/systemdrivers/pmic/PMICReset.cmm WARMRESET 

								IF ("&invocationtype"=="BUTTONPROMPT")
								(
									RETURN
								)

							)
							MENUITEM "[:FLASH]&PMIC Peek " 
							( 
PMIC_PEEK:
								LOCAL &invocationtype
								ENTRY &invocationtype
								do std_utils EXECUTESCRIPT ERRORHANDLE &METATOOLSDIR/general/attachmanager.cmm attach MDM9655 
								do std_utils EXECUTESCRIPT ERRORHANDLE &METATOOLSDIR/systemdrivers/pmic/bear/PMICPeek.cmm 

								IF ("&invocationtype"=="BUTTONPROMPT")
								(
									RETURN
								)

							)
							MENUITEM "[:FLASH]&PBUS Logger " 
							( 
PBUS_LOGGER:
								LOCAL &invocationtype
								ENTRY &invocationtype
								do std_utils EXECUTESCRIPT ERRORHANDLE &METATOOLSDIR/general/attachmanager.cmm attach MDM9655 
								do std_utils EXECUTESCRIPT ERRORHANDLE &METATOOLSDIR/systemdrivers/pmic/bear/PBUSLogger.cmm 

								IF ("&invocationtype"=="BUTTONPROMPT")
								(
									RETURN
								)

							)
							MENUITEM "[:FLASH]&PMIC Hard Reset " 
							( 
PMIC_HARD_RESET:
								LOCAL &invocationtype
								ENTRY &invocationtype
								do std_utils EXECUTESCRIPT ERRORHANDLE &METATOOLSDIR/general/attachmanager.cmm attach MDM9655 
								do std_utils EXECUTESCRIPT ERRORHANDLE &METATOOLSDIR/systemdrivers/pmic/PMICReset.cmm HARDRESET 

								IF ("&invocationtype"=="BUTTONPROMPT")
								(
									RETURN
								)

							)
						) 
						POPUP "[:PSTEP]&hwio" 
						( 
							MENUITEM "[:FLASH]&View HWIO Registers " 
							( 
VIEW_HWIO_REGISTERS:
								LOCAL &invocationtype
								ENTRY &invocationtype
								do std_utils EXECUTESCRIPT ERRORHANDLE &METATOOLSDIR/systemdrivers/hwio/HWIORegisters.cmm MDM9655 

								IF ("&invocationtype"=="BUTTONPROMPT")
								(
									RETURN
								)

							)
						) 
					) 
					POPUP "[:PSTEP]&tz" 
					( 
						POPUP "[:PSTEP]&tz" 
						( 
							MENUITEM "[:FLASH]&Load TZ elfs " 
							( 
LOAD_TZ_ELFS:
								LOCAL &invocationtype
								ENTRY &invocationtype
								do std_utils EXECUTESCRIPT ERRORHANDLE &METATOOLSDIR/tz/load_qsee_elf.cmm &TZ_BUILDROOT &TZ_BUILDID 

								IF ("&invocationtype"=="BUTTONPROMPT")
								(
									RETURN
								)

							)
							MENUITEM "[:FLASH]&SMMU Fault parser " 
							( 
SMMU_FAULT_PARSER:
								LOCAL &invocationtype
								ENTRY &invocationtype
								do std_utils EXECUTESCRIPT ERRORHANDLE &METATOOLSDIR/general/attachmanager.cmm attach MDM9655 
								do std_utils EXECUTESCRIPT ERRORHANDLE &METATOOLSDIR/tz/smmu/MDM9655/smmu_debug_fault.cmm 

								IF ("&invocationtype"=="BUTTONPROMPT")
								(
									RETURN
								)

							)
							MENUITEM "[:FLASH]&Print TZ Log " 
							( 
PRINT_TZ_LOG:
								LOCAL &invocationtype
								ENTRY &invocationtype
								do std_utils EXECUTESCRIPT ERRORHANDLE &METATOOLSDIR/tz/tzlogs/print_tz_log.cmm &TZ_BUILDROOT MDM9655 

								IF ("&invocationtype"=="BUTTONPROMPT")
								(
									RETURN
								)

							)
							MENUITEM "[:FLASH]&Stage 2 pagetable walker " 
							( 
STAGE_2_PAGETABLE_WALKER:
								LOCAL &invocationtype
								ENTRY &invocationtype
								do std_utils EXECUTESCRIPT ERRORHANDLE &METATOOLSDIR/general/attachmanager.cmm attach MDM9655 
								do std_utils EXECUTESCRIPT ERRORHANDLE &METATOOLSDIR/tz/smmu/MDM9655/dump_pt.cmm 

								IF ("&invocationtype"=="BUTTONPROMPT")
								(
									RETURN
								)

							)
						) 
					) 
				) 
			) 
		) 
	
	RETURN SUCCESS


 
 
////////////////////////////////////////                               
//                                                                     
//            ADDMENUBUTTONS                                                     
//            Creates dropdown menu for Qualcomm Scripts                  
//                                                                     
/////////////////////////////////////////                              
ADDMENUBUTTONS:                                                            
	 
		 
			MENU.ADDTOOL "View HWIO Registers" "_,X,:chip" "DO std_utils EXECUTESCRIPT ERRORHANDLE &METATOOLSDIR/MDM9655/std_rootcmm_menu_APPS-CORTEXA5-LE_internal.cmm VIEW_HWIO_REGISTERS BUTTONPROMPT"

			
			RETURN                                                            
 



 
 
////////////////////////////////////////                               
//                                                                     
//            HELP                                                     
//            Displays available tools for Qualcomm Scripts                  
//                                                                     
/////////////////////////////////////////                              
HELP:                                                            
 
		 
		AREA.CREATE QualcommScripts 112. 35.                        
		AREA.SELECT QualcommScripts                                             
		WINPOS 60% 29. 112. 35.                               
		AREA.VIEW QualcommScripts                                               
		                                                                 
		//HEADER "Qualcomm Scripts Help window"                         
		                                                                 
		                                                                 
		PRINT " ///////////////////////////////////////////////////////////////////"
		PRINT " /////////////////// Qualcomm Scripts Help //////////////////////////"
		PRINT " ///////////////////////////////////////////////////////////////////"
		PRINT " //" 
		PRINT " // The following are the available tools. " 
		PRINT " // Use the dropdown menu labeled Qualcomm Scripts " 
		PRINT " // To navigate to your desired script " 
		PRINT " //" 
		PRINT " ///////////////////////////////////////////////////////////////////"
		PRINT " //" 
		PRINT " //  ALPACA GUI                  : ALPACA GUI" 
		PRINT " //  AttachManager-Attach        : Attach to a runningMDM9655 APPS-CORTEXA5-LE" 
		PRINT " //  AttachManager-Break         : Attach and break on a MDM9655 APPS-CORTEXA5-LE" 
		PRINT " //  Dump ETB                    : Dump ETB" 
		PRINT " //  Load TZ elfs                : Load TZ elfs" 
		PRINT " //  MainHWIOScript              : Load HWIO Symbols" 
		PRINT " //  PBUS Logger                 : Logs and displays the SPMI/PBS transactions" 
		PRINT " //  PMIC Dashboard              : Displays PMIC power rails, clocks and GPIOs status" 
		PRINT " //  PMIC Dump                   : Collects PMIC register dump" 
		PRINT " //  PMIC HARD RESET             : Does a PMIC Hard Reset" 
		PRINT " //  PMIC Peek                   : Peek/poke PMIC registers" 
		PRINT " //  PMIC Registers              : PMIC Registers" 
		PRINT " //  PMIC WARM RESET             : Does a PMIC Warm Reset" 
		PRINT " //  PostScriptPrompt            : None" 
		PRINT " //  Print TZ Log                : Print TZ Logs" 
		PRINT " //  SMMU Fault parser           : SMMU Fault parser - Parse SMMU fault" 
		PRINT " //  Stage 2 Pagetable Walker    : Stage 2 pagetable walker for SMMU" 
		PRINT " //  SymbolManager-Loadsyms      : Load symbols for APPS-CORTEXA5-LE" 
		PRINT " //  VCS                         : VCS Configuration" 
		PRINT " //  View HWIO Registers         : View HWIO Registers - Register Tree view (per file)" 
		PRINT " //  dragonlink delay 15 seconds : None" 
		PRINT " //  stddebug                    : Main debug menu for debugging various subsystems" 
		PRINT " //  stdloadbuild                : Main build loading routine for cleaning and loading a build onto device" 
		PRINT " //" 
		PRINT " ///////////////////////////////////////////////////////////////////"


		RETURN                                                            
 



//In case a return was missed from above                                    
    RETURN                                                                  
                                                                            
EXIT:                                                                       
    LOCAL &rvalue                                                           
    ENTRY %LINE &rvalue                                                     
                                                                            
    //Clear any persistent variables needed                                 
    do std_cti_&CHIPSET CLEARSENTINELS                                      
                                                                            
    ENDDO &rvalue                                                           
                                                                            
                                                                            
//Should never get here.                                                    
FATALEXIT:                                                                  
    LOCAL &rvalue                                                           
    ENTRY %LINE &rvalue                                                     
    IF STRING.SCAN("&FAILUREKEYWORD","FAILUREKEYWORD",0)==-1                
    (                                                                       
        GOSUB EXIT &FAILUREKEYWORD - &rvalue                                
    )                                                                       
    ELSE                                                                    
    (                                                                       
        GOSUB EXIT &rvalue                                                  
    )                                                                       
                                                                            
//Should never get here                                                     
    END                                                                     
