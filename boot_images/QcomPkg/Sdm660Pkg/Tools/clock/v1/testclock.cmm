
;============================================================================
;
; *************** THIS SCRIPT WAS AUTOGENERATED ****************
;
; TARGET
;
;
; SCRIPT
;   TESTCLOCK.CMM
;
; GENERAL DESCRIPTION
;   This script can be used to route specific clocks to the clock test output.
;
; FUNCTIONS
;   N/A
;
;    Copyright (c) 2016 by QUALCOMM Technologies Inc.  All Rights Reserved.
;============================================================================



;-----------------------------------------------------------------------------
; Local variables
;-----------------------------------------------------------------------------

local &clk
local &clk_name
local &clk_state
local &clk_state_filter
local &clk_freq
local &header_printed
local &clk_test
local &clk_reg
local &clk_reg_str
local &clk_reg_name
local &clk_reg_cbcr_type
local &state_change
local &clock_count
local &multiplier
local &tcxo_count
local &match
local &clk_access_mode
local &clk_cmd_rcgr_addr
local &clk_cfg_rcgr_addr
local &clk_cmd_rcgr_val
local &clk_cfg_rcgr_val
local &clk_src_name
local &clk_src_sel
local &clk_src_div
local &clk_m_addr
local &clk_n_addr
local &clk_d_addr
local &clk_m_val
local &clk_n_val
local &clk_2d_val
local &chipset_name
local &frq_measure_ctl_addr
local &frq_measure_status_addr
local &xo_div4_cbcr_addr
local &dbg_clk_ctl_addr


;-----------------------------------------------------------------------------
; Initialize autogenerated constants
;-----------------------------------------------------------------------------

goto Init_Constants


Init_Constants:

; Chipset Name
&chipset_name="sdm660"

; Default Access Mode
&access_mode="ezaxi"

; Mux-specific Access Modes
&APCS_access_mode="ezaxi"
&CDSP_access_mode="ezaxi"
&DDRSS_access_mode="ezaxi"
&GCC_access_mode="ezaxi"
&GPU_access_mode="ezaxi"
&LPASS_access_mode="ezaxi"
&LPASS_Q6_access_mode="ezaxi"
&MMSS_access_mode="ezaxi"
&MSS_access_mode="ezaxi"
&MSS_Q6_access_mode="ezaxi"
&WCSS_access_mode="ezaxi"


;CDSP clock registers

;GCC clock registers
&HWIO_GCC_A2NOC_THROTTLE_CFG_CBCR_ADDR=0x183048
&HWIO_GCC_A2NOC_THROTTLE_CORE_AXI_CBCR_ADDR=0x183040
&HWIO_GCC_A2NOC_THROTTLE_CXO_CBCR_ADDR=0x183044
&HWIO_GCC_AGGRE2_CNOC_AHB_CBCR_ADDR=0x183014
&HWIO_GCC_AGGRE2_CNOC_NORTH_PERIPH_AHB_CBCR_ADDR=0x183054
&HWIO_GCC_AGGRE2_CNOC_PERIPH_AHB_CBCR_ADDR=0x183064
&HWIO_GCC_AGGRE2_CNOC_SOUTH_PERIPH_AHB_CBCR_ADDR=0x183050
&HWIO_GCC_AGGRE2_NOC_AT_CBCR_ADDR=0x183018
&HWIO_GCC_AGGRE2_NOC_CXO_NORTH_CBCR_ADDR=0x183058
&HWIO_GCC_AGGRE2_NOC_CXO_SOUTH_CBCR_ADDR=0x18305c
&HWIO_GCC_AGGRE2_NOC_IPA_CBCR_ADDR=0x18304c
&HWIO_GCC_AGGRE2_NOC_MSMPU_CFG_AHB_CBCR_ADDR=0x18d004
&HWIO_GCC_AGGRE2_SNOC_AXI_CBCR_ADDR=0x183008
&HWIO_GCC_AGGRE2_SNOC_MSMPU_CLIENT_AXI_CBCR_ADDR=0x18d010
&HWIO_GCC_AGGRE2_SNOC_NORTH_AXI_CBCR_ADDR=0x183060
&HWIO_GCC_AGGRE2_SNOC_SOUTH_AXI_CBCR_ADDR=0x18300c
&HWIO_GCC_AGGRE2_UFS_AXI_CBCR_ADDR=0x175034
&HWIO_GCC_AGGRE2_USB3_AXI_CBCR_ADDR=0x10f03c
&HWIO_GCC_AHB2PHY_EAST_CBCR_ADDR=0x107004
&HWIO_GCC_GCC_AHB_CBCR_ADDR=0x143000
&HWIO_GCC_APC0_VS_CBCR_ADDR=0x17a0dc
&HWIO_GCC_APC1_VS_CBCR_ADDR=0x17a0e0
&HWIO_GCC_APSS_QDSS_TSCTR_DIV2_CBCR_ADDR=0x148090
&HWIO_GCC_APSS_QDSS_TSCTR_DIV8_CBCR_ADDR=0x148094
&HWIO_GCC_BIMC_AT_CBCR_ADDR=0x144020
&HWIO_GCC_BIMC_CFG_AHB_CBCR_ADDR=0x14400c
&HWIO_GCC_BIMC_CBCR_ADDR=0x144018
&HWIO_GCC_BIMC_DDR_CPLL0_CBCR_ADDR=0x146004
&HWIO_GCC_BIMC_DDR_CPLL1_CBCR_ADDR=0x146008
&HWIO_GCC_BIMC_DTTS_XO_CBCR_ADDR=0x144028
&HWIO_GCC_BIMC_GFX_CBCR_ADDR=0x17106c
&HWIO_GCC_BIMC_HMSS_AXI_CBCR_ADDR=0x148004
&HWIO_GCC_BIMC_MSS_Q6_AXI_CBCR_ADDR=0x14401c
&HWIO_GCC_BIMC_NIUS_AXI_CBCR_ADDR=0x104034
&HWIO_GCC_BIMC_NIUS_CFG_AHB_CBCR_ADDR=0x104038
&HWIO_GCC_BIMC_NIUS_HS_AXI_CBCR_ADDR=0x104030
&HWIO_GCC_BIMC_PIMEM_AXI_CBCR_ADDR=0x10a028
&HWIO_GCC_BIMC_SLEEP_CBCR_ADDR=0x144010
&HWIO_GCC_BIMC_SYSNOC_AXI_CBCR_ADDR=0x144014
&HWIO_GCC_BIMC_SYSNOC_HS_AXI_CBCR_ADDR=0x144024
&HWIO_GCC_BIMC_XO_CBCR_ADDR=0x144008
&HWIO_GCC_BLSP1_AHB_CBCR_ADDR=0x117004
&HWIO_GCC_BLSP1_QUP1_I2C_APPS_CBCR_ADDR=0x119008
&HWIO_GCC_BLSP1_QUP1_SPI_APPS_CBCR_ADDR=0x119004
&HWIO_GCC_BLSP1_QUP2_I2C_APPS_CBCR_ADDR=0x11b008
&HWIO_GCC_BLSP1_QUP2_SPI_APPS_CBCR_ADDR=0x11b004
&HWIO_GCC_BLSP1_QUP3_I2C_APPS_CBCR_ADDR=0x11d008
&HWIO_GCC_BLSP1_QUP3_SPI_APPS_CBCR_ADDR=0x11d004
&HWIO_GCC_BLSP1_QUP4_I2C_APPS_CBCR_ADDR=0x11f008
&HWIO_GCC_BLSP1_QUP4_SPI_APPS_CBCR_ADDR=0x11f004
&HWIO_GCC_BLSP1_SLEEP_CBCR_ADDR=0x117008
&HWIO_GCC_BLSP1_UART1_APPS_CBCR_ADDR=0x11a004
&HWIO_GCC_BLSP1_UART1_SIM_CBCR_ADDR=0x11a008
&HWIO_GCC_BLSP1_UART2_APPS_CBCR_ADDR=0x11c004
&HWIO_GCC_BLSP1_UART2_SIM_CBCR_ADDR=0x11c008
&HWIO_GCC_BLSP2_AHB_CBCR_ADDR=0x125004
&HWIO_GCC_BLSP2_QUP1_I2C_APPS_CBCR_ADDR=0x126008
&HWIO_GCC_BLSP2_QUP1_SPI_APPS_CBCR_ADDR=0x126004
&HWIO_GCC_BLSP2_QUP2_I2C_APPS_CBCR_ADDR=0x128008
&HWIO_GCC_BLSP2_QUP2_SPI_APPS_CBCR_ADDR=0x128004
&HWIO_GCC_BLSP2_QUP3_I2C_APPS_CBCR_ADDR=0x12a008
&HWIO_GCC_BLSP2_QUP3_SPI_APPS_CBCR_ADDR=0x12a004
&HWIO_GCC_BLSP2_QUP4_I2C_APPS_CBCR_ADDR=0x12c008
&HWIO_GCC_BLSP2_QUP4_SPI_APPS_CBCR_ADDR=0x12c004
&HWIO_GCC_BLSP2_SLEEP_CBCR_ADDR=0x125008
&HWIO_GCC_BLSP2_UART1_APPS_CBCR_ADDR=0x127004
&HWIO_GCC_BLSP2_UART1_SIM_CBCR_ADDR=0x127008
&HWIO_GCC_BLSP2_UART2_APPS_CBCR_ADDR=0x129004
&HWIO_GCC_BLSP2_UART2_SIM_CBCR_ADDR=0x129008
&HWIO_GCC_BOOT_ROM_AHB_CBCR_ADDR=0x138004
&HWIO_GCC_CDSP_BIMC_CBCR_ADDR=0x14402c
&HWIO_GCC_CE1_AHB_CBCR_ADDR=0x14100c
&HWIO_GCC_CE1_AXI_CBCR_ADDR=0x141008
&HWIO_GCC_CE1_CBCR_ADDR=0x141004
&HWIO_GCC_CENTER_APB_CBCR_ADDR=0x10c050
&HWIO_GCC_CFG_NOC_AH2PHY_XO_CBCR_ADDR=0x105034
&HWIO_GCC_CFG_NOC_AHB_CBCR_ADDR=0x105004
&HWIO_GCC_CFG_NOC_DCD_XO_CBCR_ADDR=0x105024
&HWIO_GCC_CFG_NOC_DDR_CFG_CBCR_ADDR=0x105014
&HWIO_GCC_CFG_NOC_LPASS_AON_AHB_CBCR_ADDR=0x147040
&HWIO_GCC_CFG_NOC_NORTH_AHB_CBCR_ADDR=0x10500c
&HWIO_GCC_CFG_NOC_NORTH_DCD_XO_CBCR_ADDR=0x105028
&HWIO_GCC_CFG_NOC_SOUTH_AHB_CBCR_ADDR=0x105008
&HWIO_GCC_CFG_NOC_SOUTH_DCD_XO_CBCR_ADDR=0x10502c
&HWIO_GCC_CFG_NOC_TURING_AON_AHB_CBCR_ADDR=0x18c01c
&HWIO_GCC_CFG_NOC_USB2_AXI_CBCR_ADDR=0x105058
&HWIO_GCC_CFG_NOC_USB3_AXI_CBCR_ADDR=0x105018
&HWIO_GCC_CM_PHY_REFGEN1_CBCR_ADDR=0x122004
&HWIO_GCC_CM_PHY_REFGEN2_CBCR_ADDR=0x124004
&HWIO_GCC_CNOC_BUS_TIMEOUT0_AHB_CBCR_ADDR=0x14b004
&HWIO_GCC_CNOC_BUS_TIMEOUT10_AHB_CBCR_ADDR=0x180014
&HWIO_GCC_CNOC_BUS_TIMEOUT11_AHB_CBCR_ADDR=0x18001c
&HWIO_GCC_CNOC_BUS_TIMEOUT12_AHB_CBCR_ADDR=0x180024
&HWIO_GCC_CNOC_BUS_TIMEOUT13_AHB_CBCR_ADDR=0x18002c
&HWIO_GCC_CNOC_BUS_TIMEOUT14_AHB_CBCR_ADDR=0x180034
&HWIO_GCC_CNOC_BUS_TIMEOUT2_AHB_CBCR_ADDR=0x14b014
&HWIO_GCC_CNOC_BUS_TIMEOUT3_AHB_CBCR_ADDR=0x14b01c
&HWIO_GCC_CNOC_BUS_TIMEOUT4_AHB_CBCR_ADDR=0x14b024
&HWIO_GCC_CNOC_BUS_TIMEOUT5_AHB_CBCR_ADDR=0x14b02c
&HWIO_GCC_CNOC_BUS_TIMEOUT6_AHB_CBCR_ADDR=0x14b034
&HWIO_GCC_CNOC_BUS_TIMEOUT7_AHB_CBCR_ADDR=0x14b03c
&HWIO_GCC_CNOC_BUS_TIMEOUT8_AHB_CBCR_ADDR=0x180004
&HWIO_GCC_CNOC_BUS_TIMEOUT9_AHB_CBCR_ADDR=0x18000c
&HWIO_GCC_CNOC_MST_RPM_AHB_CBCR_ADDR=0x13c014
&HWIO_GCC_CNOC_PERIPH_AHB_CBCR_ADDR=0x105040
&HWIO_GCC_CNOC_PERIPH_BUS_TIMEOUT1_AHB_CBCR_ADDR=0x14a008
&HWIO_GCC_CNOC_PERIPH_BUS_TIMEOUT2_AHB_CBCR_ADDR=0x14a010
&HWIO_GCC_CNOC_PERIPH_NORTH_AHB_CBCR_ADDR=0x105020
&HWIO_GCC_CNOC_PERIPH_SOUTH_AHB_CBCR_ADDR=0x10501c
&HWIO_GCC_DCC_AHB_CBCR_ADDR=0x184004
&HWIO_GCC_DDR_DIM_CFG_CBCR_ADDR=0x146000
&HWIO_GCC_DDR_DIM_SLEEP_CBCR_ADDR=0x14600c
&HWIO_GCC_GLM_AHB_CBCR_ADDR=0x18b004
&HWIO_GCC_GLM_CBCR_ADDR=0x18b008
&HWIO_GCC_GLM_XO_CBCR_ADDR=0x18b00c
&HWIO_GCC_GP1_CBCR_ADDR=0x164000
&HWIO_GCC_GP2_CBCR_ADDR=0x165000
&HWIO_GCC_GP3_CBCR_ADDR=0x166000
&HWIO_GCC_GPU_AT_CBCR_ADDR=0x171008
&HWIO_GCC_GPU_BIMC_GFX_CBCR_ADDR=0x171010
&HWIO_GCC_GPU_BIMC_GFX_SRC_CBCR_ADDR=0x17100c
&HWIO_GCC_GPU_CFG_AHB_CBCR_ADDR=0x171004
&HWIO_GCC_GPU_SNOC_DVM_GFX_CBCR_ADDR=0x171018
&HWIO_GCC_GPU_TRIG_CBCR_ADDR=0x171014
&HWIO_GCC_HMSS_AHB_CBCR_ADDR=0x148000
&HWIO_GCC_HMSS_AT_CBCR_ADDR=0x148010
&HWIO_GCC_HMSS_DVM_BUS_CBCR_ADDR=0x14808c
&HWIO_GCC_HMSS_RBCPR_CBCR_ADDR=0x148008
&HWIO_GCC_HMSS_TRIG_CBCR_ADDR=0x14800c
&HWIO_GCC_GCC_IM_SLEEP_CBCR_ADDR=0x14300c
&HWIO_GCC_IMEM_AXI_CBCR_ADDR=0x108004
&HWIO_GCC_IMEM_CFG_AHB_CBCR_ADDR=0x108008
&HWIO_GCC_IPA_2X_CBCR_ADDR=0x189008
&HWIO_GCC_IPA_AHB_CBCR_ADDR=0x189010
&HWIO_GCC_IPA_CBCR_ADDR=0x18900c
&HWIO_GCC_IPA_SLEEP_CBCR_ADDR=0x189014
&HWIO_GCC_LPASS_AT_CBCR_ADDR=0x147020
&HWIO_GCC_LPASS_CNOC_CFG_CBCR_ADDR=0x147038
&HWIO_GCC_LPASS_CXO_CBCR_ADDR=0x14704c
&HWIO_GCC_LPASS_MPORT_CBCR_ADDR=0x147044
&HWIO_GCC_LPASS_Q6_AXI_CBCR_ADDR=0x147000
&HWIO_GCC_LPASS_Q6_SMMU_AHB_CBCR_ADDR=0x147010
&HWIO_GCC_LPASS_Q6_SMMU_AXI_CBCR_ADDR=0x147008
&HWIO_GCC_LPASS_Q6_SMMU_AXI_SRC_CBCR_ADDR=0x147004
&HWIO_GCC_LPASS_Q6_SMMU_GDS_CFG_CBCR_ADDR=0x14703c
&HWIO_GCC_LPASS_SWAY_CBCR_ADDR=0x14700c
&HWIO_GCC_LPASS_SWAY_MPU_CBCR_ADDR=0x147050
&HWIO_GCC_LPASS_TRIG_CBCR_ADDR=0x14701c
&HWIO_GCC_MCCC_CFG_AHB_CBCR_ADDR=0x146044
&HWIO_GCC_MMSS_AT_CBCR_ADDR=0x109008
&HWIO_GCC_MMSS_NOC_AT_CBCR_ADDR=0x109034
&HWIO_GCC_MMSS_NOC_CFG_AHB_CBCR_ADDR=0x109004
&HWIO_GCC_MMSS_QM_AHB_CBCR_ADDR=0x109030
&HWIO_GCC_MMSS_QM_CORE_CBCR_ADDR=0x10900c
&HWIO_GCC_MMSS_SYS_NOC_AXI_CBCR_ADDR=0x109000
&HWIO_GCC_MMSS_TRIG_CBCR_ADDR=0x109010
&HWIO_GCC_MPM_AHB_CBCR_ADDR=0x13b008
&HWIO_GCC_MSG_RAM_AHB_CBCR_ADDR=0x139004
&HWIO_GCC_MSS_AT_CBCR_ADDR=0x18a00c
&HWIO_GCC_MSS_CFG_AHB_CBCR_ADDR=0x18a000
&HWIO_GCC_MSS_MNOC_BIMC_AXI_CBCR_ADDR=0x18a004
&HWIO_GCC_MSS_MSMPU_CFG_AHB_CBCR_ADDR=0x18d00c
&HWIO_GCC_MSS_MSMPU_CLIENT_AXI_CBCR_ADDR=0x18d018
&HWIO_GCC_MSS_Q6_BIMC_AXI_CBCR_ADDR=0x18a040
&HWIO_GCC_MSS_Q6_MSMPU_CFG_AHB_CBCR_ADDR=0x18d008
&HWIO_GCC_MSS_Q6_MSMPU_CLIENT_AXI_CBCR_ADDR=0x18d014
&HWIO_GCC_MSS_SNOC_AXI_CBCR_ADDR=0x18a03c
&HWIO_GCC_MSS_TRIG_CBCR_ADDR=0x18a008
&HWIO_GCC_MSS_VS_CBCR_ADDR=0x17a0d4
&HWIO_GCC_NORTH_APB_CBCR_ADDR=0x10c04c
&HWIO_GCC_NORTH_AT_CBCR_ADDR=0x10c018
&HWIO_GCC_OBT_ODT_CBCR_ADDR=0x173018
&HWIO_GCC_PDM2_CBCR_ADDR=0x13300c
&HWIO_GCC_PDM_AHB_CBCR_ADDR=0x133004
&HWIO_GCC_PDM_XO4_CBCR_ADDR=0x133008
&HWIO_GCC_PIMEM_AHB_CBCR_ADDR=0x10a020
&HWIO_GCC_PIMEM_AXI_CBCR_ADDR=0x10a004
&HWIO_GCC_PRNG_AHB_CBCR_ADDR=0x134004
&HWIO_GCC_QDSS_APB2JTAG_CBCR_ADDR=0x14c004
&HWIO_GCC_QDSS_CENTER_AT_CBCR_ADDR=0x10c00c
&HWIO_GCC_QDSS_CFG_AHB_CBCR_ADDR=0x10c008
&HWIO_GCC_QDSS_DAP_AHB_CBCR_ADDR=0x10c004
&HWIO_GCC_QDSS_DAP_CBCR_ADDR=0x10c040
&HWIO_GCC_QDSS_ETR_USB_CBCR_ADDR=0x10c01c
&HWIO_GCC_QDSS_STM_CBCR_ADDR=0x10c020
&HWIO_GCC_QDSS_TRACECLKIN_CBCR_ADDR=0x10c024
&HWIO_GCC_QDSS_TRIG_CBCR_ADDR=0x10c03c
&HWIO_GCC_QDSS_TSCTR_DIV16_CBCR_ADDR=0x10c038
&HWIO_GCC_QDSS_TSCTR_DIV2_CBCR_ADDR=0x10c028
&HWIO_GCC_QDSS_TSCTR_DIV3_CBCR_ADDR=0x10c02c
&HWIO_GCC_QDSS_TSCTR_DIV4_CBCR_ADDR=0x10c030
&HWIO_GCC_QDSS_TSCTR_DIV8_CBCR_ADDR=0x10c034
&HWIO_GCC_QDSS_XO_CBCR_ADDR=0x10c054
&HWIO_GCC_QREFS_VBG_CAL_CBCR_ADDR=0x18802c
&HWIO_GCC_QSPI_AHB_CBCR_ADDR=0x14d004
&HWIO_GCC_QSPI_SER_CBCR_ADDR=0x14d008
&HWIO_GCC_RBCPR_CX_AHB_CBCR_ADDR=0x14e008
&HWIO_GCC_RBCPR_CX_CBCR_ADDR=0x14e004
&HWIO_GCC_RBCPR_MX_AHB_CBCR_ADDR=0x14f008
&HWIO_GCC_RBCPR_MX_CBCR_ADDR=0x14f004
&HWIO_GCC_RPM_BUS_AHB_CBCR_ADDR=0x13c004
&HWIO_GCC_RPM_MST_M2_CNOC_AHB_CBCR_ADDR=0x13c010
&HWIO_GCC_RPM_PROC_HCLK_CBCR_ADDR=0x13c000
&HWIO_GCC_RPM_SLEEP_CBCR_ADDR=0x13c008
&HWIO_GCC_RPM_TIMER_CBCR_ADDR=0x13c00c
&HWIO_GCC_SDCC1_AHB_CBCR_ADDR=0x116008
&HWIO_GCC_SDCC1_APPS_CBCR_ADDR=0x116004
&HWIO_GCC_SDCC1_ICE_CORE_CBCR_ADDR=0x11600c
&HWIO_GCC_SDCC2_AHB_CBCR_ADDR=0x114008
&HWIO_GCC_SDCC2_APPS_CBCR_ADDR=0x114004
&HWIO_GCC_SEC_CTRL_ACC_CBCR_ADDR=0x13d004
&HWIO_GCC_SEC_CTRL_AHB_CBCR_ADDR=0x13d008
&HWIO_GCC_SEC_CTRL_BOOT_ROM_PATCH_CBCR_ADDR=0x13d014
&HWIO_GCC_SEC_CTRL_CBCR_ADDR=0x13d00c
&HWIO_GCC_SEC_CTRL_SENSE_CBCR_ADDR=0x13d010
&HWIO_GCC_SMMU_AGGRE2_AHB_CBCR_ADDR=0x183024
&HWIO_GCC_SMMU_AGGRE2_AXI_CBCR_ADDR=0x183020
&HWIO_GCC_SMMU_AGGRE2_AXI_SRC_CBCR_ADDR=0x18301c
&HWIO_GCC_SNOC_BUS_TIMEOUT0_AHB_CBCR_ADDR=0x149004
&HWIO_GCC_SNOC_BUS_TIMEOUT1_AHB_CBCR_ADDR=0x14900c
&HWIO_GCC_SNOC_BUS_TIMEOUT3_AHB_CBCR_ADDR=0x149014
&HWIO_GCC_SNOC_BUS_TIMEOUT4_AHB_CBCR_ADDR=0x149034
&HWIO_GCC_SNOC_CNOC_AHB_CBCR_ADDR=0x104018
&HWIO_GCC_SNOC_LPASS_Q6_AXIS_CBCR_ADDR=0x147048
&HWIO_GCC_SOUTH_APB_CBCR_ADDR=0x10c048
&HWIO_GCC_SOUTH_AT_CBCR_ADDR=0x10c010
&HWIO_GCC_SPDM_BIMC_CY_CBCR_ADDR=0x140010
&HWIO_GCC_SPDM_CFG_AHB_CBCR_ADDR=0x140004
&HWIO_GCC_SPDM_DEBUG_CY_CBCR_ADDR=0x140018
&HWIO_GCC_SPDM_FF_CBCR_ADDR=0x14000c
&HWIO_GCC_SPDM_MSTR_AHB_CBCR_ADDR=0x140008
&HWIO_GCC_SPDM_PNOC_CY_CBCR_ADDR=0x14001c
&HWIO_GCC_SPDM_RPM_CY_CBCR_ADDR=0x140020
&HWIO_GCC_SPDM_SNOC_CY_CBCR_ADDR=0x140014
&HWIO_GCC_SPMI_AHB_CBCR_ADDR=0x13f00c
&HWIO_GCC_SPMI_CNOC_AHB_CBCR_ADDR=0x13f008
&HWIO_GCC_SPMI_SER_CBCR_ADDR=0x13f004
&HWIO_GCC_SRAM_SENSOR_XO_CBCR_ADDR=0x12d004
&HWIO_GCC_SYS_NOC_AT_CBCR_ADDR=0x10401c
&HWIO_GCC_SYS_NOC_AXI_CBCR_ADDR=0x104004
&HWIO_GCC_SYS_NOC_CDSP_CBCR_ADDR=0x104048
&HWIO_GCC_SYS_NOC_DCD_XO_CBCR_ADDR=0x10403c
&HWIO_GCC_SYS_NOC_HMSS_AHB_CBCR_ADDR=0x104014
&HWIO_GCC_SYS_NOC_HS_AXI_CBCR_ADDR=0x10402c
&HWIO_GCC_SYS_NOC_NORTH_AXI_CBCR_ADDR=0x10400c
&HWIO_GCC_SYS_NOC_PIMEM_AXI_CBCR_ADDR=0x10a024
&HWIO_GCC_SYS_NOC_QDSS_STM_AXI_CBCR_ADDR=0x104010
&HWIO_GCC_SYS_NOC_SOUTH_AXI_CBCR_ADDR=0x104008
&HWIO_GCC_TCSR_AHB_CBCR_ADDR=0x137004
&HWIO_GCC_TIC_CFG_AHB_CBCR_ADDR=0x110000
&HWIO_GCC_TLMM_CENTRE_AHB_CBCR_ADDR=0x13a014
&HWIO_GCC_TLMM_CBCR_ADDR=0x13a010
&HWIO_GCC_TLMM_NORTH_AHB_CBCR_ADDR=0x13a004
&HWIO_GCC_TLMM_SOUTH_AHB_CBCR_ADDR=0x13a008
&HWIO_GCC_TURING_AT_CBCR_ADDR=0x18c018
&HWIO_GCC_TURING_Q6_AXI_CBCR_ADDR=0x18c000
&HWIO_GCC_TURING_Q6_SMMU_AHB_CBCR_ADDR=0x18c010
&HWIO_GCC_TURING_Q6_SMMU_AXI_CBCR_ADDR=0x18c008
&HWIO_GCC_TURING_Q6_SMMU_AXI_SRC_CBCR_ADDR=0x18c004
&HWIO_GCC_TURING_SWAY_CBCR_ADDR=0x18c00c
&HWIO_GCC_TURING_TRIG_CBCR_ADDR=0x18c014
&HWIO_GCC_UFS_AHB_CBCR_ADDR=0x17500c
&HWIO_GCC_UFS_AXI_CBCR_ADDR=0x175008
&HWIO_GCC_UFS_ICE_CORE_CBCR_ADDR=0x17600c
&HWIO_GCC_UFS_PHY_AUX_CBCR_ADDR=0x176040
&HWIO_GCC_UFS_RX_SYMBOL_0_CBCR_ADDR=0x175014
&HWIO_GCC_UFS_RX_SYMBOL_1_CBCR_ADDR=0x17605c
&HWIO_GCC_UFS_TX_SYMBOL_0_CBCR_ADDR=0x175010
&HWIO_GCC_UFS_UNIPRO_CORE_CBCR_ADDR=0x176008
&HWIO_GCC_USB20_MASTER_CBCR_ADDR=0x12f004
&HWIO_GCC_USB20_MOCK_UTMI_CBCR_ADDR=0x12f00c
&HWIO_GCC_USB20_SLEEP_CBCR_ADDR=0x12f008
&HWIO_GCC_USB30_MASTER_CBCR_ADDR=0x10f008
&HWIO_GCC_USB30_MOCK_UTMI_CBCR_ADDR=0x10f010
&HWIO_GCC_USB30_SLEEP_CBCR_ADDR=0x10f00c
&HWIO_GCC_USB3_PHY_AUX_CBCR_ADDR=0x150000
&HWIO_GCC_USB3_PHY_PIPE_CBCR_ADDR=0x150004
&HWIO_GCC_USB_PHY_CFG_AHB2PHY_CBCR_ADDR=0x16a004
&HWIO_GCC_VDDA_VS_CBCR_ADDR=0x17a00c
&HWIO_GCC_VDDCX_VS_CBCR_ADDR=0x17a004
&HWIO_GCC_VDDMX_VS_CBCR_ADDR=0x17a008
&HWIO_GCC_VS_CTRL_CBCR_ADDR=0x17a010
&HWIO_GCC_WCSS_AHB_S0_CBCR_ADDR=0x111004
&HWIO_GCC_WCSS_APB_CBCR_ADDR=0x11101c
&HWIO_GCC_WCSS_AT_CBCR_ADDR=0x111014
&HWIO_GCC_WCSS_AXI_M_CBCR_ADDR=0x111008
&HWIO_GCC_WCSS_ECAHB_CBCR_ADDR=0x11100c
&HWIO_GCC_WCSS_SHDREG_AHB_CBCR_ADDR=0x111010
&HWIO_GCC_WCSS_TSCTR_DIV2_CBCR_ADDR=0x111018
&HWIO_GCC_WCSS_VS_CBCR_ADDR=0x17a0d8
&HWIO_GCC_GCC_XO_CBCR_ADDR=0x143004
&HWIO_GCC_GCC_XO_DIV4_CBCR_ADDR=0x143008

;GPU clock registers
&HWIO_GPUCC_CXO_CBCR_ADDR=0x5066020
&HWIO_GPUCC_GFX3D_CBCR_ADDR=0x5066098
&HWIO_GPUCC_RBBMTIMER_CBCR_ADDR=0x50660d0
&HWIO_GPUCC_RBCPR_CBCR_ADDR=0x5066054
&HWIO_GPUCC_SPDM_GFX3D_CBCR_ADDR=0x50660e4

;LPASS clock registers
&HWIO_LPASS_AUDIO_CORE_AUD_SLIMBUS_CBCR_ADDR=0x15017014
&HWIO_LPASS_AUDIO_CORE_AUD_SLIMBUS_CORE_CBCR_ADDR=0x15017018
&HWIO_LPASS_AUDIO_CORE_AVSYNC_ATIME_CBCR_ADDR=0x15015014
&HWIO_LPASS_AUDIO_CORE_AVSYNC_STC_CBCR_ADDR=0x1501c000
&HWIO_LPASS_AUDIO_CORE_BCR_SLP_CBCR_ADDR=0x15008004
&HWIO_LPASS_AUDIO_CORE_BUS_TIMEOUT_CORE_CBCR_ADDR=0x1503b000
&HWIO_LPASS_AUDIO_CORE_CORE_CBCR_ADDR=0x1501f000
&HWIO_LPASS_AUDIO_CORE_GDSC_XO_CBCR_ADDR=0x1500b004
&HWIO_LPASS_AUDIO_CORE_INT_I2S0_1_IBIT_CBCR_ADDR=0x1504e014
&HWIO_LPASS_AUDIO_CORE_INT_I2S2_IBIT_CBCR_ADDR=0x1504f014
&HWIO_LPASS_AUDIO_CORE_INT_I2S3_IBIT_CBCR_ADDR=0x15050014
&HWIO_LPASS_AUDIO_CORE_INT_I2S4_IBIT_CBCR_ADDR=0x15051014
&HWIO_LPASS_AUDIO_CORE_INT_I2S5_6_IBIT_CBCR_ADDR=0x15052014
&HWIO_LPASS_AUDIO_CORE_INT_MCLK0_CBCR_ADDR=0x15053014
&HWIO_LPASS_AUDIO_CORE_INT_MCLK1_CBCR_ADDR=0x15054014
&HWIO_LPASS_AUDIO_CORE_LPAIF_PCM_DATA_OE_CBCR_ADDR=0x15019014
&HWIO_LPASS_AUDIO_CORE_LPAIF_PRI_EBIT_CBCR_ADDR=0x1501001c
&HWIO_LPASS_AUDIO_CORE_LPAIF_PRI_IBIT_CBCR_ADDR=0x15010018
&HWIO_LPASS_AUDIO_CORE_LPAIF_QUAD_EBIT_CBCR_ADDR=0x1501301c
&HWIO_LPASS_AUDIO_CORE_LPAIF_QUAD_IBIT_CBCR_ADDR=0x15013018
&HWIO_LPASS_AUDIO_CORE_LPAIF_SEC_EBIT_CBCR_ADDR=0x1501101c
&HWIO_LPASS_AUDIO_CORE_LPAIF_SEC_IBIT_CBCR_ADDR=0x15011018
&HWIO_LPASS_AUDIO_CORE_LPAIF_TER_EBIT_CBCR_ADDR=0x1501201c
&HWIO_LPASS_AUDIO_CORE_LPAIF_TER_IBIT_CBCR_ADDR=0x15012018
&HWIO_LPASS_AUDIO_CORE_LPM_CORE_CBCR_ADDR=0x1501e000
&HWIO_LPASS_AUDIO_CORE_QCA_SLIMBUS_CBCR_ADDR=0x15018014
&HWIO_LPASS_AUDIO_CORE_QCA_SLIMBUS_CORE_CBCR_ADDR=0x15018018
&HWIO_LPASS_AUDIO_CORE_QDSP_SWAY_AON_CBCR_ADDR=0x15028000
&MACRO_TOO_LONG_1=0x15036000
&HWIO_LPASS_AUDIO_CORE_RESAMPLER_CBCR_ADDR=0x15016014
&HWIO_LPASS_AUDIO_CORE_SYSNOC_MPORT_CORE_CBCR_ADDR=0x15023000
&HWIO_LPASS_AUDIO_WRAPPER_AON_CBCR_ADDR=0x15014014
&HWIO_LPASS_AUDIO_WRAPPER_BUS_TIMEOUT_AON_CBCR_ADDR=0x1503a000
&HWIO_LPASS_AUDIO_WRAPPER_EXT_MCLK0_CBCR_ADDR=0x15020014
&HWIO_LPASS_AUDIO_WRAPPER_EXT_MCLK1_CBCR_ADDR=0x15021014
&HWIO_LPASS_AUDIO_WRAPPER_EXT_MCLK2_CBCR_ADDR=0x15022014
&HWIO_LPASS_AUDIO_WRAPPER_EXT_MCLK3_CBCR_ADDR=0x15027014
&HWIO_LPASS_AUDIO_WRAPPER_MPU_CFG_AON_CBCR_ADDR=0x15031000
&HWIO_LPASS_AUDIO_WRAPPER_Q6_AHBM_MPU_AON_CBCR_ADDR=0x15032000
&HWIO_LPASS_AUDIO_WRAPPER_QOS_AHBS_AON_CBCR_ADDR=0x15035014
&MACRO_TOO_LONG_2=0x15035020
&MACRO_TOO_LONG_3=0x1503501c
&HWIO_LPASS_AUDIO_WRAPPER_QOS_XO_LAT_COUNTER_CBCR_ADDR=0x15035018
&HWIO_LPASS_AUDIO_WRAPPER_SW_NPL_CBCR_ADDR=0x1504d014
&HWIO_LPASS_AUDIO_WRAPPER_SYSNOC_SWAY_AON_CBCR_ADDR=0x15025000
&HWIO_LPASS_ISLAND_SCC_AHB_TIMEOUT_CORE_CBCR_ADDR=0x15047024
&HWIO_LPASS_ISLAND_SCC_AT_CBCR_ADDR=0x1502d018
&HWIO_LPASS_ISLAND_SCC_BLSP_H_CORE_CBCR_ADDR=0x15047004
&HWIO_LPASS_ISLAND_SCC_CFG_AHB_AON_CBCR_ADDR=0x15046014
&HWIO_LPASS_ISLAND_SCC_CRIF_AON_CBCR_ADDR=0x15046008
&HWIO_LPASS_ISLAND_SCC_CSR_H_AON_CBCR_ADDR=0x1504600c
&HWIO_LPASS_ISLAND_SCC_DATA_H_AON_CBCR_ADDR=0x15046010
&HWIO_LPASS_ISLAND_SCC_DBG_TSCTR_CBCR_ADDR=0x1502e018
&HWIO_LPASS_ISLAND_SCC_PCLKDBG_CBCR_ADDR=0x1502d020
&HWIO_LPASS_ISLAND_SCC_Q6_ATBM_CBCR_ADDR=0x1502d01c
&HWIO_LPASS_ISLAND_SCC_Q6_SPM_CBCR_ADDR=0x1504900c
&HWIO_LPASS_ISLAND_SCC_QDSP_SWAY_AON_CBCR_ADDR=0x15046020
&HWIO_LPASS_ISLAND_SCC_QUP_I2C1_CBCR_ADDR=0x1504000c
&HWIO_LPASS_ISLAND_SCC_QUP_I2C2_CBCR_ADDR=0x1504100c
&HWIO_LPASS_ISLAND_SCC_QUP_I2C3_CBCR_ADDR=0x1504200c
&HWIO_LPASS_ISLAND_SCC_QUP_SPI1_CBCR_ADDR=0x15040008
&HWIO_LPASS_ISLAND_SCC_QUP_SPI2_CBCR_ADDR=0x15041008
&HWIO_LPASS_ISLAND_SCC_QUP_SPI3_CBCR_ADDR=0x15042008
&HWIO_LPASS_ISLAND_SCC_SENSOR_CORE_BCR_SLP_CBCR_ADDR=0x15009008
&HWIO_LPASS_ISLAND_SCC_SENSOR_CORE_BCR_XO_CBCR_ADDR=0x1500900c
&HWIO_LPASS_ISLAND_SCC_SENSOR_CORE_CORE_CBCR_ADDR=0x1504702c
&HWIO_LPASS_ISLAND_SCC_SMEM_CORE_CBCR_ADDR=0x1504700c
&HWIO_LPASS_ISLAND_SCC_UART_DM_UART1_CBCR_ADDR=0x15043018
&HWIO_LPASS_ISLAND_SCC_UART_DM_UART2_CBCR_ADDR=0x15044018
&HWIO_LPASS_ISLAND_SCC_UART_DM_UART3_CBCR_ADDR=0x15045018
&HWIO_LPASS_ISLAND_SCC_UART_DM_UART4_CBCR_ADDR=0x15055018
&HWIO_LPASS_ISLAND_SCC_VS_VDDCX_CBCR_ADDR=0x1504804c
&HWIO_LPASS_ISLAND_SCC_VS_VDDMX_CBCR_ADDR=0x15048048
&HWIO_LPASS_Q6SS_AHBM_AON_CBCR_ADDR=0x15026000
&HWIO_LPASS_Q6SS_AHBS_AON_CBCR_ADDR=0x15033000
&HWIO_LPASS_Q6SS_BCR_SLP_CBCR_ADDR=0x1500a004

;MMSS clock registers
&HWIO_MMSS_BIMC_SMMU_AHB_CBCR_ADDR=0xc8ce004
&HWIO_MMSS_BIMC_SMMU_AXI_CBCR_ADDR=0xc8ce008
&HWIO_MMSS_BTO_AHB_CBCR_ADDR=0xc8d0000
&HWIO_MMSS_CAMSS_AHB_CBCR_ADDR=0xc8c348c
&HWIO_MMSS_CAMSS_CCI_AHB_CBCR_ADDR=0xc8c3348
&HWIO_MMSS_CAMSS_CCI_CBCR_ADDR=0xc8c3344
&HWIO_MMSS_CAMSS_CPHY_CSID0_CBCR_ADDR=0xc8c3730
&HWIO_MMSS_CAMSS_CPHY_CSID1_CBCR_ADDR=0xc8c3734
&HWIO_MMSS_CAMSS_CPHY_CSID2_CBCR_ADDR=0xc8c3738
&HWIO_MMSS_CAMSS_CPHY_CSID3_CBCR_ADDR=0xc8c373c
&HWIO_MMSS_CAMSS_CPP_AHB_CBCR_ADDR=0xc8c36b4
&HWIO_MMSS_CAMSS_CPP_AXI_CBCR_ADDR=0xc8c36c4
&HWIO_MMSS_CAMSS_CPP_CBCR_ADDR=0xc8c36b0
&HWIO_MMSS_CAMSS_CPP_VBIF_AHB_CBCR_ADDR=0xc8c36c8
&HWIO_MMSS_CAMSS_CSI0_AHB_CBCR_ADDR=0xc8c30bc
&HWIO_MMSS_CAMSS_CSI0_CBCR_ADDR=0xc8c30b4
&HWIO_MMSS_CAMSS_CSI0PHYTIMER_CBCR_ADDR=0xc8c3024
&HWIO_MMSS_CAMSS_CSI0PIX_CBCR_ADDR=0xc8c30e4
&HWIO_MMSS_CAMSS_CSI0RDI_CBCR_ADDR=0xc8c30d4
&HWIO_MMSS_CAMSS_CSI1_AHB_CBCR_ADDR=0xc8c3128
&HWIO_MMSS_CAMSS_CSI1_CBCR_ADDR=0xc8c3124
&HWIO_MMSS_CAMSS_CSI1PHYTIMER_CBCR_ADDR=0xc8c3054
&HWIO_MMSS_CAMSS_CSI1PIX_CBCR_ADDR=0xc8c3154
&HWIO_MMSS_CAMSS_CSI1RDI_CBCR_ADDR=0xc8c3144
&HWIO_MMSS_CAMSS_CSI2_AHB_CBCR_ADDR=0xc8c3188
&HWIO_MMSS_CAMSS_CSI2_CBCR_ADDR=0xc8c3184
&HWIO_MMSS_CAMSS_CSI2PHYTIMER_CBCR_ADDR=0xc8c3084
&HWIO_MMSS_CAMSS_CSI2PIX_CBCR_ADDR=0xc8c31b4
&HWIO_MMSS_CAMSS_CSI2RDI_CBCR_ADDR=0xc8c31a4
&HWIO_MMSS_CAMSS_CSI3_AHB_CBCR_ADDR=0xc8c31e8
&HWIO_MMSS_CAMSS_CSI3_CBCR_ADDR=0xc8c31e4
&HWIO_MMSS_CAMSS_CSI3PIX_CBCR_ADDR=0xc8c3214
&HWIO_MMSS_CAMSS_CSI3RDI_CBCR_ADDR=0xc8c3204
&HWIO_MMSS_CAMSS_CSI_VFE0_CBCR_ADDR=0xc8c3704
&HWIO_MMSS_CAMSS_CSI_VFE1_CBCR_ADDR=0xc8c3714
&HWIO_MMSS_CAMSS_CSIPHY0_CBCR_ADDR=0xc8c3740
&HWIO_MMSS_CAMSS_CSIPHY1_CBCR_ADDR=0xc8c3744
&HWIO_MMSS_CAMSS_CSIPHY2_CBCR_ADDR=0xc8c3748
&HWIO_MMSS_CAMSS_GP0_CBCR_ADDR=0xc8c3444
&HWIO_MMSS_CAMSS_GP1_CBCR_ADDR=0xc8c3474
&HWIO_MMSS_CAMSS_ISPIF_AHB_CBCR_ADDR=0xc8c3224
&HWIO_MMSS_CAMSS_JPEG0_CBCR_ADDR=0xc8c35a8
&HWIO_MMSS_CAMSS_JPEG_AHB_CBCR_ADDR=0xc8c35b4
&HWIO_MMSS_CAMSS_JPEG_AXI_CBCR_ADDR=0xc8c35b8
&HWIO_MMSS_CAMSS_MCLK0_CBCR_ADDR=0xc8c3384
&HWIO_MMSS_CAMSS_MCLK1_CBCR_ADDR=0xc8c33b4
&HWIO_MMSS_CAMSS_MCLK2_CBCR_ADDR=0xc8c33e4
&HWIO_MMSS_CAMSS_MCLK3_CBCR_ADDR=0xc8c3414
&HWIO_MMSS_CAMSS_MICRO_AHB_CBCR_ADDR=0xc8c3494
&HWIO_MMSS_CAMSS_TOP_AHB_CBCR_ADDR=0xc8c3484
&HWIO_MMSS_CAMSS_VFE0_AHB_CBCR_ADDR=0xc8c3668
&HWIO_MMSS_CAMSS_VFE0_CBCR_ADDR=0xc8c36a8
&HWIO_MMSS_CAMSS_VFE0_STREAM_CBCR_ADDR=0xc8c3720
&HWIO_MMSS_CAMSS_VFE1_AHB_CBCR_ADDR=0xc8c3678
&HWIO_MMSS_CAMSS_VFE1_CBCR_ADDR=0xc8c36ac
&HWIO_MMSS_CAMSS_VFE1_STREAM_CBCR_ADDR=0xc8c3724
&HWIO_MMSS_CAMSS_VFE_VBIF_AHB_CBCR_ADDR=0xc8c36b8
&HWIO_MMSS_CAMSS_VFE_VBIF_AXI_CBCR_ADDR=0xc8c36bc
&HWIO_MMSS_CSIPHY_AHB2CRIF_CBCR_ADDR=0xc8c374c
&HWIO_MMSS_CXO_CBCR_ADDR=0xc8cc104
&HWIO_MMSS_MDSS_AHB_CBCR_ADDR=0xc8c2308
&HWIO_MMSS_MDSS_AXI_CBCR_ADDR=0xc8c2310
&HWIO_MMSS_MDSS_BYTE0_CBCR_ADDR=0xc8c233c
&HWIO_MMSS_MDSS_BYTE0_INTF_CBCR_ADDR=0xc8c2374
&HWIO_MMSS_MDSS_BYTE1_CBCR_ADDR=0xc8c2340
&HWIO_MMSS_MDSS_BYTE1_INTF_CBCR_ADDR=0xc8c2378
&HWIO_MMSS_MDSS_DP_AUX_CBCR_ADDR=0xc8c2364
&HWIO_MMSS_MDSS_DP_CRYPTO_CBCR_ADDR=0xc8c235c
&HWIO_MMSS_MDSS_DP_GTC_CBCR_ADDR=0xc8c2368
&HWIO_MMSS_MDSS_DP_LINK_CBCR_ADDR=0xc8c2354
&HWIO_MMSS_MDSS_DP_LINK_INTF_CBCR_ADDR=0xc8c2358
&HWIO_MMSS_MDSS_DP_PIXEL_CBCR_ADDR=0xc8c2360
&HWIO_MMSS_MDSS_ESC0_CBCR_ADDR=0xc8c2344
&HWIO_MMSS_MDSS_ESC1_CBCR_ADDR=0xc8c2348
&HWIO_MMSS_MDSS_HDMI_DP_AHB_CBCR_ADDR=0xc8c230c
&HWIO_MMSS_MDSS_MDP_CBCR_ADDR=0xc8c231c
&HWIO_MMSS_MDSS_PCLK0_CBCR_ADDR=0xc8c2314
&HWIO_MMSS_MDSS_PCLK1_CBCR_ADDR=0xc8c2318
&HWIO_MMSS_MDSS_ROT_CBCR_ADDR=0xc8c2350
&HWIO_MMSS_MDSS_VSYNC_CBCR_ADDR=0xc8c2328
&HWIO_MMSS_MISC_AHB_CBCR_ADDR=0xc8c0328
&HWIO_MMSS_MISC_CXO_CBCR_ADDR=0xc8c0324
&HWIO_MMSS_MNOC_AHB_CBCR_ADDR=0xc8c5024
&HWIO_MMSS_MNOC_AXI_CBCR_ADDR=0xc8cd028
&HWIO_MMSS_S0_AXI_CBCR_ADDR=0xc8cd024
&HWIO_MMSS_SLEEP_CBCR_ADDR=0xc8cc100
&HWIO_MMSS_SNOC_DVM_AXI_CBCR_ADDR=0xc8ce040
&HWIO_MMSS_SPDM_AHB_CBCR_ADDR=0xc8c0230
&HWIO_MMSS_SPDM_AXI_CBCR_ADDR=0xc8c0210
&HWIO_MMSS_SPDM_CPP_CBCR_ADDR=0xc8c0220
&HWIO_MMSS_SPDM_CSI0_CBCR_ADDR=0xc8c023c
&HWIO_MMSS_SPDM_DEBUG_CBCR_ADDR=0xc8c0240
&HWIO_MMSS_SPDM_DP_CRYPTO_CBCR_ADDR=0xc8c024c
&HWIO_MMSS_SPDM_DP_PIXEL_CBCR_ADDR=0xc8c0248
&HWIO_MMSS_SPDM_JPEG0_CBCR_ADDR=0xc8c0204
&HWIO_MMSS_SPDM_MDP_CBCR_ADDR=0xc8c020c
&HWIO_MMSS_SPDM_PCLK0_CBCR_ADDR=0xc8c0234
&HWIO_MMSS_SPDM_PCLK1_CBCR_ADDR=0xc8c0228
&HWIO_MMSS_SPDM_RM_AXI_CBCR_ADDR=0xc8c0304
&HWIO_MMSS_SPDM_ROT_CBCR_ADDR=0xc8c0244
&HWIO_MMSS_SPDM_VFE0_CBCR_ADDR=0xc8c0218
&HWIO_MMSS_SPDM_VFE1_CBCR_ADDR=0xc8c021c
&HWIO_MMSS_SPDM_VIDEO_CORE_CBCR_ADDR=0xc8c0214
&HWIO_MMSS_THROTTLE_CAMSS_AHB_CBCR_ADDR=0xc8c3c34
&HWIO_MMSS_THROTTLE_CAMSS_AXI_CBCR_ADDR=0xc8c3c3c
&HWIO_MMSS_THROTTLE_CAMSS_CXO_CBCR_ADDR=0xc8c3c38
&HWIO_MMSS_THROTTLE_MDSS_AHB_CBCR_ADDR=0xc8c2464
&HWIO_MMSS_THROTTLE_MDSS_AXI_CBCR_ADDR=0xc8c246c
&HWIO_MMSS_THROTTLE_MDSS_CXO_CBCR_ADDR=0xc8c2468
&HWIO_MMSS_THROTTLE_VIDEO_AHB_CBCR_ADDR=0xc8c1184
&HWIO_MMSS_THROTTLE_VIDEO_AXI_CBCR_ADDR=0xc8c118c
&HWIO_MMSS_THROTTLE_VIDEO_CXO_CBCR_ADDR=0xc8c1188
&HWIO_MMSS_VIDEO_AHB_CBCR_ADDR=0xc8c1030
&HWIO_MMSS_VIDEO_AXI_CBCR_ADDR=0xc8c1034
&HWIO_MMSS_VIDEO_CORE_CBCR_ADDR=0xc8c1028
&HWIO_MMSS_VIDEO_SUBCORE0_CBCR_ADDR=0xc8c1048

; CMD and CFG RCGRs for clocks with configurable frequencies
&HWIO_GCC_ACC_CMD_RCGR_ADDR=0x13e000
&HWIO_GCC_ACC_CFG_RCGR_ADDR=0x13e004
&HWIO_GCC_APC0_VS_CMD_RCGR_ADDR=0x17a0a4
&HWIO_GCC_APC0_VS_CFG_RCGR_ADDR=0x17a0a8
&HWIO_GCC_APC1_VS_CMD_RCGR_ADDR=0x17a0bc
&HWIO_GCC_APC1_VS_CFG_RCGR_ADDR=0x17a0c0
&HWIO_GCC_BIMC_CMD_RCGR_ADDR=0x145018
&HWIO_GCC_BIMC_CFG_RCGR_ADDR=0x14501c
&HWIO_GCC_BIMC_DDR_XO_CMD_RCGR_ADDR=0x145000
&HWIO_GCC_BIMC_DDR_XO_CFG_RCGR_ADDR=0x145004
&HWIO_GCC_BIMC_HMSS_AXI_CMD_RCGR_ADDR=0x14802c
&HWIO_GCC_BIMC_HMSS_AXI_CFG_RCGR_ADDR=0x148030
&HWIO_GCC_BLSP1_QUP1_I2C_APPS_CMD_RCGR_ADDR=0x119020
&HWIO_GCC_BLSP1_QUP1_I2C_APPS_CFG_RCGR_ADDR=0x119024
&HWIO_GCC_BLSP1_QUP1_SPI_APPS_CMD_RCGR_ADDR=0x11900c
&HWIO_GCC_BLSP1_QUP1_SPI_APPS_CFG_RCGR_ADDR=0x119010
&HWIO_GCC_BLSP1_QUP2_I2C_APPS_CMD_RCGR_ADDR=0x11b020
&HWIO_GCC_BLSP1_QUP2_I2C_APPS_CFG_RCGR_ADDR=0x11b024
&HWIO_GCC_BLSP1_QUP2_SPI_APPS_CMD_RCGR_ADDR=0x11b00c
&HWIO_GCC_BLSP1_QUP2_SPI_APPS_CFG_RCGR_ADDR=0x11b010
&HWIO_GCC_BLSP1_QUP3_I2C_APPS_CMD_RCGR_ADDR=0x11d020
&HWIO_GCC_BLSP1_QUP3_I2C_APPS_CFG_RCGR_ADDR=0x11d024
&HWIO_GCC_BLSP1_QUP3_SPI_APPS_CMD_RCGR_ADDR=0x11d00c
&HWIO_GCC_BLSP1_QUP3_SPI_APPS_CFG_RCGR_ADDR=0x11d010
&HWIO_GCC_BLSP1_QUP4_I2C_APPS_CMD_RCGR_ADDR=0x11f020
&HWIO_GCC_BLSP1_QUP4_I2C_APPS_CFG_RCGR_ADDR=0x11f024
&HWIO_GCC_BLSP1_QUP4_SPI_APPS_CMD_RCGR_ADDR=0x11f00c
&HWIO_GCC_BLSP1_QUP4_SPI_APPS_CFG_RCGR_ADDR=0x11f010
&HWIO_GCC_BLSP1_UART1_APPS_CMD_RCGR_ADDR=0x11a00c
&HWIO_GCC_BLSP1_UART1_APPS_CFG_RCGR_ADDR=0x11a010
&HWIO_GCC_BLSP1_UART2_APPS_CMD_RCGR_ADDR=0x11c00c
&HWIO_GCC_BLSP1_UART2_APPS_CFG_RCGR_ADDR=0x11c010
&HWIO_GCC_BLSP2_QUP1_I2C_APPS_CMD_RCGR_ADDR=0x126020
&HWIO_GCC_BLSP2_QUP1_I2C_APPS_CFG_RCGR_ADDR=0x126024
&HWIO_GCC_BLSP2_QUP1_SPI_APPS_CMD_RCGR_ADDR=0x12600c
&HWIO_GCC_BLSP2_QUP1_SPI_APPS_CFG_RCGR_ADDR=0x126010
&HWIO_GCC_BLSP2_QUP2_I2C_APPS_CMD_RCGR_ADDR=0x128020
&HWIO_GCC_BLSP2_QUP2_I2C_APPS_CFG_RCGR_ADDR=0x128024
&HWIO_GCC_BLSP2_QUP2_SPI_APPS_CMD_RCGR_ADDR=0x12800c
&HWIO_GCC_BLSP2_QUP2_SPI_APPS_CFG_RCGR_ADDR=0x128010
&HWIO_GCC_BLSP2_QUP3_I2C_APPS_CMD_RCGR_ADDR=0x12a020
&HWIO_GCC_BLSP2_QUP3_I2C_APPS_CFG_RCGR_ADDR=0x12a024
&HWIO_GCC_BLSP2_QUP3_SPI_APPS_CMD_RCGR_ADDR=0x12a00c
&HWIO_GCC_BLSP2_QUP3_SPI_APPS_CFG_RCGR_ADDR=0x12a010
&HWIO_GCC_BLSP2_QUP4_I2C_APPS_CMD_RCGR_ADDR=0x12c020
&HWIO_GCC_BLSP2_QUP4_I2C_APPS_CFG_RCGR_ADDR=0x12c024
&HWIO_GCC_BLSP2_QUP4_SPI_APPS_CMD_RCGR_ADDR=0x12c00c
&HWIO_GCC_BLSP2_QUP4_SPI_APPS_CFG_RCGR_ADDR=0x12c010
&HWIO_GCC_BLSP2_UART1_APPS_CMD_RCGR_ADDR=0x12700c
&HWIO_GCC_BLSP2_UART1_APPS_CFG_RCGR_ADDR=0x127010
&HWIO_GCC_BLSP2_UART2_APPS_CMD_RCGR_ADDR=0x12900c
&HWIO_GCC_BLSP2_UART2_APPS_CFG_RCGR_ADDR=0x129010
&HWIO_GCC_BLSP_UART_SIM_CMD_RCGR_ADDR=0x118000
&HWIO_GCC_BLSP_UART_SIM_CFG_RCGR_ADDR=0x118004
&HWIO_GCC_CDSP_BIMC_CMD_RCGR_ADDR=0x147030
&HWIO_GCC_CDSP_BIMC_CFG_RCGR_ADDR=0x147034
&HWIO_GCC_CE1_CMD_RCGR_ADDR=0x141010
&HWIO_GCC_CE1_CFG_RCGR_ADDR=0x141014
&HWIO_GCC_CNOC_PERIPH_CMD_RCGR_ADDR=0x105050
&HWIO_GCC_CNOC_PERIPH_CFG_RCGR_ADDR=0x105054
&HWIO_GCC_CONFIG_NOC_CMD_RCGR_ADDR=0x105038
&HWIO_GCC_CONFIG_NOC_CFG_RCGR_ADDR=0x10503c
&HWIO_GCC_GLM_CMD_RCGR_ADDR=0x18b010
&HWIO_GCC_GLM_CFG_RCGR_ADDR=0x18b014
&HWIO_GCC_GP1_CMD_RCGR_ADDR=0x164004
&HWIO_GCC_GP1_CFG_RCGR_ADDR=0x164008
&HWIO_GCC_GP2_CMD_RCGR_ADDR=0x165004
&HWIO_GCC_GP2_CFG_RCGR_ADDR=0x165008
&HWIO_GCC_GP3_CMD_RCGR_ADDR=0x166004
&HWIO_GCC_GP3_CFG_RCGR_ADDR=0x166008
&HWIO_GCC_GPU_BIMC_GFX_CMD_RCGR_ADDR=0x17101c
&HWIO_GCC_GPU_BIMC_GFX_CFG_RCGR_ADDR=0x171020
&HWIO_GCC_HMSS_AHB_CMD_RCGR_ADDR=0x148014
&HWIO_GCC_HMSS_AHB_CFG_RCGR_ADDR=0x148018
&HWIO_GCC_HMSS_RBCPR_CMD_RCGR_ADDR=0x148044
&HWIO_GCC_HMSS_RBCPR_CFG_RCGR_ADDR=0x148048
&HWIO_GCC_MMSS_QM_CORE_CMD_RCGR_ADDR=0x109014
&HWIO_GCC_MMSS_QM_CORE_CFG_RCGR_ADDR=0x109018
&HWIO_GCC_MSS_Q6_BIMC_AXI_CMD_RCGR_ADDR=0x18a024
&HWIO_GCC_MSS_Q6_BIMC_AXI_CFG_RCGR_ADDR=0x18a028
&HWIO_GCC_MSS_VS_CMD_RCGR_ADDR=0x17a074
&HWIO_GCC_MSS_VS_CFG_RCGR_ADDR=0x17a078
&HWIO_GCC_PDM2_CMD_RCGR_ADDR=0x133010
&HWIO_GCC_PDM2_CFG_RCGR_ADDR=0x133014
&HWIO_GCC_PIMEM_AXI_CMD_RCGR_ADDR=0x10a008
&HWIO_GCC_PIMEM_AXI_CFG_RCGR_ADDR=0x10a00c
&HWIO_GCC_QDSS_APB_TRIG_CMD_RCGR_ADDR=0x10e030
&HWIO_GCC_QDSS_APB_TRIG_CFG_RCGR_ADDR=0x10e034
&HWIO_GCC_QDSS_ATB_A_CMD_RCGR_ADDR=0x10d000
&HWIO_GCC_QDSS_ATB_A_CFG_RCGR_ADDR=0x10d004
&HWIO_GCC_QDSS_STM_CMD_RCGR_ADDR=0x10d048
&HWIO_GCC_QDSS_STM_CFG_RCGR_ADDR=0x10d04c
&HWIO_GCC_QDSS_TRACECLKIN_CMD_RCGR_ADDR=0x10e000
&HWIO_GCC_QDSS_TRACECLKIN_CFG_RCGR_ADDR=0x10e004
&HWIO_GCC_QDSS_TSCTR_CMD_RCGR_ADDR=0x10e018
&HWIO_GCC_QDSS_TSCTR_CFG_RCGR_ADDR=0x10e01c
&HWIO_GCC_QSPI_SER_CMD_RCGR_ADDR=0x14d00c
&HWIO_GCC_QSPI_SER_CFG_RCGR_ADDR=0x14d010
&HWIO_GCC_RBCPR_CX_CMD_RCGR_ADDR=0x14e00c
&HWIO_GCC_RBCPR_CX_CFG_RCGR_ADDR=0x14e010
&HWIO_GCC_RBCPR_MX_CMD_RCGR_ADDR=0x14f00c
&HWIO_GCC_RBCPR_MX_CFG_RCGR_ADDR=0x14f010
&HWIO_GCC_RPM_CMD_RCGR_ADDR=0x13c018
&HWIO_GCC_RPM_CFG_RCGR_ADDR=0x13c01c
&HWIO_GCC_SDCC1_APPS_CMD_RCGR_ADDR=0x11602c
&HWIO_GCC_SDCC1_APPS_CFG_RCGR_ADDR=0x116030
&HWIO_GCC_SDCC1_ICE_CORE_CMD_RCGR_ADDR=0x116010
&HWIO_GCC_SDCC1_ICE_CORE_CFG_RCGR_ADDR=0x116014
&HWIO_GCC_SDCC2_APPS_CMD_RCGR_ADDR=0x114010
&HWIO_GCC_SDCC2_APPS_CFG_RCGR_ADDR=0x114014
&HWIO_GCC_SEC_CTRL_CMD_RCGR_ADDR=0x13e018
&HWIO_GCC_SEC_CTRL_CFG_RCGR_ADDR=0x13e01c
&HWIO_GCC_SPMI_AHB_CMD_RCGR_ADDR=0x13f028
&HWIO_GCC_SPMI_AHB_CFG_RCGR_ADDR=0x13f02c
&HWIO_GCC_SPMI_SER_CMD_RCGR_ADDR=0x13f010
&HWIO_GCC_SPMI_SER_CFG_RCGR_ADDR=0x13f014
&HWIO_GCC_SYS_NOC_HS_AXI_CMD_RCGR_ADDR=0x104040
&HWIO_GCC_SYS_NOC_HS_AXI_CFG_RCGR_ADDR=0x104044
&HWIO_GCC_SYSTEM_NOC_CMD_RCGR_ADDR=0x104020
&HWIO_GCC_SYSTEM_NOC_CFG_RCGR_ADDR=0x104024
&HWIO_GCC_UFS_AXI_CMD_RCGR_ADDR=0x175018
&HWIO_GCC_UFS_AXI_CFG_RCGR_ADDR=0x17501c
&HWIO_GCC_UFS_ICE_CORE_CMD_RCGR_ADDR=0x176010
&HWIO_GCC_UFS_ICE_CORE_CFG_RCGR_ADDR=0x176014
&HWIO_GCC_UFS_PHY_AUX_CMD_RCGR_ADDR=0x176044
&HWIO_GCC_UFS_PHY_AUX_CFG_RCGR_ADDR=0x176048
&HWIO_GCC_UFS_UNIPRO_CORE_CMD_RCGR_ADDR=0x176028
&HWIO_GCC_UFS_UNIPRO_CORE_CFG_RCGR_ADDR=0x17602c
&HWIO_GCC_USB20_MASTER_CMD_RCGR_ADDR=0x12f010
&HWIO_GCC_USB20_MASTER_CFG_RCGR_ADDR=0x12f014
&HWIO_GCC_USB20_MOCK_UTMI_CMD_RCGR_ADDR=0x12f024
&HWIO_GCC_USB20_MOCK_UTMI_CFG_RCGR_ADDR=0x12f028
&HWIO_GCC_USB30_MASTER_CMD_RCGR_ADDR=0x10f014
&HWIO_GCC_USB30_MASTER_CFG_RCGR_ADDR=0x10f018
&HWIO_GCC_USB30_MOCK_UTMI_CMD_RCGR_ADDR=0x10f028
&HWIO_GCC_USB30_MOCK_UTMI_CFG_RCGR_ADDR=0x10f02c
&HWIO_GCC_USB3_PHY_AUX_CMD_RCGR_ADDR=0x15000c
&HWIO_GCC_USB3_PHY_AUX_CFG_RCGR_ADDR=0x150010
&HWIO_GCC_VDDA_VS_CMD_RCGR_ADDR=0x17a044
&HWIO_GCC_VDDA_VS_CFG_RCGR_ADDR=0x17a048
&HWIO_GCC_VDDCX_VS_CMD_RCGR_ADDR=0x17a014
&HWIO_GCC_VDDCX_VS_CFG_RCGR_ADDR=0x17a018
&HWIO_GCC_VDDMX_VS_CMD_RCGR_ADDR=0x17a02c
&HWIO_GCC_VDDMX_VS_CFG_RCGR_ADDR=0x17a030
&HWIO_GCC_VS_CTRL_CMD_RCGR_ADDR=0x17a05c
&HWIO_GCC_VS_CTRL_CFG_RCGR_ADDR=0x17a060
&HWIO_GCC_WCSS_VS_CMD_RCGR_ADDR=0x17a08c
&HWIO_GCC_WCSS_VS_CFG_RCGR_ADDR=0x17a090
&HWIO_GPUCC_GFX3D_CMD_RCGR_ADDR=0x5066070
&HWIO_GPUCC_GFX3D_CFG_RCGR_ADDR=0x5066074
&HWIO_GPUCC_RBBMTIMER_CMD_RCGR_ADDR=0x50660b0
&HWIO_GPUCC_RBBMTIMER_CFG_RCGR_ADDR=0x50660b4
&HWIO_GPUCC_RBCPR_CMD_RCGR_ADDR=0x5066030
&HWIO_GPUCC_RBCPR_CFG_RCGR_ADDR=0x5066034
&HWIO_LPASS_AON_CMD_RCGR_ADDR=0x15014000
&HWIO_LPASS_AON_CFG_RCGR_ADDR=0x15014004
&HWIO_LPASS_ATIME_CMD_RCGR_ADDR=0x15015000
&HWIO_LPASS_ATIME_CFG_RCGR_ADDR=0x15015004
&HWIO_LPASS_AUD_SLIMBUS_CMD_RCGR_ADDR=0x15017000
&HWIO_LPASS_AUD_SLIMBUS_CFG_RCGR_ADDR=0x15017004
&HWIO_LPASS_CORE_CMD_RCGR_ADDR=0x1501d000
&HWIO_LPASS_CORE_CFG_RCGR_ADDR=0x1501d004
&HWIO_LPASS_EXT_MCLK0_CMD_RCGR_ADDR=0x15020000
&HWIO_LPASS_EXT_MCLK0_CFG_RCGR_ADDR=0x15020004
&HWIO_LPASS_EXT_MCLK1_CMD_RCGR_ADDR=0x15021000
&HWIO_LPASS_EXT_MCLK1_CFG_RCGR_ADDR=0x15021004
&HWIO_LPASS_EXT_MCLK2_CMD_RCGR_ADDR=0x15022000
&HWIO_LPASS_EXT_MCLK2_CFG_RCGR_ADDR=0x15022004
&HWIO_LPASS_EXT_MCLK3_CMD_RCGR_ADDR=0x15027000
&HWIO_LPASS_EXT_MCLK3_CFG_RCGR_ADDR=0x15027004
&HWIO_LPASS_INT_I2S0_1_CMD_RCGR_ADDR=0x1504e000
&HWIO_LPASS_INT_I2S0_1_CFG_RCGR_ADDR=0x1504e004
&HWIO_LPASS_INT_I2S2_CMD_RCGR_ADDR=0x1504f000
&HWIO_LPASS_INT_I2S2_CFG_RCGR_ADDR=0x1504f004
&HWIO_LPASS_INT_I2S3_CMD_RCGR_ADDR=0x15050000
&HWIO_LPASS_INT_I2S3_CFG_RCGR_ADDR=0x15050004
&HWIO_LPASS_INT_I2S4_CMD_RCGR_ADDR=0x15051000
&HWIO_LPASS_INT_I2S4_CFG_RCGR_ADDR=0x15051004
&HWIO_LPASS_INT_I2S5_6_CMD_RCGR_ADDR=0x15052000
&HWIO_LPASS_INT_I2S5_6_CFG_RCGR_ADDR=0x15052004
&HWIO_LPASS_INT_MCLK0_CMD_RCGR_ADDR=0x15053000
&HWIO_LPASS_INT_MCLK0_CFG_RCGR_ADDR=0x15053004
&HWIO_LPASS_INT_MCLK1_CMD_RCGR_ADDR=0x15054000
&HWIO_LPASS_INT_MCLK1_CFG_RCGR_ADDR=0x15054004
&HWIO_LPASS_LPAIF_PCMOE_CMD_RCGR_ADDR=0x15019000
&HWIO_LPASS_LPAIF_PCMOE_CFG_RCGR_ADDR=0x15019004
&HWIO_LPASS_LPAIF_PRI_CMD_RCGR_ADDR=0x15010000
&HWIO_LPASS_LPAIF_PRI_CFG_RCGR_ADDR=0x15010004
&HWIO_LPASS_LPAIF_QUAD_CMD_RCGR_ADDR=0x15013000
&HWIO_LPASS_LPAIF_QUAD_CFG_RCGR_ADDR=0x15013004
&HWIO_LPASS_LPAIF_SEC_CMD_RCGR_ADDR=0x15011000
&HWIO_LPASS_LPAIF_SEC_CFG_RCGR_ADDR=0x15011004
&HWIO_LPASS_LPAIF_TER_CMD_RCGR_ADDR=0x15012000
&HWIO_LPASS_LPAIF_TER_CFG_RCGR_ADDR=0x15012004
&HWIO_LPASS_Q6_SPM_CMD_RCGR_ADDR=0x15049000
&HWIO_LPASS_Q6_SPM_CFG_RCGR_ADDR=0x15049004
&HWIO_LPASS_QCA_SLIMBUS_CMD_RCGR_ADDR=0x15018000
&HWIO_LPASS_QCA_SLIMBUS_CFG_RCGR_ADDR=0x15018004
&HWIO_LPASS_QOS_FIXED_LAT_COUNTER_CMD_RCGR_ADDR=0x15035000
&HWIO_LPASS_QOS_FIXED_LAT_COUNTER_CFG_RCGR_ADDR=0x15035004
&HWIO_LPASS_RESAMPLER_CMD_RCGR_ADDR=0x15016000
&HWIO_LPASS_RESAMPLER_CFG_RCGR_ADDR=0x15016004
&HWIO_LPASS_SCC_100M_CMD_RCGR_ADDR=0x1503f000
&HWIO_LPASS_SCC_100M_CFG_RCGR_ADDR=0x1503f004
&HWIO_LPASS_SCC_AON_DBG_CMD_RCGR_ADDR=0x1502d004
&HWIO_LPASS_SCC_AON_DBG_CFG_RCGR_ADDR=0x1502d008
&HWIO_LPASS_SCC_AON_DBG_TSCTR_CMD_RCGR_ADDR=0x1502e004
&HWIO_LPASS_SCC_AON_DBG_TSCTR_CFG_RCGR_ADDR=0x1502e008
&HWIO_LPASS_SCC_UART1_CMD_RCGR_ADDR=0x15043004
&HWIO_LPASS_SCC_UART1_CFG_RCGR_ADDR=0x15043008
&HWIO_LPASS_SCC_UART2_CMD_RCGR_ADDR=0x15044004
&HWIO_LPASS_SCC_UART2_CFG_RCGR_ADDR=0x15044008
&HWIO_LPASS_SCC_UART3_CMD_RCGR_ADDR=0x15045004
&HWIO_LPASS_SCC_UART3_CFG_RCGR_ADDR=0x15045008
&HWIO_LPASS_SCC_UART4_CMD_RCGR_ADDR=0x15055004
&HWIO_LPASS_SCC_UART4_CFG_RCGR_ADDR=0x15055008
&HWIO_LPASS_SCC_VS_VDDCX_CMD_RCGR_ADDR=0x15048030
&HWIO_LPASS_SCC_VS_VDDCX_CFG_RCGR_ADDR=0x15048034
&HWIO_LPASS_SCC_VS_VDDMX_CMD_RCGR_ADDR=0x15048018
&HWIO_LPASS_SCC_VS_VDDMX_CFG_RCGR_ADDR=0x1504801c
&HWIO_LPASS_SLEEP_CMD_RCGR_ADDR=0x1501a000
&HWIO_LPASS_SLEEP_CFG_RCGR_ADDR=0x1501a004
&HWIO_LPASS_SW_NPL_CMD_RCGR_ADDR=0x1504d000
&HWIO_LPASS_SW_NPL_CFG_RCGR_ADDR=0x1504d004
&HWIO_LPASS_XO_CMD_RCGR_ADDR=0x1501b000
&HWIO_LPASS_XO_CFG_RCGR_ADDR=0x1501b004
&HWIO_MMSS_AHB_CMD_RCGR_ADDR=0xc8c5000
&HWIO_MMSS_AHB_CFG_RCGR_ADDR=0xc8c5004
&HWIO_MMSS_AXI_CMD_RCGR_ADDR=0xc8cd000
&HWIO_MMSS_AXI_CFG_RCGR_ADDR=0xc8cd004
&HWIO_MMSS_BYTE0_CMD_RCGR_ADDR=0xc8c2120
&HWIO_MMSS_BYTE0_CFG_RCGR_ADDR=0xc8c2124
&HWIO_MMSS_BYTE1_CMD_RCGR_ADDR=0xc8c2140
&HWIO_MMSS_BYTE1_CFG_RCGR_ADDR=0xc8c2144
&HWIO_MMSS_CAMSS_GP0_CMD_RCGR_ADDR=0xc8c3420
&HWIO_MMSS_CAMSS_GP0_CFG_RCGR_ADDR=0xc8c3424
&HWIO_MMSS_CAMSS_GP1_CMD_RCGR_ADDR=0xc8c3450
&HWIO_MMSS_CAMSS_GP1_CFG_RCGR_ADDR=0xc8c3454
&HWIO_MMSS_CCI_CMD_RCGR_ADDR=0xc8c3300
&HWIO_MMSS_CCI_CFG_RCGR_ADDR=0xc8c3304
&HWIO_MMSS_CPP_CMD_RCGR_ADDR=0xc8c3640
&HWIO_MMSS_CPP_CFG_RCGR_ADDR=0xc8c3644
&HWIO_MMSS_CSI0_CMD_RCGR_ADDR=0xc8c3090
&HWIO_MMSS_CSI0_CFG_RCGR_ADDR=0xc8c3094
&HWIO_MMSS_CSI0PHYTIMER_CMD_RCGR_ADDR=0xc8c3000
&HWIO_MMSS_CSI0PHYTIMER_CFG_RCGR_ADDR=0xc8c3004
&HWIO_MMSS_CSI1_CMD_RCGR_ADDR=0xc8c3100
&HWIO_MMSS_CSI1_CFG_RCGR_ADDR=0xc8c3104
&HWIO_MMSS_CSI1PHYTIMER_CMD_RCGR_ADDR=0xc8c3030
&HWIO_MMSS_CSI1PHYTIMER_CFG_RCGR_ADDR=0xc8c3034
&HWIO_MMSS_CSI2_CMD_RCGR_ADDR=0xc8c3160
&HWIO_MMSS_CSI2_CFG_RCGR_ADDR=0xc8c3164
&HWIO_MMSS_CSI2PHYTIMER_CMD_RCGR_ADDR=0xc8c3060
&HWIO_MMSS_CSI2PHYTIMER_CFG_RCGR_ADDR=0xc8c3064
&HWIO_MMSS_CSI3_CMD_RCGR_ADDR=0xc8c31c0
&HWIO_MMSS_CSI3_CFG_RCGR_ADDR=0xc8c31c4
&HWIO_MMSS_CSIPHY_CMD_RCGR_ADDR=0xc8c3800
&HWIO_MMSS_CSIPHY_CFG_RCGR_ADDR=0xc8c3804
&HWIO_MMSS_DP_AUX_CMD_RCGR_ADDR=0xc8c2260
&HWIO_MMSS_DP_AUX_CFG_RCGR_ADDR=0xc8c2264
&HWIO_MMSS_DP_CRYPTO_CMD_RCGR_ADDR=0xc8c2220
&HWIO_MMSS_DP_CRYPTO_CFG_RCGR_ADDR=0xc8c2224
&HWIO_MMSS_DP_GTC_CMD_RCGR_ADDR=0xc8c2280
&HWIO_MMSS_DP_GTC_CFG_RCGR_ADDR=0xc8c2284
&HWIO_MMSS_DP_LINK_CMD_RCGR_ADDR=0xc8c2200
&HWIO_MMSS_DP_LINK_CFG_RCGR_ADDR=0xc8c2204
&HWIO_MMSS_DP_PIXEL_CMD_RCGR_ADDR=0xc8c2240
&HWIO_MMSS_DP_PIXEL_CFG_RCGR_ADDR=0xc8c2244
&HWIO_MMSS_ESC0_CMD_RCGR_ADDR=0xc8c2160
&HWIO_MMSS_ESC0_CFG_RCGR_ADDR=0xc8c2164
&HWIO_MMSS_ESC1_CMD_RCGR_ADDR=0xc8c2180
&HWIO_MMSS_ESC1_CFG_RCGR_ADDR=0xc8c2184
&HWIO_MMSS_JPEG0_CMD_RCGR_ADDR=0xc8c3500
&HWIO_MMSS_JPEG0_CFG_RCGR_ADDR=0xc8c3504
&HWIO_MMSS_MCLK0_CMD_RCGR_ADDR=0xc8c3360
&HWIO_MMSS_MCLK0_CFG_RCGR_ADDR=0xc8c3364
&HWIO_MMSS_MCLK1_CMD_RCGR_ADDR=0xc8c3390
&HWIO_MMSS_MCLK1_CFG_RCGR_ADDR=0xc8c3394
&HWIO_MMSS_MCLK2_CMD_RCGR_ADDR=0xc8c33c0
&HWIO_MMSS_MCLK2_CFG_RCGR_ADDR=0xc8c33c4
&HWIO_MMSS_MCLK3_CMD_RCGR_ADDR=0xc8c33f0
&HWIO_MMSS_MCLK3_CFG_RCGR_ADDR=0xc8c33f4
&HWIO_MMSS_MDP_CMD_RCGR_ADDR=0xc8c2040
&HWIO_MMSS_MDP_CFG_RCGR_ADDR=0xc8c2044
&HWIO_MMSS_PCLK0_CMD_RCGR_ADDR=0xc8c2000
&HWIO_MMSS_PCLK0_CFG_RCGR_ADDR=0xc8c2004
&HWIO_MMSS_PCLK1_CMD_RCGR_ADDR=0xc8c2020
&HWIO_MMSS_PCLK1_CFG_RCGR_ADDR=0xc8c2024
&HWIO_MMSS_ROT_CMD_RCGR_ADDR=0xc8c21a0
&HWIO_MMSS_ROT_CFG_RCGR_ADDR=0xc8c21a4
&HWIO_MMSS_VFE0_CMD_RCGR_ADDR=0xc8c3600
&HWIO_MMSS_VFE0_CFG_RCGR_ADDR=0xc8c3604
&HWIO_MMSS_VFE1_CMD_RCGR_ADDR=0xc8c3620
&HWIO_MMSS_VFE1_CFG_RCGR_ADDR=0xc8c3624
&HWIO_MMSS_VIDEO_CORE_CMD_RCGR_ADDR=0xc8c1000
&HWIO_MMSS_VIDEO_CORE_CFG_RCGR_ADDR=0xc8c1004
&HWIO_MMSS_VSYNC_CMD_RCGR_ADDR=0xc8c2080
&HWIO_MMSS_VSYNC_CFG_RCGR_ADDR=0xc8c2084

; Utility registers
&HWIO_GCC_GCC_XO_DIV4_CBCR_ADDR=0x143008
&HWIO_GCC_PLLTEST_PAD_CFG_ADDR=0x16200c
&HWIO_TLMM_GPIO_CFG11_ADDR=0x390B000
&HWIO_GCC_CLOCK_FRQ_MEASURE_STATUS_ADDR=0x162008
&HWIO_GCC_CLOCK_FRQ_MEASURE_CTL_ADDR=0x162004
&HWIO_GCC_GCC_DEBUG_CLK_CTL_ADDR=0x162000
; Vote registers
v.new int[2] \vote_regs
v.a \vote_regs[0]=0x157004
v.a \vote_regs[1]=0x157008

; Constants for setting clock frequencies
&HAL_CLK_CMD_CFG_UPDATE_FMSK=0x1
&HAL_CLK_CFG_CGR_SRC_SEL_SHFT=0x8
&HAL_CLK_CFG_CGR_SRC_DIV_SHFT=0x0
&HAL_CLK_CFG_CGR_SRC_SEL_FMSK=0x700
&HAL_CLK_CFG_CGR_SRC_DIV_FMSK=0x1f
&HAL_CLK_CFG_CGR_MODE_FMSK=0x3000
&HAL_CLK_CFG_CFG_DUAL_EDGE_MODE_VAL=0x2
&HAL_CLK_CFG_CGR_MODE_SHFT=0xc
&HAL_CLK_M_REG_OFFSET=0x8
&HAL_CLK_N_REG_OFFSET=0xc
&HAL_CLK_D_REG_OFFSET=0x10


; Test Masks
&CLK_TEST_TYPE_MASK=(0x00007FFF)
&CLK_TEST_SEL_MASK=(0x000F0000)
&CLK_TEST_SUB_MUX_MASK=(0xF0000000)

; APCS Debug register
&HWIO_APCS_ALIAS0_GLB_CLK_DIAG_ADDR=0x1791101c

; APCS Test Mask
&CLK_APCS_TEST=(0x1<<0x10)

; CDSP Debug register
&HWIO_TURING_DBG_CLK_ADDR=0x1a03c000

; CDSP Test Mask
&CLK_CDSP_TEST=(0x2<<0x10)

; DDRSS Debug register
&HWIO_MCCC_MCCC_CH0_SPARE0_ADDR=0xffd0c8

; DDRSS Test Mask
&CLK_DDRSS_TEST=(0x3<<0x10)

; GCC Debug register
&HWIO_GCC_GCC_DEBUG_CLK_CTL_ADDR=0x162000

; GCC Test Mask
&CLK_GCC_TEST=(0x4<<0x10)

; GPU Debug register
&HWIO_GPUCC_DEBUG_CLK_CTL_ADDR=0x5065120

; GPU Test Mask
&CLK_GPU_TEST=(0x5<<0x10)

; LPASS Debug register
&HWIO_LPASS_DBG_CLK_ADDR=0x15057000

; LPASS Test Mask
&CLK_LPASS_TEST=(0x6<<0x10)

; LPASS_Q6 Debug register
&HWIO_LPASS_QDSP6SS_TEST_CLK_CTL_ADDR=0x15702010

; LPASS_Q6 Test Mask
&CLK_LPASS_Q6_TEST=(0x7<<0x10)

; MMSS Debug register
&HWIO_MMSS_DEBUG_CLK_CTL_ADDR=0xc8c0900

; MMSS Test Mask
&CLK_MMSS_TEST=(0x8<<0x10)

; MSS Debug register
&HWIO_MSS_DEBUG_CLOCK_CTL_ADDR=0x41a8014

; MSS Test Mask
&CLK_MSS_TEST=(0x9<<0x10)

; MSS_Q6 Debug register
&HWIO_MSS_QDSP6SS_TEST_CLK_CTL_ADDR=0x4082010

; MSS_Q6 Test Mask
&CLK_MSS_Q6_TEST=(0xa<<0x10)

; WCSS Debug register
&HWIO_WCSS_HM_A_WCSS_CLK_CTL_WCSS_DEBUG_CLK_ADDR=0x189d6f00

; WCSS Test Mask
&CLK_WCSS_TEST=(0xb<<0x10)


; APCS test clocks
&CLK_TEST_APC0_SYSLEAF_CLK=(&CLK_APCS_TEST|0x000)
&CLK_TEST_APC1_SYSLEAF_CLK=(&CLK_APCS_TEST|0x001)
&CLK_TEST_GLADIATOR_SYSLEAF_CLK=(&CLK_APCS_TEST|0x002)
&CLK_TEST_SYS_APCSQSB_CLK=(&CLK_APCS_TEST|0x050)
&CLK_TEST_IM_SLEEP_CLK=(&CLK_APCS_TEST|0x070)
&CLK_TEST_LMH_LITE_CLK=(&CLK_APCS_TEST|0x212)
&CLK_TEST_CL0_APCPLL_LOCKDET=(&CLK_APCS_TEST|0x201)
&CLK_TEST_CL1_APCPLL_LOCKDET=(&CLK_APCS_TEST|0x211)
&CLK_TEST_CCI_APCPLL_LOCKDET=(&CLK_APCS_TEST|0x202)

; CDSP test clocks
&CLK_TEST_AON_CLK_SRC=(&CLK_CDSP_TEST|0x016)
&CLK_TEST_Q6SS_AHBM_AON_CLK=(&CLK_CDSP_TEST|0x04A)
&CLK_TEST_Q6SS_AHBS_AON_CLK=(&CLK_CDSP_TEST|0x050)
&CLK_TEST_TURING_WRAPPER_AON_CLK=(&CLK_CDSP_TEST|0x044)
&CLK_TEST_TURING_WRAPPER_BUS_TIMEOUT_AON_CLK=(&CLK_CDSP_TEST|0x056)
&CLK_TEST_TURING_WRAPPER_MPU_CFG_AON_CLK=(&CLK_CDSP_TEST|0x04E)
&CLK_TEST_TURING_WRAPPER_Q6_AHBM_MPU_AON_CLK=(&CLK_CDSP_TEST|0x04F)
&CLK_TEST_TURING_WRAPPER_QOS_AHBS_AON_CLK=(&CLK_CDSP_TEST|0x045)
&CLK_TEST_TURING_WRAPPER_SYSNOC_SWAY_AON_CLK=(&CLK_CDSP_TEST|0x049)
&CLK_TEST_TURING_WRAPPER_SYSNOC_SWAY_SNOC_CLK=(&CLK_CDSP_TEST|0x043)
&CLK_TEST_QOS_FIXED_LAT_COUNTER_SRC=(&CLK_CDSP_TEST|0x022)
&CLK_TEST_TURING_WRAPPER_QOS_DANGER_FIXED_LAT_COUNTER_CLK=(&CLK_CDSP_TEST|0x053)
&CLK_TEST_TURING_WRAPPER_QOS_DMONITOR_FIXED_LAT_COUNTER_CLK=(&CLK_CDSP_TEST|0x052)
&CLK_TEST_SLEEP_CLK_SRC=(&CLK_CDSP_TEST|0x00A)
&CLK_TEST_XO_CLK_SRC=(&CLK_CDSP_TEST|0x01D)
&CLK_TEST_AUDIO_CORE_GDSC_XO_CLK=(&CLK_CDSP_TEST|0x023)
&CLK_TEST_TURING_WRAPPER_Q6_SMMU_GDSC_XO_CLK=(&CLK_CDSP_TEST|0x04C)
&CLK_TEST_TURING_WRAPPER_QOS_XO_LAT_COUNTER_CLK=(&CLK_CDSP_TEST|0x051)

; DDRSS test clocks
&CLK_TEST_DDRSS_CH0_MC_CLK=(&CLK_DDRSS_TEST|0x2)
&CLK_TEST_DDRSS_CH1_MC_CLK=(&CLK_DDRSS_TEST|0x3)

; GCC test clocks
&CLK_TEST_GCC_SEC_CTRL_ACC_CLK=(&CLK_GCC_TEST|0x088)
&CLK_TEST_GCC_APC0_VS_CLK=(&CLK_GCC_TEST|0x101)
&CLK_TEST_GCC_APC1_VS_CLK=(&CLK_GCC_TEST|0x102)
&CLK_TEST_GCC_BIMC_CLK=(&CLK_GCC_TEST|0x0A2)
&CLK_TEST_GCC_SPDM_BIMC_CY_CLK=(&CLK_GCC_TEST|0x093)
&CLK_TEST_GCC_BIMC_DDR_CPLL0_CLK=(&CLK_GCC_TEST|0x0A9)
&CLK_TEST_GCC_BIMC_DDR_CPLL1_CLK=(&CLK_GCC_TEST|0x0AA)
&CLK_TEST_GCC_BIMC_DTTS_XO_CLK=(&CLK_GCC_TEST|0x0A7)
&CLK_TEST_GCC_BIMC_XO_CLK=(&CLK_GCC_TEST|0x09E)
&CLK_TEST_GCC_CFG_NOC_DDR_CFG_CLK=(&CLK_GCC_TEST|0x012)
&CLK_TEST_GCC_CNOC_BUS_TIMEOUT5_AHB_CLK=(&CLK_GCC_TEST|0x0CC)
&CLK_TEST_GCC_DDR_DIM_CFG_CLK=(&CLK_GCC_TEST|0x0A8)
&CLK_TEST_GCC_BIMC_HMSS_AXI_CLK=(&CLK_GCC_TEST|0x0BB)
&CLK_TEST_GCC_BLSP1_QUP1_I2C_APPS_CLK=(&CLK_GCC_TEST|0x04D)
&CLK_TEST_GCC_BLSP1_QUP1_SPI_APPS_CLK=(&CLK_GCC_TEST|0x04C)
&CLK_TEST_GCC_BLSP1_QUP2_I2C_APPS_CLK=(&CLK_GCC_TEST|0x051)
&CLK_TEST_GCC_BLSP1_QUP2_SPI_APPS_CLK=(&CLK_GCC_TEST|0x050)
&CLK_TEST_GCC_BLSP1_QUP3_I2C_APPS_CLK=(&CLK_GCC_TEST|0x055)
&CLK_TEST_GCC_BLSP1_QUP3_SPI_APPS_CLK=(&CLK_GCC_TEST|0x054)
&CLK_TEST_GCC_BLSP1_QUP4_I2C_APPS_CLK=(&CLK_GCC_TEST|0x059)
&CLK_TEST_GCC_BLSP1_QUP4_SPI_APPS_CLK=(&CLK_GCC_TEST|0x058)
&CLK_TEST_GCC_BLSP1_UART1_APPS_CLK=(&CLK_GCC_TEST|0x04E)
&CLK_TEST_GCC_BLSP1_UART2_APPS_CLK=(&CLK_GCC_TEST|0x052)
&CLK_TEST_GCC_BLSP2_QUP1_I2C_APPS_CLK=(&CLK_GCC_TEST|0x061)
&CLK_TEST_GCC_BLSP2_QUP1_SPI_APPS_CLK=(&CLK_GCC_TEST|0x060)
&CLK_TEST_GCC_BLSP2_QUP2_I2C_APPS_CLK=(&CLK_GCC_TEST|0x065)
&CLK_TEST_GCC_BLSP2_QUP2_SPI_APPS_CLK=(&CLK_GCC_TEST|0x064)
&CLK_TEST_GCC_BLSP2_QUP3_I2C_APPS_CLK=(&CLK_GCC_TEST|0x069)
&CLK_TEST_GCC_BLSP2_QUP3_SPI_APPS_CLK=(&CLK_GCC_TEST|0x068)
&CLK_TEST_GCC_BLSP2_QUP4_I2C_APPS_CLK=(&CLK_GCC_TEST|0x06D)
&CLK_TEST_GCC_BLSP2_QUP4_SPI_APPS_CLK=(&CLK_GCC_TEST|0x06C)
&CLK_TEST_GCC_BLSP2_UART1_APPS_CLK=(&CLK_GCC_TEST|0x062)
&CLK_TEST_GCC_BLSP2_UART2_APPS_CLK=(&CLK_GCC_TEST|0x066)
&CLK_TEST_GCC_BLSP1_UART1_SIM_CLK=(&CLK_GCC_TEST|0x04F)
&CLK_TEST_GCC_BLSP1_UART2_SIM_CLK=(&CLK_GCC_TEST|0x053)
&CLK_TEST_GCC_BLSP2_UART1_SIM_CLK=(&CLK_GCC_TEST|0x063)
&CLK_TEST_GCC_BLSP2_UART2_SIM_CLK=(&CLK_GCC_TEST|0x067)
&CLK_TEST_GCC_CDSP_BIMC_CLK=(&CLK_GCC_TEST|0x174)
&CLK_TEST_GCC_SYS_NOC_CDSP_CLK=(&CLK_GCC_TEST|0x177)
&CLK_TEST_GCC_TURING_Q6_AXI_CLK=(&CLK_GCC_TEST|0x182)
&CLK_TEST_GCC_TURING_Q6_SMMU_AXI_CLK=(&CLK_GCC_TEST|0x184)
&CLK_TEST_GCC_TURING_Q6_SMMU_AXI_SRC_CLK=(&CLK_GCC_TEST|0x183)
&CLK_TEST_GCC_CE1_CLK=(&CLK_GCC_TEST|0x097)
&CLK_TEST_GCC_AGGRE2_CNOC_NORTH_PERIPH_AHB_CLK=(&CLK_GCC_TEST|0x193)
&CLK_TEST_GCC_AGGRE2_CNOC_PERIPH_AHB_CLK=(&CLK_GCC_TEST|0x199)
&CLK_TEST_GCC_AGGRE2_CNOC_SOUTH_PERIPH_AHB_CLK=(&CLK_GCC_TEST|0x118)
&CLK_TEST_GCC_BLSP1_AHB_CLK=(&CLK_GCC_TEST|0x04A)
&CLK_TEST_GCC_BLSP2_AHB_CLK=(&CLK_GCC_TEST|0x05E)
&CLK_TEST_GCC_CNOC_BUS_TIMEOUT0_AHB_CLK=(&CLK_GCC_TEST|0x0C7)
&CLK_TEST_GCC_CNOC_PERIPH_AHB_CLK=(&CLK_GCC_TEST|0x198)
&CLK_TEST_GCC_CNOC_PERIPH_BUS_TIMEOUT1_AHB_CLK=(&CLK_GCC_TEST|0x0C5)
&CLK_TEST_GCC_CNOC_PERIPH_BUS_TIMEOUT2_AHB_CLK=(&CLK_GCC_TEST|0x0C6)
&CLK_TEST_GCC_CNOC_PERIPH_NORTH_AHB_CLK=(&CLK_GCC_TEST|0x016)
&CLK_TEST_GCC_CNOC_PERIPH_SOUTH_AHB_CLK=(&CLK_GCC_TEST|0x015)
&CLK_TEST_GCC_PDM_AHB_CLK=(&CLK_GCC_TEST|0x072)
&CLK_TEST_GCC_QSPI_AHB_CLK=(&CLK_GCC_TEST|0x172)
&CLK_TEST_GCC_SDCC1_AHB_CLK=(&CLK_GCC_TEST|0x16E)
&CLK_TEST_GCC_SDCC2_AHB_CLK=(&CLK_GCC_TEST|0x047)
&CLK_TEST_GCC_SPDM_PNOC_CY_CLK=(&CLK_GCC_TEST|0x095)
&CLK_TEST_GCC_A2NOC_THROTTLE_CFG_CLK=(&CLK_GCC_TEST|0x154)
&CLK_TEST_GCC_AGGRE2_CNOC_AHB_CLK=(&CLK_GCC_TEST|0x111)
&CLK_TEST_GCC_AGGRE2_NOC_MSMPU_CFG_AHB_CLK=(&CLK_GCC_TEST|0x12B)
&CLK_TEST_GCC_AHB_CLK=(&CLK_GCC_TEST|0x09A)
&CLK_TEST_GCC_BIMC_CFG_AHB_CLK=(&CLK_GCC_TEST|0x09F)
&CLK_TEST_GCC_BIMC_NIUS_CFG_AHB_CLK=(&CLK_GCC_TEST|0x00C)
&CLK_TEST_GCC_BOOT_ROM_AHB_CLK=(&CLK_GCC_TEST|0x07A)
&CLK_TEST_GCC_CE1_AHB_CLK=(&CLK_GCC_TEST|0x099)
&CLK_TEST_GCC_CFG_NOC_AHB_CLK=(&CLK_GCC_TEST|0x00E)
&CLK_TEST_GCC_CFG_NOC_LPASS_AON_AHB_CLK=(&CLK_GCC_TEST|0x17A)
&CLK_TEST_GCC_CFG_NOC_NORTH_AHB_CLK=(&CLK_GCC_TEST|0x192)
&CLK_TEST_GCC_CFG_NOC_SOUTH_AHB_CLK=(&CLK_GCC_TEST|0x010)
&CLK_TEST_GCC_CFG_NOC_TURING_AON_AHB_CLK=(&CLK_GCC_TEST|0x18A)
&CLK_TEST_GCC_CNOC_BUS_TIMEOUT10_AHB_CLK=(&CLK_GCC_TEST|0x0D1)
&CLK_TEST_GCC_CNOC_BUS_TIMEOUT11_AHB_CLK=(&CLK_GCC_TEST|0x0D2)
&CLK_TEST_GCC_CNOC_BUS_TIMEOUT2_AHB_CLK=(&CLK_GCC_TEST|0x0C9)
&CLK_TEST_GCC_CNOC_BUS_TIMEOUT3_AHB_CLK=(&CLK_GCC_TEST|0x0CA)
&CLK_TEST_GCC_CNOC_BUS_TIMEOUT4_AHB_CLK=(&CLK_GCC_TEST|0x0CB)
&CLK_TEST_GCC_CNOC_BUS_TIMEOUT6_AHB_CLK=(&CLK_GCC_TEST|0x0CD)
&CLK_TEST_GCC_CNOC_BUS_TIMEOUT7_AHB_CLK=(&CLK_GCC_TEST|0x0CE)
&CLK_TEST_GCC_CNOC_BUS_TIMEOUT8_AHB_CLK=(&CLK_GCC_TEST|0x0CF)
&CLK_TEST_GCC_CNOC_BUS_TIMEOUT9_AHB_CLK=(&CLK_GCC_TEST|0x0D0)
&CLK_TEST_GCC_CNOC_MST_RPM_AHB_CLK=(&CLK_GCC_TEST|0x087)
&CLK_TEST_GCC_DCC_AHB_CLK=(&CLK_GCC_TEST|0x119)
&CLK_TEST_GCC_GLM_AHB_CLK=(&CLK_GCC_TEST|0x126)
&CLK_TEST_GCC_GPU_CFG_AHB_CLK=(&CLK_GCC_TEST|0x13B)
&CLK_TEST_GCC_IMEM_CFG_AHB_CLK=(&CLK_GCC_TEST|0x01E)
&CLK_TEST_GCC_IPA_AHB_CLK=(&CLK_GCC_TEST|0x11C)
&CLK_TEST_GCC_LPASS_CNOC_CFG_CLK=(&CLK_GCC_TEST|0x178)
&CLK_TEST_GCC_LPASS_Q6_SMMU_AHB_CLK=(&CLK_GCC_TEST|0x0B2)
&CLK_TEST_GCC_LPASS_Q6_SMMU_GDS_CFG_CLK=(&CLK_GCC_TEST|0x179)
&CLK_TEST_GCC_MCCC_CFG_AHB_CLK=(&CLK_GCC_TEST|0x0AD)
&CLK_TEST_GCC_MMSS_NOC_CFG_AHB_CLK=(&CLK_GCC_TEST|0x020)
&CLK_TEST_GCC_MMSS_QM_AHB_CLK=(&CLK_GCC_TEST|0x025)
&CLK_TEST_GCC_MPM_AHB_CLK=(&CLK_GCC_TEST|0x080)
&CLK_TEST_GCC_MSG_RAM_AHB_CLK=(&CLK_GCC_TEST|0x07B)
&CLK_TEST_GCC_MSS_CFG_AHB_CLK=(&CLK_GCC_TEST|0x11F)
&CLK_TEST_GCC_MSS_MSMPU_CFG_AHB_CLK=(&CLK_GCC_TEST|0x12D)
&CLK_TEST_GCC_MSS_Q6_MSMPU_CFG_AHB_CLK=(&CLK_GCC_TEST|0x12C)
&CLK_TEST_GCC_PIMEM_AHB_CLK=(&CLK_GCC_TEST|0x028)
&CLK_TEST_GCC_PRNG_AHB_CLK=(&CLK_GCC_TEST|0x075)
&CLK_TEST_GCC_QDSS_CFG_AHB_CLK=(&CLK_GCC_TEST|0x02A)
&CLK_TEST_GCC_QDSS_DAP_AHB_CLK=(&CLK_GCC_TEST|0x029)
&CLK_TEST_GCC_RBCPR_CX_AHB_CLK=(&CLK_GCC_TEST|0x0D9)
&CLK_TEST_GCC_RBCPR_MX_AHB_CLK=(&CLK_GCC_TEST|0x0DB)
&CLK_TEST_GCC_RPM_MST_M2_CNOC_AHB_CLK=(&CLK_GCC_TEST|0x086)
&CLK_TEST_GCC_SEC_CTRL_AHB_CLK=(&CLK_GCC_TEST|0x089)
&CLK_TEST_GCC_SEC_CTRL_BOOT_ROM_PATCH_CLK=(&CLK_GCC_TEST|0x08C)
&CLK_TEST_GCC_SMMU_AGGRE2_AHB_CLK=(&CLK_GCC_TEST|0x115)
&CLK_TEST_GCC_SNOC_BUS_TIMEOUT4_AHB_CLK=(&CLK_GCC_TEST|0x175)
&CLK_TEST_GCC_SNOC_CNOC_AHB_CLK=(&CLK_GCC_TEST|0x005)
&CLK_TEST_GCC_SPDM_CFG_AHB_CLK=(&CLK_GCC_TEST|0x090)
&CLK_TEST_GCC_SPDM_MSTR_AHB_CLK=(&CLK_GCC_TEST|0x091)
&CLK_TEST_GCC_SPMI_CNOC_AHB_CLK=(&CLK_GCC_TEST|0x08E)
&CLK_TEST_GCC_TCSR_AHB_CLK=(&CLK_GCC_TEST|0x079)
&CLK_TEST_GCC_TIC_CFG_AHB_CLK=(&CLK_GCC_TEST|0x01C)
&CLK_TEST_GCC_TLMM_CENTRE_AHB_CLK=(&CLK_GCC_TEST|0x197)
&CLK_TEST_GCC_TLMM_CLK=(&CLK_GCC_TEST|0x07F)
&CLK_TEST_GCC_TLMM_NORTH_AHB_CLK=(&CLK_GCC_TEST|0x07C)
&CLK_TEST_GCC_TLMM_SOUTH_AHB_CLK=(&CLK_GCC_TEST|0x07D)
&CLK_TEST_GCC_TURING_Q6_SMMU_AHB_CLK=(&CLK_GCC_TEST|0x186)
&CLK_TEST_GCC_UFS_AHB_CLK=(&CLK_GCC_TEST|0x0EB)
&CLK_TEST_GCC_USB_PHY_CFG_AHB2PHY_CLK=(&CLK_GCC_TEST|0x045)
&CLK_TEST_GCC_BIMC_SLEEP_CLK=(&CLK_GCC_TEST|0x0A0)
&CLK_TEST_GCC_BLSP1_SLEEP_CLK=(&CLK_GCC_TEST|0x04B)
&CLK_TEST_GCC_BLSP2_SLEEP_CLK=(&CLK_GCC_TEST|0x05F)
&CLK_TEST_GCC_DDR_DIM_SLEEP_CLK=(&CLK_GCC_TEST|0x0AB)
&CLK_TEST_GCC_IM_SLEEP_CLK=(&CLK_GCC_TEST|0x09D)
&CLK_TEST_GCC_IPA_SLEEP_CLK=(&CLK_GCC_TEST|0x11D)
&CLK_TEST_GCC_RPM_SLEEP_CLK=(&CLK_GCC_TEST|0x084)
&CLK_TEST_GCC_USB20_SLEEP_CLK=(&CLK_GCC_TEST|0x16A)
&CLK_TEST_GCC_USB30_SLEEP_CLK=(&CLK_GCC_TEST|0x03D)
&CLK_TEST_GCC_A2NOC_THROTTLE_CXO_CLK=(&CLK_GCC_TEST|0x155)
&CLK_TEST_GCC_AGGRE2_NOC_CXO_NORTH_CLK=(&CLK_GCC_TEST|0x194)
&CLK_TEST_GCC_AGGRE2_NOC_CXO_SOUTH_CLK=(&CLK_GCC_TEST|0x195)
&CLK_TEST_GCC_AHB2PHY_EAST_CLK=(&CLK_GCC_TEST|0x14A)
&CLK_TEST_GCC_CFG_NOC_AH2PHY_XO_CLK=(&CLK_GCC_TEST|0x01B)
&CLK_TEST_GCC_CFG_NOC_DCD_XO_CLK=(&CLK_GCC_TEST|0x017)
&CLK_TEST_GCC_CFG_NOC_NORTH_DCD_XO_CLK=(&CLK_GCC_TEST|0x018)
&CLK_TEST_GCC_CFG_NOC_SOUTH_DCD_XO_CLK=(&CLK_GCC_TEST|0x019)
&CLK_TEST_GCC_CM_PHY_REFGEN1_CLK=(&CLK_GCC_TEST|0x14B)
&CLK_TEST_GCC_CM_PHY_REFGEN2_CLK=(&CLK_GCC_TEST|0x14C)
&CLK_TEST_GCC_CNOC_BUS_TIMEOUT13_AHB_CLK=(&CLK_GCC_TEST|0x0D4)
&CLK_TEST_GCC_GLM_XO_CLK=(&CLK_GCC_TEST|0x128)
&CLK_TEST_GCC_LPASS_CXO_CLK=(&CLK_GCC_TEST|0x19A)
&CLK_TEST_GCC_PDM_XO4_CLK=(&CLK_GCC_TEST|0x073)
&CLK_TEST_GCC_QDSS_XO_CLK=(&CLK_GCC_TEST|0x03B)
&CLK_TEST_GCC_QREFS_VBG_CAL_CLK=(&CLK_GCC_TEST|0x132)
&CLK_TEST_GCC_RPM_TIMER_CLK=(&CLK_GCC_TEST|0x085)
&CLK_TEST_GCC_SPDM_FF_CLK=(&CLK_GCC_TEST|0x092)
&CLK_TEST_GCC_SRAM_SENSOR_XO_CLK=(&CLK_GCC_TEST|0x14D)
&CLK_TEST_GCC_SYS_NOC_DCD_XO_CLK=(&CLK_GCC_TEST|0x00D)
&CLK_TEST_GCC_XO_CLK=(&CLK_GCC_TEST|0x09B)
&CLK_TEST_GCC_XO_DIV4_CLK=(&CLK_GCC_TEST|0x09C)
&CLK_TEST_GCC_GLM_CLK=(&CLK_GCC_TEST|0x127)
&CLK_TEST_GCC_GP1_CLK=(&CLK_GCC_TEST|0x0DF)
&CLK_TEST_GCC_GP2_CLK=(&CLK_GCC_TEST|0x0E0)
&CLK_TEST_GCC_GP3_CLK=(&CLK_GCC_TEST|0x0E1)
&CLK_TEST_GCC_BIMC_GFX_CLK=(&CLK_GCC_TEST|0x0AC)
&CLK_TEST_GCC_GPU_BIMC_GFX_CLK=(&CLK_GCC_TEST|0x13F)
&CLK_TEST_GCC_GPU_BIMC_GFX_SRC_CLK=(&CLK_GCC_TEST|0x13E)
&CLK_TEST_GCC_GPU_SNOC_DVM_GFX_CLK=(&CLK_GCC_TEST|0x141)
&CLK_TEST_GCC_HMSS_AHB_CLK=(&CLK_GCC_TEST|0x0BA)
&CLK_TEST_GCC_SYS_NOC_HMSS_AHB_CLK=(&CLK_GCC_TEST|0x004)
&CLK_TEST_GCC_HMSS_RBCPR_CLK=(&CLK_GCC_TEST|0x0BC)
&CLK_TEST_GCC_AGGRE2_NOC_IPA_CLK=(&CLK_GCC_TEST|0x117)
&CLK_TEST_GCC_IPA_2X_CLK=(&CLK_GCC_TEST|0x11A)
&CLK_TEST_GCC_IPA_CLK=(&CLK_GCC_TEST|0x11B)
&CLK_TEST_GCC_MMSS_QM_CORE_CLK=(&CLK_GCC_TEST|0x023)
&CLK_TEST_GCC_BIMC_MSS_Q6_AXI_CLK=(&CLK_GCC_TEST|0x0A3)
&CLK_TEST_GCC_MSS_Q6_BIMC_AXI_CLK=(&CLK_GCC_TEST|0x124)
&CLK_TEST_GCC_MSS_Q6_MSMPU_CLIENT_AXI_CLK=(&CLK_GCC_TEST|0x130)
&CLK_TEST_GCC_MSS_VS_CLK=(&CLK_GCC_TEST|0x0FF)
&CLK_TEST_GCC_OBT_ODT_CLK=(&CLK_GCC_TEST|0x0E9)
&CLK_TEST_GCC_PDM2_CLK=(&CLK_GCC_TEST|0x074)
&CLK_TEST_GCC_BIMC_PIMEM_AXI_CLK=(&CLK_GCC_TEST|0x0A6)
&CLK_TEST_GCC_PIMEM_AXI_CLK=(&CLK_GCC_TEST|0x027)
&CLK_TEST_GCC_SYS_NOC_PIMEM_AXI_CLK=(&CLK_GCC_TEST|0x008)
&CLK_TEST_GCC_CENTER_APB_CLK=(&CLK_GCC_TEST|0x03A)
&CLK_TEST_GCC_GPU_TRIG_CLK=(&CLK_GCC_TEST|0x140)
&CLK_TEST_GCC_HMSS_TRIG_CLK=(&CLK_GCC_TEST|0x0BD)
&CLK_TEST_GCC_LPASS_TRIG_CLK=(&CLK_GCC_TEST|0x0B5)
&CLK_TEST_GCC_MMSS_TRIG_CLK=(&CLK_GCC_TEST|0x024)
&CLK_TEST_GCC_MSS_TRIG_CLK=(&CLK_GCC_TEST|0x121)
&CLK_TEST_GCC_NORTH_APB_CLK=(&CLK_GCC_TEST|0x039)
&CLK_TEST_GCC_QDSS_APB2JTAG_CLK=(&CLK_GCC_TEST|0x0D7)
&CLK_TEST_GCC_QDSS_DAP_CLK=(&CLK_GCC_TEST|0x037)
&CLK_TEST_GCC_QDSS_TRIG_CLK=(&CLK_GCC_TEST|0x036)
&CLK_TEST_GCC_SOUTH_APB_CLK=(&CLK_GCC_TEST|0x038)
&CLK_TEST_GCC_TURING_TRIG_CLK=(&CLK_GCC_TEST|0x187)
&CLK_TEST_GCC_WCSS_APB_CLK=(&CLK_GCC_TEST|0x139)
&CLK_TEST_GCC_AGGRE2_NOC_AT_CLK=(&CLK_GCC_TEST|0x112)
&CLK_TEST_GCC_GPU_AT_CLK=(&CLK_GCC_TEST|0x13C)
&CLK_TEST_GCC_HMSS_AT_CLK=(&CLK_GCC_TEST|0x0BE)
&CLK_TEST_GCC_MMSS_AT_CLK=(&CLK_GCC_TEST|0x021)
&CLK_TEST_GCC_MMSS_NOC_AT_CLK=(&CLK_GCC_TEST|0x026)
&CLK_TEST_GCC_NORTH_AT_CLK=(&CLK_GCC_TEST|0x02D)
&CLK_TEST_GCC_QDSS_CENTER_AT_CLK=(&CLK_GCC_TEST|0x02B)
&CLK_TEST_GCC_SOUTH_AT_CLK=(&CLK_GCC_TEST|0x02C)
&CLK_TEST_GCC_SYS_NOC_AT_CLK=(&CLK_GCC_TEST|0x006)
&CLK_TEST_GCC_WCSS_AT_CLK=(&CLK_GCC_TEST|0x137)
&CLK_TEST_GCC_BIMC_AT_CLK=(&CLK_GCC_TEST|0x0A4)
&CLK_TEST_GCC_MSS_AT_CLK=(&CLK_GCC_TEST|0x122)
&CLK_TEST_GCC_LPASS_AT_CLK=(&CLK_GCC_TEST|0x0B6)
&CLK_TEST_GCC_TURING_AT_CLK=(&CLK_GCC_TEST|0x188)
&CLK_TEST_GCC_QDSS_STM_CLK=(&CLK_GCC_TEST|0x02F)
&CLK_TEST_GCC_SYS_NOC_QDSS_STM_AXI_CLK=(&CLK_GCC_TEST|0x003)
&CLK_TEST_GCC_QDSS_TRACECLKIN_CLK=(&CLK_GCC_TEST|0x030)
&CLK_TEST_GCC_APSS_QDSS_TSCTR_DIV2_CLK=(&CLK_GCC_TEST|0x160)
&CLK_TEST_GCC_APSS_QDSS_TSCTR_DIV8_CLK=(&CLK_GCC_TEST|0x161)
&CLK_TEST_GCC_QDSS_TSCTR_DIV16_CLK=(&CLK_GCC_TEST|0x035)
&CLK_TEST_GCC_QDSS_TSCTR_DIV2_CLK=(&CLK_GCC_TEST|0x031)
&CLK_TEST_GCC_QDSS_TSCTR_DIV3_CLK=(&CLK_GCC_TEST|0x032)
&CLK_TEST_GCC_QDSS_TSCTR_DIV4_CLK=(&CLK_GCC_TEST|0x033)
&CLK_TEST_GCC_QDSS_TSCTR_DIV8_CLK=(&CLK_GCC_TEST|0x034)
&CLK_TEST_GCC_WCSS_TSCTR_DIV2_CLK=(&CLK_GCC_TEST|0x138)
&CLK_TEST_GCC_QSPI_SER_CLK=(&CLK_GCC_TEST|0x173)
&CLK_TEST_GCC_RBCPR_CX_CLK=(&CLK_GCC_TEST|0x0D8)
&CLK_TEST_GCC_RBCPR_MX_CLK=(&CLK_GCC_TEST|0x0DA)
&CLK_TEST_GCC_RPM_BUS_AHB_CLK=(&CLK_GCC_TEST|0x083)
&CLK_TEST_GCC_RPM_PROC_FCLK=(&CLK_GCC_TEST|0x081)
&CLK_TEST_GCC_RPM_PROC_HCLK=(&CLK_GCC_TEST|0x082)
&CLK_TEST_GCC_SPDM_RPM_CY_CLK=(&CLK_GCC_TEST|0x096)
&CLK_TEST_GCC_SDCC1_APPS_CLK=(&CLK_GCC_TEST|0x16D)
&CLK_TEST_GCC_SDCC1_ICE_CORE_CLK=(&CLK_GCC_TEST|0x16F)
&CLK_TEST_GCC_SDCC2_APPS_CLK=(&CLK_GCC_TEST|0x046)
&CLK_TEST_GCC_SEC_CTRL_CLK=(&CLK_GCC_TEST|0x08A)
&CLK_TEST_GCC_SEC_CTRL_SENSE_CLK=(&CLK_GCC_TEST|0x08B)
&CLK_TEST_GCC_SPMI_AHB_CLK=(&CLK_GCC_TEST|0x08F)
&CLK_TEST_GCC_SPMI_SER_CLK=(&CLK_GCC_TEST|0x08D)
&CLK_TEST_GCC_BIMC_NIUS_HS_AXI_CLK=(&CLK_GCC_TEST|0x00A)
&CLK_TEST_GCC_BIMC_SYSNOC_HS_AXI_CLK=(&CLK_GCC_TEST|0x0A5)
&CLK_TEST_GCC_LPASS_Q6_AXI_CLK=(&CLK_GCC_TEST|0x0AE)
&CLK_TEST_GCC_LPASS_Q6_SMMU_AXI_CLK=(&CLK_GCC_TEST|0x0B0)
&CLK_TEST_GCC_LPASS_Q6_SMMU_AXI_SRC_CLK=(&CLK_GCC_TEST|0x0AF)
&CLK_TEST_GCC_MSS_MNOC_BIMC_AXI_CLK=(&CLK_GCC_TEST|0x120)
&CLK_TEST_GCC_MSS_MSMPU_CLIENT_AXI_CLK=(&CLK_GCC_TEST|0x131)
&CLK_TEST_GCC_SYS_NOC_HS_AXI_CLK=(&CLK_GCC_TEST|0x009)
&CLK_TEST_GCC_A2NOC_THROTTLE_CORE_AXI_CLK=(&CLK_GCC_TEST|0x153)
&CLK_TEST_GCC_AGGRE2_SNOC_AXI_CLK=(&CLK_GCC_TEST|0x10E)
&CLK_TEST_GCC_AGGRE2_SNOC_MSMPU_CLIENT_AXI_CLK=(&CLK_GCC_TEST|0x12F)
&CLK_TEST_GCC_AGGRE2_SNOC_NORTH_AXI_CLK=(&CLK_GCC_TEST|0x196)
&CLK_TEST_GCC_AGGRE2_SNOC_SOUTH_AXI_CLK=(&CLK_GCC_TEST|0x10F)
&CLK_TEST_GCC_BIMC_NIUS_AXI_CLK=(&CLK_GCC_TEST|0x00B)
&CLK_TEST_GCC_BIMC_SYSNOC_AXI_CLK=(&CLK_GCC_TEST|0x0A1)
&CLK_TEST_GCC_CE1_AXI_CLK=(&CLK_GCC_TEST|0x098)
&CLK_TEST_GCC_HMSS_DVM_BUS_CLK=(&CLK_GCC_TEST|0x0BF)
&CLK_TEST_GCC_IMEM_AXI_CLK=(&CLK_GCC_TEST|0x01D)
&CLK_TEST_GCC_LPASS_MPORT_CLK=(&CLK_GCC_TEST|0x17B)
&CLK_TEST_GCC_LPASS_SWAY_CLK=(&CLK_GCC_TEST|0x0B1)
&CLK_TEST_GCC_LPASS_SWAY_MPU_CLK=(&CLK_GCC_TEST|0x19C)
&CLK_TEST_GCC_MMSS_SYS_NOC_AXI_CLK=(&CLK_GCC_TEST|0x01F)
&CLK_TEST_GCC_MSS_SNOC_AXI_CLK=(&CLK_GCC_TEST|0x123)
&CLK_TEST_GCC_QDSS_ETR_USB_CLK=(&CLK_GCC_TEST|0x02E)
&CLK_TEST_GCC_SMMU_AGGRE2_AXI_CLK=(&CLK_GCC_TEST|0x114)
&CLK_TEST_GCC_SMMU_AGGRE2_AXI_SRC_CLK=(&CLK_GCC_TEST|0x113)
&CLK_TEST_GCC_SNOC_BUS_TIMEOUT0_AHB_CLK=(&CLK_GCC_TEST|0x0C1)
&CLK_TEST_GCC_SNOC_BUS_TIMEOUT1_AHB_CLK=(&CLK_GCC_TEST|0x0C2)
&CLK_TEST_GCC_SNOC_BUS_TIMEOUT3_AHB_CLK=(&CLK_GCC_TEST|0x0C3)
&CLK_TEST_GCC_SNOC_LPASS_Q6_AXIS_CLK=(&CLK_GCC_TEST|0x17C)
&CLK_TEST_GCC_SPDM_SNOC_CY_CLK=(&CLK_GCC_TEST|0x094)
&CLK_TEST_GCC_SYS_NOC_AXI_CLK=(&CLK_GCC_TEST|0x000)
&CLK_TEST_GCC_SYS_NOC_NORTH_AXI_CLK=(&CLK_GCC_TEST|0x002)
&CLK_TEST_GCC_SYS_NOC_SOUTH_AXI_CLK=(&CLK_GCC_TEST|0x001)
&CLK_TEST_GCC_TURING_SWAY_CLK=(&CLK_GCC_TEST|0x185)
&CLK_TEST_GCC_WCSS_AHB_S0_CLK=(&CLK_GCC_TEST|0x133)
&CLK_TEST_GCC_WCSS_AXI_M_CLK=(&CLK_GCC_TEST|0x134)
&CLK_TEST_GCC_WCSS_ECAHB_CLK=(&CLK_GCC_TEST|0x135)
&CLK_TEST_GCC_WCSS_SHDREG_AHB_CLK=(&CLK_GCC_TEST|0x136)
&CLK_TEST_GCC_CFG_NOC_TIC_CLK=(&CLK_GCC_TEST|0x013)
&CLK_TEST_GCC_AGGRE2_UFS_AXI_CLK=(&CLK_GCC_TEST|0x10B)
&CLK_TEST_GCC_UFS_AXI_CLK=(&CLK_GCC_TEST|0x0EA)
&CLK_TEST_GCC_UFS_ICE_CORE_CLK=(&CLK_GCC_TEST|0x0F1)
&CLK_TEST_GCC_UFS_PHY_AUX_CLK=(&CLK_GCC_TEST|0x0F2)
&CLK_TEST_GCC_UFS_RX_SYMBOL_0_CLK=(&CLK_GCC_TEST|0x0ED)
&CLK_TEST_GCC_UFS_RX_SYMBOL_1_CLK=(&CLK_GCC_TEST|0x162)
&CLK_TEST_GCC_UFS_TX_SYMBOL_0_CLK=(&CLK_GCC_TEST|0x0EC)
&CLK_TEST_GCC_UFS_UNIPRO_CORE_CLK=(&CLK_GCC_TEST|0x0F0)
&CLK_TEST_GCC_CFG_NOC_USB2_AXI_CLK=(&CLK_GCC_TEST|0x168)
&CLK_TEST_GCC_CNOC_BUS_TIMEOUT12_AHB_CLK=(&CLK_GCC_TEST|0x0D3)
&CLK_TEST_GCC_USB20_MASTER_CLK=(&CLK_GCC_TEST|0x169)
&CLK_TEST_GCC_USB20_MOCK_UTMI_CLK=(&CLK_GCC_TEST|0x16B)
&CLK_TEST_GCC_AGGRE2_USB3_AXI_CLK=(&CLK_GCC_TEST|0x10A)
&CLK_TEST_GCC_CFG_NOC_USB3_AXI_CLK=(&CLK_GCC_TEST|0x014)
&CLK_TEST_GCC_CNOC_BUS_TIMEOUT14_AHB_CLK=(&CLK_GCC_TEST|0x0D5)
&CLK_TEST_GCC_USB30_MASTER_CLK=(&CLK_GCC_TEST|0x03C)
&CLK_TEST_GCC_USB30_MOCK_UTMI_CLK=(&CLK_GCC_TEST|0x03E)
&CLK_TEST_GCC_USB3_PHY_AUX_CLK=(&CLK_GCC_TEST|0x03F)
&CLK_TEST_GCC_USB3_PHY_PIPE_CLK=(&CLK_GCC_TEST|0x040)
&CLK_TEST_GCC_VDDA_VS_CLK=(&CLK_GCC_TEST|0x0FD)
&CLK_TEST_GCC_VDDCX_VS_CLK=(&CLK_GCC_TEST|0x0FB)
&CLK_TEST_GCC_VDDMX_VS_CLK=(&CLK_GCC_TEST|0x0FC)
&CLK_TEST_GCC_VS_CTRL_CLK=(&CLK_GCC_TEST|0x0FE)
&CLK_TEST_GCC_WCSS_VS_CLK=(&CLK_GCC_TEST|0x100)
&CLK_TEST_GCC_AGGRE2_NOC_QOSGEN_EXTREF=(&CLK_GCC_TEST|0x116)
&CLK_TEST_GCC_CNOC_BUS_TIMEOUT_EXTREF=(&CLK_GCC_TEST|0x0D6)
&CLK_TEST_GCC_SNOC_BUS_TIMEOUT_EXTREF=(&CLK_GCC_TEST|0x0C4)
&CLK_TEST_GCC_SNOC_QOSGEN_EXTREF=(&CLK_GCC_TEST|0x007)
&CLK_TEST_GPLL0_DTEST=(&CLK_GCC_TEST|0x18B)
&CLK_TEST_GPLL1_DTEST=(&CLK_GCC_TEST|0x18C)
&CLK_TEST_GPLL2_DTEST=(&CLK_GCC_TEST|0x18D)
&CLK_TEST_GPLL3_DTEST=(&CLK_GCC_TEST|0x18E)
&CLK_TEST_GPLL4_DTEST=(&CLK_GCC_TEST|0x18F)
&CLK_TEST_GPLL5_DTEST=(&CLK_GCC_TEST|0x190)
&CLK_TEST_GPLL6_DTEST=(&CLK_GCC_TEST|0x191)
&CLK_TEST_GPU_GCC_DBG_CLK=(&CLK_GCC_TEST|0x13D)
&CLK_TEST_HMSS_GCC_DBG_CLK=(&CLK_GCC_TEST|0x0C0)
&CLK_TEST_LPASS_GCC_DBG_CLK=(&CLK_GCC_TEST|0x0B9)
&CLK_TEST_MCCC_DDRSS_GCC_CH_CLK=(&CLK_GCC_TEST|0x19D)
&CLK_TEST_MMSS_GCC_DBG_CLK=(&CLK_GCC_TEST|0x022)
&CLK_TEST_MPM_GCC_TEMP0_SENSOR_RINGOSC_CLK=(&CLK_GCC_TEST|0x0DD)
&CLK_TEST_MPM_GCC_TEMP1_SENSOR_RINGOSC_CLK=(&CLK_GCC_TEST|0x0DE)
&CLK_TEST_MSS_GCC_DBG_CLK=(&CLK_GCC_TEST|0x125)
&CLK_TEST_NAV_GCC_DBG_CLK=(&CLK_GCC_TEST|0x149)
&CLK_TEST_NAV_PLL_DTEST=(&CLK_GCC_TEST|0x19B)
&CLK_TEST_QUSB2PHY_GCC_CLK_TEST_PRIM=(&CLK_GCC_TEST|0x0DC)
&CLK_TEST_QUSB2PHY_GCC_CLK_TEST_SEC=(&CLK_GCC_TEST|0x19E)
&CLK_TEST_QUSB2PHY_PRIM_GCC_USB30_UTMI_CLK=(&CLK_GCC_TEST|0x044)
&CLK_TEST_QUSB2PHY_SEC_GCC_USB20S_UTMI_CLK=(&CLK_GCC_TEST|0x16C)
&CLK_TEST_TURING_GCC_DBG_CLK=(&CLK_GCC_TEST|0x189)
&CLK_TEST_UFS_RX_SYMBOL_0_CLK=(&CLK_GCC_TEST|0x0EF)
&CLK_TEST_UFS_RX_SYMBOL_1_CLK=(&CLK_GCC_TEST|0x163)
&CLK_TEST_UFS_TX_SYMBOL_0_CLK=(&CLK_GCC_TEST|0x0EE)
&CLK_TEST_USB3_PHY_WRAPPER_GCC_USB3_PIPE_CLK=(&CLK_GCC_TEST|0x043)
&CLK_TEST_WCSS_GCC_DBG_CLK=(&CLK_GCC_TEST|0x13A)

; GPU test clocks
&CLK_TEST_GPUCC_GFX3D_CLK=(&CLK_GPU_TEST|0x008)
&CLK_TEST_GPUCC_SPDM_GFX3D_CLK=(&CLK_GPU_TEST|0x007)
&CLK_TEST_GPUCC_RBBMTIMER_CLK=(&CLK_GPU_TEST|0x005)
&CLK_TEST_GPUCC_RBCPR_CLK=(&CLK_GPU_TEST|0x003)

; LPASS test clocks
&CLK_TEST_AON_CLK_SRC=(&CLK_LPASS_TEST|0x016)
&CLK_TEST_AUDIO_CORE_QDSP_SWAY_AON_CLK=(&CLK_LPASS_TEST|0x03D)
&CLK_TEST_AUDIO_WRAPPER_AON_CLK=(&CLK_LPASS_TEST|0x044)
&CLK_TEST_AUDIO_WRAPPER_BUS_TIMEOUT_AON_CLK=(&CLK_LPASS_TEST|0x04D)
&CLK_TEST_AUDIO_WRAPPER_MPU_CFG_AON_CLK=(&CLK_LPASS_TEST|0x04E)
&CLK_TEST_AUDIO_WRAPPER_Q6_AHBM_MPU_AON_CLK=(&CLK_LPASS_TEST|0x04F)
&CLK_TEST_AUDIO_WRAPPER_QOS_AHBS_AON_CLK=(&CLK_LPASS_TEST|0x045)
&CLK_TEST_AUDIO_WRAPPER_SYSNOC_SWAY_AON_CLK=(&CLK_LPASS_TEST|0x049)
&CLK_TEST_ISLAND_SCC_CFG_AHB_AON_CLK=(&CLK_LPASS_TEST|0x05D)
&CLK_TEST_ISLAND_SCC_CRIF_AON_CLK=(&CLK_LPASS_TEST|0x05A)
&CLK_TEST_ISLAND_SCC_CSR_H_AON_CLK=(&CLK_LPASS_TEST|0x05B)
&CLK_TEST_ISLAND_SCC_DATA_H_AON_CLK=(&CLK_LPASS_TEST|0x05E)
&CLK_TEST_ISLAND_SCC_QDSP_SWAY_AON_CLK=(&CLK_LPASS_TEST|0x078)
&CLK_TEST_Q6SS_AHBM_AON_CLK=(&CLK_LPASS_TEST|0x04A)
&CLK_TEST_Q6SS_AHBS_AON_CLK=(&CLK_LPASS_TEST|0x050)
&CLK_TEST_ATIME_CLK_SRC=(&CLK_LPASS_TEST|0x011)
&CLK_TEST_AUDIO_CORE_AVSYNC_ATIME_CLK=(&CLK_LPASS_TEST|0x02F)
&CLK_TEST_AUD_SLIMBUS_CLK_SRC=(&CLK_LPASS_TEST|0x013)
&CLK_TEST_AUDIO_CORE_AUD_SLIMBUS_CLK=(&CLK_LPASS_TEST|0x032)
&CLK_TEST_CORE_CLK_SRC=(&CLK_LPASS_TEST|0x015)
&CLK_TEST_AUDIO_CORE_AUD_SLIMBUS_CORE_CLK=(&CLK_LPASS_TEST|0x036)
&CLK_TEST_AUDIO_CORE_BUS_TIMEOUT_CORE_CLK=(&CLK_LPASS_TEST|0x056)
&CLK_TEST_AUDIO_CORE_CORE_CLK=(&CLK_LPASS_TEST|0x034)
&CLK_TEST_AUDIO_CORE_LPM_CORE_CLK=(&CLK_LPASS_TEST|0x038)
&CLK_TEST_AUDIO_CORE_QCA_SLIMBUS_CORE_CLK=(&CLK_LPASS_TEST|0x037)
&CLK_TEST_AUDIO_CORE_SYSNOC_MPORT_CORE_CLK=(&CLK_LPASS_TEST|0x035)
&CLK_TEST_ISLAND_SCC_AHB_TIMEOUT_CORE_CLK=(&CLK_LPASS_TEST|0x06D)
&CLK_TEST_ISLAND_SCC_BLSP_H_CORE_CLK=(&CLK_LPASS_TEST|0x059)
&CLK_TEST_ISLAND_SCC_SENSOR_CORE_CORE_CLK=(&CLK_LPASS_TEST|0x06E)
&CLK_TEST_ISLAND_SCC_SMEM_CORE_CLK=(&CLK_LPASS_TEST|0x067)
&CLK_TEST_EXT_MCLK0_CLK_SRC=(&CLK_LPASS_TEST|0x018)
&CLK_TEST_AUDIO_WRAPPER_EXT_MCLK0_CLK=(&CLK_LPASS_TEST|0x046)
&CLK_TEST_EXT_MCLK1_CLK_SRC=(&CLK_LPASS_TEST|0x019)
&CLK_TEST_AUDIO_WRAPPER_EXT_MCLK1_CLK=(&CLK_LPASS_TEST|0x047)
&CLK_TEST_EXT_MCLK2_CLK_SRC=(&CLK_LPASS_TEST|0x01A)
&CLK_TEST_AUDIO_WRAPPER_EXT_MCLK2_CLK=(&CLK_LPASS_TEST|0x048)
&CLK_TEST_AUDIO_WRAPPER_EXT_MCLK3_CLK=(&CLK_LPASS_TEST|0x086)
&CLK_TEST_AUDIO_CORE_INT_I2S0_1_IBIT_CLK=(&CLK_LPASS_TEST|0x07E)
&CLK_TEST_AUDIO_CORE_INT_I2S2_IBIT_CLK=(&CLK_LPASS_TEST|0x07F)
&CLK_TEST_AUDIO_CORE_INT_I2S3_IBIT_CLK=(&CLK_LPASS_TEST|0x080)
&CLK_TEST_AUDIO_CORE_INT_I2S4_IBIT_CLK=(&CLK_LPASS_TEST|0x087)
&CLK_TEST_AUDIO_CORE_INT_I2S5_6_IBIT_CLK=(&CLK_LPASS_TEST|0x081)
&CLK_TEST_AUDIO_CORE_INT_MCLK0_CLK=(&CLK_LPASS_TEST|0x082)
&CLK_TEST_AUDIO_CORE_INT_MCLK1_CLK=(&CLK_LPASS_TEST|0x083)
&CLK_TEST_LPAIF_PCMOE_CLK_SRC=(&CLK_LPASS_TEST|0x010)
&CLK_TEST_AUDIO_CORE_LPAIF_PCM_DATA_OE_CLK=(&CLK_LPASS_TEST|0x02E)
&CLK_TEST_LPAIF_PRI_CLK_SRC=(&CLK_LPASS_TEST|0x00C)
&CLK_TEST_AUDIO_CORE_LPAIF_PRI_IBIT_CLK=(&CLK_LPASS_TEST|0x027)
&CLK_TEST_LPAIF_QUAD_CLK_SRC=(&CLK_LPASS_TEST|0x00F)
&CLK_TEST_AUDIO_CORE_LPAIF_QUAD_IBIT_CLK=(&CLK_LPASS_TEST|0x02D)
&CLK_TEST_LPAIF_SEC_CLK_SRC=(&CLK_LPASS_TEST|0x00D)
&CLK_TEST_AUDIO_CORE_LPAIF_SEC_IBIT_CLK=(&CLK_LPASS_TEST|0x029)
&CLK_TEST_LPAIF_TER_CLK_SRC=(&CLK_LPASS_TEST|0x00E)
&CLK_TEST_AUDIO_CORE_LPAIF_TER_IBIT_CLK=(&CLK_LPASS_TEST|0x02B)
&CLK_TEST_ISLAND_SCC_Q6_SPM_CLK=(&CLK_LPASS_TEST|0x079)
&CLK_TEST_ISLAND_SCC_SENSOR_CORE_BCR_XO_CLK=(&CLK_LPASS_TEST|0x08A)
&CLK_TEST_QCA_SLIMBUS_CLK_SRC=(&CLK_LPASS_TEST|0x014)
&CLK_TEST_AUDIO_CORE_QCA_SLIMBUS_CLK=(&CLK_LPASS_TEST|0x033)
&CLK_TEST_QOS_FIXED_LAT_COUNTER_CLK_SRC=(&CLK_LPASS_TEST|0x022)
&CLK_TEST_AUDIO_CORE_QOS_DMONITOR_FIXED_LAT_COUNTER_CLK=(&CLK_LPASS_TEST|0x055)
&CLK_TEST_AUDIO_WRAPPER_QOS_DANGER_FIXED_LAT_COUNTER_CLK=(&CLK_LPASS_TEST|0x053)
&CLK_TEST_AUDIO_WRAPPER_QOS_DMONITOR_FIXED_LAT_COUNTER_CLK=(&CLK_LPASS_TEST|0x052)
&CLK_TEST_RESAMPLER_CLK_SRC=(&CLK_LPASS_TEST|0x012)
&CLK_TEST_AUDIO_CORE_RESAMPLER_CLK=(&CLK_LPASS_TEST|0x031)
&CLK_TEST_ISLAND_SCC_QUP_I2C1_CLK=(&CLK_LPASS_TEST|0x061)
&CLK_TEST_ISLAND_SCC_QUP_I2C2_CLK=(&CLK_LPASS_TEST|0x062)
&CLK_TEST_ISLAND_SCC_QUP_I2C3_CLK=(&CLK_LPASS_TEST|0x063)
&CLK_TEST_ISLAND_SCC_QUP_SPI1_CLK=(&CLK_LPASS_TEST|0x064)
&CLK_TEST_ISLAND_SCC_QUP_SPI2_CLK=(&CLK_LPASS_TEST|0x065)
&CLK_TEST_ISLAND_SCC_QUP_SPI3_CLK=(&CLK_LPASS_TEST|0x066)
&CLK_TEST_ISLAND_SCC_AT_CLK=(&CLK_LPASS_TEST|0x058)
&CLK_TEST_ISLAND_SCC_PCLKDBG_CLK=(&CLK_LPASS_TEST|0x05F)
&CLK_TEST_ISLAND_SCC_Q6_ATBM_CLK=(&CLK_LPASS_TEST|0x060)
&CLK_TEST_ISLAND_SCC_DBG_TSCTR_CLK=(&CLK_LPASS_TEST|0x05C)
&CLK_TEST_SCC_UART1_CLK_SRC=(&CLK_LPASS_TEST|0x07A)
&CLK_TEST_ISLAND_SCC_UART_DM_UART1_CLK=(&CLK_LPASS_TEST|0x068)
&CLK_TEST_SCC_UART2_CLK_SRC=(&CLK_LPASS_TEST|0x07B)
&CLK_TEST_ISLAND_SCC_UART_DM_UART2_CLK=(&CLK_LPASS_TEST|0x069)
&CLK_TEST_SCC_UART3_CLK_SRC=(&CLK_LPASS_TEST|0x07C)
&CLK_TEST_ISLAND_SCC_UART_DM_UART3_CLK=(&CLK_LPASS_TEST|0x06A)
&CLK_TEST_SCC_UART4_CLK_SRC=(&CLK_LPASS_TEST|0x085)
&CLK_TEST_ISLAND_SCC_UART_DM_UART4_CLK=(&CLK_LPASS_TEST|0x084)
&CLK_TEST_ISLAND_SCC_VS_VDDCX_CLK=(&CLK_LPASS_TEST|0x06B)
&CLK_TEST_ISLAND_SCC_VS_VDDMX_CLK=(&CLK_LPASS_TEST|0x06C)
&CLK_TEST_SLEEP_CLK_SRC=(&CLK_LPASS_TEST|0x00A)
&CLK_TEST_AUDIO_CORE_BCR_SLP_CLK=(&CLK_LPASS_TEST|0x040)
&CLK_TEST_ISLAND_SCC_SENSOR_CORE_BCR_SLP_CLK=(&CLK_LPASS_TEST|0x089)
&CLK_TEST_Q6SS_BCR_SLP_CLK=(&CLK_LPASS_TEST|0x04B)
&CLK_TEST_AUDIO_WRAPPER_SW_NPL_CLK=(&CLK_LPASS_TEST|0x07D)
&CLK_TEST_XO_CLK_SRC=(&CLK_LPASS_TEST|0x01D)
&CLK_TEST_AUDIO_CORE_AVSYNC_STC_CLK=(&CLK_LPASS_TEST|0x030)
&CLK_TEST_AUDIO_CORE_GDSC_XO_CLK=(&CLK_LPASS_TEST|0x023)
&CLK_TEST_AUDIO_WRAPPER_QOS_XO_LAT_COUNTER_CLK=(&CLK_LPASS_TEST|0x051)
&CLK_TEST_LPASS_QDSP6SS_Q6_CORE_CLK=(&CLK_LPASS_Q6_TEST|0x1)
&CLK_TEST_LPASS_QDSP6SS_AXI_M_CLK=(&CLK_LPASS_Q6_TEST|0x2)
&CLK_TEST_LPASS_QDSP6SS_LDO_NMO_OUT=(&CLK_LPASS_Q6_TEST|0x3)
&CLK_TEST_LPASS_QDSP6SS_AHB_M_CLK=(&CLK_LPASS_Q6_TEST|0x4)
&CLK_TEST_LPASS_QDSP6SS_AHB_S_CLK=(&CLK_LPASS_Q6_TEST|0x5)
&CLK_TEST_LPASS_QDSP6SS_XO_CLK=(&CLK_LPASS_Q6_TEST|0x6)
&CLK_TEST_LPASS_QDSP6SS_SLEEP_CLK=(&CLK_LPASS_Q6_TEST|0x7)
&CLK_TEST_LPASS_QDSP6SS_JTAG_TCK=(&CLK_LPASS_Q6_TEST|0x8)
&CLK_TEST_LPASS_QDSP6SS_ATB_CLK=(&CLK_LPASS_Q6_TEST|0x9)
&CLK_TEST_LPASS_QDSP6SS_APB_CLK=(&CLK_LPASS_Q6_TEST|0xA)
&CLK_TEST_LPASS_QDSP6SS_TIMESTAMP_CLK=(&CLK_LPASS_Q6_TEST|0xB)

; MMSS test clocks
&CLK_TEST_MMSS_BIMC_SMMU_AHB_CLK=(&CLK_MMSS_TEST|0x00C)
&CLK_TEST_MMSS_BTO_AHB_CLK=(&CLK_MMSS_TEST|0x002)
&CLK_TEST_MMSS_CAMSS_AHB_CLK=(&CLK_MMSS_TEST|0x037)
&CLK_TEST_MMSS_CAMSS_CCI_AHB_CLK=(&CLK_MMSS_TEST|0x02E)
&CLK_TEST_MMSS_CAMSS_CPP_AHB_CLK=(&CLK_MMSS_TEST|0x03B)
&CLK_TEST_MMSS_CAMSS_CPP_VBIF_AHB_CLK=(&CLK_MMSS_TEST|0x073)
&CLK_TEST_MMSS_CAMSS_CSI0_AHB_CLK=(&CLK_MMSS_TEST|0x042)
&CLK_TEST_MMSS_CAMSS_CSI1_AHB_CLK=(&CLK_MMSS_TEST|0x047)
&CLK_TEST_MMSS_CAMSS_CSI2_AHB_CLK=(&CLK_MMSS_TEST|0x04C)
&CLK_TEST_MMSS_CAMSS_CSI3_AHB_CLK=(&CLK_MMSS_TEST|0x051)
&CLK_TEST_MMSS_CAMSS_ISPIF_AHB_CLK=(&CLK_MMSS_TEST|0x033)
&CLK_TEST_MMSS_CAMSS_JPEG_AHB_CLK=(&CLK_MMSS_TEST|0x035)
&CLK_TEST_MMSS_CAMSS_MICRO_AHB_CLK=(&CLK_MMSS_TEST|0x026)
&CLK_TEST_MMSS_CAMSS_TOP_AHB_CLK=(&CLK_MMSS_TEST|0x025)
&CLK_TEST_MMSS_CAMSS_VFE0_AHB_CLK=(&CLK_MMSS_TEST|0x086)
&CLK_TEST_MMSS_CAMSS_VFE1_AHB_CLK=(&CLK_MMSS_TEST|0x087)
&CLK_TEST_MMSS_CAMSS_VFE_VBIF_AHB_CLK=(&CLK_MMSS_TEST|0x03C)
&CLK_TEST_MMSS_CSIPHY_AHB2CRIF_CLK=(&CLK_MMSS_TEST|0x0B8)
&CLK_TEST_MMSS_MDSS_AHB_CLK=(&CLK_MMSS_TEST|0x022)
&CLK_TEST_MMSS_MDSS_HDMI_DP_AHB_CLK=(&CLK_MMSS_TEST|0x023)
&CLK_TEST_MMSS_MISC_AHB_CLK=(&CLK_MMSS_TEST|0x003)
&CLK_TEST_MMSS_MNOC_AHB_CLK=(&CLK_MMSS_TEST|0x001)
&CLK_TEST_MMSS_SPDM_AHB_CLK=(&CLK_MMSS_TEST|0x060)
&CLK_TEST_MMSS_THROTTLE_CAMSS_AHB_CLK=(&CLK_MMSS_TEST|0x0A4)
&CLK_TEST_MMSS_THROTTLE_MDSS_AHB_CLK=(&CLK_MMSS_TEST|0x0A5)
&CLK_TEST_MMSS_THROTTLE_VIDEO_AHB_CLK=(&CLK_MMSS_TEST|0x0A6)
&CLK_TEST_MMSS_VIDEO_AHB_CLK=(&CLK_MMSS_TEST|0x011)
&CLK_TEST_MMSS_BIMC_SMMU_AXI_CLK=(&CLK_MMSS_TEST|0x00D)
&CLK_TEST_MMSS_CAMSS_CPP_AXI_CLK=(&CLK_MMSS_TEST|0x07A)
&CLK_TEST_MMSS_CAMSS_JPEG_AXI_CLK=(&CLK_MMSS_TEST|0x036)
&CLK_TEST_MMSS_CAMSS_VFE_VBIF_AXI_CLK=(&CLK_MMSS_TEST|0x03D)
&CLK_TEST_MMSS_MDSS_AXI_CLK=(&CLK_MMSS_TEST|0x024)
&CLK_TEST_MMSS_MNOC_AXI_CLK=(&CLK_MMSS_TEST|0x004)
&CLK_TEST_MMSS_S0_AXI_CLK=(&CLK_MMSS_TEST|0x005)
&CLK_TEST_MMSS_SNOC_DVM_AXI_CLK=(&CLK_MMSS_TEST|0x013)
&CLK_TEST_MMSS_SPDM_AXI_CLK=(&CLK_MMSS_TEST|0x059)
&CLK_TEST_MMSS_SPDM_RM_AXI_CLK=(&CLK_MMSS_TEST|0x063)
&CLK_TEST_MMSS_THROTTLE_CAMSS_AXI_CLK=(&CLK_MMSS_TEST|0x0AA)
&CLK_TEST_MMSS_THROTTLE_MDSS_AXI_CLK=(&CLK_MMSS_TEST|0x0AB)
&CLK_TEST_MMSS_THROTTLE_VIDEO_AXI_CLK=(&CLK_MMSS_TEST|0x0AC)
&CLK_TEST_MMSS_VIDEO_AXI_CLK=(&CLK_MMSS_TEST|0x00F)
&CLK_TEST_MMSS_MDSS_BYTE0_CLK=(&CLK_MMSS_TEST|0x01E)
&CLK_TEST_MMSS_MDSS_BYTE0_INTF_CLK=(&CLK_MMSS_TEST|0x0AD)
&CLK_TEST_MMSS_MDSS_BYTE1_CLK=(&CLK_MMSS_TEST|0x01F)
&CLK_TEST_MMSS_MDSS_BYTE1_INTF_CLK=(&CLK_MMSS_TEST|0x0B6)
&CLK_TEST_MMSS_CAMSS_GP0_CLK=(&CLK_MMSS_TEST|0x027)
&CLK_TEST_MMSS_CAMSS_GP1_CLK=(&CLK_MMSS_TEST|0x028)
&CLK_TEST_MMSS_CAMSS_CCI_CLK=(&CLK_MMSS_TEST|0x02D)
&CLK_TEST_MMSS_CAMSS_CPP_CLK=(&CLK_MMSS_TEST|0x03A)
&CLK_TEST_MMSS_SPDM_CPP_CLK=(&CLK_MMSS_TEST|0x055)
&CLK_TEST_MMSS_CAMSS_CSI0_CLK=(&CLK_MMSS_TEST|0x041)
&CLK_TEST_MMSS_CAMSS_CSI0PIX_CLK=(&CLK_MMSS_TEST|0x045)
&CLK_TEST_MMSS_CAMSS_CSI0RDI_CLK=(&CLK_MMSS_TEST|0x044)
&CLK_TEST_MMSS_SPDM_CSI0_CLK=(&CLK_MMSS_TEST|0x062)
&CLK_TEST_MMSS_CAMSS_CSI0PHYTIMER_CLK=(&CLK_MMSS_TEST|0x02F)
&CLK_TEST_MMSS_CAMSS_CSI1_CLK=(&CLK_MMSS_TEST|0x046)
&CLK_TEST_MMSS_CAMSS_CSI1PIX_CLK=(&CLK_MMSS_TEST|0x04A)
&CLK_TEST_MMSS_CAMSS_CSI1RDI_CLK=(&CLK_MMSS_TEST|0x049)
&CLK_TEST_MMSS_CAMSS_CSI1PHYTIMER_CLK=(&CLK_MMSS_TEST|0x030)
&CLK_TEST_MMSS_CAMSS_CSI2_CLK=(&CLK_MMSS_TEST|0x04B)
&CLK_TEST_MMSS_CAMSS_CSI2PIX_CLK=(&CLK_MMSS_TEST|0x04F)
&CLK_TEST_MMSS_CAMSS_CSI2RDI_CLK=(&CLK_MMSS_TEST|0x04E)
&CLK_TEST_MMSS_CAMSS_CSI2PHYTIMER_CLK=(&CLK_MMSS_TEST|0x031)
&CLK_TEST_MMSS_CAMSS_CSI3_CLK=(&CLK_MMSS_TEST|0x050)
&CLK_TEST_MMSS_CAMSS_CSI3PIX_CLK=(&CLK_MMSS_TEST|0x054)
&CLK_TEST_MMSS_CAMSS_CSI3RDI_CLK=(&CLK_MMSS_TEST|0x053)
&CLK_TEST_MMSS_CAMSS_CPHY_CSID0_CLK=(&CLK_MMSS_TEST|0x08D)
&CLK_TEST_MMSS_CAMSS_CPHY_CSID1_CLK=(&CLK_MMSS_TEST|0x08E)
&CLK_TEST_MMSS_CAMSS_CPHY_CSID2_CLK=(&CLK_MMSS_TEST|0x08F)
&CLK_TEST_MMSS_CAMSS_CPHY_CSID3_CLK=(&CLK_MMSS_TEST|0x090)
&CLK_TEST_MMSS_CAMSS_CSIPHY0_CLK=(&CLK_MMSS_TEST|0x043)
&CLK_TEST_MMSS_CAMSS_CSIPHY1_CLK=(&CLK_MMSS_TEST|0x085)
&CLK_TEST_MMSS_CAMSS_CSIPHY2_CLK=(&CLK_MMSS_TEST|0x088)
&CLK_TEST_MMSS_MISC_CXO_CLK=(&CLK_MMSS_TEST|0x077)
&CLK_TEST_MMSS_THROTTLE_CAMSS_CXO_CLK=(&CLK_MMSS_TEST|0x0A7)
&CLK_TEST_MMSS_THROTTLE_MDSS_CXO_CLK=(&CLK_MMSS_TEST|0x0A8)
&CLK_TEST_MMSS_THROTTLE_VIDEO_CXO_CLK=(&CLK_MMSS_TEST|0x0A9)
&CLK_TEST_MMSS_MDSS_DP_AUX_CLK=(&CLK_MMSS_TEST|0x09C)
&CLK_TEST_MMSS_MDSS_DP_CRYPTO_CLK=(&CLK_MMSS_TEST|0x09A)
&CLK_TEST_MMSS_SPDM_DP_CRYPTO_CLK=(&CLK_MMSS_TEST|0x074)
&CLK_TEST_MMSS_MDSS_DP_GTC_CLK=(&CLK_MMSS_TEST|0x09D)
&CLK_TEST_MMSS_MDSS_DP_LINK_CLK=(&CLK_MMSS_TEST|0x098)
&CLK_TEST_MMSS_MDSS_DP_LINK_INTF_CLK=(&CLK_MMSS_TEST|0x099)
&CLK_TEST_MMSS_MDSS_DP_PIXEL_CLK=(&CLK_MMSS_TEST|0x09B)
&CLK_TEST_MMSS_SPDM_DP_PIXEL_CLK=(&CLK_MMSS_TEST|0x03E)
&CLK_TEST_MMSS_MDSS_ESC0_CLK=(&CLK_MMSS_TEST|0x020)
&CLK_TEST_MMSS_MDSS_ESC1_CLK=(&CLK_MMSS_TEST|0x021)
&CLK_TEST_MMSS_CAMSS_JPEG0_CLK=(&CLK_MMSS_TEST|0x032)
&CLK_TEST_MMSS_SPDM_JPEG0_CLK=(&CLK_MMSS_TEST|0x056)
&CLK_TEST_MMSS_CAMSS_MCLK0_CLK=(&CLK_MMSS_TEST|0x029)
&CLK_TEST_MMSS_CAMSS_MCLK1_CLK=(&CLK_MMSS_TEST|0x02A)
&CLK_TEST_MMSS_CAMSS_MCLK2_CLK=(&CLK_MMSS_TEST|0x02B)
&CLK_TEST_MMSS_CAMSS_MCLK3_CLK=(&CLK_MMSS_TEST|0x02C)
&CLK_TEST_MMSS_MDSS_MDP_CLK=(&CLK_MMSS_TEST|0x014)
&CLK_TEST_MMSS_SPDM_MDP_CLK=(&CLK_MMSS_TEST|0x058)
&CLK_TEST_MMSS_MDSS_PCLK0_CLK=(&CLK_MMSS_TEST|0x016)
&CLK_TEST_MMSS_SPDM_PCLK0_CLK=(&CLK_MMSS_TEST|0x061)
&CLK_TEST_MMSS_MDSS_PCLK1_CLK=(&CLK_MMSS_TEST|0x017)
&CLK_TEST_MMSS_SPDM_PCLK1_CLK=(&CLK_MMSS_TEST|0x05E)
&CLK_TEST_MMSS_MDSS_ROT_CLK=(&CLK_MMSS_TEST|0x012)
&CLK_TEST_MMSS_SPDM_ROT_CLK=(&CLK_MMSS_TEST|0x05F)
&CLK_TEST_MMSS_CAMSS_CSI_VFE0_CLK=(&CLK_MMSS_TEST|0x03F)
&CLK_TEST_MMSS_CAMSS_VFE0_CLK=(&CLK_MMSS_TEST|0x038)
&CLK_TEST_MMSS_CAMSS_VFE0_STREAM_CLK=(&CLK_MMSS_TEST|0x071)
&CLK_TEST_MMSS_SPDM_VFE0_CLK=(&CLK_MMSS_TEST|0x05B)
&CLK_TEST_MMSS_CAMSS_CSI_VFE1_CLK=(&CLK_MMSS_TEST|0x040)
&CLK_TEST_MMSS_CAMSS_VFE1_CLK=(&CLK_MMSS_TEST|0x039)
&CLK_TEST_MMSS_CAMSS_VFE1_STREAM_CLK=(&CLK_MMSS_TEST|0x072)
&CLK_TEST_MMSS_SPDM_VFE1_CLK=(&CLK_MMSS_TEST|0x05C)
&CLK_TEST_MMSS_SPDM_VIDEO_CORE_CLK=(&CLK_MMSS_TEST|0x05A)
&CLK_TEST_MMSS_VIDEO_CORE_CLK=(&CLK_MMSS_TEST|0x00E)
&CLK_TEST_MMSS_VIDEO_SUBCORE0_CLK=(&CLK_MMSS_TEST|0x01A)
&CLK_TEST_MMSS_MDSS_VSYNC_CLK=(&CLK_MMSS_TEST|0x01C)

;-----------------------------------------------------------------------------
; Init testclock
;-----------------------------------------------------------------------------

; Grab the entire launch command line.
local &launch_cmd_line
entry %LINE &launch_cmd_line

local &ARGS
&ARGS=os.ppd()
gosub __acquire_args_cmm &ARGS\..
entry &ARGS

local &AID
local &opts
local &create_area_param
local &success
local &testclock_main_window
local &testclock_main_area
local &log_output
local &log_filename
local &prev_clk_grp
local &input_filename
local &got_input_filename
local &arg
local &num_unread
local &prev_cmd_line
local &clk_err
local &help_use_same_window
local &tc_mode
local &area_exists
local &show_area

local &reset_window
&reset_window=0

&input_filename="c:\temp\testclock.txt"
&log_output=0
&prev_clk_grp=""
&prev_cmd_line=""

; Check if testclock was invoked in '__help_same_window__' mode.
&help_use_same_window=string.scan("&launch_cmd_line", "__help_same_window__", 0)
if (&help_use_same_window!=-1)
(
  &launch_cmd_line=string.replace("&launch_cmd_line", "__help_same_window__", "", 1.)
)

; Detect '__tc__' mode.
&tc_mode=string.scan("&launch_cmd_line", "__tc__", 0)
if (&tc_mode!=-1)
(
  &tc_mode=1
  &launch_cmd_line=string.replace("&launch_cmd_line", "__tc__", "", 1.)
)
else
(
  &tc_mode=0
)

; Clear any leftover help/history windows.
WINCLEAR testclock_help_window
WINCLEAR testclock_hist_window

; Check if a T32 area was given.
&testclock_main_area=string.ScanAndExtract("&launch_cmd_line", "super_script_area=", "_NF_")

; Create new areas.
&create_area_param="2 TESTCLOCK_HELP 130. 1000. TESTCLOCK_HIST , ,"
if ("&testclock_main_area"=="_NF_")
(
  &testclock_main_area="TESTCLOCK"

  &area_exists=1

  ;
  ; Allow 'tc' mode to avoid clearing the area ('area.create' clears areas if
  ; it is given row/col dimensions for the area buffer)
  ;
  if (&tc_mode!=0)
  (
    gosub wa_does_area_exist TESTCLOCK
    entry &area_exists
  )

  if ((&tc_mode==0)||(&area_exists==0))
  (
    &create_area_param="3 TESTCLOCK 180. 1000. TESTCLOCK_HELP 130. 1000. TESTCLOCK_HIST , ,"
  )
)
else
(
  ; Cut the 'super_script_area' argument out of the launch command line.
  &launch_cmd_line=string.replace("&launch_cmd_line", "super_script_area=&testclock_main_area", "", 1.)

  ; Create the given area if it doesn't already exist.
  gosub wa_does_area_exist &testclock_main_area
  entry &area_exists
  if (&area_exists==0)
  (
    &create_area_param="3 &testclock_main_area 180. 1000. TESTCLOCK_HELP 130. 1000. TESTCLOCK_HIST , ,"
  )
)

gosub wa_area_create_list &create_area_param
entry &success
if (&success==0)
(
  area.select
  print %ERROR "ERROR: Failed to create areas for testclock.cmm."
  enddo
)

; Check if a T32 window was given.
&testclock_main_window=string.ScanAndExtract("&launch_cmd_line", "super_script_window=", "_NF_")
if ("&testclock_main_window"=="_NF_")
(
  &testclock_main_window="testclock_main_window"
)
else
(
  ; Cut the 'super_script_window' argument out of the launch command line.
  &launch_cmd_line=string.replace("&launch_cmd_line", "super_script_window=&testclock_main_window", "", 1.)
)

; Create a new window if needed.
if (WIN.EXIST("&testclock_main_window")==FALSE())
(
  local &x_start
  local &y_start
  local &x_len
  local &y_len

  ; Check if there are previously saved window settings.
  gosub wa_find_saved_window_settings &testclock_main_window
  entry &x_start &y_start &x_len &y_len

  if (&x_start!=-1)
  (
    ; Use the previous window settings.
    winpos &x_start &y_start &x_len &y_len 0. 0. &testclock_main_window
  )
  else
  (
    gosub Default_WINPOS_Main
  )
)

; Check if a show-area option was given.
&show_area=string.ScanAndExtract("&launch_cmd_line", "show_area=", "_NF_")
if ("&show_area"=="_NF_")
(
  &show_area=1.
)
else
(
  ; Cut the 'show_area' argument out of the launch command line.
  &launch_cmd_line=string.replace("&launch_cmd_line", "show_area=&show_area", "", 1.)
)

area.select &testclock_main_area
if (&show_area==0.)
(
  ; Force an exit if the area is not shown, because no input prompt will appear.
  &launch_cmd_line="&launch_cmd_line x"
)
else
(
  area.view &testclock_main_area
)

; Initialize the argument bufferer with the launch command line.
do &ARGS create_client clk_drv &testclock_main_area &launch_cmd_line
entry &AID
if ("&AID"=="ARGS_ERR")
(
  do &ARGS get_error
  entry &clk_err

  print %ERROR "ERROR: Failed to create an ARGS client:"
  print %ERROR "       '&clk_err'."
  enddo
)

; Set bufferer options.
&opts="print_errors=1 help_cmd=? help_sub=Display_Help"
&opts="&opts hist_cmd=hist hist_sub=Display_Hist"
do &ARGS set_opts &AID &opts
entry &clk_err
if ("&clk_err"=="ARGS_ERR")
(
  do &ARGS get_error
  entry &clk_err

  print %ERROR "ERROR: Failed to set ARGS options:"
  print %ERROR "       '&clk_err'."

  enddo
)

; Set generic testclock error handler.
ON ERROR gosub
(
  print %ERROR "ERROR: Testclock error occurred:"
  print %ERROR "       Last command='&arg'. Last clock group='&clk'."
  return
)

; Print banner before entering main loop.
print " "
print "[-------------------- [&chipset_name] TEST CLOCK TOOL --------------------]"
print " "


;-----------------------------------------------------------------------------
; Argument handler main loop
;-----------------------------------------------------------------------------

Main_Loop:
(
  &clk_err=""

  ;
  ; Reset testclock argument handler state.
  ;
  &repeat_prev_cmd=0
  &header_printed=0
  &state_change=""
  &got_input_filename=0

  ;
  ; Get next command header arg.
  ;
  do &ARGS get_num_unread &AID
  entry &num_unread
  if (&num_unread==0)
  (
    local &line

    do &ARGS get_cmd_line &AID
    entry %LINE &line

    if (("&line"!=".")&&("&line"!=""))
    (
      &prev_cmd_line="&line"
    )

    ; If the history window is open, go ahead and update it.
    if (WIN.EXIST("testclock_hist_window")==TRUE())
    (
      gosub Display_Hist SKIP_VIEW
    )

    print " "
    print "[testclock.cmm] Version: <04/30/2015>"
  )

  do &ARGS get_arg &AID Enter command ('?' for help) >
  entry &arg

  gosub wa_save_window_settings testclock_hist_window
  gosub wa_save_window_settings &testclock_main_window

  ;
  ; Pre-process the command header arg.
  ;
  if (("&arg"==".")||("&arg"==""))
  (
    if ("&prev_cmd_line"=="")
    (
      print %ERROR "No previous command to repeat."
      goto Main_Loop
    )

    ; Prepare to repeat the previous command line.
    do &ARGS reset_cmd_line &AID &prev_cmd_line
    do &ARGS get_arg &AID
    entry &arg

    &repeat_prev_cmd=1
  )

  if (("&arg"=="on")||("&arg"=="off")||("&arg"=="set"))
  (
    ; Set state change command.
    &state_change="&arg"

    ; Check if a new clock selection is specified.
    do &ARGS get_num_unread &AID
    entry &num_unread
    if (&num_unread==0)
    (
      ; Use previous clock selection for state change operation.
      if ("&prev_clk_grp"=="")
      (
        print %ERROR "Command '&arg' failed. No clock(s) were previously selected."
        goto Handle_Args
      )
      &arg="&prev_clk_grp"
    )
    else
    (
      ; Extract new clock selection from buffered command line.
      do &ARGS get_arg &AID
      entry &arg
    )

    if ("&arg"=="file")
    (
      ; Check if a new clock file input is specified.
      do &ARGS get_num_unread &AID
      entry &num_unread
      if (&num_unread!=0)
      (
        ; Extract new clock file input from buffered command line.
        do &ARGS get_arg &AID
        entry &input_filename
      )

      ; Record that the file name is already known.
      &got_input_filename=1
    )
  )

  ;
  ; Execute the command operation.
  ;
  if ("&arg"=="x")
  (
    goto Exit_Testclock
  )
  else if ("&arg"=="wr")
  (
    &reset_window=1

    ; Reset the window size/position to default settings.
    winclear testclock_help_window
    winclear testclock_hist_window
    winclear &testclock_main_window

    gosub Default_WINPOS_Main

    if (&show_area!=0.)
    (
      area.view &testclock_main_area
    )
  )
  else if ("&arg"=="gpio")
  (
    gosub Configure_GPIO
  )
  else if ("&arg"=="log")
  (
    ; Check if output is already being logged.
    if (&log_output==0)
    (
      ; Output not currently logged--prompt user for new log file name
      local &filename
      do &ARGS get_arg &AID Enter log output file (default 'c:\temp\testclock_out.log') >
      entry &filename

      if ("&filename"=="close")
      (
        print %ERROR "No open output log to close."
      )
      else
      (
        if ("&filename"=="")
        (
          &log_filename="c:\temp\testclock_out.log"
        )
        else
        (
          &log_filename="&filename"
        )
        print "Logging testclock output to '&log_filename'."

        ; Open the output log file.
        (
          ON ERROR gosub
          (
            print %ERROR "ERROR: Failed to open clock output log '&log_filename'."
            &clk_err="failed_to_open_log_out"
            return
          )
          AREA.open &testclock_main_area &log_filename
        )

        if ("&clk_err"!="failed_to_open_log_out")
        (
          &log_output=1
        )
      )
    )
    else
    (
      local &log_arg

      do &ARGS get_arg &AID Stop logging output and close '&log_filename'? [close|n] >
      entry &log_arg

      if ("&log_arg"=="close")
      (
        AREA.close &testclock_main_area
        &log_output=0
        print "Closed '&log_filename' and stopped logging output."
      )
      else
      (
        print "Did not close the open output log '&log_filename'."
      )
    )
  )
  else if ("&arg"=="file")
  (
    local &input_line

    ; Get the input filename if necessary.
    if (&got_input_filename==0)
    (
      local &prompt_filename

      do &ARGS get_arg &AID Enter input file (default 'c:\temp\testclock.txt') >
      entry &prompt_filename

      if ("&prompt_filename"!="")
      (
        &input_filename="&prompt_filename"
      )
    )

    ; Open the clock input file
    (
      ON ERROR gosub
      (
        print %ERROR "ERROR: Failed to open clock list file '&input_filename'."
        &clk_err="failed_to_open_file_in"
        return
      )
      OPEN #1 &input_filename /Read
    )

    if ("&clk_err"!="failed_to_open_file_in")
    (
      print "Operating on list of clocks from '&input_filename'."

      READ #1 %line &input_line
      WHILE !EOF()
      (
        &input_line=string.trim("&input_line")
        if ("&input_line"!="")
        (
          gosub Find_Print_Clock &input_line
        )

        READ #1 %line &input_line
      )
      CLOSE #1
    )

    &prev_clk_grp="&arg"
  )
  else if (("&arg"=="all")||("&arg"=="all_on")||("&arg"=="all_off"))
  (
    &clk_state_filter="&arg"
    gosub Print_All
    &prev_clk_grp="&arg"
  )
  else
  (
    ; Assume argument is a clock group
    local &printed_ss_clock_info
    gosub Print_All_SS &arg
    entry &printed_ss_clock_info

    if (&printed_ss_clock_info==0)
    (
      ; Didn't match a SS clock group--attempt to operate on non-SS clock group
      gosub Find_Print_Clock &arg
    )

    &prev_clk_grp="&arg"
  )

  goto Main_Loop
)

;
; Sets up the default window position/size for the main window.
;
Default_WINPOS_Main:
(
  winpos 0. 0. 150. 100% 0. 0. &testclock_main_window
  return
)

;
; Sets up the default window position/size for the history window.
;
Default_WINPOS_Hist:
(
  winpos 155. 0. 50. 50% 0. 0. testclock_hist_window
  return
)

;-----------------------------------------------------------------------------
; Exit testclock
;-----------------------------------------------------------------------------

Exit_Testclock:
(
  local &num_unread &exit_arg

  winclear testclock_help_window

  if ((&tc_mode==0)||(&reset_window!=0))  ; skip saving a second time for 'tc' mode.
  (
    gosub wa_save_window_settings testclock_hist_window
    gosub wa_save_window_settings &testclock_main_window
  )

  ; Close the output log if needed.
  if (&log_output!=0)
  (
    area.close &testclock_main_area
  )

  winclear testclock_hist_window

  do &ARGS get_num_unread &AID
  entry &num_unread
  if (&num_unread>0.)
  (
    ; Don't hide the main window if the '.' exit option is given.
    do &ARGS get_arg &AID
    entry &exit_arg
    if ("&exit_arg"!=".")
    (
      winclear &testclock_main_window
    )
  )
  else
  (
    winclear &testclock_main_window
  )

  if (&show_area!=0.)
  (
    area.select
    print "Exited [&chipset_name] 'testclock.cmm'."
  )

  ; Return the clock frequency of the last measured clock (will be empty if
  ; no clock frequency was measured).
  enddo &clk_freq
)

;-----------------------------------------------------------------------------
; Display history
;-----------------------------------------------------------------------------

Display_Hist:
(
  local &skip_view
  entry &skip_view

  ; Display the help area if required.
  if ("&skip_view"=="")
  (
    if (WIN.EXIST("testclock_hist_window")==FALSE())
    (
      local &x_start
      local &y_start
      local &x_len
      local &y_len

      ; Check if there are previously saved window settings.
      gosub wa_find_saved_window_settings testclock_hist_window
      entry &x_start &y_start &x_len &y_len

      if (&x_start!=-1)
      (
        ; Use the previous window settings.
        winpos &x_start &y_start &x_len &y_len 0. 0. testclock_hist_window
      )
      else
      (
        gosub Default_WINPOS_Hist
      )
    )

    area.view TESTCLOCK_HIST
    wintop testclock_hist_window
  )

  area.clear TESTCLOCK_HIST
  area.select TESTCLOCK_HIST

  ; Print the history entries.
  print " "
  print "[--- [&chipset_name] testclock.cmm history: ---]"
  print " "
  do &ARGS print_hist &AID

  ; Switch back to the main demo window.
  area.select &testclock_main_area

  return
)

;-----------------------------------------------------------------------------
; Display help
;-----------------------------------------------------------------------------

Display_Help:
(
  ;-----------------------------------------------------------------------------
  ; Display available clock sources that can be output to the clock test output
  ; and prompt for selection.
  ;-----------------------------------------------------------------------------

  ; If the history window is open, go ahead and update it.
  if (WIN.EXIST("testclock_hist_window")==TRUE())
  (
    gosub Display_Hist SKIP_VIEW
  )

  if (&help_use_same_window==-1)
  (
    if (WIN.EXIST("testclock_help_window")==FALSE())
    (
      WINPOS , , , , , , testclock_help_window
    )

    area.view TESTCLOCK_HELP
    area.clear TESTCLOCK_HELP
    area.select TESTCLOCK_HELP

    winresize 130. 38.
  )

  print " "
  print " "
  gosub Print_Clock_Help
  print " "
  print " "

  print "Returns the frequency in MHz of the last measured clock if any clock freqeuncy was"
  print "measured, else returns nothing."
  print " "

  print "*** Launch Options ***"
  print " "
  print "  super_script_window=<name> - Specifies a T32 window to be used."
  print "  super_script_area=<name>   - Specifies a T32 area to be used."
  print "  show_area=<0|1>            - If zero, testclock's area is not displayed (1 by default)."
  print " "

  print "*** Commands ***"
  print " "
  print "  <clk_group>      - Print the status of a single clock or clock group."
  print "  on/off [clks]    - Modifies on/off state of clock(s). If a new clock group"
  print "                     isn't given, the previously selected clock group is used."

  ; TODO: actually support this or remove?
  ;print "  set         - sets the clock to one of supported frequencies"

  print "  gpio             - Enable GPIO's for clock output."
  print "  log <name|close> - Begin/end logging output to a file (closes upon 'x' exit)."
  print "  x [.]            - Exit [and leave the main window displayed]."
  print "  ?                - Display help message."
  print "  .                - Repeat previous command. Entering an empty line will also"
  print "                     repeat the previous command."
  print "  hist             - Display a testclock history window."
  print "  wr               - Reset the script window size/position."
  print " "

  print "*** Clock Groups ***"
  print " "
  print "  all          - All clocks."
  print "  all_on       - All clocks that are on."
  print "  all_off      - All clocks that are off."
  print "  <ss>_all     - All subsystem clocks."
  print "  <wildcard>   - Search query."
  print "  buses        - All bus clocks."
  print "  cpus         - All cpu clocks."
  print "  file <name>  - File specifying enumerated clocks (separated by newlines)."
  print "                 If a file name is not given, the previous input file is"
  print "                 used (default 'c:\temp\testclock.txt')."
  print " "

  area.select &testclock_main_area

  return
)



;;;;;;;;;;;;;;;;;;;;;;;;;;;;;;;;;;;;;;;;;;;;;;;;;;;;;;;;;;;;;;;;;;;;;;;;;;;;;;
;
; Lauterbach T32 "Window/Area" Utility Subs:
;
;   bool    wa_does_area_exist ( string area )
;
;   bool    wa_try_area_create ( string area, [int cols, int rows] )
;
;   bool    wa_area_create_list (
;             int num, [string area, int cols, int rows], ... )
;
;   string  wa_get_substr_ws ( string src_str, int read_idx )
;
;   int[4]  wa_extract_stored_win_dim ( string file_name, string window_name )
;
;   bool    wa_save_window_settings ( string window_name, [flag print_error] )
;
;   int[4]  wa_find_saved_window_settings ( string window_name )
;
;   bool    wa_delete_saved_window_settings (
;             string window_name, [flag print_error] )
;
;   bool    wa_delete_saved_window_settings_ext (
;             string window, string script, [flag print_error] )
;
;;;;;;;;;;;;;;;;;;;;;;;;;;;;;;;;;;;;;;;;;;;;;;;;;;;;;;;;;;;;;;;;;;;;;;;;;;;;;;

;
; bool wa_does_area_exist ( string area )
;
; Returns non-zero if the given area currently exists.
;
; SIDE EFFECTS:  Selects the tested area if it exists, or the default area.
;
wa_does_area_exist:
(
  local &area_name
  entry &area_name

  ON ERROR gosub
  (
    ; Clear the error message.
    area.select
    print " "

    &clk_err="!"
    return
  )

  &clk_err=""
  area.select &area_name

  if ("&clk_err"=="")
  (
    return 1
  )
  else
  (
    return 0
  )
)

;
; bool wa_try_area_create ( string area, [int cols, int rows] )
;
; Attempts to create an area (see 'area.create'). Returns non-zero if the 
; area is successfully created. If the 'area.create' operation fails, the
; caller may run 'area.reset' then re-try creating the area. The 'rows' and
; 'cols' arguments can be bypassed by omitting both.
;
; T32 has a maximum number of concurrent areas (only 10 at the time of
; writing this sub). Unfortunately these areas can only be deleted in bulk
; with the highly destructive 'area.reset' (although some T32 documentation
; incorrectly states that 'area.close <area_name>' destroys the area, it
; doesn't--it only closes the area's output logging).
;
; Furthermore, areas aren't destroyed automatically upon script exit, so
; if a user were to run multiple scripts with multiple areas they could
; quickly exhaust the 10-area limit and then find that subsequent script
; launches always fail, potentially with confusing error messages. This
; utility sub is intended to mitigate this risk without having to immidiately
; resort to running a global 'area.reset' during script initialization.
;
wa_try_area_create:
(
  local &area_name
  local &cols
  local &rows

  entry &area_name &cols &rows

  ON ERROR gosub
  (
    &clk_err="!"
    return
  )

  &clk_err=""
  area.create &area_name &cols &rows

  if ("&clk_err"=="")
  (
    return 1
  )
  else
  (
    return 0
  )
)

;
; bool wa_area_create_list ( int num, [string area, int cols, int rows], ... )
;
; Attempts to create a list of areas. Will run the global 'area.reset' command
; upon the first failure, and return 0 upon the second failure. Otherwise
; returns non-zero upon success.
;
wa_area_create_list:
(
  local &success
  local &already_failed
  local &area_name
  local &cols
  local &rows
  local &area_idx
  local &num
  local &input_line
  local &line_idx
  local &area_list_line_idx

  entry %LINE &input_line

  ; Get the number of areas to create.
  gosub wa_get_substr_ws "&input_line" 0.
  entry &num &area_list_line_idx
  if ("&num"=="")
  (
    print %ERROR "ERROR: wa_area_create_list() detected invalid input: '&input_line'."
    return 0
  )

  &already_failed=0

wa_area_create_list_process_areas:

  ; Create each area.
  &area_idx=0
  &line_idx=&area_list_line_idx
  while (&area_idx<&num)
  (
    ; Read in the area information.
    gosub wa_get_substr_ws "&input_line" &line_idx
    entry &area_name &line_idx
    if ("&area_name"=="")
    (
      goto wa_area_create_list_too_few_args
    )
    gosub wa_get_substr_ws "&input_line" &line_idx
    entry &cols &line_idx
    if ("&cols"=="")
    (
      goto wa_area_create_list_too_few_args
    )
    gosub wa_get_substr_ws "&input_line" &line_idx
    entry &rows &line_idx
    if ("&rows"=="")
    (
      goto wa_area_create_list_too_few_args
    )

    ; Check if the row/col argument was bypassed.
    if (("&cols"==",")||("&rows"==","))
    (
      ; Apply a sanity check for row/col bypass.
      if (("&cols"!=",")||("&rows"!=","))
      (
        print %ERROR "ERROR: wa_area_create_list() detected invalid row/col settings for '&area_name'."
        print %ERROR "       Row/col must both be an integer or both be ',' (got row='&row', col='&col'). "
        return 0
      )

      &cols=""
      &rows=""
    )

    ; Attempt to create the area.
    gosub wa_try_area_create &area_name &cols &rows
    entry &success

    if (&success==0)
    (
      ; Already failed => infinite impending failures.
      if (&already_failed!=0)
      (
        print %ERROR %Decimal "ERROR: wa_area_create_list() failed to create &num areas."
        return 0
      )

      ; Delete all areas and try creating the area list once more.
      &already_failed=1
      area.reset
      winclear
      goto wa_area_create_list_process_areas
    )

    &area_idx=&area_idx+1
  )

  return 1

wa_area_create_list_too_few_args:

  print %ERROR "ERROR: wa_area_create_list() detected too few arguments (num_areas='&num')."
  return 0
)

;
; string wa_get_substr_ws ( string src_str, int read_idx )
;
; Returns the next sub-string word from a source string, or nothing if there
; is no such word. The words are split by spaces.
;
; Example: <gosub args_get_next_substr_ws "a  bc  de" 1.>
;          Returns "bc 5" (sans quotes).
;
wa_get_substr_ws:
(
  local &src_str
  local &src_len
  local &read_idx
  local &sub_str
  local &start_idx

  entry &src_str &read_idx

  if (&read_idx<0)
  (
    ; Negative read index--return empty string (and no index).
    return
  )

  &src_len=string.length(&src_str)

  ; Find the start of non-whitespace segment.
  while (&read_idx<&src_len)
  (
    if (string.char(&src_str, &read_idx)!=' ')
    (
      &start_idx=&read_idx
      goto wa_get_substr_ws_find_end_idx
    )

    &read_idx=&read_idx+1
  )

  ; No non-whitespace found--return empty string (and no index).
  return

wa_get_substr_ws_find_end_idx:

  ; Find the end of non-whitespace segment.
  &read_idx=&read_idx+1
  while (&read_idx<&src_len)
  (
    if (string.char(&src_str, &read_idx)==' ')
    (
      ; Cut out leading and trailing whitespace
      &sub_str=string.mid(&src_str, &start_idx, &read_idx-&start_idx)

      goto wa_get_substr_ws_return_substr
    )

    &read_idx=&read_idx+1
  )

  ; No trailing white-space found--cut out any leading whitespace.
  &sub_str=string.cut(&src_str, &start_idx)

wa_get_substr_ws_return_substr:

  return &sub_str &read_idx
)

;
; int[2] wa_extract_stored_win_dim ( string file_name,  string window_name )
;
; Returns the settings for the given window extracted from a previously
; stored file. Returns -1 if the window settings aren't found.
;
; Returns: {x_start, y_start, x_length, y_length}
;          (all values are in row or column units).
;
wa_extract_stored_win_dim:
(
  local &window_name
  local &file_name
  local &x_start
  local &y_start
  local &x_len
  local &y_len
  local &line_in
  local &idx

  entry &file_name &window_name

  &x_start=-1
  &y_start=-1
  &y_len=-1
  &x_start=-1

  ; Open the input file.
  (
    &clk_err=""
    ON ERROR gosub
    (
      print %ERROR "ERROR: wa_extract_stored_win_dim() failed to open '&file_name'."
      &clk_err="!"
      return
    )
    OPEN #1 &file_name /Read
  )

  if ("&clk_err"!="")
  (
    goto wa_extract_stored_win_dim_error
  )

  ; Scan the input file for "winpos ... window_name".
  WHILE TRUE()
  (
    READ #1 %line &line_in
    if (EOF()==TRUE())
    (
      goto wa_extract_stored_win_dim_error
    )
    &line_in=string.lower("&line_in")

    ; Search for 'winpos' line header and cut it out if found.
    &idx=string.scan("&line_in", "winpos", 0)
    if (&idx!=-1)
    (
      &line_in=string.cut("&line_in", &idx+6.)

      ; Search for the specified window name.
      if (string.scan("&line_in", "&window_name", 0)!=-1)
      (
        ; Extract the specified window's settings.
        gosub wa_get_substr_ws "&line_in" 0.
        entry &x_start &idx
        if ("&x_start"=="")
        (
          goto wa_extract_stored_win_dim_error
        )
        gosub wa_get_substr_ws "&line_in" &idx
        entry &y_start &idx
        if ("&y_start"=="")
        (
          goto wa_extract_stored_win_dim_error
        )
        gosub wa_get_substr_ws "&line_in" &idx
        entry &x_len &idx
        if ("&x_len"=="")
        (
          goto wa_extract_stored_win_dim_error
        )
        gosub wa_get_substr_ws "&line_in" &idx
        entry &y_len &idx
        if ("&y_len"=="")
        (
          goto wa_extract_stored_win_dim_error
        )

        CLOSE #1
        return &x_start &y_start &x_len &y_len
      )
    )
  )

wa_extract_stored_win_dim_error:

  CLOSE #1
  return -1 -1 -1 -1
)

;
; bool wa_save_window_settings ( string window_name, [flag print_error] )
;
; Saves a script's window configuration (position + size).
; See restore_window_settings() for the restore operation.
; Returns non-zero if the store operation succeeded.
;
; This is provided as a method to allow scripts to save/restore their window
; settings accross multiple script sessions. T32's "store <file> win" tool
; is insufficient to do this since it will only save/restore *all* T32 windows,
; not targeted windows.
;
wa_save_window_settings:
(
  local &file
  local &window_name
  local &script_name
  local &extn_less_dim_fname
  local &print_error

  &clk_err=""
  ON ERROR gosub
  (
    &clk_err="!"
    return
  )

  entry &window_name &print_error

  ; Store the full window configuration in a file under the temporary directory.
  &script_name=os.ppf()
  &script_name=os.file.name("&script_name")
  &extn_less_dim_fname="__&(script_name)_&(window_name)_dim"
  &extn_less_dim_fname=string.replace("&extn_less_dim_fname", ".", "_", 0.)

  &file=os.ptd()
  &file="&(file)\&(extn_less_dim_fname).cmm"
  store &file win

  if ("&clk_err"=="")
  (
    return 1
  )
  else
  (
    if ("&print_error"!="")
    (
      print %ERROR "ERROR: wa_save_window_settings() failed to store settings for '&window_name'."
    )
    return 0
  )
)

;
; int[4] wa_find_saved_window_settings ( string window_name )
;
; Returns the settings for the given window extracted from a previously
; save. Returns -1 if the window settings aren't found.
;
; Returns: {x_start, y_start, x_length, y_length}
;          (all values are in row or column units).
;
; This is provided as a method to allow scripts to save/restore their window
; settings accross multiple script sessions. T32's "store <file> win" tool
; is insufficient to do this since it will only save/restore *all* T32 windows,
; not targeted windows.
;
wa_find_saved_window_settings:
(
  local &x_start
  local &y_start
  local &x_len
  local &y_len
  local &window_name
  local &file
  local &script_name
  local &extn_less_dim_fname
  local &first

  entry &window_name

  &script_name=os.ppf()
  &script_name=os.file.name("&script_name")
  &extn_less_dim_fname="__&(script_name)_&(window_name)_dim"
  &extn_less_dim_fname=string.replace("&extn_less_dim_fname", ".", "_", 0.)

  &first=0.
  (
    ON ERROR gosub
    (
      var.newglobal char \&extn_less_dim_fname
      &first=1.
      return
    )

    var.assign \&extn_less_dim_fname = 0
  )

  &file=os.ptd()
  &file="&(file)\&(extn_less_dim_fname).cmm"

  if (&first!=0.)
  (
    ;
    ; Don't attempt to restore on the first time--instead delete the save.
    ; This prevents issues where a new T32 session is opened in a smaller
    ; window but the launched script maintains its old oversize dimensions.
    ;
    (
      ON ERROR continue
      del &file
    )
    return -1 -1 -1 -1
  )

  if (os.file.access("&file", "R")==FALSE())
  (
    return -1 -1 -1 -1
  )

  ; Search for previously saved settings for this window.
  gosub wa_extract_stored_win_dim &file &window_name
  entry &x_start &y_start &x_len &y_len

  return &x_start &y_start &x_len &y_len
)

;
; bool wa_delete_saved_window_settings ( string window_name, [flag print_error] )
;
; Deletes a window settings file.
;
wa_delete_saved_window_settings:
(
  local &success
  local &file
  local &script_name
  local &window_name
  local &extn_less_dim_fname
  local &print_error

  entry &window_name &print_error

  ; Check if the window's saved settings file exists.
  &script_name=os.ppf()
  &script_name=os.file.name("&script_name")
  &extn_less_dim_fname="__&(script_name)_&(window_name)_dim"
  &extn_less_dim_fname=string.replace("&extn_less_dim_fname", ".", "_", 0.)

  &file=os.ptd()
  &file="&(file)\&(extn_less_dim_fname).cmm"
  if (os.file.access("&file", "W")==TRUE())
  (
    ; Delete the file.
    del &file
    &success=1
  )
  else
  (
    if ("&print_error"!="")
    (
      print %ERROR "ERROR: wa_delete_saved_window_settings() failed to delete window settings for '&window_name'."
    )
    &success=0
  )

  return &success
)

;
; bool wa_delete_saved_window_settings_ext ( string window, string script, [flag print_error] )
;
; Deletes a window settings file.
;
wa_delete_saved_window_settings_ext:
(
  local &success
  local &file
  local &script_name
  local &extn_less_dim_fname
  local &window_name
  local &print_error

  entry &window_name &script_name &print_error

  &extn_less_dim_fname="__&(script_name)_&(window_name)_dim"
  &extn_less_dim_fname=string.replace("&extn_less_dim_fname", ".", "_", 0.)

  &file=os.ptd()
  &file="&(file)\&(extn_less_dim_fname).cmm"
  if (os.file.access("&file", "W")==TRUE())
  (
    ; Delete the file.
    del &file
    &success=1
  )
  else
  (
    if ("&print_error"!="")
    (
      print %ERROR "ERROR: delete_saved_window_settings() failed to delete window settings for '&window_name'."
    )
    &success=0
  )

  return &success
)

;;;;;;;;;;;;; End of "Lauterbach T32 "Window/Area" Utility Subs" ;;;;;;;;;;;;;



;;;;;;;;;;;;;;;;;;;;;;;;;;;;;;;;;;;;;;;;;;;;;;;;;;;;;;;;;;;;;;;;;;;;;;;;;;;;;;
;
; Lauterbach T32 "ARGS Aquisition" Utility Subs:
;
;   string      __acquire_args_cmm ( string expected_args_dir )
;
;   int         __cmp_file_ts ( string path_a, string path_b )
;
;   int         __get_file_date_int ( string path, [flag ERR_FATAL] )
;
;   (int, int)  __str_get_next_dec_int ( int idx, string str_in)
;
;;;;;;;;;;;;;;;;;;;;;;;;;;;;;;;;;;;;;;;;;;;;;;;;;;;;;;;;;;;;;;;;;;;;;;;;;;;;;;

;
; string __acquire_args_cmm ( string expected_args_dir )
;
; Returns a path to an 'args.cmm' script.
;
; Aborts the scripts upon any failure.
;
__acquire_args_cmm:
(
  local &args_path
  local &server_args_path
  local &expected_args_dir

  entry &expected_args_dir

  ON ERROR gosub
  (
    area.select
    area.view
    print " "
    print %ERROR "Caught error in '__acquire_args_cmm'. Failed to fulfill 'args.cmm' dependency."
    enddo
  )

  &args_path="&expected_args_dir\args.cmm"

  ; Check if the expected 'args.cmm' file exists.
  if (os.file(&args_path)==FALSE())
  (
    ; The expected 'args.cmm' is missing. Attempt to copy it from the server.
    &server_args_path="\\ben\corebsp_labdata_0001\sysdrv\args\args.cmm"

    &args_path=os.ptd()
    &args_path="&args_path\__temp_args.cmm"

    ; Check if a local temp server copy already exists.
    if (os.file(&args_path)==FALSE())
    (
      ; The local temp copy does not exist--attempt to create it.
      if (os.file(&server_args_path)==FALSE())
      (
        area.select
        area.view
        print " "
        print %ERROR "ERROR: '&expected_args_dir\args.cmm', '&args_path\__temp_args.cmm' and"
        print %ERROR "       '&server_args_path' do not exist. Missing required 'args.cmm' file."
        enddo
      )
      if (os.file.access("&server_args_path", "R")==FALSE())
      (
        area.select
        area.view
        print " "
        print %ERROR "ERROR: '&expected_args_dir\args.cmm' and '&args_path\__temp_args.cmm' do not exist and"
        print %ERROR "       '&server_args_path' is not readable. Missing required 'args.cmm' file."
        enddo
      )

      copy &server_args_path &args_path
      if (os.file(&args_path)==FALSE())
      (
        ; Just try to use the server version if for some reason the copy to the
        ; T32 temp directory failed.
        &args_path="&server_args_path"
      )
    )
    else
    (
      ; The local temp 'args.cmm' exists. Check if it matches the server version.
      ; If the server version isn't found, the temp copy is used.
      if ((os.file(&server_args_path)==TRUE())&&(os.file.access("&server_args_path", "R")==TRUE()))
      (
        local &args_cmp_ret

        gosub __cmp_file_ts &server_args_path &args_path
        entry &args_cmp_ret

        if (&args_cmp_ret>0.)
        (
          ; The server copy is newer than the local temp copy--attempt to refresh.
          del &args_path
          copy &server_args_path &args_path

          if (os.file(&args_path)==FALSE())
          (
            ; Just try to use the server version if for some reason the copy to the
            ; T32 temp directory failed.
            &args_path="&server_args_path"
          )
        )
      )
    )
  )

  return &args_path
)

;
; int __cmp_file_ts ( string path_a, string path_b )
;
; Returns positive number if the first file is newer than the second file,
; else returns zero if the two files have identical timestamps, else returns
; a negative number. Assumes that both files exist.
;
; Aborts the scripts upon any failure.
;
__cmp_file_ts:
(
  local &path_a
  local &path_b

  entry &path_a &path_b

  gosub __get_file_date_int &path_a ERR_FATAL
  entry &path_a

  gosub __get_file_date_int &path_b ERR_FATAL
  entry &path_b

  &path_a=(&path_a-&path_b)
  return &path_a
)

;
; int __get_file_date_int ( string path, [flag ERR_FATAL] )
;
; Returns an integer representation of the given file's timestamp data string
; (see 'os.file.date()').
;
; Upon failure, if the 'ERR_FATAL' flag is given an error message is printed
; and the script is aborted, else -1 is returned.
;
; NOTES:  This subroutine is greatly complicated by the fact that (at the time
;         of its authoring) Lauterbach does not provide a way to obtain a
;         1971-based file time-stamp integer, instead only providing methods
;         get various file date strings of various formats which are not even
;         consistant with the given Lauterbach documentation!
;
__get_file_date_int:
(
  local &year
  local &month
  local &day
  local &date_int
  local &date_str
  local &hour_min_sec_am_pm_str
  local &get_file_date_int_err

  local &path
  local &err_fatal

  entry &path &err_fatal

  &get_file_date_int_err=""
  ON ERROR gosub
  (
    if ("&err_fatal"=="")
    (
      &get_file_date_int_err="!"
      return
    )
    else
    (
      ; Abort if fatal error flag was given.
      area.select
      area.view
      print " "
      print %ERROR "Caught fatal error in __get_file_date_int(), file = '&path'."
      enddo
    )
  )

  ;
  ; Don't use raw 'os.file.date()' as it's format doesn't match Lauterbach's
  ; documentation which indicates that it might be regionalized. Instead use a
  ; combination of the two date string formats, in order to get the AM/PM
  ; included in the time string, but with a more reliable "year/month/day"
  ; format for the date string.
  ;
  &hour_min_sec_am_pm_str=os.file.date(&path)
  gosub __str_get_next_dec_int 0. "&hour_min_sec_am_pm_str"
  entry &year &date_idx
  gosub __str_get_next_dec_int &date_idx "&hour_min_sec_am_pm_str"
  entry &year &date_idx
  gosub __str_get_next_dec_int &date_idx "&hour_min_sec_am_pm_str"
  entry &year &date_idx
  &hour_min_sec_am_pm_str=string.cut("&hour_min_sec_am_pm_str", &date_idx)
  &hour_min_sec_am_pm_str=string.trim("&hour_min_sec_am_pm_str")

  &date_str=os.file.date2(&path)
  &date_str="&date_str &hour_min_sec_am_pm_str"
  &date_str=string.trim("&date_str")

  if ("&get_file_date_int_err"=="")
  (
    ; Determine the 1971 year second-offset (assumes each month is <= 31 days).
    gosub __str_get_next_dec_int 0. "&date_str"
    entry &year &date_idx
    &date_int=((&year-1971.)*32140800.)

    if ("&get_file_date_int_err"=="")
    (
      ; Read the month (assumes each month is <= 31 days).
      gosub __str_get_next_dec_int &date_idx "&date_str"
      entry &month &date_idx
      &date_int=(&date_int+(&month*2678400.))

      if ("&get_file_date_int_err"=="")
      (
        ; Read the day.
        gosub __str_get_next_dec_int &date_idx "&date_str"
        entry &day &date_idx
        &date_int=(&date_int+(&day*86400.))

        if ("&get_file_date_int_err"=="")
        (
          ; Read the hour/minute/second/AM-PM.
          local &hour
          local &min
          local &sec
          local &am_pm_str
          gosub __str_get_next_dec_int &date_idx "&date_str"
          entry &hour &date_idx

          if ("&get_file_date_int_err"=="")
          (
            gosub __str_get_next_dec_int &date_idx "&date_str"
            entry &min &date_idx

            if ("&get_file_date_int_err"=="")
            (
              gosub __str_get_next_dec_int &date_idx "&date_str"
              entry &sec &date_idx

              if ("&get_file_date_int_err"=="")
              (
                &am_pm_str=string.cut("&date_str", &date_idx)
                &am_pm_str=string.trim("&am_pm_str")
                &am_pm_str=string.lower("&am_pm_str")
                if ("&am_pm_str"=="pm")
                (
                  &hour=(&hour+12.)
                )

                ; Calculate the final date integer and return it.
                &date_int=(&date_int+(&hour*3600.)+(&min*60.)+&sec)
                if ("&get_file_date_int_err"=="")
                (
                  return &date_int
                )
              )
            )
          )
        )
      )
    )
  )

  ; Otherwise return an error code.
  return -1.
)

;
; (int, int) __str_get_next_dec_int ( int idx, string str_in )
;
; Returns the next integer value extracted from the given string and start
; index along with the next string read index. The integer value is derived
; from the string's first digit sequence which is treated as a decimal
; formatted number. Returns an empty string if no such digit section is found.
;
; NOTES: The 'str_in' input should be wrapped in double quotes.
;
__str_get_next_dec_int:
(
  local &int_val
  local &int_start_idx
  local &char
  local &len

  local &idx
  local &str_in

  entry &idx &str_in

  &int_start_idx=""
  &char=1.
  while (&char>0.)
  (
    &char=string.char(&str_in, &idx)

    if ("&int_start_idx"=="")
    (
      if ((&char>='0')&&(&char<='9'))
      (
        &int_start_idx=&idx
      )
    )
    else
    (
      if ((&char<'0')||(&char>'9'))
      (
        &len=(&idx-&int_start_idx)
        &int_val=string.mid(&str_in, &int_start_idx, &len)
        &int_val="&(int_val)."
        &idx=(&idx+1.)

        return &int_val &idx
      )
    )

    &idx=&idx+1.
  )

  return ""
)

;;;;;;;;;;; End of "Lauterbach T32 "ARGS Aquisition" Utility Subs" ;;;;;;;;;;;


;-----------------------------------------------------------------------------
; Determine clock frequency.
;-----------------------------------------------------------------------------

Calc_Clock_Freq:

  local &l2cpucpselr_val
  local &l2cpucpcpdr_val

  ; Save current values
  &xo_div4_cbcr=data.long(&access_mode:&xo_div4_cbcr_addr)
  
  ; Measure a short run
  &tcxo_count=0x800
  
  ; Config XO DIV4 comparator clock
  data.set &access_mode:&xo_div4_cbcr_addr %LONG data.long(&access_mode:&xo_div4_cbcr_addr)|0x1
  
  ; Start with the counter disabled 
  &measure_ctl=data.long(&access_mode:&frq_measure_ctl_addr)
  &measure_ctl=&measure_ctl&~0x1FFFFF
  data.set &access_mode:&frq_measure_ctl_addr %LONG &measure_ctl
  
  ; Program the starting counter value, high enough to get good accuracy
  &measure_ctl=&measure_ctl|&tcxo_count
  
  ; Start the counting
  &measure_ctl=&measure_ctl|0x100000
  data.set &access_mode:&frq_measure_ctl_addr %LONG &measure_ctl
  
  ; Wait for the counters to finish
  wait 1.ms
  while (data.long(&access_mode:&frq_measure_status_addr)&0x2000000)==0
  (
  )
  
  ; Turn off the test clock and read the clock count
  &measure_ctl=data.long(&access_mode:&frq_measure_ctl_addr)
  data.set &access_mode:&frq_measure_ctl_addr %LONG (&measure_ctl&~0x100000)
  
  &short_clock_count=data.long(&access_mode:&frq_measure_status_addr)&0x1FFFFFF
  
  ; Restore the registers
  data.set &access_mode:&xo_div4_cbcr_addr %LONG &xo_div4_cbcr
 
  ; Now do a longer count and compare
  ; Save current values
  &xo_div4_cbcr=data.long(&access_mode:&xo_div4_cbcr_addr)
  
  &tcxo_count=0x8000
  
  ; Config XO DIV4 comparator clock
  data.set &access_mode:&xo_div4_cbcr_addr %LONG data.long(&access_mode:&xo_div4_cbcr_addr)|0x1
  
  ; Start with the counter disabled 
  &measure_ctl=data.long(&access_mode:&frq_measure_ctl_addr)
  &measure_ctl=&measure_ctl&~0x1FFFFF
  data.set &access_mode:&frq_measure_ctl_addr %LONG &measure_ctl
  
  ; Program the starting counter value, high enough to get good accuracy
  &measure_ctl=&measure_ctl|&tcxo_count
  
  ; Start the counting
  &measure_ctl=&measure_ctl|0x100000
  data.set &access_mode:&frq_measure_ctl_addr %LONG &measure_ctl
  
  ; Wait for the counters to finish
  wait 1.ms
  while (data.long(&access_mode:&frq_measure_status_addr)&0x2000000)==0
  (
  )
  
  ; Turn off the test clock and read the clock count
  &measure_ctl=data.long(&access_mode:&frq_measure_ctl_addr)
  data.set &access_mode:&frq_measure_ctl_addr %LONG (&measure_ctl&~0x100000)
  
  &clock_count=data.long(&access_mode:&frq_measure_status_addr)&0x1FFFFFF
  
  ; Calculate the frequency.  Function is provided by
  ; Power Control 42.8.1.2 Measurement technique
  ; f ring = f tcxo/4 * (Nring + 1.5) / (TCtcxo + 3.5)
  ;
  ; The formula below is the equivalent one converted
  ; to integer arithmetic.
  ; 
  ; We add half of the denominator value to the dividend
  ; to guard against rounding errors inherent to
  ; integer arithmetic.
  ;
  
  if &clock_count==&short_clock_count
  (
    &clk_freq=0
  )
  else
  (
    &clk_freq=4.8*(&clock_count+1.5)/(&tcxo_count+3.5)
  )
  
  ; Restore the registers
  data.set &access_mode:&xo_div4_cbcr_addr %LONG &xo_div4_cbcr

  return




PRINT_SET_CLOCK_FREQ_WARNING:

  print " "
  print "Warning: This feature is in beta and does not account for voltage requirements. Clock driver state will be out of sync."
  print " "

  return



;-----------------------------------------------------------------------------
; Set clock frequency.
;-----------------------------------------------------------------------------

Set_Clock_Freq:

  ; Use testpll.cmm to turn on required source
  do testpll.cmm on &clk_src_name

  ; Convert src divider to appropriate register value
  if (&clk_src_div!=0)
  (
    &clk_src_div=&clk_src_div-1
  )

  ; Read current cmd_rcgr and cfg_rcgr values
  &clk_cmd_rcgr_val=data.long(&access_mode:&clk_cmd_rcgr_addr)
  &clk_cfg_rcgr_val=data.long(&access_mode:&clk_cfg_rcgr_addr)

  ; Clear src_sel, src_div, and mode fields
  &clk_cfg_rcgr_val=&clk_cfg_rcgr_val&~(&HAL_CLK_CFG_CGR_SRC_SEL_FMSK|&HAL_CLK_CFG_CGR_SRC_DIV_FMSK|&HAL_CLK_CFG_CGR_MODE_FMSK)

  ; Program src_sel and src_div
  &clk_cfg_rcgr_val=&clk_cfg_rcgr_val|((&clk_src_sel<<&HAL_CLK_CFG_CGR_SRC_SEL_SHFT)&(&HAL_CLK_CFG_CGR_SRC_SEL_FMSK))
  &clk_cfg_rcgr_val=&clk_cfg_rcgr_val|((&clk_src_div<<&HAL_CLK_CFG_CGR_SRC_DIV_SHFT)&(&HAL_CLK_CFG_CGR_SRC_DIV_FMSK))

  ; Program M, N, D registers if necessary
  if (&clk_m_val!=0.)&&(&clk_m_val<&clk_n_val)
  (
    &clk_m_addr=&clk_cmd_rcgr_addr+&HAL_CLK_M_REG_OFFSET
    &clk_n_addr=&clk_cmd_rcgr_addr+&HAL_CLK_N_REG_OFFSET
    &clk_2d_addr=&clk_cmd_rcgr_addr+&HAL_CLK_D_REG_OFFSET

    ; Write to M register
    data.set &access_mode:&clk_m_addr %long &clk_m_val
    
    ; Write to N register
    data.set &access_mode:&clk_n_addr %long ~(&clk_n_val-&clk_m_val)
    
    ; Write to D register
    data.set &access_mode:&clk_2d_addr %long ~&clk_2d_val
    
    ; Dual edge mode
    &clk_cfg_rcgr_val=&clk_cfg_rcgr_val|((&HAL_CLK_CFG_CFG_DUAL_EDGE_MODE_VAL<<&HAL_CLK_CFG_CGR_MODE_SHFT)&(&HAL_CLK_CFG_CGR_MODE_FMSK))
  )
  
  ; Write to cfg_rcgr
  data.set &access_mode:&clk_cfg_rcgr_addr %long &clk_cfg_rcgr_val

  ; Write to cmd_rcgr to trigger update
  data.set &access_mode:&clk_cmd_rcgr_addr %long (&clk_cmd_rcgr_val|&HAL_CLK_CMD_CFG_UPDATE_FMSK)

  ; Wait for update to finish
  wait 1.ms
  while (data.long(&access_mode:&clk_cmd_rcgr_addr)&(&HAL_CLK_CMD_CFG_UPDATE_FMSK))!=0
  (
  )

  return




;-----------------------------------------------------------------------------
; Display clock info header
;-----------------------------------------------------------------------------

Print_Header:

  if &header_printed==0
  (
    print " "
    print "Clock                                      State      Frequency (MHz)         CBCR Addr : Value        CBCR Type "
    print "---------------------------------------------------------------------------------------------------------------- "

    &header_printed=1
  )

  return




;-----------------------------------------------------------------------------
; Display clock info line
;-----------------------------------------------------------------------------

Print_Clk_Info_Line:
(
  local &is_on &clk_reg_val &clk_reg_val_str &on_reg &on_mask &clk_freq_str

  ;-----------------------------------------------------------------------------
  ; Toggle clock state if requested
  ;-----------------------------------------------------------------------------
  if (&clk_reg!=0)
  (
    if &clk_vote_bit!=-1.
    (
      &vote_idx=&clk_vote_bit/32.
      &on_reg=v.value(\vote_regs[&vote_idx])
      &on_mask=(1<<(&clk_vote_bit-(32.*&vote_idx)))
    )
    else
    (
      &on_reg="&clk_reg"
      &on_mask=0x1
    )

    if "&state_change"=="on"
    (
      data.set &clk_access_mode:&on_reg %LONG (data.long(&clk_access_mode:&on_reg)|&on_mask)
    )
    else if "&state_change"=="off"
    (
      data.set &clk_access_mode:&on_reg %LONG (data.long(&clk_access_mode:&on_reg)&~(&on_mask))
    )
  )

  if "&state_change"=="set"
  (
    gosub Set_Clock_Freq_Enter
  )

  ;-----------------------------------------------------------------------------
  ; Print the clock header
  ;-----------------------------------------------------------------------------
  gosub Print_Header

  ;-----------------------------------------------------------------------------
  ; Test if clock is on
  ;-----------------------------------------------------------------------------
  
  if (&clk_reg!=0)
  (
    if (data.long(&clk_access_mode:&clk_reg)&(0x80000000))==0x0
    (
      &clk_state="ON "
      &is_on=1
    )
    else
    (
      &clk_state="OFF"
      &clk_freq=0
      &is_on=0
    )
  )
  else
  (
    &clk_state=" ? " 
    &is_on=-1
  )
  
  ;-----------------------------------------------------------------------------
  ; Calculate the clock frequency based on the TCXO counter
  ;-----------------------------------------------------------------------------

  if (&clk_test!=0)&&((&is_on==1)||(&is_on==-1))
  (
    gosub Program_Clk_Test

    ; Set dividers before calculation to ensure clock is within range of
    ; the frequency counter. Clear dividers after calculation so they
    ; don't affect frequency when probing with a scope.
    gosub Set_Dividers
    gosub Calc_Clock_Freq
    gosub Clear_Dividers

    if (&clk_freq==0)
    (
      &clk_freq_str=FORMAT.DECIMAL(14., 0x0)
    )
    else
    (
      &clk_freq=&clk_freq*&clk_multiplier
      &clk_freq_str=FORMAT.FLOAT(12., 0x6, &clk_freq) 
    )

    if (&is_on==-1)
    (
      if (&clk_freq==0)
      (
        &is_on=0
      )
      else
      (
        &is_on=1
      )
    )
  )
  else if (&is_on==0)
  (
    &clk_freq_str=FORMAT.DECIMAL(14., 0x0)
  )
  else
  (
    &clk_freq_str="  Not Testable"
  )
  
  if ((("&clk_state_filter"=="all_on")&&(&is_on==0))||(("&clk_state_filter"=="all_off")&&(&is_on==1)))
  (
    return
  )

  if (&clk_reg!=0)
  (
    &clk_reg_val=FORMAT.HEX(0x8, data.long(&clk_access_mode:&clk_reg))
    &clk_reg_val_str="0x&clk_reg_val"
    
    &clk_reg=FORMAT.HEX(0x8, &clk_reg)
    &clk_reg_str="0x&clk_reg"
  )
  else
  (
    &clk_reg_str="----------" 
    &clk_reg_val_str="----------"
  )

  ; Format clock name width

  &left_width="                                           "
  &padding=STRING.CUT("&left_width", STRING.LEN("&clk_name"))

  print "&clk_name&padding &clk_state       &clk_freq_str         &clk_reg_str : &clk_reg_val_str   &clk_reg_cbcr_type"

  return
)



;-----------------------------------------------------------------------------
; Program the clk_test register
;-----------------------------------------------------------------------------

Program_Clk_Test:

  &testval=&clk_test&(&CLK_TEST_TYPE_MASK)
  &selval=&clk_test&(&CLK_TEST_SEL_MASK)

  ; APCS
  if &selval==&CLK_APCS_TEST
  (

    
    &apcs_alias0_glb_clk_diag_reg=&HWIO_APCS_ALIAS0_GLB_CLK_DIAG_ADDR
    &apcs_alias0_glb_clk_diag_val=(data.long(&APCS_access_mode:&apcs_alias0_glb_clk_diag_reg)&~0xffffffff)|(0x0&0xffffffff)
    &apcs_alias0_glb_clk_diag_val=&apcs_alias0_glb_clk_diag_val&~(0x37300<<8.)
    data.set &APCS_access_mode:&apcs_alias0_glb_clk_diag_reg %LONG &apcs_alias0_glb_clk_diag_val&~0x37300|((&testval<<8.)&0x37300)

    
    &gcc_gcc_debug_clk_ctl_reg=&HWIO_GCC_GCC_DEBUG_CLK_CTL_ADDR
    &gcc_gcc_debug_clk_ctl_val=(data.long(&GCC_access_mode:&gcc_gcc_debug_clk_ctl_reg)&~0xffffffff)|(0x10000&0xffffffff)
    &gcc_gcc_debug_clk_ctl_val=&gcc_gcc_debug_clk_ctl_val&~(0x3ff<<0.)
    data.set &GCC_access_mode:&gcc_gcc_debug_clk_ctl_reg %LONG &gcc_gcc_debug_clk_ctl_val&~0x3ff|((0xc0<<0.)&0x3ff)



    ; Frequency counter utility registers.
    &frq_measure_ctl_addr=&HWIO_GCC_CLOCK_FRQ_MEASURE_CTL_ADDR
    &frq_measure_status_addr=&HWIO_GCC_CLOCK_FRQ_MEASURE_STATUS_ADDR
    &xo_div4_cbcr_addr=&HWIO_GCC_GCC_XO_DIV4_CBCR_ADDR

  )

  ; CDSP
  else if &selval==&CLK_CDSP_TEST
  (

    
    &turing_dbg_clk_reg=&HWIO_TURING_DBG_CLK_ADDR
    &turing_dbg_clk_val=(data.long(&CDSP_access_mode:&turing_dbg_clk_reg)&~0xffffffff)|(0x0&0xffffffff)
    &turing_dbg_clk_val=&turing_dbg_clk_val&~(0xff<<0.)
    data.set &CDSP_access_mode:&turing_dbg_clk_reg %LONG &turing_dbg_clk_val&~0xff|((&testval<<0.)&0xff)

    
    &gcc_gcc_debug_clk_ctl_reg=&HWIO_GCC_GCC_DEBUG_CLK_CTL_ADDR
    &gcc_gcc_debug_clk_ctl_val=(data.long(&GCC_access_mode:&gcc_gcc_debug_clk_ctl_reg)&~0xffffffff)|(0x10000&0xffffffff)
    &gcc_gcc_debug_clk_ctl_val=&gcc_gcc_debug_clk_ctl_val&~(0x3ff<<0.)
    data.set &GCC_access_mode:&gcc_gcc_debug_clk_ctl_reg %LONG &gcc_gcc_debug_clk_ctl_val&~0x3ff|((0x189<<0.)&0x3ff)



    ; Frequency counter utility registers.
    &frq_measure_ctl_addr=&HWIO_GCC_CLOCK_FRQ_MEASURE_CTL_ADDR
    &frq_measure_status_addr=&HWIO_GCC_CLOCK_FRQ_MEASURE_STATUS_ADDR
    &xo_div4_cbcr_addr=&HWIO_GCC_GCC_XO_DIV4_CBCR_ADDR

  )

  ; DDRSS
  else if &selval==&CLK_DDRSS_TEST
  (

    
    &mccc_mccc_ch0_spare0_reg=&HWIO_MCCC_MCCC_CH0_SPARE0_ADDR
    &mccc_mccc_ch0_spare0_val=(data.long(&DDRSS_access_mode:&mccc_mccc_ch0_spare0_reg)&~0xffffffff)|(0x0&0xffffffff)
    &mccc_mccc_ch0_spare0_val=&mccc_mccc_ch0_spare0_val&~(0x3<<0.)
    data.set &DDRSS_access_mode:&mccc_mccc_ch0_spare0_reg %LONG &mccc_mccc_ch0_spare0_val&~0x3|((&testval<<0.)&0x3)

    
    &gcc_gcc_debug_clk_ctl_reg=&HWIO_GCC_GCC_DEBUG_CLK_CTL_ADDR
    &gcc_gcc_debug_clk_ctl_val=(data.long(&GCC_access_mode:&gcc_gcc_debug_clk_ctl_reg)&~0xffffffff)|(0x10000&0xffffffff)
    &gcc_gcc_debug_clk_ctl_val=&gcc_gcc_debug_clk_ctl_val&~(0x3ff<<0.)
    data.set &GCC_access_mode:&gcc_gcc_debug_clk_ctl_reg %LONG &gcc_gcc_debug_clk_ctl_val&~0x3ff|((0x19d<<0.)&0x3ff)


    ;MCCC_MCCC_CH0_FSC_STATUS1 : 0x00FFD030
    &mccc_mccc_ch0_fsc_status1=(data.long(&access_mode:0x00FFD030)&0x1)
    if (&mccc_mccc_ch0_fsc_status1==0x1)
    (
      &clk_multiplier=8.
    )

    ; Frequency counter utility registers.
    &frq_measure_ctl_addr=&HWIO_GCC_CLOCK_FRQ_MEASURE_CTL_ADDR
    &frq_measure_status_addr=&HWIO_GCC_CLOCK_FRQ_MEASURE_STATUS_ADDR
    &xo_div4_cbcr_addr=&HWIO_GCC_GCC_XO_DIV4_CBCR_ADDR

  )

  ; GCC
  else if &selval==&CLK_GCC_TEST
  (

    
    &gcc_gcc_debug_clk_ctl_reg=&HWIO_GCC_GCC_DEBUG_CLK_CTL_ADDR
    &gcc_gcc_debug_clk_ctl_val=(data.long(&GCC_access_mode:&gcc_gcc_debug_clk_ctl_reg)&~0xffffffff)|(0x10000&0xffffffff)
    &gcc_gcc_debug_clk_ctl_val=&gcc_gcc_debug_clk_ctl_val&~(0x3ff<<0.)
    data.set &GCC_access_mode:&gcc_gcc_debug_clk_ctl_reg %LONG &gcc_gcc_debug_clk_ctl_val&~0x3ff|((&testval<<0.)&0x3ff)



    ; Frequency counter utility registers.
    &frq_measure_ctl_addr=&HWIO_GCC_CLOCK_FRQ_MEASURE_CTL_ADDR
    &frq_measure_status_addr=&HWIO_GCC_CLOCK_FRQ_MEASURE_STATUS_ADDR
    &xo_div4_cbcr_addr=&HWIO_GCC_GCC_XO_DIV4_CBCR_ADDR

  )

  ; GPU
  else if &selval==&CLK_GPU_TEST
  (

    
    &gpucc_debug_clk_ctl_reg=&HWIO_GPUCC_DEBUG_CLK_CTL_ADDR
    &gpucc_debug_clk_ctl_val=(data.long(&GPU_access_mode:&gpucc_debug_clk_ctl_reg)&~0xffffffff)|(0x50600&0xffffffff)
    &gpucc_debug_clk_ctl_val=&gpucc_debug_clk_ctl_val&~(0xf<<0.)
    data.set &GPU_access_mode:&gpucc_debug_clk_ctl_reg %LONG &gpucc_debug_clk_ctl_val&~0xf|((&testval<<0.)&0xf)

    
    &gcc_gcc_debug_clk_ctl_reg=&HWIO_GCC_GCC_DEBUG_CLK_CTL_ADDR
    &gcc_gcc_debug_clk_ctl_val=(data.long(&GCC_access_mode:&gcc_gcc_debug_clk_ctl_reg)&~0xffffffff)|(0x10000&0xffffffff)
    &gcc_gcc_debug_clk_ctl_val=&gcc_gcc_debug_clk_ctl_val&~(0x3ff<<0.)
    data.set &GCC_access_mode:&gcc_gcc_debug_clk_ctl_reg %LONG &gcc_gcc_debug_clk_ctl_val&~0x3ff|((0x13d<<0.)&0x3ff)



    ; Frequency counter utility registers.
    &frq_measure_ctl_addr=&HWIO_GCC_CLOCK_FRQ_MEASURE_CTL_ADDR
    &frq_measure_status_addr=&HWIO_GCC_CLOCK_FRQ_MEASURE_STATUS_ADDR
    &xo_div4_cbcr_addr=&HWIO_GCC_GCC_XO_DIV4_CBCR_ADDR

  )

  ; LPASS
  else if &selval==&CLK_LPASS_TEST
  (

    
    &lpass_dbg_clk_reg=&HWIO_LPASS_DBG_CLK_ADDR
    &lpass_dbg_clk_val=(data.long(&LPASS_access_mode:&lpass_dbg_clk_reg)&~0xffffffff)|(0x100000&0xffffffff)
    &lpass_dbg_clk_val=&lpass_dbg_clk_val&~(0xffff<<0.)
    data.set &LPASS_access_mode:&lpass_dbg_clk_reg %LONG &lpass_dbg_clk_val&~0xffff|((&testval<<0.)&0xffff)

    
    &gcc_gcc_debug_clk_ctl_reg=&HWIO_GCC_GCC_DEBUG_CLK_CTL_ADDR
    &gcc_gcc_debug_clk_ctl_val=(data.long(&GCC_access_mode:&gcc_gcc_debug_clk_ctl_reg)&~0xffffffff)|(0x10000&0xffffffff)
    &gcc_gcc_debug_clk_ctl_val=&gcc_gcc_debug_clk_ctl_val&~(0x3ff<<0.)
    data.set &GCC_access_mode:&gcc_gcc_debug_clk_ctl_reg %LONG &gcc_gcc_debug_clk_ctl_val&~0x3ff|((0xb9<<0.)&0x3ff)



    ; Frequency counter utility registers.
    &frq_measure_ctl_addr=&HWIO_GCC_CLOCK_FRQ_MEASURE_CTL_ADDR
    &frq_measure_status_addr=&HWIO_GCC_CLOCK_FRQ_MEASURE_STATUS_ADDR
    &xo_div4_cbcr_addr=&HWIO_GCC_GCC_XO_DIV4_CBCR_ADDR

  )

  ; LPASS_Q6
  else if &selval==&CLK_LPASS_Q6_TEST
  (

    
    &lpass_qdsp6ss_test_clk_ctl_reg=&HWIO_LPASS_QDSP6SS_TEST_CLK_CTL_ADDR
    &lpass_qdsp6ss_test_clk_ctl_val=(data.long(&LPASS_Q6_access_mode:&lpass_qdsp6ss_test_clk_ctl_reg)&~0xffffffff)|(0x40&0xffffffff)
    &lpass_qdsp6ss_test_clk_ctl_val=&lpass_qdsp6ss_test_clk_ctl_val&~(0x1f<<0.)
    data.set &LPASS_Q6_access_mode:&lpass_qdsp6ss_test_clk_ctl_reg %LONG &lpass_qdsp6ss_test_clk_ctl_val&~0x1f|((&testval<<0.)&0x1f)

    
    &lpass_dbg_clk_reg=&HWIO_LPASS_DBG_CLK_ADDR
    &lpass_dbg_clk_val=(data.long(&LPASS_access_mode:&lpass_dbg_clk_reg)&~0xffffffff)|(0x100000&0xffffffff)
    &lpass_dbg_clk_val=&lpass_dbg_clk_val&~(0xffff<<0.)
    data.set &LPASS_access_mode:&lpass_dbg_clk_reg %LONG &lpass_dbg_clk_val&~0xffff|((0x1<<0.)&0xffff)

    
    &gcc_gcc_debug_clk_ctl_reg=&HWIO_GCC_GCC_DEBUG_CLK_CTL_ADDR
    &gcc_gcc_debug_clk_ctl_val=(data.long(&GCC_access_mode:&gcc_gcc_debug_clk_ctl_reg)&~0xffffffff)|(0x10000&0xffffffff)
    &gcc_gcc_debug_clk_ctl_val=&gcc_gcc_debug_clk_ctl_val&~(0x3ff<<0.)
    data.set &GCC_access_mode:&gcc_gcc_debug_clk_ctl_reg %LONG &gcc_gcc_debug_clk_ctl_val&~0x3ff|((0xb9<<0.)&0x3ff)



    ; Frequency counter utility registers.
    &frq_measure_ctl_addr=&HWIO_GCC_CLOCK_FRQ_MEASURE_CTL_ADDR
    &frq_measure_status_addr=&HWIO_GCC_CLOCK_FRQ_MEASURE_STATUS_ADDR
    &xo_div4_cbcr_addr=&HWIO_GCC_GCC_XO_DIV4_CBCR_ADDR

  )

  ; MMSS
  else if &selval==&CLK_MMSS_TEST
  (

    
    &mmss_debug_clk_ctl_reg=&HWIO_MMSS_DEBUG_CLK_CTL_ADDR
    &mmss_debug_clk_ctl_val=(data.long(&MMSS_access_mode:&mmss_debug_clk_ctl_reg)&~0xffffffff)|(0x5600&0xffffffff)
    &mmss_debug_clk_ctl_val=&mmss_debug_clk_ctl_val&~(0x1ff<<0.)
    data.set &MMSS_access_mode:&mmss_debug_clk_ctl_reg %LONG &mmss_debug_clk_ctl_val&~0x1ff|((&testval<<0.)&0x1ff)

    
    &gcc_gcc_debug_clk_ctl_reg=&HWIO_GCC_GCC_DEBUG_CLK_CTL_ADDR
    &gcc_gcc_debug_clk_ctl_val=(data.long(&GCC_access_mode:&gcc_gcc_debug_clk_ctl_reg)&~0xffffffff)|(0x10000&0xffffffff)
    &gcc_gcc_debug_clk_ctl_val=&gcc_gcc_debug_clk_ctl_val&~(0x3ff<<0.)
    data.set &GCC_access_mode:&gcc_gcc_debug_clk_ctl_reg %LONG &gcc_gcc_debug_clk_ctl_val&~0x3ff|((0x22<<0.)&0x3ff)



    ; Frequency counter utility registers.
    &frq_measure_ctl_addr=&HWIO_GCC_CLOCK_FRQ_MEASURE_CTL_ADDR
    &frq_measure_status_addr=&HWIO_GCC_CLOCK_FRQ_MEASURE_STATUS_ADDR
    &xo_div4_cbcr_addr=&HWIO_GCC_GCC_XO_DIV4_CBCR_ADDR

  )

  ; MSS
  else if &selval==&CLK_MSS_TEST
  (

    
    &mss_debug_clock_ctl_reg=&HWIO_MSS_DEBUG_CLOCK_CTL_ADDR
    &mss_debug_clock_ctl_val=(data.long(&MSS_access_mode:&mss_debug_clock_ctl_reg)&~0xffffffff)|(0x0&0xffffffff)
    &mss_debug_clock_ctl_val=&mss_debug_clock_ctl_val&~(0x7ff<<0.)
    data.set &MSS_access_mode:&mss_debug_clock_ctl_reg %LONG &mss_debug_clock_ctl_val&~0x7ff|((&testval<<0.)&0x7ff)

    
    &gcc_gcc_debug_clk_ctl_reg=&HWIO_GCC_GCC_DEBUG_CLK_CTL_ADDR
    &gcc_gcc_debug_clk_ctl_val=(data.long(&GCC_access_mode:&gcc_gcc_debug_clk_ctl_reg)&~0xffffffff)|(0x10000&0xffffffff)
    &gcc_gcc_debug_clk_ctl_val=&gcc_gcc_debug_clk_ctl_val&~(0x3ff<<0.)
    data.set &GCC_access_mode:&gcc_gcc_debug_clk_ctl_reg %LONG &gcc_gcc_debug_clk_ctl_val&~0x3ff|((0x125<<0.)&0x3ff)



    ; Frequency counter utility registers.
    &frq_measure_ctl_addr=&HWIO_GCC_CLOCK_FRQ_MEASURE_CTL_ADDR
    &frq_measure_status_addr=&HWIO_GCC_CLOCK_FRQ_MEASURE_STATUS_ADDR
    &xo_div4_cbcr_addr=&HWIO_GCC_GCC_XO_DIV4_CBCR_ADDR

  )

  ; MSS_Q6
  else if &selval==&CLK_MSS_Q6_TEST
  (

    
    &mss_qdsp6ss_test_clk_ctl_reg=&HWIO_MSS_QDSP6SS_TEST_CLK_CTL_ADDR
    &mss_qdsp6ss_test_clk_ctl_val=(data.long(&MSS_Q6_access_mode:&mss_qdsp6ss_test_clk_ctl_reg)&~0xffffffff)|(0x40&0xffffffff)
    &mss_qdsp6ss_test_clk_ctl_val=&mss_qdsp6ss_test_clk_ctl_val&~(0x1f<<0.)
    data.set &MSS_Q6_access_mode:&mss_qdsp6ss_test_clk_ctl_reg %LONG &mss_qdsp6ss_test_clk_ctl_val&~0x1f|((&testval<<0.)&0x1f)

    
    &mss_debug_clock_ctl_reg=&HWIO_MSS_DEBUG_CLOCK_CTL_ADDR
    &mss_debug_clock_ctl_val=(data.long(&MSS_access_mode:&mss_debug_clock_ctl_reg)&~0xffffffff)|(0x0&0xffffffff)
    &mss_debug_clock_ctl_val=&mss_debug_clock_ctl_val&~(0x7ff<<0.)
    data.set &MSS_access_mode:&mss_debug_clock_ctl_reg %LONG &mss_debug_clock_ctl_val&~0x7ff|((0x69<<0.)&0x7ff)

    
    &gcc_gcc_debug_clk_ctl_reg=&HWIO_GCC_GCC_DEBUG_CLK_CTL_ADDR
    &gcc_gcc_debug_clk_ctl_val=(data.long(&GCC_access_mode:&gcc_gcc_debug_clk_ctl_reg)&~0xffffffff)|(0x10000&0xffffffff)
    &gcc_gcc_debug_clk_ctl_val=&gcc_gcc_debug_clk_ctl_val&~(0x3ff<<0.)
    data.set &GCC_access_mode:&gcc_gcc_debug_clk_ctl_reg %LONG &gcc_gcc_debug_clk_ctl_val&~0x3ff|((0x125<<0.)&0x3ff)



    ; Frequency counter utility registers.
    &frq_measure_ctl_addr=&HWIO_GCC_CLOCK_FRQ_MEASURE_CTL_ADDR
    &frq_measure_status_addr=&HWIO_GCC_CLOCK_FRQ_MEASURE_STATUS_ADDR
    &xo_div4_cbcr_addr=&HWIO_GCC_GCC_XO_DIV4_CBCR_ADDR

  )

  ; WCSS
  else if &selval==&CLK_WCSS_TEST
  (

    
    &wcss_hm_a_wcss_clk_ctl_wcss_debug_clk_reg=&HWIO_WCSS_HM_A_WCSS_CLK_CTL_WCSS_DEBUG_CLK_ADDR
    &wcss_hm_a_wcss_clk_ctl_wcss_debug_clk_val=(data.long(&WCSS_access_mode:&wcss_hm_a_wcss_clk_ctl_wcss_debug_clk_reg)&~0xffffffff)|(0x0&0xffffffff)
    &wcss_hm_a_wcss_clk_ctl_wcss_debug_clk_val=&wcss_hm_a_wcss_clk_ctl_wcss_debug_clk_val&~(0x7ff<<0.)
    data.set &WCSS_access_mode:&wcss_hm_a_wcss_clk_ctl_wcss_debug_clk_reg %LONG &wcss_hm_a_wcss_clk_ctl_wcss_debug_clk_val&~0x7ff|((&testval<<0.)&0x7ff)

    
    &gcc_gcc_debug_clk_ctl_reg=&HWIO_GCC_GCC_DEBUG_CLK_CTL_ADDR
    &gcc_gcc_debug_clk_ctl_val=(data.long(&GCC_access_mode:&gcc_gcc_debug_clk_ctl_reg)&~0xffffffff)|(0x10000&0xffffffff)
    &gcc_gcc_debug_clk_ctl_val=&gcc_gcc_debug_clk_ctl_val&~(0x3ff<<0.)
    data.set &GCC_access_mode:&gcc_gcc_debug_clk_ctl_reg %LONG &gcc_gcc_debug_clk_ctl_val&~0x3ff|((0x13a<<0.)&0x3ff)


    data.set &WCSS_access_mode:0x189d60f4 %long 0x1 ; WCSS_HM_A_WCSS_CLK_CTL_WCSS_DEBUG_CBCR

    ; Frequency counter utility registers.
    &frq_measure_ctl_addr=&HWIO_GCC_CLOCK_FRQ_MEASURE_CTL_ADDR
    &frq_measure_status_addr=&HWIO_GCC_CLOCK_FRQ_MEASURE_STATUS_ADDR
    &xo_div4_cbcr_addr=&HWIO_GCC_GCC_XO_DIV4_CBCR_ADDR

  )
 
  return
  

Configure_GPIO:
    
    ; Configure HS GPIO
     data.set &access_mode:&HWIO_TLMM_GPIO_CFG11_ADDR %LONG 0x1D0
     print "GPIO 11 configured and output enabled"    

    ;&val=data.long(&GCC_access_mode:&HWIO_GCC_PLLTEST_PAD_CFG_ADDR)|0xa1000
    ;data.set &GCC_access_mode:&HWIO_GCC_PLLTEST_PAD_CFG_ADDR %LONG &val
    ;print "PLLTEST_PAD enabled in GCC_PLLTEST_PAD_CFG."

    return

Set_Dividers:
    
    &val=(data.long(&GCC_access_mode:&HWIO_GCC_GCC_DEBUG_CLK_CTL_ADDR)&~0xf000)|(0x3<<12.)
    data.set &GCC_access_mode:&HWIO_GCC_GCC_DEBUG_CLK_CTL_ADDR %LONG &val

    return

Clear_Dividers:
    
    &val=(data.long(&GCC_access_mode:&HWIO_GCC_GCC_DEBUG_CLK_CTL_ADDR)&~0xf000)
    data.set &GCC_access_mode:&HWIO_GCC_GCC_DEBUG_CLK_CTL_ADDR %LONG &val

    return


Print_Clock_Help:


  print " "
  print "*****************************************************  APCS  ******************************************************"

  print " "
  print "[ APCS ]" 
  print " apc0_sysleaf_clk                   apc1_sysleaf_clk                   gladiator_sysleaf_clk               " 
  print " sys_apcsqsb_clk                    im_sleep_clk                       lmh_lite_clk                        " 
  print " cl0_apcpll_lockdet                 cl1_apcpll_lockdet                 cci_apcpll_lockdet                  " 
  print " "
  print "[ EXT ]" 

  print " "
  print "*****************************************************  CDSP  ******************************************************"

  print " "
  print "[ AON BUS ]" 
  print " aon_clk_src                        q6ss_ahbm_aon_clk                  q6ss_ahbs_aon_clk                   " 
  print " turing_wrapper_aon_clk             turing_wrapper_bus_timeout_aon_clk turing_wrapper_mpu_cfg_aon_clk      " 
  print " turing_wrapper_q6_ahbm_mpu_aon_clk turing_wrapper_qos_ahbs_aon_clk    turing_wrapper_sysnoc_sway_aon_clk  " 
  print " "
  print "[ AUDIO_CORE ]" 
  print "  " 
  print " "
  print "[ AXI ]" 
  print " q6ss_q6_axim_clk                   turing_wrapper_q6_smmu_axi_clk      " 
  print " "
  print "[ CAMSS_STREAMING_0 ]" 
  print " q6ss_q6_camss_dsp_streaming_0_clk   " 
  print " "
  print "[ CAMSS_STREAMING_1 ]" 
  print " q6ss_q6_camss_dsp_streaming_1_clk   " 
  print " "
  print "[ CNOC ]" 
  print " turing_wrapper_q6_smmu_cfg_cnoc_clk " 
  print " "
  print "[ CXO ]" 
  print " xo_clk_src                         audio_core_gdsc_xo_clk             q6ss_xo_clk                         " 
  print " turing_wrapper_q6_smmu_gdsc_xo_clk turing_wrapper_qos_xo_lat_counter_clk " 
  print " "
  print "[ DEBUG CLOCK MUX ]" 
  print "  " 
  print " "
  print "[ Q6_SMMU ]" 
  print "  " 
  print " "
  print "[ Q6SS ZMEAS & RCG ]" 
  print "  " 
  print " "
  print "[ QOS FIXED MONITOR ]" 
  print " qos_fixed_lat_counter_src          turing_wrapper_qos_danger_fixed_lat_counter_clkturing_wrapper_qos_dmonitor_fixed_lat_counter_clk " 
  print " "
  print "[ SLEEP ]" 
  print " sleep_clk_src                      q6ss_slp_clk                        " 
  print " "
  print "[ SNOC ]" 
  print " turing_wrapper_sysnoc_sway_snoc_clk " 
  print " "
  print "[ EXT ]" 
  print "  " 

  print " "
  print "***************************************************** DDRSS  ******************************************************"

  print " "
  print "[ DDRSS ]" 
  print " ddrss_ch0_mc_clk                   ddrss_ch1_mc_clk                    " 
  print " "
  print "[ EXT ]" 

  print " "
  print "*****************************************************  GCC   ******************************************************"

  print " "
  print "[ STANDALONEBCR ]" 
  print "  " 
  print " "
  print "[ AGGRE2_NOC ]" 
  print "  " 
  print " "
  print "[ BIMC ]" 
  print " gcc_bimc_clk                       gcc_spdm_bimc_cy_clk               gcc_bimc_dtts_xo_clk                " 
  print " gcc_bimc_xo_clk                    gcc_cfg_noc_ddr_cfg_clk            gcc_cnoc_bus_timeout5_ahb_clk       " 
  print " gcc_ddr_dim_cfg_clk                 " 
  print " "
  print "[ BLSP1 ]" 
  print " gcc_blsp1_uart1_sim_clk            gcc_blsp1_uart2_sim_clk            gcc_blsp2_uart1_sim_clk             " 
  print " gcc_blsp2_uart2_sim_clk             " 
  print " "
  print "[ BLSP1_QUP1 ]" 
  print " gcc_blsp1_qup1_i2c_apps_clk        gcc_blsp1_qup1_spi_apps_clk         " 
  print " "
  print "[ BLSP1_QUP2 ]" 
  print " gcc_blsp1_qup2_i2c_apps_clk        gcc_blsp1_qup2_spi_apps_clk         " 
  print " "
  print "[ BLSP1_QUP3 ]" 
  print " gcc_blsp1_qup3_i2c_apps_clk        gcc_blsp1_qup3_spi_apps_clk         " 
  print " "
  print "[ BLSP1_QUP4 ]" 
  print " gcc_blsp1_qup4_i2c_apps_clk        gcc_blsp1_qup4_spi_apps_clk         " 
  print " "
  print "[ BLSP1_UART1 ]" 
  print " gcc_blsp1_uart1_apps_clk            " 
  print " "
  print "[ BLSP1_UART2 ]" 
  print " gcc_blsp1_uart2_apps_clk            " 
  print " "
  print "[ BLSP2_QUP1 ]" 
  print " gcc_blsp2_qup1_i2c_apps_clk        gcc_blsp2_qup1_spi_apps_clk         " 
  print " "
  print "[ BLSP2_QUP2 ]" 
  print " gcc_blsp2_qup2_i2c_apps_clk        gcc_blsp2_qup2_spi_apps_clk         " 
  print " "
  print "[ BLSP2_QUP3 ]" 
  print " gcc_blsp2_qup3_i2c_apps_clk        gcc_blsp2_qup3_spi_apps_clk         " 
  print " "
  print "[ BLSP2_QUP4 ]" 
  print " gcc_blsp2_qup4_i2c_apps_clk        gcc_blsp2_qup4_spi_apps_clk         " 
  print " "
  print "[ BLSP2_UART1 ]" 
  print " gcc_blsp2_uart1_apps_clk            " 
  print " "
  print "[ BLSP2_UART2 ]" 
  print " gcc_blsp2_uart2_apps_clk            " 
  print " "
  print "[ CE1 ]" 
  print " gcc_ce1_clk                         " 
  print " "
  print "[ CONFIG_NOC ]" 
  print " gcc_aggre2_cnoc_north_periph_ahb_clkgcc_aggre2_cnoc_periph_ahb_clk     gcc_aggre2_cnoc_south_periph_ahb_clk " 
  print " gcc_blsp1_ahb_clk                  gcc_blsp2_ahb_clk                  gcc_cnoc_bus_timeout0_ahb_clk       " 
  print " gcc_cnoc_periph_ahb_clk            gcc_cnoc_periph_bus_timeout1_ahb_clkgcc_cnoc_periph_bus_timeout2_ahb_clk " 
  print " gcc_cnoc_periph_north_ahb_clk      gcc_cnoc_periph_south_ahb_clk      gcc_pdm_ahb_clk                     " 
  print " gcc_qspi_ahb_clk                   gcc_sdcc1_ahb_clk                  gcc_sdcc2_ahb_clk                   " 
  print " gcc_spdm_pnoc_cy_clk               gcc_a2noc_throttle_cfg_clk         gcc_aggre2_cnoc_ahb_clk             " 
  print " gcc_aggre2_noc_msmpu_cfg_ahb_clk   gcc_ahb_clk                        gcc_bimc_cfg_ahb_clk                " 
  print " gcc_bimc_nius_cfg_ahb_clk          gcc_boot_rom_ahb_clk               gcc_ce1_ahb_clk                     " 
  print " gcc_cfg_noc_ahb_clk                gcc_cfg_noc_lpass_aon_ahb_clk      gcc_cfg_noc_north_ahb_clk           " 
  print " gcc_cfg_noc_south_ahb_clk          gcc_cfg_noc_turing_aon_ahb_clk     gcc_cnoc_bus_timeout10_ahb_clk      " 
  print " gcc_cnoc_bus_timeout11_ahb_clk     gcc_cnoc_bus_timeout2_ahb_clk      gcc_cnoc_bus_timeout3_ahb_clk       " 
  print " gcc_cnoc_bus_timeout4_ahb_clk      gcc_cnoc_bus_timeout6_ahb_clk      gcc_cnoc_bus_timeout7_ahb_clk       " 
  print " gcc_cnoc_bus_timeout8_ahb_clk      gcc_cnoc_bus_timeout9_ahb_clk      gcc_cnoc_mst_rpm_ahb_clk            " 
  print " gcc_dcc_ahb_clk                    gcc_glm_ahb_clk                    gcc_gpu_cfg_ahb_clk                 " 
  print " gcc_imem_cfg_ahb_clk               gcc_ipa_ahb_clk                    gcc_lpass_cnoc_cfg_clk              " 
  print " gcc_lpass_q6_smmu_ahb_clk          gcc_lpass_q6_smmu_gds_cfg_clk      gcc_mccc_cfg_ahb_clk                " 
  print " gcc_mmss_noc_cfg_ahb_clk           gcc_mmss_qm_ahb_clk                gcc_mpm_ahb_clk                     " 
  print " gcc_msg_ram_ahb_clk                gcc_mss_cfg_ahb_clk                gcc_mss_msmpu_cfg_ahb_clk           " 
  print " gcc_mss_q6_msmpu_cfg_ahb_clk       gcc_pimem_ahb_clk                  gcc_prng_ahb_clk                    " 
  print " gcc_qdss_cfg_ahb_clk               gcc_qdss_dap_ahb_clk               gcc_rbcpr_cx_ahb_clk                " 
  print " gcc_rbcpr_mx_ahb_clk               gcc_rpm_mst_m2_cnoc_ahb_clk        gcc_sec_ctrl_ahb_clk                " 
  print " gcc_sec_ctrl_boot_rom_patch_clk    gcc_smmu_aggre2_ahb_clk            gcc_snoc_bus_timeout4_ahb_clk       " 
  print " gcc_snoc_cnoc_ahb_clk              gcc_spdm_cfg_ahb_clk               gcc_spdm_mstr_ahb_clk               " 
  print " gcc_spmi_cnoc_ahb_clk              gcc_tcsr_ahb_clk                   gcc_tic_cfg_ahb_clk                 " 
  print " gcc_tlmm_centre_ahb_clk            gcc_tlmm_clk                       gcc_tlmm_north_ahb_clk              " 
  print " gcc_tlmm_south_ahb_clk             gcc_turing_q6_smmu_ahb_clk         gcc_ufs_ahb_clk                     " 
  print " gcc_usb_phy_cfg_ahb2phy_clk         " 
  print " "
  print "[ DDR_DIM_WRAPPER ]" 
  print " gcc_bimc_ddr_cpll0_clk             gcc_bimc_ddr_cpll1_clk              " 
  print " "
  print "[ DEBUG ]" 
  print " gcc_spdm_debug_cy_clk               " 
  print " "
  print "[ EXTERNAL RAW CLOCKS ]" 
  print " gcc_cfg_noc_tic_clk                gcc_tic_clk                         " 
  print " "
  print "[ GCC ]" 
  print " gcc_bimc_sleep_clk                 gcc_blsp1_sleep_clk                gcc_blsp2_sleep_clk                 " 
  print " gcc_ddr_dim_sleep_clk              gcc_im_sleep_clk                   gcc_ipa_sleep_clk                   " 
  print " gcc_rpm_sleep_clk                  gcc_usb20_sleep_clk                gcc_usb30_sleep_clk                 " 
  print " gcc_a2noc_throttle_cxo_clk         gcc_aggre2_noc_cxo_north_clk       gcc_aggre2_noc_cxo_south_clk        " 
  print " gcc_ahb2phy_east_clk               gcc_cfg_noc_ah2phy_xo_clk          gcc_cfg_noc_dcd_xo_clk              " 
  print " gcc_cfg_noc_north_dcd_xo_clk       gcc_cfg_noc_south_dcd_xo_clk       gcc_cm_phy_refgen1_clk              " 
  print " gcc_cm_phy_refgen2_clk             gcc_cnoc_bus_timeout13_ahb_clk     gcc_glm_xo_clk                      " 
  print " gcc_lpass_cxo_clk                  gcc_pdm_xo4_clk                    gcc_qdss_xo_clk                     " 
  print " gcc_qrefs_vbg_cal_clk              gcc_rpm_timer_clk                  gcc_spdm_ff_clk                     " 
  print " gcc_sram_sensor_xo_clk             gcc_sys_noc_dcd_xo_clk             gcc_xo_clk                          " 
  print " gcc_xo_div4_clk                     " 
  print " "
  print "[ GLM ]" 
  print " gcc_glm_clk                         " 
  print " "
  print "[ GP1 ]" 
  print " gcc_gp1_clk                         " 
  print " "
  print "[ GP2 ]" 
  print " gcc_gp2_clk                         " 
  print " "
  print "[ GP3 ]" 
  print " gcc_gp3_clk                         " 
  print " "
  print "[ GPU ]" 
  print " gcc_bimc_gfx_clk                   gcc_gpu_bimc_gfx_clk               gcc_gpu_bimc_gfx_src_clk            " 
  print " gcc_gpu_snoc_dvm_gfx_clk            " 
  print " "
  print "[ HMSS ]" 
  print " gcc_bimc_hmss_axi_clk              gcc_hmss_ahb_clk                   gcc_sys_noc_hmss_ahb_clk            " 
  print " gcc_hmss_rbcpr_clk                  " 
  print " "
  print "[ IPA ]" 
  print " gcc_aggre2_noc_ipa_clk             gcc_ipa_2x_clk                     gcc_ipa_clk                         " 
  print " "
  print "[ LPASS ]" 
  print " gcc_cdsp_bimc_clk                  gcc_sys_noc_cdsp_clk               gcc_turing_q6_axi_clk               " 
  print " gcc_turing_q6_smmu_axi_clk         gcc_turing_q6_smmu_axi_src_clk      " 
  print " "
  print "[ MMSS ]" 
  print " gcc_mmss_qm_core_clk                " 
  print " "
  print "[ MSS ]" 
  print " gcc_bimc_mss_q6_axi_clk            gcc_mss_q6_bimc_axi_clk            gcc_mss_q6_msmpu_client_axi_clk     " 
  print " "
  print "[ OBT_ODT ]" 
  print " gcc_obt_odt_clk                     " 
  print " "
  print "[ PDM ]" 
  print " gcc_pdm2_clk                        " 
  print " "
  print "[ PIMEM ]" 
  print " gcc_bimc_pimem_axi_clk             gcc_pimem_axi_clk                  gcc_sys_noc_pimem_axi_clk           " 
  print " "
  print "[ QDSS ]" 
  print " gcc_center_apb_clk                 gcc_gpu_trig_clk                   gcc_hmss_trig_clk                   " 
  print " gcc_lpass_trig_clk                 gcc_mmss_trig_clk                  gcc_mss_trig_clk                    " 
  print " gcc_north_apb_clk                  gcc_qdss_apb2jtag_clk              gcc_qdss_dap_clk                    " 
  print " gcc_qdss_trig_clk                  gcc_south_apb_clk                  gcc_turing_trig_clk                 " 
  print " gcc_wcss_apb_clk                   gcc_aggre2_noc_at_clk              gcc_gpu_at_clk                      " 
  print " gcc_hmss_at_clk                    gcc_mmss_at_clk                    gcc_mmss_noc_at_clk                 " 
  print " gcc_north_at_clk                   gcc_qdss_center_at_clk             gcc_south_at_clk                    " 
  print " gcc_sys_noc_at_clk                 gcc_wcss_at_clk                    gcc_bimc_at_clk                     " 
  print " gcc_mss_at_clk                     gcc_lpass_at_clk                   gcc_turing_at_clk                   " 
  print " gcc_qdss_stm_clk                   gcc_sys_noc_qdss_stm_axi_clk       gcc_qdss_traceclkin_clk             " 
  print " gcc_apss_qdss_tsctr_div2_clk       gcc_apss_qdss_tsctr_div8_clk       gcc_qdss_tsctr_div16_clk            " 
  print " gcc_qdss_tsctr_div2_clk            gcc_qdss_tsctr_div3_clk            gcc_qdss_tsctr_div4_clk             " 
  print " gcc_qdss_tsctr_div8_clk            gcc_wcss_tsctr_div2_clk             " 
  print " "
  print "[ QSPI ]" 
  print " gcc_qspi_ser_clk                    " 
  print " "
  print "[ RBCPR_CX ]" 
  print " gcc_rbcpr_cx_clk                    " 
  print " "
  print "[ RBCPR_MX ]" 
  print " gcc_rbcpr_mx_clk                    " 
  print " "
  print "[ RPM ]" 
  print " gcc_rpm_bus_ahb_clk                gcc_rpm_proc_fclk                  gcc_rpm_proc_hclk                   " 
  print " gcc_spdm_rpm_cy_clk                 " 
  print " "
  print "[ SDCC1 ]" 
  print " gcc_sdcc1_apps_clk                 gcc_sdcc1_ice_core_clk              " 
  print " "
  print "[ SDCC2 ]" 
  print " gcc_sdcc2_apps_clk                  " 
  print " "
  print "[ SEC_CTRL ]" 
  print " gcc_sec_ctrl_acc_clk               gcc_sec_ctrl_clk                   gcc_sec_ctrl_sense_clk              " 
  print " "
  print "[ SPMI ]" 
  print " gcc_spmi_ahb_clk                   gcc_spmi_ser_clk                    " 
  print " "
  print "[ SYSTEM_NOC ]" 
  print " gcc_bimc_nius_hs_axi_clk           gcc_bimc_sysnoc_hs_axi_clk         gcc_lpass_q6_axi_clk                " 
  print " gcc_lpass_q6_smmu_axi_clk          gcc_lpass_q6_smmu_axi_src_clk      gcc_mss_mnoc_bimc_axi_clk           " 
  print " gcc_mss_msmpu_client_axi_clk       gcc_sys_noc_hs_axi_clk             gcc_a2noc_throttle_core_axi_clk     " 
  print " gcc_aggre2_snoc_axi_clk            gcc_aggre2_snoc_msmpu_client_axi_clkgcc_aggre2_snoc_north_axi_clk       " 
  print " gcc_aggre2_snoc_south_axi_clk      gcc_bimc_nius_axi_clk              gcc_bimc_sysnoc_axi_clk             " 
  print " gcc_ce1_axi_clk                    gcc_hmss_dvm_bus_clk               gcc_imem_axi_clk                    " 
  print " gcc_lpass_mport_clk                gcc_lpass_sway_clk                 gcc_lpass_sway_mpu_clk              " 
  print " gcc_mmss_sys_noc_axi_clk           gcc_mss_snoc_axi_clk               gcc_qdss_etr_usb_clk                " 
  print " gcc_smmu_aggre2_axi_clk            gcc_smmu_aggre2_axi_src_clk        gcc_snoc_bus_timeout0_ahb_clk       " 
  print " gcc_snoc_bus_timeout1_ahb_clk      gcc_snoc_bus_timeout3_ahb_clk      gcc_snoc_lpass_q6_axis_clk          " 
  print " gcc_spdm_snoc_cy_clk               gcc_sys_noc_axi_clk                gcc_sys_noc_north_axi_clk           " 
  print " gcc_sys_noc_south_axi_clk          gcc_turing_sway_clk                gcc_wcss_ahb_s0_clk                 " 
  print " gcc_wcss_axi_m_clk                 gcc_wcss_ecahb_clk                 gcc_wcss_shdreg_ahb_clk             " 
  print " "
  print "[ UFS ]" 
  print " gcc_aggre2_ufs_axi_clk             gcc_ufs_axi_clk                    gcc_ufs_ice_core_clk                " 
  print " gcc_ufs_phy_aux_clk                gcc_ufs_rx_symbol_0_clk            gcc_ufs_rx_symbol_1_clk             " 
  print " gcc_ufs_tx_symbol_0_clk            gcc_ufs_unipro_core_clk             " 
  print " "
  print "[ USB_20 ]" 
  print " gcc_cfg_noc_usb2_axi_clk           gcc_cnoc_bus_timeout12_ahb_clk     gcc_usb20_master_clk                " 
  print " gcc_usb20_mock_utmi_clk             " 
  print " "
  print "[ USB_30 ]" 
  print " gcc_aggre2_usb3_axi_clk            gcc_cfg_noc_usb3_axi_clk           gcc_cnoc_bus_timeout14_ahb_clk      " 
  print " gcc_usb30_master_clk               gcc_usb30_mock_utmi_clk            gcc_usb3_phy_aux_clk                " 
  print " gcc_usb3_phy_pipe_clk               " 
  print " "
  print "[ VS ]" 
  print " gcc_apc0_vs_clk                    gcc_apc1_vs_clk                    gcc_mss_vs_clk                      " 
  print " gcc_vdda_vs_clk                    gcc_vddcx_vs_clk                   gcc_vddmx_vs_clk                    " 
  print " gcc_vs_ctrl_clk                    gcc_wcss_vs_clk                     " 
  print " "
  print "[ EXT ]" 
  print " gcc_aggre2_noc_qosgen_extref       gcc_cnoc_bus_timeout_extref        gcc_snoc_bus_timeout_extref         " 
  print " gcc_snoc_qosgen_extref             gpll0_dtest                        gpll1_dtest                         " 
  print " gpll2_dtest                        gpll3_dtest                        gpll4_dtest                         " 
  print " gpll5_dtest                        gpll6_dtest                        gpu_gcc_dbg_clk                     " 
  print " hmss_gcc_dbg_clk                   lpass_gcc_dbg_clk                  mccc_ddrss_gcc_ch_clk               " 
  print " mmss_gcc_dbg_clk                   mpm_gcc_temp0_sensor_ringosc_clk   mpm_gcc_temp1_sensor_ringosc_clk    " 
  print " mss_gcc_dbg_clk                    nav_gcc_dbg_clk                    nav_pll_dtest                       " 
  print " qusb2phy_gcc_clk_test_prim         qusb2phy_gcc_clk_test_sec          qusb2phy_prim_gcc_usb30_utmi_clk    " 
  print " qusb2phy_sec_gcc_usb20s_utmi_clk   turing_gcc_dbg_clk                 ufs_rx_symbol_0_clk                 " 
  print " ufs_rx_symbol_1_clk                ufs_tx_symbol_0_clk                usb3_phy_wrapper_gcc_usb3_pipe_clk  " 
  print " wcss_gcc_dbg_clk                    " 

  print " "
  print "*****************************************************  GPU   ******************************************************"

  print " "
  print "[ STANDALONEBCR ]" 
  print "  " 
  print " "
  print "[ GPU_CX ]" 
  print "  " 
  print " "
  print "[ GPU_GX ]" 
  print " gpucc_gfx3d_clk                    gpucc_spdm_gfx3d_clk               gpucc_rbbmtimer_clk                 " 
  print " "
  print "[ RAW ]" 
  print " gpucc_cxo_clk                       " 
  print " "
  print "[ RBCPR ]" 
  print " gpucc_rbcpr_clk                     " 
  print " "
  print "[ EXT ]" 
  print "  " 

  print " "
  print "***************************************************** LPASS  ******************************************************"

  print " "
  print "[ STANDALONEBCR ]" 
  print "  " 
  print " "
  print "[ AON BUS ]" 
  print " aon_clk_src                        audio_core_qdsp_sway_aon_clk       audio_wrapper_aon_clk               " 
  print " audio_wrapper_bus_timeout_aon_clk  audio_wrapper_mpu_cfg_aon_clk      audio_wrapper_q6_ahbm_mpu_aon_clk   " 
  print " audio_wrapper_qos_ahbs_aon_clk     audio_wrapper_sysnoc_sway_aon_clk  island_scc_cfg_ahb_aon_clk          " 
  print " island_scc_crif_aon_clk            island_scc_csr_h_aon_clk           island_scc_data_h_aon_clk           " 
  print " island_scc_qdsp_sway_aon_clk       q6ss_ahbm_aon_clk                  q6ss_ahbs_aon_clk                   " 
  print " "
  print "[ ATIME ]" 
  print " atime_clk_src                      audio_core_avsync_atime_clk         " 
  print " "
  print "[ AUD SLIMBUS ]" 
  print " aud_slimbus_clk_src                audio_core_aud_slimbus_clk          " 
  print " "
  print "[ AUDIO_CORE ]" 
  print "  " 
  print " "
  print "[ AUDIO_CORE_LPAIF_PCM_DATA_OE ]" 
  print " lpaif_pcmoe_clk_src                audio_core_lpaif_pcm_data_oe_clk    " 
  print " "
  print "[ CORE BUS ]" 
  print " core_clk_src                       audio_core_aud_slimbus_core_clk    audio_core_bus_timeout_core_clk     " 
  print " audio_core_core_clk                audio_core_lpm_core_clk            audio_core_qca_slimbus_core_clk     " 
  print " audio_core_sysnoc_mport_core_clk   island_scc_ahb_timeout_core_clk    island_scc_blsp_h_core_clk          " 
  print " island_scc_sensor_core_core_clk    island_scc_smem_core_clk            " 
  print " "
  print "[ CXO ]" 
  print " xo_clk_src                         audio_core_avsync_stc_clk          audio_core_gdsc_xo_clk              " 
  print " audio_wrapper_qos_xo_lat_counter_clkq6ss_xo_clk                         " 
  print " "
  print "[ DEBUG BUS ]" 
  print " island_scc_at_clk                  island_scc_pclkdbg_clk             island_scc_q6_atbm_clk              " 
  print " "
  print "[ DEBUG CLOCK MUX ]" 
  print "  " 
  print " "
  print "[ DEBUG TSCTR BUS ]" 
  print " island_scc_dbg_tsctr_clk            " 
  print " "
  print "[ EXT MCLK0 ]" 
  print " ext_mclk0_clk_src                  audio_wrapper_ext_mclk0_clk         " 
  print " "
  print "[ EXT MCLK1 ]" 
  print " ext_mclk1_clk_src                  audio_wrapper_ext_mclk1_clk         " 
  print " "
  print "[ EXT MCLK2 ]" 
  print " ext_mclk2_clk_src                  audio_wrapper_ext_mclk2_clk         " 
  print " "
  print "[ EXT MCLK3 ]" 
  print " audio_wrapper_ext_mclk3_clk         " 
  print " "
  print "[ INT MCLK0 ]" 
  print " audio_core_int_mclk0_clk            " 
  print " "
  print "[ INT MCLK1 ]" 
  print " audio_core_int_mclk1_clk            " 
  print " "
  print "[ INT MI2S0_1 ]" 
  print " audio_core_int_i2s0_1_ibit_clk      " 
  print " "
  print "[ INT MI2S2 ]" 
  print " audio_core_int_i2s2_ibit_clk        " 
  print " "
  print "[ INT MI2S3 ]" 
  print " audio_core_int_i2s3_ibit_clk        " 
  print " "
  print "[ INT MI2S3_4 ]" 
  print " audio_core_int_i2s4_ibit_clk        " 
  print " "
  print "[ INT MI2S5_6 ]" 
  print " audio_core_int_i2s5_6_ibit_clk      " 
  print " "
  print "[ PRIMARY PCM ]" 
  print " lpaif_pri_clk_src                  audio_core_lpaif_pri_ibit_clk      audio_core_lpaif_pri_ebit_clk       " 
  print " "
  print "[ Q6_SMMU ]" 
  print "  " 
  print " "
  print "[ Q6SS ZMEAS & RCG ]" 
  print "  " 
  print " "
  print "[ QCA SLIMBUS ]" 
  print " qca_slimbus_clk_src                audio_core_qca_slimbus_clk          " 
  print " "
  print "[ QOS FIXED MONITOR ]" 
  print " qos_fixed_lat_counter_clk_src      audio_core_qos_dmonitor_fixed_lat_counter_clkaudio_wrapper_qos_danger_fixed_lat_counter_clk " 
  print " audio_wrapper_qos_dmonitor_fixed_lat_counter_clk " 
  print " "
  print "[ QUATERNARY PCM ]" 
  print " lpaif_quad_clk_src                 audio_core_lpaif_quad_ibit_clk     audio_core_lpaif_quad_ebit_clk      " 
  print " "
  print "[ REF CLK MUX ]" 
  print "  " 
  print " "
  print "[ RESAMPLER ]" 
  print " resampler_clk_src                  audio_core_resampler_clk            " 
  print " "
  print "[ SCC 100 ]" 
  print " island_scc_qup_i2c1_clk            island_scc_qup_i2c2_clk            island_scc_qup_i2c3_clk             " 
  print " island_scc_qup_spi1_clk            island_scc_qup_spi2_clk            island_scc_qup_spi3_clk             " 
  print " "
  print "[ SCC Q6 SPM ]" 
  print " island_scc_q6_spm_clk              island_scc_sensor_core_bcr_xo_clk   " 
  print " "
  print "[ SCC_UART1 ]" 
  print " scc_uart1_clk_src                  island_scc_uart_dm_uart1_clk        " 
  print " "
  print "[ SCC_UART2 ]" 
  print " scc_uart2_clk_src                  island_scc_uart_dm_uart2_clk        " 
  print " "
  print "[ SCC_UART3 ]" 
  print " scc_uart3_clk_src                  island_scc_uart_dm_uart3_clk        " 
  print " "
  print "[ SCC_UART4 ]" 
  print " scc_uart4_clk_src                  island_scc_uart_dm_uart4_clk        " 
  print " "
  print "[ SCC_VS ]" 
  print " island_scc_vs_vddcx_clk            island_scc_vs_vddmx_clk             " 
  print " "
  print "[ SECONDARY PCM ]" 
  print " lpaif_sec_clk_src                  audio_core_lpaif_sec_ibit_clk      audio_core_lpaif_sec_ebit_clk       " 
  print " "
  print "[ SLEEP ]" 
  print " sleep_clk_src                      audio_core_bcr_slp_clk             island_scc_sensor_core_bcr_slp_clk  " 
  print " q6ss_bcr_slp_clk                   q6ss_slp_clk                        " 
  print " "
  print "[ SW NPL ]" 
  print " audio_wrapper_sw_npl_clk            " 
  print " "
  print "[ TERTIARY PCM ]" 
  print " lpaif_ter_clk_src                  audio_core_lpaif_ter_ibit_clk      audio_core_lpaif_ter_ebit_clk       " 
  print " "
  print "[ LPASS_QDSP6_CORE ]" 
  print " lpass_qdsp6ss_q6_core_clk          lpass_qdsp6ss_axi_m_clk            lpass_qdsp6ss_ldo_nmo_out           " 
  print " lpass_qdsp6ss_ahb_m_clk            lpass_qdsp6ss_ahb_s_clk            lpass_qdsp6ss_xo_clk                " 
  print " lpass_qdsp6ss_sleep_clk            lpass_qdsp6ss_jtag_tck             lpass_qdsp6ss_atb_clk               " 
  print " lpass_qdsp6ss_apb_clk              lpass_qdsp6ss_timestamp_clk         " 
  print " "
  print "[ EXT ]" 
  print "  " 

  print " "
  print "*****************************************************  MMSS  ******************************************************"

  print " "
  print "[  ]" 
  print " mmss_sleep_clk                     mmss_cxo_clk                       mmss_misc_cxo_clk                   " 
  print " mmss_throttle_camss_cxo_clk        mmss_throttle_mdss_cxo_clk         mmss_throttle_video_cxo_clk         " 
  print " "
  print "[ BIMC_SMMU ]" 
  print "  " 
  print " "
  print "[ CAMSS_CCI ]" 
  print " mmss_camss_cci_clk                  " 
  print " "
  print "[ CAMSS_CPP ]" 
  print " mmss_camss_cpp_clk                 mmss_spdm_cpp_clk                   " 
  print " "
  print "[ CAMSS_CSI0 ]" 
  print " mmss_camss_csi0_clk                mmss_camss_csi0pix_clk             mmss_camss_csi0rdi_clk              " 
  print " mmss_spdm_csi0_clk                 mmss_spdm_debug_clk                 " 
  print " "
  print "[ CAMSS_CSI1 ]" 
  print " mmss_camss_csi1_clk                mmss_camss_csi1pix_clk             mmss_camss_csi1rdi_clk              " 
  print " "
  print "[ CAMSS_CSI2 ]" 
  print " mmss_camss_csi2_clk                mmss_camss_csi2pix_clk             mmss_camss_csi2rdi_clk              " 
  print " "
  print "[ CAMSS_CSI3 ]" 
  print " mmss_camss_csi3_clk                mmss_camss_csi3pix_clk             mmss_camss_csi3rdi_clk              " 
  print " "
  print "[ CAMSS_CSIPHY ]" 
  print " mmss_camss_cphy_csid0_clk          mmss_camss_cphy_csid1_clk          mmss_camss_cphy_csid2_clk           " 
  print " mmss_camss_cphy_csid3_clk          mmss_camss_csiphy0_clk             mmss_camss_csiphy1_clk              " 
  print " mmss_camss_csiphy2_clk              " 
  print " "
  print "[ CAMSS_GP0 ]" 
  print " mmss_camss_gp0_clk                  " 
  print " "
  print "[ CAMSS_GP1 ]" 
  print " mmss_camss_gp1_clk                  " 
  print " "
  print "[ CAMSS_JPEG ]" 
  print " mmss_camss_jpeg0_clk               mmss_spdm_jpeg0_clk                 " 
  print " "
  print "[ CAMSS_MCLK0 ]" 
  print " mmss_camss_mclk0_clk                " 
  print " "
  print "[ CAMSS_MCLK1 ]" 
  print " mmss_camss_mclk1_clk                " 
  print " "
  print "[ CAMSS_MCLK2 ]" 
  print " mmss_camss_mclk2_clk                " 
  print " "
  print "[ CAMSS_MCLK3 ]" 
  print " mmss_camss_mclk3_clk                " 
  print " "
  print "[ CAMSS_PHY0 ]" 
  print " mmss_camss_csi0phytimer_clk         " 
  print " "
  print "[ CAMSS_PHY1 ]" 
  print " mmss_camss_csi1phytimer_clk         " 
  print " "
  print "[ CAMSS_PHY2 ]" 
  print " mmss_camss_csi2phytimer_clk         " 
  print " "
  print "[ CAMSS_TOP ]" 
  print "  " 
  print " "
  print "[ CAMSS_VFE0 ]" 
  print " mmss_camss_csi_vfe0_clk            mmss_camss_vfe0_clk                mmss_camss_vfe0_stream_clk          " 
  print " mmss_spdm_vfe0_clk                  " 
  print " "
  print "[ CAMSS_VFE1 ]" 
  print " mmss_camss_csi_vfe1_clk            mmss_camss_vfe1_clk                mmss_camss_vfe1_stream_clk          " 
  print " mmss_spdm_vfe1_clk                  " 
  print " "
  print "[ MDSS ]" 
  print " mmss_mdss_byte0_clk                mmss_mdss_byte0_intf_clk           mmss_mdss_byte1_clk                 " 
  print " mmss_mdss_byte1_intf_clk           mmss_mdss_dp_aux_clk               mmss_mdss_dp_crypto_clk             " 
  print " mmss_spdm_dp_crypto_clk            mmss_mdss_dp_gtc_clk               mmss_mdss_dp_link_clk               " 
  print " mmss_mdss_dp_link_intf_clk         mmss_mdss_dp_pixel_clk             mmss_spdm_dp_pixel_clk              " 
  print " mmss_mdss_esc0_clk                 mmss_mdss_esc1_clk                 mmss_mdss_mdp_clk                   " 
  print " mmss_spdm_mdp_clk                  mmss_mdss_pclk0_clk                mmss_spdm_pclk0_clk                 " 
  print " mmss_mdss_pclk1_clk                mmss_spdm_pclk1_clk                mmss_mdss_rot_clk                   " 
  print " mmss_spdm_rot_clk                  mmss_mdss_vsync_clk                 " 
  print " "
  print "[ MNOCAHB ]" 
  print " mmss_bimc_smmu_ahb_clk             mmss_bto_ahb_clk                   mmss_camss_ahb_clk                  " 
  print " mmss_camss_cci_ahb_clk             mmss_camss_cpp_ahb_clk             mmss_camss_cpp_vbif_ahb_clk         " 
  print " mmss_camss_csi0_ahb_clk            mmss_camss_csi1_ahb_clk            mmss_camss_csi2_ahb_clk             " 
  print " mmss_camss_csi3_ahb_clk            mmss_camss_ispif_ahb_clk           mmss_camss_jpeg_ahb_clk             " 
  print " mmss_camss_micro_ahb_clk           mmss_camss_top_ahb_clk             mmss_camss_vfe0_ahb_clk             " 
  print " mmss_camss_vfe1_ahb_clk            mmss_camss_vfe_vbif_ahb_clk        mmss_csiphy_ahb2crif_clk            " 
  print " mmss_mdss_ahb_clk                  mmss_mdss_hdmi_dp_ahb_clk          mmss_misc_ahb_clk                   " 
  print " mmss_mnoc_ahb_clk                  mmss_spdm_ahb_clk                  mmss_throttle_camss_ahb_clk         " 
  print " mmss_throttle_mdss_ahb_clk         mmss_throttle_video_ahb_clk        mmss_video_ahb_clk                  " 
  print " "
  print "[ MNOCAXI ]" 
  print " mmss_bimc_smmu_axi_clk             mmss_camss_cpp_axi_clk             mmss_camss_jpeg_axi_clk             " 
  print " mmss_camss_vfe_vbif_axi_clk        mmss_mdss_axi_clk                  mmss_mnoc_axi_clk                   " 
  print " mmss_s0_axi_clk                    mmss_snoc_dvm_axi_clk              mmss_spdm_axi_clk                   " 
  print " mmss_spdm_rm_axi_clk               mmss_throttle_camss_axi_clk        mmss_throttle_mdss_axi_clk          " 
  print " mmss_throttle_video_axi_clk        mmss_video_axi_clk                  " 
  print " "
  print "[ VIDEO_SUBCORE0 ]" 
  print "  " 
  print " "
  print "[ VIDEO_TOP ]" 
  print " mmss_spdm_video_core_clk           mmss_video_core_clk                mmss_video_subcore0_clk             " 
  print " "
  print "[ EXT ]" 
  print "  " 

  return



Print_All:

  gosub Find_Print_Clock apc0_sysleaf_clk
  gosub Find_Print_Clock apc1_sysleaf_clk
  gosub Find_Print_Clock gladiator_sysleaf_clk
  gosub Find_Print_Clock sys_apcsqsb_clk
  gosub Find_Print_Clock im_sleep_clk
  gosub Find_Print_Clock lmh_lite_clk
  gosub Find_Print_Clock cl0_apcpll_lockdet
  gosub Find_Print_Clock cl1_apcpll_lockdet
  gosub Find_Print_Clock cci_apcpll_lockdet
  gosub Find_Print_Clock aon_clk_src
  gosub Find_Print_Clock q6ss_ahbm_aon_clk
  gosub Find_Print_Clock q6ss_ahbs_aon_clk
  gosub Find_Print_Clock turing_wrapper_aon_clk
  gosub Find_Print_Clock turing_wrapper_bus_timeout_aon_clk
  gosub Find_Print_Clock turing_wrapper_mpu_cfg_aon_clk
  gosub Find_Print_Clock turing_wrapper_q6_ahbm_mpu_aon_clk
  gosub Find_Print_Clock turing_wrapper_qos_ahbs_aon_clk
  gosub Find_Print_Clock turing_wrapper_sysnoc_sway_aon_clk
  gosub Find_Print_Clock q6ss_q6_axim_clk
  gosub Find_Print_Clock turing_wrapper_q6_smmu_axi_clk
  gosub Find_Print_Clock turing_wrapper_q6_smmu_cfg_cnoc_clk
  gosub Find_Print_Clock turing_wrapper_sysnoc_sway_snoc_clk
  gosub Find_Print_Clock q6ss_q6_camss_dsp_streaming_0_clk
  gosub Find_Print_Clock q6ss_q6_camss_dsp_streaming_1_clk
  gosub Find_Print_Clock qos_fixed_lat_counter_src
  gosub Find_Print_Clock turing_wrapper_qos_danger_fixed_lat_counter_clk
  gosub Find_Print_Clock turing_wrapper_qos_dmonitor_fixed_lat_counter_clk
  gosub Find_Print_Clock sleep_clk_src
  gosub Find_Print_Clock q6ss_slp_clk
  gosub Find_Print_Clock xo_clk_src
  gosub Find_Print_Clock audio_core_gdsc_xo_clk
  gosub Find_Print_Clock q6ss_xo_clk
  gosub Find_Print_Clock turing_wrapper_q6_smmu_gdsc_xo_clk
  gosub Find_Print_Clock turing_wrapper_qos_xo_lat_counter_clk
  gosub Find_Print_Clock ddrss_ch0_mc_clk
  gosub Find_Print_Clock ddrss_ch1_mc_clk
  gosub Find_Print_Clock gcc_sec_ctrl_acc_clk
  gosub Find_Print_Clock gcc_apc0_vs_clk
  gosub Find_Print_Clock gcc_apc1_vs_clk
  gosub Find_Print_Clock gcc_bimc_clk
  gosub Find_Print_Clock gcc_spdm_bimc_cy_clk
  gosub Find_Print_Clock gcc_bimc_ddr_cpll0_clk
  gosub Find_Print_Clock gcc_bimc_ddr_cpll1_clk
  gosub Find_Print_Clock gcc_bimc_dtts_xo_clk
  gosub Find_Print_Clock gcc_bimc_xo_clk
  gosub Find_Print_Clock gcc_cfg_noc_ddr_cfg_clk
  gosub Find_Print_Clock gcc_cnoc_bus_timeout5_ahb_clk
  gosub Find_Print_Clock gcc_ddr_dim_cfg_clk
  gosub Find_Print_Clock gcc_bimc_hmss_axi_clk
  gosub Find_Print_Clock gcc_blsp1_qup1_i2c_apps_clk
  gosub Find_Print_Clock gcc_blsp1_qup1_spi_apps_clk
  gosub Find_Print_Clock gcc_blsp1_qup2_i2c_apps_clk
  gosub Find_Print_Clock gcc_blsp1_qup2_spi_apps_clk
  gosub Find_Print_Clock gcc_blsp1_qup3_i2c_apps_clk
  gosub Find_Print_Clock gcc_blsp1_qup3_spi_apps_clk
  gosub Find_Print_Clock gcc_blsp1_qup4_i2c_apps_clk
  gosub Find_Print_Clock gcc_blsp1_qup4_spi_apps_clk
  gosub Find_Print_Clock gcc_blsp1_uart1_apps_clk
  gosub Find_Print_Clock gcc_blsp1_uart2_apps_clk
  gosub Find_Print_Clock gcc_blsp2_qup1_i2c_apps_clk
  gosub Find_Print_Clock gcc_blsp2_qup1_spi_apps_clk
  gosub Find_Print_Clock gcc_blsp2_qup2_i2c_apps_clk
  gosub Find_Print_Clock gcc_blsp2_qup2_spi_apps_clk
  gosub Find_Print_Clock gcc_blsp2_qup3_i2c_apps_clk
  gosub Find_Print_Clock gcc_blsp2_qup3_spi_apps_clk
  gosub Find_Print_Clock gcc_blsp2_qup4_i2c_apps_clk
  gosub Find_Print_Clock gcc_blsp2_qup4_spi_apps_clk
  gosub Find_Print_Clock gcc_blsp2_uart1_apps_clk
  gosub Find_Print_Clock gcc_blsp2_uart2_apps_clk
  gosub Find_Print_Clock gcc_blsp1_uart1_sim_clk
  gosub Find_Print_Clock gcc_blsp1_uart2_sim_clk
  gosub Find_Print_Clock gcc_blsp2_uart1_sim_clk
  gosub Find_Print_Clock gcc_blsp2_uart2_sim_clk
  gosub Find_Print_Clock gcc_cdsp_bimc_clk
  gosub Find_Print_Clock gcc_sys_noc_cdsp_clk
  gosub Find_Print_Clock gcc_turing_q6_axi_clk
  gosub Find_Print_Clock gcc_turing_q6_smmu_axi_clk
  gosub Find_Print_Clock gcc_turing_q6_smmu_axi_src_clk
  gosub Find_Print_Clock gcc_ce1_clk
  gosub Find_Print_Clock gcc_aggre2_cnoc_north_periph_ahb_clk
  gosub Find_Print_Clock gcc_aggre2_cnoc_periph_ahb_clk
  gosub Find_Print_Clock gcc_aggre2_cnoc_south_periph_ahb_clk
  gosub Find_Print_Clock gcc_blsp1_ahb_clk
  gosub Find_Print_Clock gcc_blsp2_ahb_clk
  gosub Find_Print_Clock gcc_cnoc_bus_timeout0_ahb_clk
  gosub Find_Print_Clock gcc_cnoc_periph_ahb_clk
  gosub Find_Print_Clock gcc_cnoc_periph_bus_timeout1_ahb_clk
  gosub Find_Print_Clock gcc_cnoc_periph_bus_timeout2_ahb_clk
  gosub Find_Print_Clock gcc_cnoc_periph_north_ahb_clk
  gosub Find_Print_Clock gcc_cnoc_periph_south_ahb_clk
  gosub Find_Print_Clock gcc_pdm_ahb_clk
  gosub Find_Print_Clock gcc_qspi_ahb_clk
  gosub Find_Print_Clock gcc_sdcc1_ahb_clk
  gosub Find_Print_Clock gcc_sdcc2_ahb_clk
  gosub Find_Print_Clock gcc_spdm_pnoc_cy_clk
  gosub Find_Print_Clock gcc_a2noc_throttle_cfg_clk
  gosub Find_Print_Clock gcc_aggre2_cnoc_ahb_clk
  gosub Find_Print_Clock gcc_aggre2_noc_msmpu_cfg_ahb_clk
  gosub Find_Print_Clock gcc_ahb_clk
  gosub Find_Print_Clock gcc_bimc_cfg_ahb_clk
  gosub Find_Print_Clock gcc_bimc_nius_cfg_ahb_clk
  gosub Find_Print_Clock gcc_boot_rom_ahb_clk
  gosub Find_Print_Clock gcc_ce1_ahb_clk
  gosub Find_Print_Clock gcc_cfg_noc_ahb_clk
  gosub Find_Print_Clock gcc_cfg_noc_lpass_aon_ahb_clk
  gosub Find_Print_Clock gcc_cfg_noc_north_ahb_clk
  gosub Find_Print_Clock gcc_cfg_noc_south_ahb_clk
  gosub Find_Print_Clock gcc_cfg_noc_turing_aon_ahb_clk
  gosub Find_Print_Clock gcc_cnoc_bus_timeout10_ahb_clk
  gosub Find_Print_Clock gcc_cnoc_bus_timeout11_ahb_clk
  gosub Find_Print_Clock gcc_cnoc_bus_timeout2_ahb_clk
  gosub Find_Print_Clock gcc_cnoc_bus_timeout3_ahb_clk
  gosub Find_Print_Clock gcc_cnoc_bus_timeout4_ahb_clk
  gosub Find_Print_Clock gcc_cnoc_bus_timeout6_ahb_clk
  gosub Find_Print_Clock gcc_cnoc_bus_timeout7_ahb_clk
  gosub Find_Print_Clock gcc_cnoc_bus_timeout8_ahb_clk
  gosub Find_Print_Clock gcc_cnoc_bus_timeout9_ahb_clk
  gosub Find_Print_Clock gcc_cnoc_mst_rpm_ahb_clk
  gosub Find_Print_Clock gcc_dcc_ahb_clk
  gosub Find_Print_Clock gcc_glm_ahb_clk
  gosub Find_Print_Clock gcc_gpu_cfg_ahb_clk
  gosub Find_Print_Clock gcc_imem_cfg_ahb_clk
  gosub Find_Print_Clock gcc_ipa_ahb_clk
  gosub Find_Print_Clock gcc_lpass_cnoc_cfg_clk
  gosub Find_Print_Clock gcc_lpass_q6_smmu_ahb_clk
  gosub Find_Print_Clock gcc_lpass_q6_smmu_gds_cfg_clk
  gosub Find_Print_Clock gcc_mccc_cfg_ahb_clk
  gosub Find_Print_Clock gcc_mmss_noc_cfg_ahb_clk
  gosub Find_Print_Clock gcc_mmss_qm_ahb_clk
  gosub Find_Print_Clock gcc_mpm_ahb_clk
  gosub Find_Print_Clock gcc_msg_ram_ahb_clk
  gosub Find_Print_Clock gcc_mss_cfg_ahb_clk
  gosub Find_Print_Clock gcc_mss_msmpu_cfg_ahb_clk
  gosub Find_Print_Clock gcc_mss_q6_msmpu_cfg_ahb_clk
  gosub Find_Print_Clock gcc_pimem_ahb_clk
  gosub Find_Print_Clock gcc_prng_ahb_clk
  gosub Find_Print_Clock gcc_qdss_cfg_ahb_clk
  gosub Find_Print_Clock gcc_qdss_dap_ahb_clk
  gosub Find_Print_Clock gcc_rbcpr_cx_ahb_clk
  gosub Find_Print_Clock gcc_rbcpr_mx_ahb_clk
  gosub Find_Print_Clock gcc_rpm_mst_m2_cnoc_ahb_clk
  gosub Find_Print_Clock gcc_sec_ctrl_ahb_clk
  gosub Find_Print_Clock gcc_sec_ctrl_boot_rom_patch_clk
  gosub Find_Print_Clock gcc_smmu_aggre2_ahb_clk
  gosub Find_Print_Clock gcc_snoc_bus_timeout4_ahb_clk
  gosub Find_Print_Clock gcc_snoc_cnoc_ahb_clk
  gosub Find_Print_Clock gcc_spdm_cfg_ahb_clk
  gosub Find_Print_Clock gcc_spdm_mstr_ahb_clk
  gosub Find_Print_Clock gcc_spmi_cnoc_ahb_clk
  gosub Find_Print_Clock gcc_tcsr_ahb_clk
  gosub Find_Print_Clock gcc_tic_cfg_ahb_clk
  gosub Find_Print_Clock gcc_tlmm_centre_ahb_clk
  gosub Find_Print_Clock gcc_tlmm_clk
  gosub Find_Print_Clock gcc_tlmm_north_ahb_clk
  gosub Find_Print_Clock gcc_tlmm_south_ahb_clk
  gosub Find_Print_Clock gcc_turing_q6_smmu_ahb_clk
  gosub Find_Print_Clock gcc_ufs_ahb_clk
  gosub Find_Print_Clock gcc_usb_phy_cfg_ahb2phy_clk
  gosub Find_Print_Clock gcc_spdm_debug_cy_clk
  gosub Find_Print_Clock gcc_bimc_sleep_clk
  gosub Find_Print_Clock gcc_blsp1_sleep_clk
  gosub Find_Print_Clock gcc_blsp2_sleep_clk
  gosub Find_Print_Clock gcc_ddr_dim_sleep_clk
  gosub Find_Print_Clock gcc_im_sleep_clk
  gosub Find_Print_Clock gcc_ipa_sleep_clk
  gosub Find_Print_Clock gcc_rpm_sleep_clk
  gosub Find_Print_Clock gcc_usb20_sleep_clk
  gosub Find_Print_Clock gcc_usb30_sleep_clk
  gosub Find_Print_Clock gcc_a2noc_throttle_cxo_clk
  gosub Find_Print_Clock gcc_aggre2_noc_cxo_north_clk
  gosub Find_Print_Clock gcc_aggre2_noc_cxo_south_clk
  gosub Find_Print_Clock gcc_ahb2phy_east_clk
  gosub Find_Print_Clock gcc_cfg_noc_ah2phy_xo_clk
  gosub Find_Print_Clock gcc_cfg_noc_dcd_xo_clk
  gosub Find_Print_Clock gcc_cfg_noc_north_dcd_xo_clk
  gosub Find_Print_Clock gcc_cfg_noc_south_dcd_xo_clk
  gosub Find_Print_Clock gcc_cm_phy_refgen1_clk
  gosub Find_Print_Clock gcc_cm_phy_refgen2_clk
  gosub Find_Print_Clock gcc_cnoc_bus_timeout13_ahb_clk
  gosub Find_Print_Clock gcc_glm_xo_clk
  gosub Find_Print_Clock gcc_lpass_cxo_clk
  gosub Find_Print_Clock gcc_pdm_xo4_clk
  gosub Find_Print_Clock gcc_qdss_xo_clk
  gosub Find_Print_Clock gcc_qrefs_vbg_cal_clk
  gosub Find_Print_Clock gcc_rpm_timer_clk
  gosub Find_Print_Clock gcc_spdm_ff_clk
  gosub Find_Print_Clock gcc_sram_sensor_xo_clk
  gosub Find_Print_Clock gcc_sys_noc_dcd_xo_clk
  gosub Find_Print_Clock gcc_xo_clk
  gosub Find_Print_Clock gcc_xo_div4_clk
  gosub Find_Print_Clock gcc_glm_clk
  gosub Find_Print_Clock gcc_gp1_clk
  gosub Find_Print_Clock gcc_gp2_clk
  gosub Find_Print_Clock gcc_gp3_clk
  gosub Find_Print_Clock gcc_bimc_gfx_clk
  gosub Find_Print_Clock gcc_gpu_bimc_gfx_clk
  gosub Find_Print_Clock gcc_gpu_bimc_gfx_src_clk
  gosub Find_Print_Clock gcc_gpu_snoc_dvm_gfx_clk
  gosub Find_Print_Clock gcc_hmss_ahb_clk
  gosub Find_Print_Clock gcc_sys_noc_hmss_ahb_clk
  gosub Find_Print_Clock gcc_hmss_rbcpr_clk
  gosub Find_Print_Clock gcc_aggre2_noc_ipa_clk
  gosub Find_Print_Clock gcc_ipa_2x_clk
  gosub Find_Print_Clock gcc_ipa_clk
  gosub Find_Print_Clock gcc_mmss_qm_core_clk
  gosub Find_Print_Clock gcc_bimc_mss_q6_axi_clk
  gosub Find_Print_Clock gcc_mss_q6_bimc_axi_clk
  gosub Find_Print_Clock gcc_mss_q6_msmpu_client_axi_clk
  gosub Find_Print_Clock gcc_mss_vs_clk
  gosub Find_Print_Clock gcc_obt_odt_clk
  gosub Find_Print_Clock gcc_pdm2_clk
  gosub Find_Print_Clock gcc_bimc_pimem_axi_clk
  gosub Find_Print_Clock gcc_pimem_axi_clk
  gosub Find_Print_Clock gcc_sys_noc_pimem_axi_clk
  gosub Find_Print_Clock gcc_center_apb_clk
  gosub Find_Print_Clock gcc_gpu_trig_clk
  gosub Find_Print_Clock gcc_hmss_trig_clk
  gosub Find_Print_Clock gcc_lpass_trig_clk
  gosub Find_Print_Clock gcc_mmss_trig_clk
  gosub Find_Print_Clock gcc_mss_trig_clk
  gosub Find_Print_Clock gcc_north_apb_clk
  gosub Find_Print_Clock gcc_qdss_apb2jtag_clk
  gosub Find_Print_Clock gcc_qdss_dap_clk
  gosub Find_Print_Clock gcc_qdss_trig_clk
  gosub Find_Print_Clock gcc_south_apb_clk
  gosub Find_Print_Clock gcc_turing_trig_clk
  gosub Find_Print_Clock gcc_wcss_apb_clk
  gosub Find_Print_Clock gcc_aggre2_noc_at_clk
  gosub Find_Print_Clock gcc_gpu_at_clk
  gosub Find_Print_Clock gcc_hmss_at_clk
  gosub Find_Print_Clock gcc_mmss_at_clk
  gosub Find_Print_Clock gcc_mmss_noc_at_clk
  gosub Find_Print_Clock gcc_north_at_clk
  gosub Find_Print_Clock gcc_qdss_center_at_clk
  gosub Find_Print_Clock gcc_south_at_clk
  gosub Find_Print_Clock gcc_sys_noc_at_clk
  gosub Find_Print_Clock gcc_wcss_at_clk
  gosub Find_Print_Clock gcc_bimc_at_clk
  gosub Find_Print_Clock gcc_mss_at_clk
  gosub Find_Print_Clock gcc_lpass_at_clk
  gosub Find_Print_Clock gcc_turing_at_clk
  gosub Find_Print_Clock gcc_qdss_stm_clk
  gosub Find_Print_Clock gcc_sys_noc_qdss_stm_axi_clk
  gosub Find_Print_Clock gcc_qdss_traceclkin_clk
  gosub Find_Print_Clock gcc_apss_qdss_tsctr_div2_clk
  gosub Find_Print_Clock gcc_apss_qdss_tsctr_div8_clk
  gosub Find_Print_Clock gcc_qdss_tsctr_div16_clk
  gosub Find_Print_Clock gcc_qdss_tsctr_div2_clk
  gosub Find_Print_Clock gcc_qdss_tsctr_div3_clk
  gosub Find_Print_Clock gcc_qdss_tsctr_div4_clk
  gosub Find_Print_Clock gcc_qdss_tsctr_div8_clk
  gosub Find_Print_Clock gcc_wcss_tsctr_div2_clk
  gosub Find_Print_Clock gcc_qspi_ser_clk
  gosub Find_Print_Clock gcc_rbcpr_cx_clk
  gosub Find_Print_Clock gcc_rbcpr_mx_clk
  gosub Find_Print_Clock gcc_rpm_bus_ahb_clk
  gosub Find_Print_Clock gcc_rpm_proc_fclk
  gosub Find_Print_Clock gcc_rpm_proc_hclk
  gosub Find_Print_Clock gcc_spdm_rpm_cy_clk
  gosub Find_Print_Clock gcc_sdcc1_apps_clk
  gosub Find_Print_Clock gcc_sdcc1_ice_core_clk
  gosub Find_Print_Clock gcc_sdcc2_apps_clk
  gosub Find_Print_Clock gcc_sec_ctrl_clk
  gosub Find_Print_Clock gcc_sec_ctrl_sense_clk
  gosub Find_Print_Clock gcc_spmi_ahb_clk
  gosub Find_Print_Clock gcc_spmi_ser_clk
  gosub Find_Print_Clock gcc_bimc_nius_hs_axi_clk
  gosub Find_Print_Clock gcc_bimc_sysnoc_hs_axi_clk
  gosub Find_Print_Clock gcc_lpass_q6_axi_clk
  gosub Find_Print_Clock gcc_lpass_q6_smmu_axi_clk
  gosub Find_Print_Clock gcc_lpass_q6_smmu_axi_src_clk
  gosub Find_Print_Clock gcc_mss_mnoc_bimc_axi_clk
  gosub Find_Print_Clock gcc_mss_msmpu_client_axi_clk
  gosub Find_Print_Clock gcc_sys_noc_hs_axi_clk
  gosub Find_Print_Clock gcc_a2noc_throttle_core_axi_clk
  gosub Find_Print_Clock gcc_aggre2_snoc_axi_clk
  gosub Find_Print_Clock gcc_aggre2_snoc_msmpu_client_axi_clk
  gosub Find_Print_Clock gcc_aggre2_snoc_north_axi_clk
  gosub Find_Print_Clock gcc_aggre2_snoc_south_axi_clk
  gosub Find_Print_Clock gcc_bimc_nius_axi_clk
  gosub Find_Print_Clock gcc_bimc_sysnoc_axi_clk
  gosub Find_Print_Clock gcc_ce1_axi_clk
  gosub Find_Print_Clock gcc_hmss_dvm_bus_clk
  gosub Find_Print_Clock gcc_imem_axi_clk
  gosub Find_Print_Clock gcc_lpass_mport_clk
  gosub Find_Print_Clock gcc_lpass_sway_clk
  gosub Find_Print_Clock gcc_lpass_sway_mpu_clk
  gosub Find_Print_Clock gcc_mmss_sys_noc_axi_clk
  gosub Find_Print_Clock gcc_mss_snoc_axi_clk
  gosub Find_Print_Clock gcc_qdss_etr_usb_clk
  gosub Find_Print_Clock gcc_smmu_aggre2_axi_clk
  gosub Find_Print_Clock gcc_smmu_aggre2_axi_src_clk
  gosub Find_Print_Clock gcc_snoc_bus_timeout0_ahb_clk
  gosub Find_Print_Clock gcc_snoc_bus_timeout1_ahb_clk
  gosub Find_Print_Clock gcc_snoc_bus_timeout3_ahb_clk
  gosub Find_Print_Clock gcc_snoc_lpass_q6_axis_clk
  gosub Find_Print_Clock gcc_spdm_snoc_cy_clk
  gosub Find_Print_Clock gcc_sys_noc_axi_clk
  gosub Find_Print_Clock gcc_sys_noc_north_axi_clk
  gosub Find_Print_Clock gcc_sys_noc_south_axi_clk
  gosub Find_Print_Clock gcc_turing_sway_clk
  gosub Find_Print_Clock gcc_wcss_ahb_s0_clk
  gosub Find_Print_Clock gcc_wcss_axi_m_clk
  gosub Find_Print_Clock gcc_wcss_ecahb_clk
  gosub Find_Print_Clock gcc_wcss_shdreg_ahb_clk
  gosub Find_Print_Clock gcc_cfg_noc_tic_clk
  gosub Find_Print_Clock gcc_tic_clk
  gosub Find_Print_Clock gcc_aggre2_ufs_axi_clk
  gosub Find_Print_Clock gcc_ufs_axi_clk
  gosub Find_Print_Clock gcc_ufs_ice_core_clk
  gosub Find_Print_Clock gcc_ufs_phy_aux_clk
  gosub Find_Print_Clock gcc_ufs_rx_symbol_0_clk
  gosub Find_Print_Clock gcc_ufs_rx_symbol_1_clk
  gosub Find_Print_Clock gcc_ufs_tx_symbol_0_clk
  gosub Find_Print_Clock gcc_ufs_unipro_core_clk
  gosub Find_Print_Clock gcc_cfg_noc_usb2_axi_clk
  gosub Find_Print_Clock gcc_cnoc_bus_timeout12_ahb_clk
  gosub Find_Print_Clock gcc_usb20_master_clk
  gosub Find_Print_Clock gcc_usb20_mock_utmi_clk
  gosub Find_Print_Clock gcc_aggre2_usb3_axi_clk
  gosub Find_Print_Clock gcc_cfg_noc_usb3_axi_clk
  gosub Find_Print_Clock gcc_cnoc_bus_timeout14_ahb_clk
  gosub Find_Print_Clock gcc_usb30_master_clk
  gosub Find_Print_Clock gcc_usb30_mock_utmi_clk
  gosub Find_Print_Clock gcc_usb3_phy_aux_clk
  gosub Find_Print_Clock gcc_usb3_phy_pipe_clk
  gosub Find_Print_Clock gcc_vdda_vs_clk
  gosub Find_Print_Clock gcc_vddcx_vs_clk
  gosub Find_Print_Clock gcc_vddmx_vs_clk
  gosub Find_Print_Clock gcc_vs_ctrl_clk
  gosub Find_Print_Clock gcc_wcss_vs_clk
  gosub Find_Print_Clock gcc_aggre2_noc_qosgen_extref
  gosub Find_Print_Clock gcc_cnoc_bus_timeout_extref
  gosub Find_Print_Clock gcc_snoc_bus_timeout_extref
  gosub Find_Print_Clock gcc_snoc_qosgen_extref
  gosub Find_Print_Clock gpll0_dtest
  gosub Find_Print_Clock gpll1_dtest
  gosub Find_Print_Clock gpll2_dtest
  gosub Find_Print_Clock gpll3_dtest
  gosub Find_Print_Clock gpll4_dtest
  gosub Find_Print_Clock gpll5_dtest
  gosub Find_Print_Clock gpll6_dtest
  gosub Find_Print_Clock gpu_gcc_dbg_clk
  gosub Find_Print_Clock hmss_gcc_dbg_clk
  gosub Find_Print_Clock lpass_gcc_dbg_clk
  gosub Find_Print_Clock mccc_ddrss_gcc_ch_clk
  gosub Find_Print_Clock mmss_gcc_dbg_clk
  gosub Find_Print_Clock mpm_gcc_temp0_sensor_ringosc_clk
  gosub Find_Print_Clock mpm_gcc_temp1_sensor_ringosc_clk
  gosub Find_Print_Clock mss_gcc_dbg_clk
  gosub Find_Print_Clock nav_gcc_dbg_clk
  gosub Find_Print_Clock nav_pll_dtest
  gosub Find_Print_Clock qusb2phy_gcc_clk_test_prim
  gosub Find_Print_Clock qusb2phy_gcc_clk_test_sec
  gosub Find_Print_Clock qusb2phy_prim_gcc_usb30_utmi_clk
  gosub Find_Print_Clock qusb2phy_sec_gcc_usb20s_utmi_clk
  gosub Find_Print_Clock turing_gcc_dbg_clk
  gosub Find_Print_Clock ufs_rx_symbol_0_clk
  gosub Find_Print_Clock ufs_rx_symbol_1_clk
  gosub Find_Print_Clock ufs_tx_symbol_0_clk
  gosub Find_Print_Clock usb3_phy_wrapper_gcc_usb3_pipe_clk
  gosub Find_Print_Clock wcss_gcc_dbg_clk
  gosub Find_Print_Clock gpucc_gfx3d_clk
  gosub Find_Print_Clock gpucc_spdm_gfx3d_clk
  gosub Find_Print_Clock gpucc_rbbmtimer_clk
  gosub Find_Print_Clock gpucc_rbcpr_clk
  gosub Find_Print_Clock gpucc_cxo_clk
  gosub Find_Print_Clock aon_clk_src
  gosub Find_Print_Clock audio_core_qdsp_sway_aon_clk
  gosub Find_Print_Clock audio_wrapper_aon_clk
  gosub Find_Print_Clock audio_wrapper_bus_timeout_aon_clk
  gosub Find_Print_Clock audio_wrapper_mpu_cfg_aon_clk
  gosub Find_Print_Clock audio_wrapper_q6_ahbm_mpu_aon_clk
  gosub Find_Print_Clock audio_wrapper_qos_ahbs_aon_clk
  gosub Find_Print_Clock audio_wrapper_sysnoc_sway_aon_clk
  gosub Find_Print_Clock island_scc_cfg_ahb_aon_clk
  gosub Find_Print_Clock island_scc_crif_aon_clk
  gosub Find_Print_Clock island_scc_csr_h_aon_clk
  gosub Find_Print_Clock island_scc_data_h_aon_clk
  gosub Find_Print_Clock island_scc_qdsp_sway_aon_clk
  gosub Find_Print_Clock q6ss_ahbm_aon_clk
  gosub Find_Print_Clock q6ss_ahbs_aon_clk
  gosub Find_Print_Clock atime_clk_src
  gosub Find_Print_Clock audio_core_avsync_atime_clk
  gosub Find_Print_Clock aud_slimbus_clk_src
  gosub Find_Print_Clock audio_core_aud_slimbus_clk
  gosub Find_Print_Clock core_clk_src
  gosub Find_Print_Clock audio_core_aud_slimbus_core_clk
  gosub Find_Print_Clock audio_core_bus_timeout_core_clk
  gosub Find_Print_Clock audio_core_core_clk
  gosub Find_Print_Clock audio_core_lpm_core_clk
  gosub Find_Print_Clock audio_core_qca_slimbus_core_clk
  gosub Find_Print_Clock audio_core_sysnoc_mport_core_clk
  gosub Find_Print_Clock island_scc_ahb_timeout_core_clk
  gosub Find_Print_Clock island_scc_blsp_h_core_clk
  gosub Find_Print_Clock island_scc_sensor_core_core_clk
  gosub Find_Print_Clock island_scc_smem_core_clk
  gosub Find_Print_Clock ext_mclk0_clk_src
  gosub Find_Print_Clock audio_wrapper_ext_mclk0_clk
  gosub Find_Print_Clock ext_mclk1_clk_src
  gosub Find_Print_Clock audio_wrapper_ext_mclk1_clk
  gosub Find_Print_Clock ext_mclk2_clk_src
  gosub Find_Print_Clock audio_wrapper_ext_mclk2_clk
  gosub Find_Print_Clock audio_wrapper_ext_mclk3_clk
  gosub Find_Print_Clock audio_core_int_i2s0_1_ibit_clk
  gosub Find_Print_Clock audio_core_int_i2s2_ibit_clk
  gosub Find_Print_Clock audio_core_int_i2s3_ibit_clk
  gosub Find_Print_Clock audio_core_int_i2s4_ibit_clk
  gosub Find_Print_Clock audio_core_int_i2s5_6_ibit_clk
  gosub Find_Print_Clock audio_core_int_mclk0_clk
  gosub Find_Print_Clock audio_core_int_mclk1_clk
  gosub Find_Print_Clock lpaif_pcmoe_clk_src
  gosub Find_Print_Clock audio_core_lpaif_pcm_data_oe_clk
  gosub Find_Print_Clock lpaif_pri_clk_src
  gosub Find_Print_Clock audio_core_lpaif_pri_ibit_clk
  gosub Find_Print_Clock lpaif_quad_clk_src
  gosub Find_Print_Clock audio_core_lpaif_quad_ibit_clk
  gosub Find_Print_Clock lpaif_sec_clk_src
  gosub Find_Print_Clock audio_core_lpaif_sec_ibit_clk
  gosub Find_Print_Clock lpaif_ter_clk_src
  gosub Find_Print_Clock audio_core_lpaif_ter_ibit_clk
  gosub Find_Print_Clock audio_core_lpaif_pri_ebit_clk
  gosub Find_Print_Clock island_scc_q6_spm_clk
  gosub Find_Print_Clock island_scc_sensor_core_bcr_xo_clk
  gosub Find_Print_Clock qca_slimbus_clk_src
  gosub Find_Print_Clock audio_core_qca_slimbus_clk
  gosub Find_Print_Clock qos_fixed_lat_counter_clk_src
  gosub Find_Print_Clock audio_core_qos_dmonitor_fixed_lat_counter_clk
  gosub Find_Print_Clock audio_wrapper_qos_danger_fixed_lat_counter_clk
  gosub Find_Print_Clock audio_wrapper_qos_dmonitor_fixed_lat_counter_clk
  gosub Find_Print_Clock audio_core_lpaif_quad_ebit_clk
  gosub Find_Print_Clock resampler_clk_src
  gosub Find_Print_Clock audio_core_resampler_clk
  gosub Find_Print_Clock island_scc_qup_i2c1_clk
  gosub Find_Print_Clock island_scc_qup_i2c2_clk
  gosub Find_Print_Clock island_scc_qup_i2c3_clk
  gosub Find_Print_Clock island_scc_qup_spi1_clk
  gosub Find_Print_Clock island_scc_qup_spi2_clk
  gosub Find_Print_Clock island_scc_qup_spi3_clk
  gosub Find_Print_Clock island_scc_at_clk
  gosub Find_Print_Clock island_scc_pclkdbg_clk
  gosub Find_Print_Clock island_scc_q6_atbm_clk
  gosub Find_Print_Clock island_scc_dbg_tsctr_clk
  gosub Find_Print_Clock scc_uart1_clk_src
  gosub Find_Print_Clock island_scc_uart_dm_uart1_clk
  gosub Find_Print_Clock scc_uart2_clk_src
  gosub Find_Print_Clock island_scc_uart_dm_uart2_clk
  gosub Find_Print_Clock scc_uart3_clk_src
  gosub Find_Print_Clock island_scc_uart_dm_uart3_clk
  gosub Find_Print_Clock scc_uart4_clk_src
  gosub Find_Print_Clock island_scc_uart_dm_uart4_clk
  gosub Find_Print_Clock island_scc_vs_vddcx_clk
  gosub Find_Print_Clock island_scc_vs_vddmx_clk
  gosub Find_Print_Clock audio_core_lpaif_sec_ebit_clk
  gosub Find_Print_Clock sleep_clk_src
  gosub Find_Print_Clock audio_core_bcr_slp_clk
  gosub Find_Print_Clock island_scc_sensor_core_bcr_slp_clk
  gosub Find_Print_Clock q6ss_bcr_slp_clk
  gosub Find_Print_Clock q6ss_slp_clk
  gosub Find_Print_Clock audio_wrapper_sw_npl_clk
  gosub Find_Print_Clock audio_core_lpaif_ter_ebit_clk
  gosub Find_Print_Clock xo_clk_src
  gosub Find_Print_Clock audio_core_avsync_stc_clk
  gosub Find_Print_Clock audio_core_gdsc_xo_clk
  gosub Find_Print_Clock audio_wrapper_qos_xo_lat_counter_clk
  gosub Find_Print_Clock q6ss_xo_clk
  gosub Find_Print_Clock lpass_qdsp6ss_q6_core_clk
  gosub Find_Print_Clock lpass_qdsp6ss_axi_m_clk
  gosub Find_Print_Clock lpass_qdsp6ss_ldo_nmo_out
  gosub Find_Print_Clock lpass_qdsp6ss_ahb_m_clk
  gosub Find_Print_Clock lpass_qdsp6ss_ahb_s_clk
  gosub Find_Print_Clock lpass_qdsp6ss_xo_clk
  gosub Find_Print_Clock lpass_qdsp6ss_sleep_clk
  gosub Find_Print_Clock lpass_qdsp6ss_jtag_tck
  gosub Find_Print_Clock lpass_qdsp6ss_atb_clk
  gosub Find_Print_Clock lpass_qdsp6ss_apb_clk
  gosub Find_Print_Clock lpass_qdsp6ss_timestamp_clk
  gosub Find_Print_Clock mmss_bimc_smmu_ahb_clk
  gosub Find_Print_Clock mmss_bto_ahb_clk
  gosub Find_Print_Clock mmss_camss_ahb_clk
  gosub Find_Print_Clock mmss_camss_cci_ahb_clk
  gosub Find_Print_Clock mmss_camss_cpp_ahb_clk
  gosub Find_Print_Clock mmss_camss_cpp_vbif_ahb_clk
  gosub Find_Print_Clock mmss_camss_csi0_ahb_clk
  gosub Find_Print_Clock mmss_camss_csi1_ahb_clk
  gosub Find_Print_Clock mmss_camss_csi2_ahb_clk
  gosub Find_Print_Clock mmss_camss_csi3_ahb_clk
  gosub Find_Print_Clock mmss_camss_ispif_ahb_clk
  gosub Find_Print_Clock mmss_camss_jpeg_ahb_clk
  gosub Find_Print_Clock mmss_camss_micro_ahb_clk
  gosub Find_Print_Clock mmss_camss_top_ahb_clk
  gosub Find_Print_Clock mmss_camss_vfe0_ahb_clk
  gosub Find_Print_Clock mmss_camss_vfe1_ahb_clk
  gosub Find_Print_Clock mmss_camss_vfe_vbif_ahb_clk
  gosub Find_Print_Clock mmss_csiphy_ahb2crif_clk
  gosub Find_Print_Clock mmss_mdss_ahb_clk
  gosub Find_Print_Clock mmss_mdss_hdmi_dp_ahb_clk
  gosub Find_Print_Clock mmss_misc_ahb_clk
  gosub Find_Print_Clock mmss_mnoc_ahb_clk
  gosub Find_Print_Clock mmss_spdm_ahb_clk
  gosub Find_Print_Clock mmss_throttle_camss_ahb_clk
  gosub Find_Print_Clock mmss_throttle_mdss_ahb_clk
  gosub Find_Print_Clock mmss_throttle_video_ahb_clk
  gosub Find_Print_Clock mmss_video_ahb_clk
  gosub Find_Print_Clock mmss_bimc_smmu_axi_clk
  gosub Find_Print_Clock mmss_camss_cpp_axi_clk
  gosub Find_Print_Clock mmss_camss_jpeg_axi_clk
  gosub Find_Print_Clock mmss_camss_vfe_vbif_axi_clk
  gosub Find_Print_Clock mmss_mdss_axi_clk
  gosub Find_Print_Clock mmss_mnoc_axi_clk
  gosub Find_Print_Clock mmss_s0_axi_clk
  gosub Find_Print_Clock mmss_snoc_dvm_axi_clk
  gosub Find_Print_Clock mmss_spdm_axi_clk
  gosub Find_Print_Clock mmss_spdm_rm_axi_clk
  gosub Find_Print_Clock mmss_throttle_camss_axi_clk
  gosub Find_Print_Clock mmss_throttle_mdss_axi_clk
  gosub Find_Print_Clock mmss_throttle_video_axi_clk
  gosub Find_Print_Clock mmss_video_axi_clk
  gosub Find_Print_Clock mmss_mdss_byte0_clk
  gosub Find_Print_Clock mmss_mdss_byte0_intf_clk
  gosub Find_Print_Clock mmss_mdss_byte1_clk
  gosub Find_Print_Clock mmss_mdss_byte1_intf_clk
  gosub Find_Print_Clock mmss_camss_gp0_clk
  gosub Find_Print_Clock mmss_camss_gp1_clk
  gosub Find_Print_Clock mmss_camss_cci_clk
  gosub Find_Print_Clock mmss_sleep_clk
  gosub Find_Print_Clock mmss_camss_cpp_clk
  gosub Find_Print_Clock mmss_spdm_cpp_clk
  gosub Find_Print_Clock mmss_camss_csi0_clk
  gosub Find_Print_Clock mmss_camss_csi0pix_clk
  gosub Find_Print_Clock mmss_camss_csi0rdi_clk
  gosub Find_Print_Clock mmss_spdm_csi0_clk
  gosub Find_Print_Clock mmss_spdm_debug_clk
  gosub Find_Print_Clock mmss_camss_csi0phytimer_clk
  gosub Find_Print_Clock mmss_camss_csi1_clk
  gosub Find_Print_Clock mmss_camss_csi1pix_clk
  gosub Find_Print_Clock mmss_camss_csi1rdi_clk
  gosub Find_Print_Clock mmss_camss_csi1phytimer_clk
  gosub Find_Print_Clock mmss_camss_csi2_clk
  gosub Find_Print_Clock mmss_camss_csi2pix_clk
  gosub Find_Print_Clock mmss_camss_csi2rdi_clk
  gosub Find_Print_Clock mmss_camss_csi2phytimer_clk
  gosub Find_Print_Clock mmss_camss_csi3_clk
  gosub Find_Print_Clock mmss_camss_csi3pix_clk
  gosub Find_Print_Clock mmss_camss_csi3rdi_clk
  gosub Find_Print_Clock mmss_camss_cphy_csid0_clk
  gosub Find_Print_Clock mmss_camss_cphy_csid1_clk
  gosub Find_Print_Clock mmss_camss_cphy_csid2_clk
  gosub Find_Print_Clock mmss_camss_cphy_csid3_clk
  gosub Find_Print_Clock mmss_camss_csiphy0_clk
  gosub Find_Print_Clock mmss_camss_csiphy1_clk
  gosub Find_Print_Clock mmss_camss_csiphy2_clk
  gosub Find_Print_Clock mmss_cxo_clk
  gosub Find_Print_Clock mmss_misc_cxo_clk
  gosub Find_Print_Clock mmss_throttle_camss_cxo_clk
  gosub Find_Print_Clock mmss_throttle_mdss_cxo_clk
  gosub Find_Print_Clock mmss_throttle_video_cxo_clk
  gosub Find_Print_Clock mmss_mdss_dp_aux_clk
  gosub Find_Print_Clock mmss_mdss_dp_crypto_clk
  gosub Find_Print_Clock mmss_spdm_dp_crypto_clk
  gosub Find_Print_Clock mmss_mdss_dp_gtc_clk
  gosub Find_Print_Clock mmss_mdss_dp_link_clk
  gosub Find_Print_Clock mmss_mdss_dp_link_intf_clk
  gosub Find_Print_Clock mmss_mdss_dp_pixel_clk
  gosub Find_Print_Clock mmss_spdm_dp_pixel_clk
  gosub Find_Print_Clock mmss_mdss_esc0_clk
  gosub Find_Print_Clock mmss_mdss_esc1_clk
  gosub Find_Print_Clock mmss_camss_jpeg0_clk
  gosub Find_Print_Clock mmss_spdm_jpeg0_clk
  gosub Find_Print_Clock mmss_camss_mclk0_clk
  gosub Find_Print_Clock mmss_camss_mclk1_clk
  gosub Find_Print_Clock mmss_camss_mclk2_clk
  gosub Find_Print_Clock mmss_camss_mclk3_clk
  gosub Find_Print_Clock mmss_mdss_mdp_clk
  gosub Find_Print_Clock mmss_spdm_mdp_clk
  gosub Find_Print_Clock mmss_mdss_pclk0_clk
  gosub Find_Print_Clock mmss_spdm_pclk0_clk
  gosub Find_Print_Clock mmss_mdss_pclk1_clk
  gosub Find_Print_Clock mmss_spdm_pclk1_clk
  gosub Find_Print_Clock mmss_mdss_rot_clk
  gosub Find_Print_Clock mmss_spdm_rot_clk
  gosub Find_Print_Clock mmss_camss_csi_vfe0_clk
  gosub Find_Print_Clock mmss_camss_vfe0_clk
  gosub Find_Print_Clock mmss_camss_vfe0_stream_clk
  gosub Find_Print_Clock mmss_spdm_vfe0_clk
  gosub Find_Print_Clock mmss_camss_csi_vfe1_clk
  gosub Find_Print_Clock mmss_camss_vfe1_clk
  gosub Find_Print_Clock mmss_camss_vfe1_stream_clk
  gosub Find_Print_Clock mmss_spdm_vfe1_clk
  gosub Find_Print_Clock mmss_spdm_video_core_clk
  gosub Find_Print_Clock mmss_video_core_clk
  gosub Find_Print_Clock mmss_video_subcore0_clk
  gosub Find_Print_Clock mmss_mdss_vsync_clk

  return


Print_All_SS:
(
  local &choice
  entry &choice

  if ("&choice"=="apcs_all")
  (
    gosub Find_Print_Clock apc0_sysleaf_clk
    gosub Find_Print_Clock apc1_sysleaf_clk
    gosub Find_Print_Clock gladiator_sysleaf_clk
    gosub Find_Print_Clock sys_apcsqsb_clk
    gosub Find_Print_Clock im_sleep_clk
    gosub Find_Print_Clock lmh_lite_clk
    gosub Find_Print_Clock cl0_apcpll_lockdet
    gosub Find_Print_Clock cl1_apcpll_lockdet
    gosub Find_Print_Clock cci_apcpll_lockdet
    return 1.
  )
  if ("&choice"=="cdsp_all")
  (
    gosub Find_Print_Clock aon_clk_src
    gosub Find_Print_Clock q6ss_ahbm_aon_clk
    gosub Find_Print_Clock q6ss_ahbs_aon_clk
    gosub Find_Print_Clock turing_wrapper_aon_clk
    gosub Find_Print_Clock turing_wrapper_bus_timeout_aon_clk
    gosub Find_Print_Clock turing_wrapper_mpu_cfg_aon_clk
    gosub Find_Print_Clock turing_wrapper_q6_ahbm_mpu_aon_clk
    gosub Find_Print_Clock turing_wrapper_qos_ahbs_aon_clk
    gosub Find_Print_Clock turing_wrapper_sysnoc_sway_aon_clk
    gosub Find_Print_Clock q6ss_q6_axim_clk
    gosub Find_Print_Clock turing_wrapper_q6_smmu_axi_clk
    gosub Find_Print_Clock turing_wrapper_q6_smmu_cfg_cnoc_clk
    gosub Find_Print_Clock turing_wrapper_sysnoc_sway_snoc_clk
    gosub Find_Print_Clock q6ss_q6_camss_dsp_streaming_0_clk
    gosub Find_Print_Clock q6ss_q6_camss_dsp_streaming_1_clk
    gosub Find_Print_Clock qos_fixed_lat_counter_src
    gosub Find_Print_Clock turing_wrapper_qos_danger_fixed_lat_counter_clk
    gosub Find_Print_Clock turing_wrapper_qos_dmonitor_fixed_lat_counter_clk
    gosub Find_Print_Clock sleep_clk_src
    gosub Find_Print_Clock q6ss_slp_clk
    gosub Find_Print_Clock turing_gcc_dbg_clk
    gosub Find_Print_Clock turing_q6ss_gfmux_clk_src
    gosub Find_Print_Clock turing_q6ss_zmeas_clk_mux
    gosub Find_Print_Clock xo_clk_src
    gosub Find_Print_Clock audio_core_gdsc_xo_clk
    gosub Find_Print_Clock q6ss_xo_clk
    gosub Find_Print_Clock turing_wrapper_q6_smmu_gdsc_xo_clk
    gosub Find_Print_Clock turing_wrapper_qos_xo_lat_counter_clk
    return 1.
  )
  if ("&choice"=="ddrss_all")
  (
    gosub Find_Print_Clock ddrss_ch0_mc_clk
    gosub Find_Print_Clock ddrss_ch1_mc_clk
    return 1.
  )
  if ("&choice"=="gcc_all")
  (
    gosub Find_Print_Clock gcc_sec_ctrl_acc_clk
    gosub Find_Print_Clock gcc_apc0_vs_clk
    gosub Find_Print_Clock apc0_vs_pll0_clk_src
    gosub Find_Print_Clock gcc_apc1_vs_clk
    gosub Find_Print_Clock apc1_vs_pll0_clk_src
    gosub Find_Print_Clock gcc_bimc_clk
    gosub Find_Print_Clock gcc_spdm_bimc_cy_clk
    gosub Find_Print_Clock gcc_bimc_ddr_cpll0_clk
    gosub Find_Print_Clock gcc_bimc_ddr_cpll1_clk
    gosub Find_Print_Clock gcc_bimc_dtts_xo_clk
    gosub Find_Print_Clock gcc_bimc_xo_clk
    gosub Find_Print_Clock gcc_cfg_noc_ddr_cfg_clk
    gosub Find_Print_Clock gcc_cnoc_bus_timeout5_ahb_clk
    gosub Find_Print_Clock gcc_ddr_dim_cfg_clk
    gosub Find_Print_Clock gcc_bimc_hmss_axi_clk
    gosub Find_Print_Clock gcc_blsp1_qup1_i2c_apps_clk
    gosub Find_Print_Clock gcc_blsp1_qup1_spi_apps_clk
    gosub Find_Print_Clock gcc_blsp1_qup2_i2c_apps_clk
    gosub Find_Print_Clock gcc_blsp1_qup2_spi_apps_clk
    gosub Find_Print_Clock gcc_blsp1_qup3_i2c_apps_clk
    gosub Find_Print_Clock gcc_blsp1_qup3_spi_apps_clk
    gosub Find_Print_Clock gcc_blsp1_qup4_i2c_apps_clk
    gosub Find_Print_Clock gcc_blsp1_qup4_spi_apps_clk
    gosub Find_Print_Clock gcc_blsp1_uart1_apps_clk
    gosub Find_Print_Clock gcc_blsp1_uart2_apps_clk
    gosub Find_Print_Clock gcc_blsp2_qup1_i2c_apps_clk
    gosub Find_Print_Clock gcc_blsp2_qup1_spi_apps_clk
    gosub Find_Print_Clock gcc_blsp2_qup2_i2c_apps_clk
    gosub Find_Print_Clock gcc_blsp2_qup2_spi_apps_clk
    gosub Find_Print_Clock gcc_blsp2_qup3_i2c_apps_clk
    gosub Find_Print_Clock gcc_blsp2_qup3_spi_apps_clk
    gosub Find_Print_Clock gcc_blsp2_qup4_i2c_apps_clk
    gosub Find_Print_Clock gcc_blsp2_qup4_spi_apps_clk
    gosub Find_Print_Clock gcc_blsp2_uart1_apps_clk
    gosub Find_Print_Clock gcc_blsp2_uart2_apps_clk
    gosub Find_Print_Clock gcc_blsp1_uart1_sim_clk
    gosub Find_Print_Clock gcc_blsp1_uart2_sim_clk
    gosub Find_Print_Clock gcc_blsp2_uart1_sim_clk
    gosub Find_Print_Clock gcc_blsp2_uart2_sim_clk
    gosub Find_Print_Clock gcc_cdsp_bimc_clk
    gosub Find_Print_Clock gcc_sys_noc_cdsp_clk
    gosub Find_Print_Clock gcc_turing_q6_axi_clk
    gosub Find_Print_Clock gcc_turing_q6_smmu_axi_clk
    gosub Find_Print_Clock gcc_turing_q6_smmu_axi_src_clk
    gosub Find_Print_Clock gcc_ce1_clk
    gosub Find_Print_Clock gcc_aggre2_cnoc_north_periph_ahb_clk
    gosub Find_Print_Clock gcc_aggre2_cnoc_periph_ahb_clk
    gosub Find_Print_Clock gcc_aggre2_cnoc_south_periph_ahb_clk
    gosub Find_Print_Clock gcc_blsp1_ahb_clk
    gosub Find_Print_Clock gcc_blsp2_ahb_clk
    gosub Find_Print_Clock gcc_cnoc_bus_timeout0_ahb_clk
    gosub Find_Print_Clock gcc_cnoc_periph_ahb_clk
    gosub Find_Print_Clock gcc_cnoc_periph_bus_timeout1_ahb_clk
    gosub Find_Print_Clock gcc_cnoc_periph_bus_timeout2_ahb_clk
    gosub Find_Print_Clock gcc_cnoc_periph_north_ahb_clk
    gosub Find_Print_Clock gcc_cnoc_periph_south_ahb_clk
    gosub Find_Print_Clock gcc_pdm_ahb_clk
    gosub Find_Print_Clock gcc_qspi_ahb_clk
    gosub Find_Print_Clock gcc_sdcc1_ahb_clk
    gosub Find_Print_Clock gcc_sdcc2_ahb_clk
    gosub Find_Print_Clock gcc_spdm_pnoc_cy_clk
    gosub Find_Print_Clock gcc_a2noc_throttle_cfg_clk
    gosub Find_Print_Clock gcc_aggre2_cnoc_ahb_clk
    gosub Find_Print_Clock gcc_aggre2_noc_msmpu_cfg_ahb_clk
    gosub Find_Print_Clock gcc_ahb_clk
    gosub Find_Print_Clock gcc_bimc_cfg_ahb_clk
    gosub Find_Print_Clock gcc_bimc_nius_cfg_ahb_clk
    gosub Find_Print_Clock gcc_boot_rom_ahb_clk
    gosub Find_Print_Clock gcc_ce1_ahb_clk
    gosub Find_Print_Clock gcc_cfg_noc_ahb_clk
    gosub Find_Print_Clock gcc_cfg_noc_lpass_aon_ahb_clk
    gosub Find_Print_Clock gcc_cfg_noc_north_ahb_clk
    gosub Find_Print_Clock gcc_cfg_noc_south_ahb_clk
    gosub Find_Print_Clock gcc_cfg_noc_turing_aon_ahb_clk
    gosub Find_Print_Clock gcc_cnoc_bus_timeout10_ahb_clk
    gosub Find_Print_Clock gcc_cnoc_bus_timeout11_ahb_clk
    gosub Find_Print_Clock gcc_cnoc_bus_timeout2_ahb_clk
    gosub Find_Print_Clock gcc_cnoc_bus_timeout3_ahb_clk
    gosub Find_Print_Clock gcc_cnoc_bus_timeout4_ahb_clk
    gosub Find_Print_Clock gcc_cnoc_bus_timeout6_ahb_clk
    gosub Find_Print_Clock gcc_cnoc_bus_timeout7_ahb_clk
    gosub Find_Print_Clock gcc_cnoc_bus_timeout8_ahb_clk
    gosub Find_Print_Clock gcc_cnoc_bus_timeout9_ahb_clk
    gosub Find_Print_Clock gcc_cnoc_mst_rpm_ahb_clk
    gosub Find_Print_Clock gcc_dcc_ahb_clk
    gosub Find_Print_Clock gcc_glm_ahb_clk
    gosub Find_Print_Clock gcc_gpu_cfg_ahb_clk
    gosub Find_Print_Clock gcc_imem_cfg_ahb_clk
    gosub Find_Print_Clock gcc_ipa_ahb_clk
    gosub Find_Print_Clock gcc_lpass_cnoc_cfg_clk
    gosub Find_Print_Clock gcc_lpass_q6_smmu_ahb_clk
    gosub Find_Print_Clock gcc_lpass_q6_smmu_gds_cfg_clk
    gosub Find_Print_Clock gcc_mccc_cfg_ahb_clk
    gosub Find_Print_Clock gcc_mmss_noc_cfg_ahb_clk
    gosub Find_Print_Clock gcc_mmss_qm_ahb_clk
    gosub Find_Print_Clock gcc_mpm_ahb_clk
    gosub Find_Print_Clock gcc_msg_ram_ahb_clk
    gosub Find_Print_Clock gcc_mss_cfg_ahb_clk
    gosub Find_Print_Clock gcc_mss_msmpu_cfg_ahb_clk
    gosub Find_Print_Clock gcc_mss_q6_msmpu_cfg_ahb_clk
    gosub Find_Print_Clock gcc_pimem_ahb_clk
    gosub Find_Print_Clock gcc_prng_ahb_clk
    gosub Find_Print_Clock gcc_qdss_cfg_ahb_clk
    gosub Find_Print_Clock gcc_qdss_dap_ahb_clk
    gosub Find_Print_Clock gcc_rbcpr_cx_ahb_clk
    gosub Find_Print_Clock gcc_rbcpr_mx_ahb_clk
    gosub Find_Print_Clock gcc_rpm_mst_m2_cnoc_ahb_clk
    gosub Find_Print_Clock gcc_sec_ctrl_ahb_clk
    gosub Find_Print_Clock gcc_sec_ctrl_boot_rom_patch_clk
    gosub Find_Print_Clock gcc_smmu_aggre2_ahb_clk
    gosub Find_Print_Clock gcc_snoc_bus_timeout4_ahb_clk
    gosub Find_Print_Clock gcc_snoc_cnoc_ahb_clk
    gosub Find_Print_Clock gcc_spdm_cfg_ahb_clk
    gosub Find_Print_Clock gcc_spdm_mstr_ahb_clk
    gosub Find_Print_Clock gcc_spmi_cnoc_ahb_clk
    gosub Find_Print_Clock gcc_tcsr_ahb_clk
    gosub Find_Print_Clock gcc_tic_cfg_ahb_clk
    gosub Find_Print_Clock gcc_tlmm_centre_ahb_clk
    gosub Find_Print_Clock gcc_tlmm_clk
    gosub Find_Print_Clock gcc_tlmm_north_ahb_clk
    gosub Find_Print_Clock gcc_tlmm_south_ahb_clk
    gosub Find_Print_Clock gcc_turing_q6_smmu_ahb_clk
    gosub Find_Print_Clock gcc_ufs_ahb_clk
    gosub Find_Print_Clock gcc_usb_phy_cfg_ahb2phy_clk
    gosub Find_Print_Clock gcc_spdm_debug_cy_clk
    gosub Find_Print_Clock gcc_bimc_sleep_clk
    gosub Find_Print_Clock gcc_blsp1_sleep_clk
    gosub Find_Print_Clock gcc_blsp2_sleep_clk
    gosub Find_Print_Clock gcc_ddr_dim_sleep_clk
    gosub Find_Print_Clock gcc_im_sleep_clk
    gosub Find_Print_Clock gcc_ipa_sleep_clk
    gosub Find_Print_Clock gcc_rpm_sleep_clk
    gosub Find_Print_Clock gcc_usb20_sleep_clk
    gosub Find_Print_Clock gcc_usb30_sleep_clk
    gosub Find_Print_Clock gcc_a2noc_throttle_cxo_clk
    gosub Find_Print_Clock gcc_aggre2_noc_cxo_north_clk
    gosub Find_Print_Clock gcc_aggre2_noc_cxo_south_clk
    gosub Find_Print_Clock gcc_ahb2phy_east_clk
    gosub Find_Print_Clock gcc_cfg_noc_ah2phy_xo_clk
    gosub Find_Print_Clock gcc_cfg_noc_dcd_xo_clk
    gosub Find_Print_Clock gcc_cfg_noc_north_dcd_xo_clk
    gosub Find_Print_Clock gcc_cfg_noc_south_dcd_xo_clk
    gosub Find_Print_Clock gcc_cm_phy_refgen1_clk
    gosub Find_Print_Clock gcc_cm_phy_refgen2_clk
    gosub Find_Print_Clock gcc_cnoc_bus_timeout13_ahb_clk
    gosub Find_Print_Clock gcc_glm_xo_clk
    gosub Find_Print_Clock gcc_lpass_cxo_clk
    gosub Find_Print_Clock gcc_pdm_xo4_clk
    gosub Find_Print_Clock gcc_qdss_xo_clk
    gosub Find_Print_Clock gcc_qrefs_vbg_cal_clk
    gosub Find_Print_Clock gcc_rpm_timer_clk
    gosub Find_Print_Clock gcc_spdm_ff_clk
    gosub Find_Print_Clock gcc_sram_sensor_xo_clk
    gosub Find_Print_Clock gcc_sys_noc_dcd_xo_clk
    gosub Find_Print_Clock gcc_xo_clk
    gosub Find_Print_Clock gcc_xo_div4_clk
    gosub Find_Print_Clock gcc_glm_clk
    gosub Find_Print_Clock gcc_gp1_clk
    gosub Find_Print_Clock gcc_gp2_clk
    gosub Find_Print_Clock gcc_gp3_clk
    gosub Find_Print_Clock gcc_bimc_gfx_clk
    gosub Find_Print_Clock gcc_gpu_bimc_gfx_clk
    gosub Find_Print_Clock gcc_gpu_bimc_gfx_src_clk
    gosub Find_Print_Clock gcc_gpu_snoc_dvm_gfx_clk
    gosub Find_Print_Clock gcc_hmss_ahb_clk
    gosub Find_Print_Clock gcc_sys_noc_hmss_ahb_clk
    gosub Find_Print_Clock gcc_hmss_rbcpr_clk
    gosub Find_Print_Clock gcc_aggre2_noc_ipa_clk
    gosub Find_Print_Clock gcc_ipa_2x_clk
    gosub Find_Print_Clock gcc_ipa_clk
    gosub Find_Print_Clock gcc_mmss_qm_core_clk
    gosub Find_Print_Clock gcc_bimc_mss_q6_axi_clk
    gosub Find_Print_Clock gcc_mss_q6_bimc_axi_clk
    gosub Find_Print_Clock gcc_mss_q6_msmpu_client_axi_clk
    gosub Find_Print_Clock gcc_mss_vs_clk
    gosub Find_Print_Clock mss_vs_pll0_clk_src
    gosub Find_Print_Clock gcc_obt_odt_clk
    gosub Find_Print_Clock gcc_pdm2_clk
    gosub Find_Print_Clock gcc_bimc_pimem_axi_clk
    gosub Find_Print_Clock gcc_pimem_axi_clk
    gosub Find_Print_Clock gcc_sys_noc_pimem_axi_clk
    gosub Find_Print_Clock gcc_center_apb_clk
    gosub Find_Print_Clock gcc_gpu_trig_clk
    gosub Find_Print_Clock gcc_hmss_trig_clk
    gosub Find_Print_Clock gcc_lpass_trig_clk
    gosub Find_Print_Clock gcc_mmss_trig_clk
    gosub Find_Print_Clock gcc_mss_trig_clk
    gosub Find_Print_Clock gcc_north_apb_clk
    gosub Find_Print_Clock gcc_qdss_apb2jtag_clk
    gosub Find_Print_Clock gcc_qdss_dap_clk
    gosub Find_Print_Clock gcc_qdss_trig_clk
    gosub Find_Print_Clock gcc_south_apb_clk
    gosub Find_Print_Clock gcc_turing_trig_clk
    gosub Find_Print_Clock gcc_wcss_apb_clk
    gosub Find_Print_Clock gcc_aggre2_noc_at_clk
    gosub Find_Print_Clock gcc_gpu_at_clk
    gosub Find_Print_Clock gcc_hmss_at_clk
    gosub Find_Print_Clock gcc_mmss_at_clk
    gosub Find_Print_Clock gcc_mmss_noc_at_clk
    gosub Find_Print_Clock gcc_north_at_clk
    gosub Find_Print_Clock gcc_qdss_center_at_clk
    gosub Find_Print_Clock gcc_south_at_clk
    gosub Find_Print_Clock gcc_sys_noc_at_clk
    gosub Find_Print_Clock gcc_wcss_at_clk
    gosub Find_Print_Clock gcc_bimc_at_clk
    gosub Find_Print_Clock gcc_mss_at_clk
    gosub Find_Print_Clock gcc_lpass_at_clk
    gosub Find_Print_Clock gcc_turing_at_clk
    gosub Find_Print_Clock gcc_qdss_stm_clk
    gosub Find_Print_Clock gcc_sys_noc_qdss_stm_axi_clk
    gosub Find_Print_Clock gcc_qdss_traceclkin_clk
    gosub Find_Print_Clock gcc_apss_qdss_tsctr_div2_clk
    gosub Find_Print_Clock gcc_apss_qdss_tsctr_div8_clk
    gosub Find_Print_Clock gcc_qdss_tsctr_div16_clk
    gosub Find_Print_Clock gcc_qdss_tsctr_div2_clk
    gosub Find_Print_Clock gcc_qdss_tsctr_div3_clk
    gosub Find_Print_Clock gcc_qdss_tsctr_div4_clk
    gosub Find_Print_Clock gcc_qdss_tsctr_div8_clk
    gosub Find_Print_Clock gcc_wcss_tsctr_div2_clk
    gosub Find_Print_Clock gcc_qspi_ser_clk
    gosub Find_Print_Clock gcc_rbcpr_cx_clk
    gosub Find_Print_Clock gcc_rbcpr_mx_clk
    gosub Find_Print_Clock gcc_rpm_bus_ahb_clk
    gosub Find_Print_Clock gcc_rpm_proc_fclk
    gosub Find_Print_Clock gcc_rpm_proc_hclk
    gosub Find_Print_Clock gcc_spdm_rpm_cy_clk
    gosub Find_Print_Clock gcc_sdcc1_apps_clk
    gosub Find_Print_Clock gcc_sdcc1_ice_core_clk
    gosub Find_Print_Clock gcc_sdcc2_apps_clk
    gosub Find_Print_Clock gcc_sec_ctrl_clk
    gosub Find_Print_Clock gcc_sec_ctrl_sense_clk
    gosub Find_Print_Clock sec_ctrl_acc_clk_src
    gosub Find_Print_Clock gcc_spmi_ahb_clk
    gosub Find_Print_Clock gcc_spmi_ser_clk
    gosub Find_Print_Clock gcc_bimc_nius_hs_axi_clk
    gosub Find_Print_Clock gcc_bimc_sysnoc_hs_axi_clk
    gosub Find_Print_Clock gcc_lpass_q6_axi_clk
    gosub Find_Print_Clock gcc_lpass_q6_smmu_axi_clk
    gosub Find_Print_Clock gcc_lpass_q6_smmu_axi_src_clk
    gosub Find_Print_Clock gcc_mss_mnoc_bimc_axi_clk
    gosub Find_Print_Clock gcc_mss_msmpu_client_axi_clk
    gosub Find_Print_Clock gcc_sys_noc_hs_axi_clk
    gosub Find_Print_Clock gcc_a2noc_throttle_core_axi_clk
    gosub Find_Print_Clock gcc_aggre2_snoc_axi_clk
    gosub Find_Print_Clock gcc_aggre2_snoc_msmpu_client_axi_clk
    gosub Find_Print_Clock gcc_aggre2_snoc_north_axi_clk
    gosub Find_Print_Clock gcc_aggre2_snoc_south_axi_clk
    gosub Find_Print_Clock gcc_bimc_nius_axi_clk
    gosub Find_Print_Clock gcc_bimc_sysnoc_axi_clk
    gosub Find_Print_Clock gcc_ce1_axi_clk
    gosub Find_Print_Clock gcc_hmss_dvm_bus_clk
    gosub Find_Print_Clock gcc_imem_axi_clk
    gosub Find_Print_Clock gcc_lpass_mport_clk
    gosub Find_Print_Clock gcc_lpass_sway_clk
    gosub Find_Print_Clock gcc_lpass_sway_mpu_clk
    gosub Find_Print_Clock gcc_mmss_sys_noc_axi_clk
    gosub Find_Print_Clock gcc_mss_snoc_axi_clk
    gosub Find_Print_Clock gcc_qdss_etr_usb_clk
    gosub Find_Print_Clock gcc_smmu_aggre2_axi_clk
    gosub Find_Print_Clock gcc_smmu_aggre2_axi_src_clk
    gosub Find_Print_Clock gcc_snoc_bus_timeout0_ahb_clk
    gosub Find_Print_Clock gcc_snoc_bus_timeout1_ahb_clk
    gosub Find_Print_Clock gcc_snoc_bus_timeout3_ahb_clk
    gosub Find_Print_Clock gcc_snoc_lpass_q6_axis_clk
    gosub Find_Print_Clock gcc_spdm_snoc_cy_clk
    gosub Find_Print_Clock gcc_sys_noc_axi_clk
    gosub Find_Print_Clock gcc_sys_noc_north_axi_clk
    gosub Find_Print_Clock gcc_sys_noc_south_axi_clk
    gosub Find_Print_Clock gcc_turing_sway_clk
    gosub Find_Print_Clock gcc_wcss_ahb_s0_clk
    gosub Find_Print_Clock gcc_wcss_axi_m_clk
    gosub Find_Print_Clock gcc_wcss_ecahb_clk
    gosub Find_Print_Clock gcc_wcss_shdreg_ahb_clk
    gosub Find_Print_Clock gcc_cfg_noc_tic_clk
    gosub Find_Print_Clock gcc_tic_clk
    gosub Find_Print_Clock gcc_aggre2_ufs_axi_clk
    gosub Find_Print_Clock gcc_ufs_axi_clk
    gosub Find_Print_Clock gcc_ufs_ice_core_clk
    gosub Find_Print_Clock gcc_ufs_phy_aux_clk
    gosub Find_Print_Clock gcc_ufs_rx_symbol_0_clk
    gosub Find_Print_Clock ufs_rx_symbol_0_clk_src
    gosub Find_Print_Clock gcc_ufs_rx_symbol_1_clk
    gosub Find_Print_Clock ufs_rx_symbol_1_clk_src
    gosub Find_Print_Clock gcc_ufs_tx_symbol_0_clk
    gosub Find_Print_Clock ufs_tx_symbol_0_clk_src
    gosub Find_Print_Clock gcc_ufs_unipro_core_clk
    gosub Find_Print_Clock gcc_cfg_noc_usb2_axi_clk
    gosub Find_Print_Clock gcc_cnoc_bus_timeout12_ahb_clk
    gosub Find_Print_Clock gcc_usb20_master_clk
    gosub Find_Print_Clock gcc_usb20_mock_utmi_clk
    gosub Find_Print_Clock gcc_aggre2_usb3_axi_clk
    gosub Find_Print_Clock gcc_cfg_noc_usb3_axi_clk
    gosub Find_Print_Clock gcc_cnoc_bus_timeout14_ahb_clk
    gosub Find_Print_Clock gcc_usb30_master_clk
    gosub Find_Print_Clock gcc_usb30_mock_utmi_clk
    gosub Find_Print_Clock gcc_usb3_phy_aux_clk
    gosub Find_Print_Clock gcc_usb3_phy_pipe_clk
    gosub Find_Print_Clock usb3_phy_pipe_clk_src
    gosub Find_Print_Clock gcc_vdda_vs_clk
    gosub Find_Print_Clock vdda_vs_pll0_clk_src
    gosub Find_Print_Clock gcc_vddcx_vs_clk
    gosub Find_Print_Clock vddcx_vs_pll0_clk_src
    gosub Find_Print_Clock gcc_vddmx_vs_clk
    gosub Find_Print_Clock vddmx_vs_pll0_clk_src
    gosub Find_Print_Clock gcc_vs_ctrl_clk
    gosub Find_Print_Clock gcc_wcss_vs_clk
    gosub Find_Print_Clock wcss_vs_pll0_clk_src
    gosub Find_Print_Clock gcc_aggre2_noc_qosgen_extref
    gosub Find_Print_Clock gcc_cnoc_bus_timeout_extref
    gosub Find_Print_Clock gcc_snoc_bus_timeout_extref
    gosub Find_Print_Clock gcc_snoc_qosgen_extref
    gosub Find_Print_Clock gpll0_dtest
    gosub Find_Print_Clock gpll1_dtest
    gosub Find_Print_Clock gpll2_dtest
    gosub Find_Print_Clock gpll3_dtest
    gosub Find_Print_Clock gpll4_dtest
    gosub Find_Print_Clock gpll5_dtest
    gosub Find_Print_Clock gpll6_dtest
    gosub Find_Print_Clock gpu_gcc_dbg_clk
    gosub Find_Print_Clock hmss_gcc_dbg_clk
    gosub Find_Print_Clock lpass_gcc_dbg_clk
    gosub Find_Print_Clock mccc_ddrss_gcc_ch_clk
    gosub Find_Print_Clock mmss_gcc_dbg_clk
    gosub Find_Print_Clock mpm_gcc_temp0_sensor_ringosc_clk
    gosub Find_Print_Clock mpm_gcc_temp1_sensor_ringosc_clk
    gosub Find_Print_Clock mss_gcc_dbg_clk
    gosub Find_Print_Clock nav_gcc_dbg_clk
    gosub Find_Print_Clock nav_pll_dtest
    gosub Find_Print_Clock qusb2phy_gcc_clk_test_prim
    gosub Find_Print_Clock qusb2phy_gcc_clk_test_sec
    gosub Find_Print_Clock qusb2phy_prim_gcc_usb30_utmi_clk
    gosub Find_Print_Clock qusb2phy_sec_gcc_usb20s_utmi_clk
    gosub Find_Print_Clock turing_gcc_dbg_clk
    gosub Find_Print_Clock ufs_rx_symbol_0_clk
    gosub Find_Print_Clock ufs_rx_symbol_1_clk
    gosub Find_Print_Clock ufs_tx_symbol_0_clk
    gosub Find_Print_Clock usb3_phy_wrapper_gcc_usb3_pipe_clk
    gosub Find_Print_Clock wcss_gcc_dbg_clk
    return 1.
  )
  if ("&choice"=="gpu_all")
  (
    gosub Find_Print_Clock gpucc_gfx3d_clk
    gosub Find_Print_Clock gpucc_spdm_gfx3d_clk
    gosub Find_Print_Clock gpucc_rbbmtimer_clk
    gosub Find_Print_Clock gpucc_rbcpr_clk
    gosub Find_Print_Clock gpucc_cxo_clk
    return 1.
  )
  if ("&choice"=="lpass_all")
  (
    gosub Find_Print_Clock aon_clk_src
    gosub Find_Print_Clock audio_core_qdsp_sway_aon_clk
    gosub Find_Print_Clock audio_wrapper_aon_clk
    gosub Find_Print_Clock audio_wrapper_bus_timeout_aon_clk
    gosub Find_Print_Clock audio_wrapper_mpu_cfg_aon_clk
    gosub Find_Print_Clock audio_wrapper_q6_ahbm_mpu_aon_clk
    gosub Find_Print_Clock audio_wrapper_qos_ahbs_aon_clk
    gosub Find_Print_Clock audio_wrapper_sysnoc_sway_aon_clk
    gosub Find_Print_Clock island_scc_cfg_ahb_aon_clk
    gosub Find_Print_Clock island_scc_crif_aon_clk
    gosub Find_Print_Clock island_scc_csr_h_aon_clk
    gosub Find_Print_Clock island_scc_data_h_aon_clk
    gosub Find_Print_Clock island_scc_qdsp_sway_aon_clk
    gosub Find_Print_Clock q6ss_ahbm_aon_clk
    gosub Find_Print_Clock q6ss_ahbs_aon_clk
    gosub Find_Print_Clock atime_clk_src
    gosub Find_Print_Clock audio_core_avsync_atime_clk
    gosub Find_Print_Clock audio_core_lpaif_pri_bit_clk
    gosub Find_Print_Clock audio_core_lpaif_quad_bit_clk
    gosub Find_Print_Clock audio_core_lpaif_sec_bit_clk
    gosub Find_Print_Clock audio_core_lpaif_ter_bit_clk
    gosub Find_Print_Clock aud_slimbus_clk_src
    gosub Find_Print_Clock audio_core_aud_slimbus_clk
    gosub Find_Print_Clock core_clk_src
    gosub Find_Print_Clock audio_core_aud_slimbus_core_clk
    gosub Find_Print_Clock audio_core_bus_timeout_core_clk
    gosub Find_Print_Clock audio_core_core_clk
    gosub Find_Print_Clock audio_core_lpm_core_clk
    gosub Find_Print_Clock audio_core_qca_slimbus_core_clk
    gosub Find_Print_Clock audio_core_sysnoc_mport_core_clk
    gosub Find_Print_Clock island_scc_ahb_timeout_core_clk
    gosub Find_Print_Clock island_scc_blsp_h_core_clk
    gosub Find_Print_Clock island_scc_sensor_core_core_clk
    gosub Find_Print_Clock island_scc_smem_core_clk
    gosub Find_Print_Clock dbg_clk
    gosub Find_Print_Clock ext_mclk0_clk_src
    gosub Find_Print_Clock audio_wrapper_ext_mclk0_clk
    gosub Find_Print_Clock ext_mclk1_clk_src
    gosub Find_Print_Clock audio_wrapper_ext_mclk1_clk
    gosub Find_Print_Clock ext_mclk2_clk_src
    gosub Find_Print_Clock audio_wrapper_ext_mclk2_clk
    gosub Find_Print_Clock audio_wrapper_ext_mclk3_clk
    gosub Find_Print_Clock audio_core_int_i2s0_1_ibit_clk
    gosub Find_Print_Clock audio_core_int_i2s2_ibit_clk
    gosub Find_Print_Clock audio_core_int_i2s3_ibit_clk
    gosub Find_Print_Clock audio_core_int_i2s4_ibit_clk
    gosub Find_Print_Clock audio_core_int_i2s5_6_ibit_clk
    gosub Find_Print_Clock audio_core_int_mclk0_clk
    gosub Find_Print_Clock audio_core_int_mclk1_clk
    gosub Find_Print_Clock lpaaudio_dig_pll_ref_clk_src_sel
    gosub Find_Print_Clock lpaaudio_pll_ref_clk_src_sel
    gosub Find_Print_Clock lpaif_pcmoe_clk_src
    gosub Find_Print_Clock audio_core_lpaif_pcm_data_oe_clk
    gosub Find_Print_Clock lpaif_pri_clk_src
    gosub Find_Print_Clock audio_core_lpaif_pri_ibit_clk
    gosub Find_Print_Clock lpaif_quad_clk_src
    gosub Find_Print_Clock audio_core_lpaif_quad_ibit_clk
    gosub Find_Print_Clock lpaif_sec_clk_src
    gosub Find_Print_Clock audio_core_lpaif_sec_ibit_clk
    gosub Find_Print_Clock lpaif_ter_clk_src
    gosub Find_Print_Clock audio_core_lpaif_ter_ibit_clk
    gosub Find_Print_Clock audio_core_lpaif_pri_ebit_clk
    gosub Find_Print_Clock island_scc_q6_spm_clk
    gosub Find_Print_Clock island_scc_sensor_core_bcr_xo_clk
    gosub Find_Print_Clock q6ss_gfmux_clk_src
    gosub Find_Print_Clock q6ss_zmeas_clk_mux
    gosub Find_Print_Clock qca_slimbus_clk_src
    gosub Find_Print_Clock audio_core_qca_slimbus_clk
    gosub Find_Print_Clock qdsp6ss_pll_ref_clk_src_sel
    gosub Find_Print_Clock qos_fixed_lat_counter_clk_src
    gosub Find_Print_Clock audio_core_qos_dmonitor_fixed_lat_counter_clk
    gosub Find_Print_Clock audio_wrapper_qos_danger_fixed_lat_counter_clk
    gosub Find_Print_Clock audio_wrapper_qos_dmonitor_fixed_lat_counter_clk
    gosub Find_Print_Clock audio_core_lpaif_quad_ebit_clk
    gosub Find_Print_Clock resampler_clk_src
    gosub Find_Print_Clock audio_core_resampler_clk
    gosub Find_Print_Clock island_scc_qup_i2c1_clk
    gosub Find_Print_Clock island_scc_qup_i2c2_clk
    gosub Find_Print_Clock island_scc_qup_i2c3_clk
    gosub Find_Print_Clock island_scc_qup_spi1_clk
    gosub Find_Print_Clock island_scc_qup_spi2_clk
    gosub Find_Print_Clock island_scc_qup_spi3_clk
    gosub Find_Print_Clock island_scc_at_clk
    gosub Find_Print_Clock island_scc_pclkdbg_clk
    gosub Find_Print_Clock island_scc_q6_atbm_clk
    gosub Find_Print_Clock island_scc_dbg_tsctr_clk
    gosub Find_Print_Clock scc_uart1_clk_src
    gosub Find_Print_Clock island_scc_uart_dm_uart1_clk
    gosub Find_Print_Clock scc_uart2_clk_src
    gosub Find_Print_Clock island_scc_uart_dm_uart2_clk
    gosub Find_Print_Clock scc_uart3_clk_src
    gosub Find_Print_Clock island_scc_uart_dm_uart3_clk
    gosub Find_Print_Clock scc_uart4_clk_src
    gosub Find_Print_Clock island_scc_uart_dm_uart4_clk
    gosub Find_Print_Clock island_scc_vs_vddcx_clk
    gosub Find_Print_Clock island_scc_vs_vddmx_clk
    gosub Find_Print_Clock audio_core_lpaif_sec_ebit_clk
    gosub Find_Print_Clock sleep_clk_src
    gosub Find_Print_Clock audio_core_bcr_slp_clk
    gosub Find_Print_Clock island_scc_sensor_core_bcr_slp_clk
    gosub Find_Print_Clock q6ss_bcr_slp_clk
    gosub Find_Print_Clock q6ss_slp_clk
    gosub Find_Print_Clock audio_wrapper_sw_npl_clk
    gosub Find_Print_Clock audio_core_lpaif_ter_ebit_clk
    gosub Find_Print_Clock xo_clk_src
    gosub Find_Print_Clock audio_core_avsync_stc_clk
    gosub Find_Print_Clock audio_core_gdsc_xo_clk
    gosub Find_Print_Clock audio_wrapper_qos_xo_lat_counter_clk
    gosub Find_Print_Clock q6ss_xo_clk
    gosub Find_Print_Clock lpass_qdsp6ss_q6_core_clk
    gosub Find_Print_Clock lpass_qdsp6ss_axi_m_clk
    gosub Find_Print_Clock lpass_qdsp6ss_ldo_nmo_out
    gosub Find_Print_Clock lpass_qdsp6ss_ahb_m_clk
    gosub Find_Print_Clock lpass_qdsp6ss_ahb_s_clk
    gosub Find_Print_Clock lpass_qdsp6ss_xo_clk
    gosub Find_Print_Clock lpass_qdsp6ss_sleep_clk
    gosub Find_Print_Clock lpass_qdsp6ss_jtag_tck
    gosub Find_Print_Clock lpass_qdsp6ss_atb_clk
    gosub Find_Print_Clock lpass_qdsp6ss_apb_clk
    gosub Find_Print_Clock lpass_qdsp6ss_timestamp_clk
    return 1.
  )
  if ("&choice"=="mmss_all")
  (
    gosub Find_Print_Clock mmss_bimc_smmu_ahb_clk
    gosub Find_Print_Clock mmss_bto_ahb_clk
    gosub Find_Print_Clock mmss_camss_ahb_clk
    gosub Find_Print_Clock mmss_camss_cci_ahb_clk
    gosub Find_Print_Clock mmss_camss_cpp_ahb_clk
    gosub Find_Print_Clock mmss_camss_cpp_vbif_ahb_clk
    gosub Find_Print_Clock mmss_camss_csi0_ahb_clk
    gosub Find_Print_Clock mmss_camss_csi1_ahb_clk
    gosub Find_Print_Clock mmss_camss_csi2_ahb_clk
    gosub Find_Print_Clock mmss_camss_csi3_ahb_clk
    gosub Find_Print_Clock mmss_camss_ispif_ahb_clk
    gosub Find_Print_Clock mmss_camss_jpeg_ahb_clk
    gosub Find_Print_Clock mmss_camss_micro_ahb_clk
    gosub Find_Print_Clock mmss_camss_top_ahb_clk
    gosub Find_Print_Clock mmss_camss_vfe0_ahb_clk
    gosub Find_Print_Clock mmss_camss_vfe1_ahb_clk
    gosub Find_Print_Clock mmss_camss_vfe_vbif_ahb_clk
    gosub Find_Print_Clock mmss_csiphy_ahb2crif_clk
    gosub Find_Print_Clock mmss_mdss_ahb_clk
    gosub Find_Print_Clock mmss_mdss_hdmi_dp_ahb_clk
    gosub Find_Print_Clock mmss_misc_ahb_clk
    gosub Find_Print_Clock mmss_mnoc_ahb_clk
    gosub Find_Print_Clock mmss_spdm_ahb_clk
    gosub Find_Print_Clock mmss_throttle_camss_ahb_clk
    gosub Find_Print_Clock mmss_throttle_mdss_ahb_clk
    gosub Find_Print_Clock mmss_throttle_video_ahb_clk
    gosub Find_Print_Clock mmss_video_ahb_clk
    gosub Find_Print_Clock mmss_bimc_smmu_axi_clk
    gosub Find_Print_Clock mmss_camss_cpp_axi_clk
    gosub Find_Print_Clock mmss_camss_jpeg_axi_clk
    gosub Find_Print_Clock mmss_camss_vfe_vbif_axi_clk
    gosub Find_Print_Clock mmss_mdss_axi_clk
    gosub Find_Print_Clock mmss_mnoc_axi_clk
    gosub Find_Print_Clock mmss_s0_axi_clk
    gosub Find_Print_Clock mmss_snoc_dvm_axi_clk
    gosub Find_Print_Clock mmss_spdm_axi_clk
    gosub Find_Print_Clock mmss_spdm_rm_axi_clk
    gosub Find_Print_Clock mmss_throttle_camss_axi_clk
    gosub Find_Print_Clock mmss_throttle_mdss_axi_clk
    gosub Find_Print_Clock mmss_throttle_video_axi_clk
    gosub Find_Print_Clock mmss_video_axi_clk
    gosub Find_Print_Clock mmss_mdss_byte0_clk
    gosub Find_Print_Clock mmss_mdss_byte0_intf_clk
    gosub Find_Print_Clock mmss_mdss_byte1_clk
    gosub Find_Print_Clock mmss_mdss_byte1_intf_clk
    gosub Find_Print_Clock mmss_camss_gp0_clk
    gosub Find_Print_Clock mmss_camss_gp1_clk
    gosub Find_Print_Clock mmss_camss_cci_clk
    gosub Find_Print_Clock mmss_sleep_clk
    gosub Find_Print_Clock mmss_camss_cpp_clk
    gosub Find_Print_Clock mmss_spdm_cpp_clk
    gosub Find_Print_Clock mmss_camss_csi0_clk
    gosub Find_Print_Clock mmss_camss_csi0pix_clk
    gosub Find_Print_Clock mmss_camss_csi0rdi_clk
    gosub Find_Print_Clock mmss_spdm_csi0_clk
    gosub Find_Print_Clock mmss_spdm_debug_clk
    gosub Find_Print_Clock mmss_camss_csi0phytimer_clk
    gosub Find_Print_Clock mmss_camss_csi1_clk
    gosub Find_Print_Clock mmss_camss_csi1pix_clk
    gosub Find_Print_Clock mmss_camss_csi1rdi_clk
    gosub Find_Print_Clock mmss_camss_csi1phytimer_clk
    gosub Find_Print_Clock mmss_camss_csi2_clk
    gosub Find_Print_Clock mmss_camss_csi2pix_clk
    gosub Find_Print_Clock mmss_camss_csi2rdi_clk
    gosub Find_Print_Clock mmss_camss_csi2phytimer_clk
    gosub Find_Print_Clock mmss_camss_csi3_clk
    gosub Find_Print_Clock mmss_camss_csi3pix_clk
    gosub Find_Print_Clock mmss_camss_csi3rdi_clk
    gosub Find_Print_Clock mmss_camss_cphy_csid0_clk
    gosub Find_Print_Clock mmss_camss_cphy_csid1_clk
    gosub Find_Print_Clock mmss_camss_cphy_csid2_clk
    gosub Find_Print_Clock mmss_camss_cphy_csid3_clk
    gosub Find_Print_Clock mmss_camss_csiphy0_clk
    gosub Find_Print_Clock mmss_camss_csiphy1_clk
    gosub Find_Print_Clock mmss_camss_csiphy2_clk
    gosub Find_Print_Clock mmss_cxo_clk
    gosub Find_Print_Clock mmss_misc_cxo_clk
    gosub Find_Print_Clock mmss_throttle_camss_cxo_clk
    gosub Find_Print_Clock mmss_throttle_mdss_cxo_clk
    gosub Find_Print_Clock mmss_throttle_video_cxo_clk
    gosub Find_Print_Clock mmss_mdss_dp_aux_clk
    gosub Find_Print_Clock mmss_mdss_dp_crypto_clk
    gosub Find_Print_Clock mmss_spdm_dp_crypto_clk
    gosub Find_Print_Clock mmss_mdss_dp_gtc_clk
    gosub Find_Print_Clock mmss_mdss_dp_link_clk
    gosub Find_Print_Clock mmss_mdss_dp_link_intf_clk
    gosub Find_Print_Clock mmss_mdss_dp_pixel_clk
    gosub Find_Print_Clock mmss_spdm_dp_pixel_clk
    gosub Find_Print_Clock mmss_mdss_esc0_clk
    gosub Find_Print_Clock mmss_mdss_esc1_clk
    gosub Find_Print_Clock mmss_camss_jpeg0_clk
    gosub Find_Print_Clock mmss_spdm_jpeg0_clk
    gosub Find_Print_Clock mmss_camss_mclk0_clk
    gosub Find_Print_Clock mmss_camss_mclk1_clk
    gosub Find_Print_Clock mmss_camss_mclk2_clk
    gosub Find_Print_Clock mmss_camss_mclk3_clk
    gosub Find_Print_Clock mmss_mdss_mdp_clk
    gosub Find_Print_Clock mmss_spdm_mdp_clk
    gosub Find_Print_Clock mmss_mdss_pclk0_clk
    gosub Find_Print_Clock mmss_spdm_pclk0_clk
    gosub Find_Print_Clock mmss_mdss_pclk1_clk
    gosub Find_Print_Clock mmss_spdm_pclk1_clk
    gosub Find_Print_Clock mmss_mdss_rot_clk
    gosub Find_Print_Clock mmss_spdm_rot_clk
    gosub Find_Print_Clock mmss_camss_csi_vfe0_clk
    gosub Find_Print_Clock mmss_camss_vfe0_clk
    gosub Find_Print_Clock mmss_camss_vfe0_stream_clk
    gosub Find_Print_Clock mmss_spdm_vfe0_clk
    gosub Find_Print_Clock mmss_camss_csi_vfe1_clk
    gosub Find_Print_Clock mmss_camss_vfe1_clk
    gosub Find_Print_Clock mmss_camss_vfe1_stream_clk
    gosub Find_Print_Clock mmss_spdm_vfe1_clk
    gosub Find_Print_Clock mmss_spdm_video_core_clk
    gosub Find_Print_Clock mmss_video_core_clk
    gosub Find_Print_Clock mmss_video_subcore0_clk
    gosub Find_Print_Clock mmss_mdss_vsync_clk
    return 1.
  )

  return 0.
)


;-----------------------------------------------------------------------------
; Find clocks that match what the user entered and print their information 
;-----------------------------------------------------------------------------

Find_Print_Clock:

ENTRY &clk

&clk_test=0
&clk_reg=0
&clk_reg_name=""

  &match=0
  &wild_head=0
  &wild_tail=0
  &clk_input_length=STRING.LENGTH("&clk")
  &clk_itr_length=STRING.LENGTH("apc0_sysleaf_clk")

  if (STRING.SCAN("&clk", "*", 0)==0)
  (
    &wild_head=1
  )
  if (STRING.SCAN("&clk", "*", 1)==(STRING.LENGTH("&clk")-1))
  (
    &wild_tail=1
  )

  if ((&wild_head==1)&&(&wild_tail==1))
  (
    if (STRING.SCAN("apc0_sysleaf_clk", STRING.MID("&clk", 1, &clk_input_length-2), 0)!=-1)
    ( 
      &match=1
    )
  )
  else if (&wild_head==1)
  (
    if (STRING.MID("apc0_sysleaf_clk", &clk_itr_length-&clk_input_length+1, &clk_input_length-1)==STRING.CUT("&clk", 1))
    ( 
      &match=1
    )
  )
  else if (&wild_tail==1)
  (
    if (STRING.MID("apc0_sysleaf_clk", 0, &clk_input_length-1)==STRING.CUT("&clk", -1))
    ( 
      &match=1
    )
  )
  else if ("apc0_sysleaf_clk"=="&clk")||("cpus"=="&clk")
  (
    &match=1
  )
  
  if (&match==1)
  (
    &clk_test=&CLK_TEST_APC0_SYSLEAF_CLK
    &clk_reg=0
    &clk_reg_name="No CBCR"
    &clk_name="apc0_sysleaf_clk"
    &clk_reg_cbcr_type=""
    &clk_vote_bit=-1.
    &clk_multiplier=32.
    &clk_access_mode="&APCS_access_mode"

    gosub Print_Clk_Info_Line
  )

  &match=0
  &wild_head=0
  &wild_tail=0
  &clk_input_length=STRING.LENGTH("&clk")
  &clk_itr_length=STRING.LENGTH("apc1_sysleaf_clk")

  if (STRING.SCAN("&clk", "*", 0)==0)
  (
    &wild_head=1
  )
  if (STRING.SCAN("&clk", "*", 1)==(STRING.LENGTH("&clk")-1))
  (
    &wild_tail=1
  )

  if ((&wild_head==1)&&(&wild_tail==1))
  (
    if (STRING.SCAN("apc1_sysleaf_clk", STRING.MID("&clk", 1, &clk_input_length-2), 0)!=-1)
    ( 
      &match=1
    )
  )
  else if (&wild_head==1)
  (
    if (STRING.MID("apc1_sysleaf_clk", &clk_itr_length-&clk_input_length+1, &clk_input_length-1)==STRING.CUT("&clk", 1))
    ( 
      &match=1
    )
  )
  else if (&wild_tail==1)
  (
    if (STRING.MID("apc1_sysleaf_clk", 0, &clk_input_length-1)==STRING.CUT("&clk", -1))
    ( 
      &match=1
    )
  )
  else if ("apc1_sysleaf_clk"=="&clk")||("cpus"=="&clk")
  (
    &match=1
  )
  
  if (&match==1)
  (
    &clk_test=&CLK_TEST_APC1_SYSLEAF_CLK
    &clk_reg=0
    &clk_reg_name="No CBCR"
    &clk_name="apc1_sysleaf_clk"
    &clk_reg_cbcr_type=""
    &clk_vote_bit=-1.
    &clk_multiplier=32.
    &clk_access_mode="&APCS_access_mode"

    gosub Print_Clk_Info_Line
  )

  &match=0
  &wild_head=0
  &wild_tail=0
  &clk_input_length=STRING.LENGTH("&clk")
  &clk_itr_length=STRING.LENGTH("gladiator_sysleaf_clk")

  if (STRING.SCAN("&clk", "*", 0)==0)
  (
    &wild_head=1
  )
  if (STRING.SCAN("&clk", "*", 1)==(STRING.LENGTH("&clk")-1))
  (
    &wild_tail=1
  )

  if ((&wild_head==1)&&(&wild_tail==1))
  (
    if (STRING.SCAN("gladiator_sysleaf_clk", STRING.MID("&clk", 1, &clk_input_length-2), 0)!=-1)
    ( 
      &match=1
    )
  )
  else if (&wild_head==1)
  (
    if (STRING.MID("gladiator_sysleaf_clk", &clk_itr_length-&clk_input_length+1, &clk_input_length-1)==STRING.CUT("&clk", 1))
    ( 
      &match=1
    )
  )
  else if (&wild_tail==1)
  (
    if (STRING.MID("gladiator_sysleaf_clk", 0, &clk_input_length-1)==STRING.CUT("&clk", -1))
    ( 
      &match=1
    )
  )
  else if ("gladiator_sysleaf_clk"=="&clk")
  (
    &match=1
  )
  
  if (&match==1)
  (
    &clk_test=&CLK_TEST_GLADIATOR_SYSLEAF_CLK
    &clk_reg=0
    &clk_reg_name="No CBCR"
    &clk_name="gladiator_sysleaf_clk"
    &clk_reg_cbcr_type=""
    &clk_vote_bit=-1.
    &clk_multiplier=16.
    &clk_access_mode="&APCS_access_mode"

    gosub Print_Clk_Info_Line
  )

  &match=0
  &wild_head=0
  &wild_tail=0
  &clk_input_length=STRING.LENGTH("&clk")
  &clk_itr_length=STRING.LENGTH("sys_apcsqsb_clk")

  if (STRING.SCAN("&clk", "*", 0)==0)
  (
    &wild_head=1
  )
  if (STRING.SCAN("&clk", "*", 1)==(STRING.LENGTH("&clk")-1))
  (
    &wild_tail=1
  )

  if ((&wild_head==1)&&(&wild_tail==1))
  (
    if (STRING.SCAN("sys_apcsqsb_clk", STRING.MID("&clk", 1, &clk_input_length-2), 0)!=-1)
    ( 
      &match=1
    )
  )
  else if (&wild_head==1)
  (
    if (STRING.MID("sys_apcsqsb_clk", &clk_itr_length-&clk_input_length+1, &clk_input_length-1)==STRING.CUT("&clk", 1))
    ( 
      &match=1
    )
  )
  else if (&wild_tail==1)
  (
    if (STRING.MID("sys_apcsqsb_clk", 0, &clk_input_length-1)==STRING.CUT("&clk", -1))
    ( 
      &match=1
    )
  )
  else if ("sys_apcsqsb_clk"=="&clk")
  (
    &match=1
  )
  
  if (&match==1)
  (
    &clk_test=&CLK_TEST_SYS_APCSQSB_CLK
    &clk_reg=0
    &clk_reg_name="No CBCR"
    &clk_name="sys_apcsqsb_clk"
    &clk_reg_cbcr_type=""
    &clk_vote_bit=-1.
    &clk_multiplier=4.
    &clk_access_mode="&APCS_access_mode"

    gosub Print_Clk_Info_Line
  )

  &match=0
  &wild_head=0
  &wild_tail=0
  &clk_input_length=STRING.LENGTH("&clk")
  &clk_itr_length=STRING.LENGTH("im_sleep_clk")

  if (STRING.SCAN("&clk", "*", 0)==0)
  (
    &wild_head=1
  )
  if (STRING.SCAN("&clk", "*", 1)==(STRING.LENGTH("&clk")-1))
  (
    &wild_tail=1
  )

  if ((&wild_head==1)&&(&wild_tail==1))
  (
    if (STRING.SCAN("im_sleep_clk", STRING.MID("&clk", 1, &clk_input_length-2), 0)!=-1)
    ( 
      &match=1
    )
  )
  else if (&wild_head==1)
  (
    if (STRING.MID("im_sleep_clk", &clk_itr_length-&clk_input_length+1, &clk_input_length-1)==STRING.CUT("&clk", 1))
    ( 
      &match=1
    )
  )
  else if (&wild_tail==1)
  (
    if (STRING.MID("im_sleep_clk", 0, &clk_input_length-1)==STRING.CUT("&clk", -1))
    ( 
      &match=1
    )
  )
  else if ("im_sleep_clk"=="&clk")
  (
    &match=1
  )
  
  if (&match==1)
  (
    &clk_test=&CLK_TEST_IM_SLEEP_CLK
    &clk_reg=0
    &clk_reg_name="No CBCR"
    &clk_name="im_sleep_clk"
    &clk_reg_cbcr_type=""
    &clk_vote_bit=-1.
    &clk_multiplier=4.
    &clk_access_mode="&APCS_access_mode"

    gosub Print_Clk_Info_Line
  )

  &match=0
  &wild_head=0
  &wild_tail=0
  &clk_input_length=STRING.LENGTH("&clk")
  &clk_itr_length=STRING.LENGTH("lmh_lite_clk")

  if (STRING.SCAN("&clk", "*", 0)==0)
  (
    &wild_head=1
  )
  if (STRING.SCAN("&clk", "*", 1)==(STRING.LENGTH("&clk")-1))
  (
    &wild_tail=1
  )

  if ((&wild_head==1)&&(&wild_tail==1))
  (
    if (STRING.SCAN("lmh_lite_clk", STRING.MID("&clk", 1, &clk_input_length-2), 0)!=-1)
    ( 
      &match=1
    )
  )
  else if (&wild_head==1)
  (
    if (STRING.MID("lmh_lite_clk", &clk_itr_length-&clk_input_length+1, &clk_input_length-1)==STRING.CUT("&clk", 1))
    ( 
      &match=1
    )
  )
  else if (&wild_tail==1)
  (
    if (STRING.MID("lmh_lite_clk", 0, &clk_input_length-1)==STRING.CUT("&clk", -1))
    ( 
      &match=1
    )
  )
  else if ("lmh_lite_clk"=="&clk")
  (
    &match=1
  )
  
  if (&match==1)
  (
    &clk_test=&CLK_TEST_LMH_LITE_CLK
    &clk_reg=0
    &clk_reg_name="No CBCR"
    &clk_name="lmh_lite_clk"
    &clk_reg_cbcr_type=""
    &clk_vote_bit=-1.
    &clk_multiplier=4.
    &clk_access_mode="&APCS_access_mode"

    gosub Print_Clk_Info_Line
  )

  &match=0
  &wild_head=0
  &wild_tail=0
  &clk_input_length=STRING.LENGTH("&clk")
  &clk_itr_length=STRING.LENGTH("cl0_apcpll_lockdet")

  if (STRING.SCAN("&clk", "*", 0)==0)
  (
    &wild_head=1
  )
  if (STRING.SCAN("&clk", "*", 1)==(STRING.LENGTH("&clk")-1))
  (
    &wild_tail=1
  )

  if ((&wild_head==1)&&(&wild_tail==1))
  (
    if (STRING.SCAN("cl0_apcpll_lockdet", STRING.MID("&clk", 1, &clk_input_length-2), 0)!=-1)
    ( 
      &match=1
    )
  )
  else if (&wild_head==1)
  (
    if (STRING.MID("cl0_apcpll_lockdet", &clk_itr_length-&clk_input_length+1, &clk_input_length-1)==STRING.CUT("&clk", 1))
    ( 
      &match=1
    )
  )
  else if (&wild_tail==1)
  (
    if (STRING.MID("cl0_apcpll_lockdet", 0, &clk_input_length-1)==STRING.CUT("&clk", -1))
    ( 
      &match=1
    )
  )
  else if ("cl0_apcpll_lockdet"=="&clk")
  (
    &match=1
  )
  
  if (&match==1)
  (
    &clk_test=&CLK_TEST_CL0_APCPLL_LOCKDET
    &clk_reg=0
    &clk_reg_name="No CBCR"
    &clk_name="cl0_apcpll_lockdet"
    &clk_reg_cbcr_type=""
    &clk_vote_bit=-1.
    &clk_multiplier=4.
    &clk_access_mode="&APCS_access_mode"

    gosub Print_Clk_Info_Line
  )

  &match=0
  &wild_head=0
  &wild_tail=0
  &clk_input_length=STRING.LENGTH("&clk")
  &clk_itr_length=STRING.LENGTH("cl1_apcpll_lockdet")

  if (STRING.SCAN("&clk", "*", 0)==0)
  (
    &wild_head=1
  )
  if (STRING.SCAN("&clk", "*", 1)==(STRING.LENGTH("&clk")-1))
  (
    &wild_tail=1
  )

  if ((&wild_head==1)&&(&wild_tail==1))
  (
    if (STRING.SCAN("cl1_apcpll_lockdet", STRING.MID("&clk", 1, &clk_input_length-2), 0)!=-1)
    ( 
      &match=1
    )
  )
  else if (&wild_head==1)
  (
    if (STRING.MID("cl1_apcpll_lockdet", &clk_itr_length-&clk_input_length+1, &clk_input_length-1)==STRING.CUT("&clk", 1))
    ( 
      &match=1
    )
  )
  else if (&wild_tail==1)
  (
    if (STRING.MID("cl1_apcpll_lockdet", 0, &clk_input_length-1)==STRING.CUT("&clk", -1))
    ( 
      &match=1
    )
  )
  else if ("cl1_apcpll_lockdet"=="&clk")
  (
    &match=1
  )
  
  if (&match==1)
  (
    &clk_test=&CLK_TEST_CL1_APCPLL_LOCKDET
    &clk_reg=0
    &clk_reg_name="No CBCR"
    &clk_name="cl1_apcpll_lockdet"
    &clk_reg_cbcr_type=""
    &clk_vote_bit=-1.
    &clk_multiplier=4.
    &clk_access_mode="&APCS_access_mode"

    gosub Print_Clk_Info_Line
  )

  &match=0
  &wild_head=0
  &wild_tail=0
  &clk_input_length=STRING.LENGTH("&clk")
  &clk_itr_length=STRING.LENGTH("cci_apcpll_lockdet")

  if (STRING.SCAN("&clk", "*", 0)==0)
  (
    &wild_head=1
  )
  if (STRING.SCAN("&clk", "*", 1)==(STRING.LENGTH("&clk")-1))
  (
    &wild_tail=1
  )

  if ((&wild_head==1)&&(&wild_tail==1))
  (
    if (STRING.SCAN("cci_apcpll_lockdet", STRING.MID("&clk", 1, &clk_input_length-2), 0)!=-1)
    ( 
      &match=1
    )
  )
  else if (&wild_head==1)
  (
    if (STRING.MID("cci_apcpll_lockdet", &clk_itr_length-&clk_input_length+1, &clk_input_length-1)==STRING.CUT("&clk", 1))
    ( 
      &match=1
    )
  )
  else if (&wild_tail==1)
  (
    if (STRING.MID("cci_apcpll_lockdet", 0, &clk_input_length-1)==STRING.CUT("&clk", -1))
    ( 
      &match=1
    )
  )
  else if ("cci_apcpll_lockdet"=="&clk")
  (
    &match=1
  )
  
  if (&match==1)
  (
    &clk_test=&CLK_TEST_CCI_APCPLL_LOCKDET
    &clk_reg=0
    &clk_reg_name="No CBCR"
    &clk_name="cci_apcpll_lockdet"
    &clk_reg_cbcr_type=""
    &clk_vote_bit=-1.
    &clk_multiplier=4.
    &clk_access_mode="&APCS_access_mode"

    gosub Print_Clk_Info_Line
  )

  &match=0
  &wild_head=0
  &wild_tail=0
  &clk_input_length=STRING.LENGTH("&clk")
  &clk_itr_length=STRING.LENGTH("aon_clk_src")

  if (STRING.SCAN("&clk", "*", 0)==0)
  (
    &wild_head=1
  )
  if (STRING.SCAN("&clk", "*", 1)==(STRING.LENGTH("&clk")-1))
  (
    &wild_tail=1
  )

  if ((&wild_head==1)&&(&wild_tail==1))
  (
    if (STRING.SCAN("aon_clk_src", STRING.MID("&clk", 1, &clk_input_length-2), 0)!=-1)
    ( 
      &match=1
    )
  )
  else if (&wild_head==1)
  (
    if (STRING.MID("aon_clk_src", &clk_itr_length-&clk_input_length+1, &clk_input_length-1)==STRING.CUT("&clk", 1))
    ( 
      &match=1
    )
  )
  else if (&wild_tail==1)
  (
    if (STRING.MID("aon_clk_src", 0, &clk_input_length-1)==STRING.CUT("&clk", -1))
    ( 
      &match=1
    )
  )
  else if ("aon_clk_src"=="&clk")
  (
    &match=1
  )
  
  if (&match==1)
  (
    &clk_test=&CLK_TEST_AON_CLK_SRC
    &clk_reg=0
    &clk_reg_name="No CBCR"
    &clk_name="aon_clk_src"
    &clk_reg_cbcr_type=""
    &clk_vote_bit=-1.
    &clk_multiplier=4.
    &clk_access_mode="&CDSP_access_mode"

    gosub Print_Clk_Info_Line
  )

  &match=0
  &wild_head=0
  &wild_tail=0
  &clk_input_length=STRING.LENGTH("&clk")
  &clk_itr_length=STRING.LENGTH("q6ss_ahbm_aon_clk")

  if (STRING.SCAN("&clk", "*", 0)==0)
  (
    &wild_head=1
  )
  if (STRING.SCAN("&clk", "*", 1)==(STRING.LENGTH("&clk")-1))
  (
    &wild_tail=1
  )

  if ((&wild_head==1)&&(&wild_tail==1))
  (
    if (STRING.SCAN("q6ss_ahbm_aon_clk", STRING.MID("&clk", 1, &clk_input_length-2), 0)!=-1)
    ( 
      &match=1
    )
  )
  else if (&wild_head==1)
  (
    if (STRING.MID("q6ss_ahbm_aon_clk", &clk_itr_length-&clk_input_length+1, &clk_input_length-1)==STRING.CUT("&clk", 1))
    ( 
      &match=1
    )
  )
  else if (&wild_tail==1)
  (
    if (STRING.MID("q6ss_ahbm_aon_clk", 0, &clk_input_length-1)==STRING.CUT("&clk", -1))
    ( 
      &match=1
    )
  )
  else if ("q6ss_ahbm_aon_clk"=="&clk")
  (
    &match=1
  )
  
  if (&match==1)
  (
    &clk_test=&CLK_TEST_Q6SS_AHBM_AON_CLK
    &clk_reg=0
    &clk_reg_name="No CBCR"
    &clk_name="q6ss_ahbm_aon_clk"
    &clk_reg_cbcr_type=""
    &clk_vote_bit=-1.
    &clk_multiplier=4.
    &clk_access_mode="&CDSP_access_mode"

    gosub Print_Clk_Info_Line
  )

  &match=0
  &wild_head=0
  &wild_tail=0
  &clk_input_length=STRING.LENGTH("&clk")
  &clk_itr_length=STRING.LENGTH("q6ss_ahbs_aon_clk")

  if (STRING.SCAN("&clk", "*", 0)==0)
  (
    &wild_head=1
  )
  if (STRING.SCAN("&clk", "*", 1)==(STRING.LENGTH("&clk")-1))
  (
    &wild_tail=1
  )

  if ((&wild_head==1)&&(&wild_tail==1))
  (
    if (STRING.SCAN("q6ss_ahbs_aon_clk", STRING.MID("&clk", 1, &clk_input_length-2), 0)!=-1)
    ( 
      &match=1
    )
  )
  else if (&wild_head==1)
  (
    if (STRING.MID("q6ss_ahbs_aon_clk", &clk_itr_length-&clk_input_length+1, &clk_input_length-1)==STRING.CUT("&clk", 1))
    ( 
      &match=1
    )
  )
  else if (&wild_tail==1)
  (
    if (STRING.MID("q6ss_ahbs_aon_clk", 0, &clk_input_length-1)==STRING.CUT("&clk", -1))
    ( 
      &match=1
    )
  )
  else if ("q6ss_ahbs_aon_clk"=="&clk")
  (
    &match=1
  )
  
  if (&match==1)
  (
    &clk_test=&CLK_TEST_Q6SS_AHBS_AON_CLK
    &clk_reg=0
    &clk_reg_name="No CBCR"
    &clk_name="q6ss_ahbs_aon_clk"
    &clk_reg_cbcr_type=""
    &clk_vote_bit=-1.
    &clk_multiplier=4.
    &clk_access_mode="&CDSP_access_mode"

    gosub Print_Clk_Info_Line
  )

  &match=0
  &wild_head=0
  &wild_tail=0
  &clk_input_length=STRING.LENGTH("&clk")
  &clk_itr_length=STRING.LENGTH("turing_wrapper_aon_clk")

  if (STRING.SCAN("&clk", "*", 0)==0)
  (
    &wild_head=1
  )
  if (STRING.SCAN("&clk", "*", 1)==(STRING.LENGTH("&clk")-1))
  (
    &wild_tail=1
  )

  if ((&wild_head==1)&&(&wild_tail==1))
  (
    if (STRING.SCAN("turing_wrapper_aon_clk", STRING.MID("&clk", 1, &clk_input_length-2), 0)!=-1)
    ( 
      &match=1
    )
  )
  else if (&wild_head==1)
  (
    if (STRING.MID("turing_wrapper_aon_clk", &clk_itr_length-&clk_input_length+1, &clk_input_length-1)==STRING.CUT("&clk", 1))
    ( 
      &match=1
    )
  )
  else if (&wild_tail==1)
  (
    if (STRING.MID("turing_wrapper_aon_clk", 0, &clk_input_length-1)==STRING.CUT("&clk", -1))
    ( 
      &match=1
    )
  )
  else if ("turing_wrapper_aon_clk"=="&clk")
  (
    &match=1
  )
  
  if (&match==1)
  (
    &clk_test=&CLK_TEST_TURING_WRAPPER_AON_CLK
    &clk_reg=0
    &clk_reg_name="No CBCR"
    &clk_name="turing_wrapper_aon_clk"
    &clk_reg_cbcr_type=""
    &clk_vote_bit=-1.
    &clk_multiplier=4.
    &clk_access_mode="&CDSP_access_mode"

    gosub Print_Clk_Info_Line
  )

  &match=0
  &wild_head=0
  &wild_tail=0
  &clk_input_length=STRING.LENGTH("&clk")
  &clk_itr_length=STRING.LENGTH("turing_wrapper_bus_timeout_aon_clk")

  if (STRING.SCAN("&clk", "*", 0)==0)
  (
    &wild_head=1
  )
  if (STRING.SCAN("&clk", "*", 1)==(STRING.LENGTH("&clk")-1))
  (
    &wild_tail=1
  )

  if ((&wild_head==1)&&(&wild_tail==1))
  (
    if (STRING.SCAN("turing_wrapper_bus_timeout_aon_clk", STRING.MID("&clk", 1, &clk_input_length-2), 0)!=-1)
    ( 
      &match=1
    )
  )
  else if (&wild_head==1)
  (
    if (STRING.MID("turing_wrapper_bus_timeout_aon_clk", &clk_itr_length-&clk_input_length+1, &clk_input_length-1)==STRING.CUT("&clk", 1))
    ( 
      &match=1
    )
  )
  else if (&wild_tail==1)
  (
    if (STRING.MID("turing_wrapper_bus_timeout_aon_clk", 0, &clk_input_length-1)==STRING.CUT("&clk", -1))
    ( 
      &match=1
    )
  )
  else if ("turing_wrapper_bus_timeout_aon_clk"=="&clk")
  (
    &match=1
  )
  
  if (&match==1)
  (
    &clk_test=&CLK_TEST_TURING_WRAPPER_BUS_TIMEOUT_AON_CLK
    &clk_reg=0
    &clk_reg_name="No CBCR"
    &clk_name="turing_wrapper_bus_timeout_aon_clk"
    &clk_reg_cbcr_type=""
    &clk_vote_bit=-1.
    &clk_multiplier=4.
    &clk_access_mode="&CDSP_access_mode"

    gosub Print_Clk_Info_Line
  )

  &match=0
  &wild_head=0
  &wild_tail=0
  &clk_input_length=STRING.LENGTH("&clk")
  &clk_itr_length=STRING.LENGTH("turing_wrapper_mpu_cfg_aon_clk")

  if (STRING.SCAN("&clk", "*", 0)==0)
  (
    &wild_head=1
  )
  if (STRING.SCAN("&clk", "*", 1)==(STRING.LENGTH("&clk")-1))
  (
    &wild_tail=1
  )

  if ((&wild_head==1)&&(&wild_tail==1))
  (
    if (STRING.SCAN("turing_wrapper_mpu_cfg_aon_clk", STRING.MID("&clk", 1, &clk_input_length-2), 0)!=-1)
    ( 
      &match=1
    )
  )
  else if (&wild_head==1)
  (
    if (STRING.MID("turing_wrapper_mpu_cfg_aon_clk", &clk_itr_length-&clk_input_length+1, &clk_input_length-1)==STRING.CUT("&clk", 1))
    ( 
      &match=1
    )
  )
  else if (&wild_tail==1)
  (
    if (STRING.MID("turing_wrapper_mpu_cfg_aon_clk", 0, &clk_input_length-1)==STRING.CUT("&clk", -1))
    ( 
      &match=1
    )
  )
  else if ("turing_wrapper_mpu_cfg_aon_clk"=="&clk")
  (
    &match=1
  )
  
  if (&match==1)
  (
    &clk_test=&CLK_TEST_TURING_WRAPPER_MPU_CFG_AON_CLK
    &clk_reg=0
    &clk_reg_name="No CBCR"
    &clk_name="turing_wrapper_mpu_cfg_aon_clk"
    &clk_reg_cbcr_type=""
    &clk_vote_bit=-1.
    &clk_multiplier=4.
    &clk_access_mode="&CDSP_access_mode"

    gosub Print_Clk_Info_Line
  )

  &match=0
  &wild_head=0
  &wild_tail=0
  &clk_input_length=STRING.LENGTH("&clk")
  &clk_itr_length=STRING.LENGTH("turing_wrapper_q6_ahbm_mpu_aon_clk")

  if (STRING.SCAN("&clk", "*", 0)==0)
  (
    &wild_head=1
  )
  if (STRING.SCAN("&clk", "*", 1)==(STRING.LENGTH("&clk")-1))
  (
    &wild_tail=1
  )

  if ((&wild_head==1)&&(&wild_tail==1))
  (
    if (STRING.SCAN("turing_wrapper_q6_ahbm_mpu_aon_clk", STRING.MID("&clk", 1, &clk_input_length-2), 0)!=-1)
    ( 
      &match=1
    )
  )
  else if (&wild_head==1)
  (
    if (STRING.MID("turing_wrapper_q6_ahbm_mpu_aon_clk", &clk_itr_length-&clk_input_length+1, &clk_input_length-1)==STRING.CUT("&clk", 1))
    ( 
      &match=1
    )
  )
  else if (&wild_tail==1)
  (
    if (STRING.MID("turing_wrapper_q6_ahbm_mpu_aon_clk", 0, &clk_input_length-1)==STRING.CUT("&clk", -1))
    ( 
      &match=1
    )
  )
  else if ("turing_wrapper_q6_ahbm_mpu_aon_clk"=="&clk")
  (
    &match=1
  )
  
  if (&match==1)
  (
    &clk_test=&CLK_TEST_TURING_WRAPPER_Q6_AHBM_MPU_AON_CLK
    &clk_reg=0
    &clk_reg_name="No CBCR"
    &clk_name="turing_wrapper_q6_ahbm_mpu_aon_clk"
    &clk_reg_cbcr_type=""
    &clk_vote_bit=-1.
    &clk_multiplier=4.
    &clk_access_mode="&CDSP_access_mode"

    gosub Print_Clk_Info_Line
  )

  &match=0
  &wild_head=0
  &wild_tail=0
  &clk_input_length=STRING.LENGTH("&clk")
  &clk_itr_length=STRING.LENGTH("turing_wrapper_qos_ahbs_aon_clk")

  if (STRING.SCAN("&clk", "*", 0)==0)
  (
    &wild_head=1
  )
  if (STRING.SCAN("&clk", "*", 1)==(STRING.LENGTH("&clk")-1))
  (
    &wild_tail=1
  )

  if ((&wild_head==1)&&(&wild_tail==1))
  (
    if (STRING.SCAN("turing_wrapper_qos_ahbs_aon_clk", STRING.MID("&clk", 1, &clk_input_length-2), 0)!=-1)
    ( 
      &match=1
    )
  )
  else if (&wild_head==1)
  (
    if (STRING.MID("turing_wrapper_qos_ahbs_aon_clk", &clk_itr_length-&clk_input_length+1, &clk_input_length-1)==STRING.CUT("&clk", 1))
    ( 
      &match=1
    )
  )
  else if (&wild_tail==1)
  (
    if (STRING.MID("turing_wrapper_qos_ahbs_aon_clk", 0, &clk_input_length-1)==STRING.CUT("&clk", -1))
    ( 
      &match=1
    )
  )
  else if ("turing_wrapper_qos_ahbs_aon_clk"=="&clk")
  (
    &match=1
  )
  
  if (&match==1)
  (
    &clk_test=&CLK_TEST_TURING_WRAPPER_QOS_AHBS_AON_CLK
    &clk_reg=0
    &clk_reg_name="No CBCR"
    &clk_name="turing_wrapper_qos_ahbs_aon_clk"
    &clk_reg_cbcr_type=""
    &clk_vote_bit=-1.
    &clk_multiplier=4.
    &clk_access_mode="&CDSP_access_mode"

    gosub Print_Clk_Info_Line
  )

  &match=0
  &wild_head=0
  &wild_tail=0
  &clk_input_length=STRING.LENGTH("&clk")
  &clk_itr_length=STRING.LENGTH("turing_wrapper_sysnoc_sway_aon_clk")

  if (STRING.SCAN("&clk", "*", 0)==0)
  (
    &wild_head=1
  )
  if (STRING.SCAN("&clk", "*", 1)==(STRING.LENGTH("&clk")-1))
  (
    &wild_tail=1
  )

  if ((&wild_head==1)&&(&wild_tail==1))
  (
    if (STRING.SCAN("turing_wrapper_sysnoc_sway_aon_clk", STRING.MID("&clk", 1, &clk_input_length-2), 0)!=-1)
    ( 
      &match=1
    )
  )
  else if (&wild_head==1)
  (
    if (STRING.MID("turing_wrapper_sysnoc_sway_aon_clk", &clk_itr_length-&clk_input_length+1, &clk_input_length-1)==STRING.CUT("&clk", 1))
    ( 
      &match=1
    )
  )
  else if (&wild_tail==1)
  (
    if (STRING.MID("turing_wrapper_sysnoc_sway_aon_clk", 0, &clk_input_length-1)==STRING.CUT("&clk", -1))
    ( 
      &match=1
    )
  )
  else if ("turing_wrapper_sysnoc_sway_aon_clk"=="&clk")
  (
    &match=1
  )
  
  if (&match==1)
  (
    &clk_test=&CLK_TEST_TURING_WRAPPER_SYSNOC_SWAY_AON_CLK
    &clk_reg=0
    &clk_reg_name="No CBCR"
    &clk_name="turing_wrapper_sysnoc_sway_aon_clk"
    &clk_reg_cbcr_type=""
    &clk_vote_bit=-1.
    &clk_multiplier=4.
    &clk_access_mode="&CDSP_access_mode"

    gosub Print_Clk_Info_Line
  )

  &match=0
  &wild_head=0
  &wild_tail=0
  &clk_input_length=STRING.LENGTH("&clk")
  &clk_itr_length=STRING.LENGTH("q6ss_q6_axim_clk")

  if (STRING.SCAN("&clk", "*", 0)==0)
  (
    &wild_head=1
  )
  if (STRING.SCAN("&clk", "*", 1)==(STRING.LENGTH("&clk")-1))
  (
    &wild_tail=1
  )

  if ((&wild_head==1)&&(&wild_tail==1))
  (
    if (STRING.SCAN("q6ss_q6_axim_clk", STRING.MID("&clk", 1, &clk_input_length-2), 0)!=-1)
    ( 
      &match=1
    )
  )
  else if (&wild_head==1)
  (
    if (STRING.MID("q6ss_q6_axim_clk", &clk_itr_length-&clk_input_length+1, &clk_input_length-1)==STRING.CUT("&clk", 1))
    ( 
      &match=1
    )
  )
  else if (&wild_tail==1)
  (
    if (STRING.MID("q6ss_q6_axim_clk", 0, &clk_input_length-1)==STRING.CUT("&clk", -1))
    ( 
      &match=1
    )
  )
  else if ("q6ss_q6_axim_clk"=="&clk")
  (
    &match=1
  )
  
  if (&match==1)
  (
    &clk_test=0
    &clk_reg=0
    &clk_reg_name="No CBCR"
    &clk_name="q6ss_q6_axim_clk"
    &clk_reg_cbcr_type=""
    &clk_vote_bit=-1.
    &clk_multiplier=4.
    &clk_access_mode="&CDSP_access_mode"

    gosub Print_Clk_Info_Line
  )

  &match=0
  &wild_head=0
  &wild_tail=0
  &clk_input_length=STRING.LENGTH("&clk")
  &clk_itr_length=STRING.LENGTH("turing_wrapper_q6_smmu_axi_clk")

  if (STRING.SCAN("&clk", "*", 0)==0)
  (
    &wild_head=1
  )
  if (STRING.SCAN("&clk", "*", 1)==(STRING.LENGTH("&clk")-1))
  (
    &wild_tail=1
  )

  if ((&wild_head==1)&&(&wild_tail==1))
  (
    if (STRING.SCAN("turing_wrapper_q6_smmu_axi_clk", STRING.MID("&clk", 1, &clk_input_length-2), 0)!=-1)
    ( 
      &match=1
    )
  )
  else if (&wild_head==1)
  (
    if (STRING.MID("turing_wrapper_q6_smmu_axi_clk", &clk_itr_length-&clk_input_length+1, &clk_input_length-1)==STRING.CUT("&clk", 1))
    ( 
      &match=1
    )
  )
  else if (&wild_tail==1)
  (
    if (STRING.MID("turing_wrapper_q6_smmu_axi_clk", 0, &clk_input_length-1)==STRING.CUT("&clk", -1))
    ( 
      &match=1
    )
  )
  else if ("turing_wrapper_q6_smmu_axi_clk"=="&clk")
  (
    &match=1
  )
  
  if (&match==1)
  (
    &clk_test=0
    &clk_reg=0
    &clk_reg_name="No CBCR"
    &clk_name="turing_wrapper_q6_smmu_axi_clk"
    &clk_reg_cbcr_type=""
    &clk_vote_bit=-1.
    &clk_multiplier=4.
    &clk_access_mode="&CDSP_access_mode"

    gosub Print_Clk_Info_Line
  )

  &match=0
  &wild_head=0
  &wild_tail=0
  &clk_input_length=STRING.LENGTH("&clk")
  &clk_itr_length=STRING.LENGTH("turing_wrapper_q6_smmu_cfg_cnoc_clk")

  if (STRING.SCAN("&clk", "*", 0)==0)
  (
    &wild_head=1
  )
  if (STRING.SCAN("&clk", "*", 1)==(STRING.LENGTH("&clk")-1))
  (
    &wild_tail=1
  )

  if ((&wild_head==1)&&(&wild_tail==1))
  (
    if (STRING.SCAN("turing_wrapper_q6_smmu_cfg_cnoc_clk", STRING.MID("&clk", 1, &clk_input_length-2), 0)!=-1)
    ( 
      &match=1
    )
  )
  else if (&wild_head==1)
  (
    if (STRING.MID("turing_wrapper_q6_smmu_cfg_cnoc_clk", &clk_itr_length-&clk_input_length+1, &clk_input_length-1)==STRING.CUT("&clk", 1))
    ( 
      &match=1
    )
  )
  else if (&wild_tail==1)
  (
    if (STRING.MID("turing_wrapper_q6_smmu_cfg_cnoc_clk", 0, &clk_input_length-1)==STRING.CUT("&clk", -1))
    ( 
      &match=1
    )
  )
  else if ("turing_wrapper_q6_smmu_cfg_cnoc_clk"=="&clk")
  (
    &match=1
  )
  
  if (&match==1)
  (
    &clk_test=0
    &clk_reg=0
    &clk_reg_name="No CBCR"
    &clk_name="turing_wrapper_q6_smmu_cfg_cnoc_clk"
    &clk_reg_cbcr_type=""
    &clk_vote_bit=-1.
    &clk_multiplier=4.
    &clk_access_mode="&CDSP_access_mode"

    gosub Print_Clk_Info_Line
  )

  &match=0
  &wild_head=0
  &wild_tail=0
  &clk_input_length=STRING.LENGTH("&clk")
  &clk_itr_length=STRING.LENGTH("turing_wrapper_sysnoc_sway_snoc_clk")

  if (STRING.SCAN("&clk", "*", 0)==0)
  (
    &wild_head=1
  )
  if (STRING.SCAN("&clk", "*", 1)==(STRING.LENGTH("&clk")-1))
  (
    &wild_tail=1
  )

  if ((&wild_head==1)&&(&wild_tail==1))
  (
    if (STRING.SCAN("turing_wrapper_sysnoc_sway_snoc_clk", STRING.MID("&clk", 1, &clk_input_length-2), 0)!=-1)
    ( 
      &match=1
    )
  )
  else if (&wild_head==1)
  (
    if (STRING.MID("turing_wrapper_sysnoc_sway_snoc_clk", &clk_itr_length-&clk_input_length+1, &clk_input_length-1)==STRING.CUT("&clk", 1))
    ( 
      &match=1
    )
  )
  else if (&wild_tail==1)
  (
    if (STRING.MID("turing_wrapper_sysnoc_sway_snoc_clk", 0, &clk_input_length-1)==STRING.CUT("&clk", -1))
    ( 
      &match=1
    )
  )
  else if ("turing_wrapper_sysnoc_sway_snoc_clk"=="&clk")
  (
    &match=1
  )
  
  if (&match==1)
  (
    &clk_test=&CLK_TEST_TURING_WRAPPER_SYSNOC_SWAY_SNOC_CLK
    &clk_reg=0
    &clk_reg_name="No CBCR"
    &clk_name="turing_wrapper_sysnoc_sway_snoc_clk"
    &clk_reg_cbcr_type=""
    &clk_vote_bit=-1.
    &clk_multiplier=4.
    &clk_access_mode="&CDSP_access_mode"

    gosub Print_Clk_Info_Line
  )

  &match=0
  &wild_head=0
  &wild_tail=0
  &clk_input_length=STRING.LENGTH("&clk")
  &clk_itr_length=STRING.LENGTH("q6ss_q6_camss_dsp_streaming_0_clk")

  if (STRING.SCAN("&clk", "*", 0)==0)
  (
    &wild_head=1
  )
  if (STRING.SCAN("&clk", "*", 1)==(STRING.LENGTH("&clk")-1))
  (
    &wild_tail=1
  )

  if ((&wild_head==1)&&(&wild_tail==1))
  (
    if (STRING.SCAN("q6ss_q6_camss_dsp_streaming_0_clk", STRING.MID("&clk", 1, &clk_input_length-2), 0)!=-1)
    ( 
      &match=1
    )
  )
  else if (&wild_head==1)
  (
    if (STRING.MID("q6ss_q6_camss_dsp_streaming_0_clk", &clk_itr_length-&clk_input_length+1, &clk_input_length-1)==STRING.CUT("&clk", 1))
    ( 
      &match=1
    )
  )
  else if (&wild_tail==1)
  (
    if (STRING.MID("q6ss_q6_camss_dsp_streaming_0_clk", 0, &clk_input_length-1)==STRING.CUT("&clk", -1))
    ( 
      &match=1
    )
  )
  else if ("q6ss_q6_camss_dsp_streaming_0_clk"=="&clk")
  (
    &match=1
  )
  
  if (&match==1)
  (
    &clk_test=0
    &clk_reg=0
    &clk_reg_name="No CBCR"
    &clk_name="q6ss_q6_camss_dsp_streaming_0_clk"
    &clk_reg_cbcr_type=""
    &clk_vote_bit=-1.
    &clk_multiplier=4.
    &clk_access_mode="&CDSP_access_mode"

    gosub Print_Clk_Info_Line
  )

  &match=0
  &wild_head=0
  &wild_tail=0
  &clk_input_length=STRING.LENGTH("&clk")
  &clk_itr_length=STRING.LENGTH("q6ss_q6_camss_dsp_streaming_1_clk")

  if (STRING.SCAN("&clk", "*", 0)==0)
  (
    &wild_head=1
  )
  if (STRING.SCAN("&clk", "*", 1)==(STRING.LENGTH("&clk")-1))
  (
    &wild_tail=1
  )

  if ((&wild_head==1)&&(&wild_tail==1))
  (
    if (STRING.SCAN("q6ss_q6_camss_dsp_streaming_1_clk", STRING.MID("&clk", 1, &clk_input_length-2), 0)!=-1)
    ( 
      &match=1
    )
  )
  else if (&wild_head==1)
  (
    if (STRING.MID("q6ss_q6_camss_dsp_streaming_1_clk", &clk_itr_length-&clk_input_length+1, &clk_input_length-1)==STRING.CUT("&clk", 1))
    ( 
      &match=1
    )
  )
  else if (&wild_tail==1)
  (
    if (STRING.MID("q6ss_q6_camss_dsp_streaming_1_clk", 0, &clk_input_length-1)==STRING.CUT("&clk", -1))
    ( 
      &match=1
    )
  )
  else if ("q6ss_q6_camss_dsp_streaming_1_clk"=="&clk")
  (
    &match=1
  )
  
  if (&match==1)
  (
    &clk_test=0
    &clk_reg=0
    &clk_reg_name="No CBCR"
    &clk_name="q6ss_q6_camss_dsp_streaming_1_clk"
    &clk_reg_cbcr_type=""
    &clk_vote_bit=-1.
    &clk_multiplier=4.
    &clk_access_mode="&CDSP_access_mode"

    gosub Print_Clk_Info_Line
  )

  &match=0
  &wild_head=0
  &wild_tail=0
  &clk_input_length=STRING.LENGTH("&clk")
  &clk_itr_length=STRING.LENGTH("qos_fixed_lat_counter_src")

  if (STRING.SCAN("&clk", "*", 0)==0)
  (
    &wild_head=1
  )
  if (STRING.SCAN("&clk", "*", 1)==(STRING.LENGTH("&clk")-1))
  (
    &wild_tail=1
  )

  if ((&wild_head==1)&&(&wild_tail==1))
  (
    if (STRING.SCAN("qos_fixed_lat_counter_src", STRING.MID("&clk", 1, &clk_input_length-2), 0)!=-1)
    ( 
      &match=1
    )
  )
  else if (&wild_head==1)
  (
    if (STRING.MID("qos_fixed_lat_counter_src", &clk_itr_length-&clk_input_length+1, &clk_input_length-1)==STRING.CUT("&clk", 1))
    ( 
      &match=1
    )
  )
  else if (&wild_tail==1)
  (
    if (STRING.MID("qos_fixed_lat_counter_src", 0, &clk_input_length-1)==STRING.CUT("&clk", -1))
    ( 
      &match=1
    )
  )
  else if ("qos_fixed_lat_counter_src"=="&clk")
  (
    &match=1
  )
  
  if (&match==1)
  (
    &clk_test=&CLK_TEST_QOS_FIXED_LAT_COUNTER_SRC
    &clk_reg=0
    &clk_reg_name="No CBCR"
    &clk_name="qos_fixed_lat_counter_src"
    &clk_reg_cbcr_type=""
    &clk_vote_bit=-1.
    &clk_multiplier=4.
    &clk_access_mode="&CDSP_access_mode"

    gosub Print_Clk_Info_Line
  )

  &match=0
  &wild_head=0
  &wild_tail=0
  &clk_input_length=STRING.LENGTH("&clk")
  &clk_itr_length=STRING.LENGTH("turing_wrapper_qos_danger_fixed_lat_counter_clk")

  if (STRING.SCAN("&clk", "*", 0)==0)
  (
    &wild_head=1
  )
  if (STRING.SCAN("&clk", "*", 1)==(STRING.LENGTH("&clk")-1))
  (
    &wild_tail=1
  )

  if ((&wild_head==1)&&(&wild_tail==1))
  (
    if (STRING.SCAN("turing_wrapper_qos_danger_fixed_lat_counter_clk", STRING.MID("&clk", 1, &clk_input_length-2), 0)!=-1)
    ( 
      &match=1
    )
  )
  else if (&wild_head==1)
  (
    if (STRING.MID("turing_wrapper_qos_danger_fixed_lat_counter_clk", &clk_itr_length-&clk_input_length+1, &clk_input_length-1)==STRING.CUT("&clk", 1))
    ( 
      &match=1
    )
  )
  else if (&wild_tail==1)
  (
    if (STRING.MID("turing_wrapper_qos_danger_fixed_lat_counter_clk", 0, &clk_input_length-1)==STRING.CUT("&clk", -1))
    ( 
      &match=1
    )
  )
  else if ("turing_wrapper_qos_danger_fixed_lat_counter_clk"=="&clk")
  (
    &match=1
  )
  
  if (&match==1)
  (
    &clk_test=&CLK_TEST_TURING_WRAPPER_QOS_DANGER_FIXED_LAT_COUNTER_CLK
    &clk_reg=0
    &clk_reg_name="No CBCR"
    &clk_name="turing_wrapper_qos_danger_fixed_lat_counter_clk"
    &clk_reg_cbcr_type=""
    &clk_vote_bit=-1.
    &clk_multiplier=4.
    &clk_access_mode="&CDSP_access_mode"

    gosub Print_Clk_Info_Line
  )

  &match=0
  &wild_head=0
  &wild_tail=0
  &clk_input_length=STRING.LENGTH("&clk")
  &clk_itr_length=STRING.LENGTH("turing_wrapper_qos_dmonitor_fixed_lat_counter_clk")

  if (STRING.SCAN("&clk", "*", 0)==0)
  (
    &wild_head=1
  )
  if (STRING.SCAN("&clk", "*", 1)==(STRING.LENGTH("&clk")-1))
  (
    &wild_tail=1
  )

  if ((&wild_head==1)&&(&wild_tail==1))
  (
    if (STRING.SCAN("turing_wrapper_qos_dmonitor_fixed_lat_counter_clk", STRING.MID("&clk", 1, &clk_input_length-2), 0)!=-1)
    ( 
      &match=1
    )
  )
  else if (&wild_head==1)
  (
    if (STRING.MID("turing_wrapper_qos_dmonitor_fixed_lat_counter_clk", &clk_itr_length-&clk_input_length+1, &clk_input_length-1)==STRING.CUT("&clk", 1))
    ( 
      &match=1
    )
  )
  else if (&wild_tail==1)
  (
    if (STRING.MID("turing_wrapper_qos_dmonitor_fixed_lat_counter_clk", 0, &clk_input_length-1)==STRING.CUT("&clk", -1))
    ( 
      &match=1
    )
  )
  else if ("turing_wrapper_qos_dmonitor_fixed_lat_counter_clk"=="&clk")
  (
    &match=1
  )
  
  if (&match==1)
  (
    &clk_test=&CLK_TEST_TURING_WRAPPER_QOS_DMONITOR_FIXED_LAT_COUNTER_CLK
    &clk_reg=0
    &clk_reg_name="No CBCR"
    &clk_name="turing_wrapper_qos_dmonitor_fixed_lat_counter_clk"
    &clk_reg_cbcr_type=""
    &clk_vote_bit=-1.
    &clk_multiplier=4.
    &clk_access_mode="&CDSP_access_mode"

    gosub Print_Clk_Info_Line
  )

  &match=0
  &wild_head=0
  &wild_tail=0
  &clk_input_length=STRING.LENGTH("&clk")
  &clk_itr_length=STRING.LENGTH("sleep_clk_src")

  if (STRING.SCAN("&clk", "*", 0)==0)
  (
    &wild_head=1
  )
  if (STRING.SCAN("&clk", "*", 1)==(STRING.LENGTH("&clk")-1))
  (
    &wild_tail=1
  )

  if ((&wild_head==1)&&(&wild_tail==1))
  (
    if (STRING.SCAN("sleep_clk_src", STRING.MID("&clk", 1, &clk_input_length-2), 0)!=-1)
    ( 
      &match=1
    )
  )
  else if (&wild_head==1)
  (
    if (STRING.MID("sleep_clk_src", &clk_itr_length-&clk_input_length+1, &clk_input_length-1)==STRING.CUT("&clk", 1))
    ( 
      &match=1
    )
  )
  else if (&wild_tail==1)
  (
    if (STRING.MID("sleep_clk_src", 0, &clk_input_length-1)==STRING.CUT("&clk", -1))
    ( 
      &match=1
    )
  )
  else if ("sleep_clk_src"=="&clk")
  (
    &match=1
  )
  
  if (&match==1)
  (
    &clk_test=&CLK_TEST_SLEEP_CLK_SRC
    &clk_reg=0
    &clk_reg_name="No CBCR"
    &clk_name="sleep_clk_src"
    &clk_reg_cbcr_type=""
    &clk_vote_bit=-1.
    &clk_multiplier=4.
    &clk_access_mode="&CDSP_access_mode"

    gosub Print_Clk_Info_Line
  )

  &match=0
  &wild_head=0
  &wild_tail=0
  &clk_input_length=STRING.LENGTH("&clk")
  &clk_itr_length=STRING.LENGTH("q6ss_slp_clk")

  if (STRING.SCAN("&clk", "*", 0)==0)
  (
    &wild_head=1
  )
  if (STRING.SCAN("&clk", "*", 1)==(STRING.LENGTH("&clk")-1))
  (
    &wild_tail=1
  )

  if ((&wild_head==1)&&(&wild_tail==1))
  (
    if (STRING.SCAN("q6ss_slp_clk", STRING.MID("&clk", 1, &clk_input_length-2), 0)!=-1)
    ( 
      &match=1
    )
  )
  else if (&wild_head==1)
  (
    if (STRING.MID("q6ss_slp_clk", &clk_itr_length-&clk_input_length+1, &clk_input_length-1)==STRING.CUT("&clk", 1))
    ( 
      &match=1
    )
  )
  else if (&wild_tail==1)
  (
    if (STRING.MID("q6ss_slp_clk", 0, &clk_input_length-1)==STRING.CUT("&clk", -1))
    ( 
      &match=1
    )
  )
  else if ("q6ss_slp_clk"=="&clk")
  (
    &match=1
  )
  
  if (&match==1)
  (
    &clk_test=0
    &clk_reg=0
    &clk_reg_name="No CBCR"
    &clk_name="q6ss_slp_clk"
    &clk_reg_cbcr_type=""
    &clk_vote_bit=-1.
    &clk_multiplier=4.
    &clk_access_mode="&CDSP_access_mode"

    gosub Print_Clk_Info_Line
  )

  &match=0
  &wild_head=0
  &wild_tail=0
  &clk_input_length=STRING.LENGTH("&clk")
  &clk_itr_length=STRING.LENGTH("xo_clk_src")

  if (STRING.SCAN("&clk", "*", 0)==0)
  (
    &wild_head=1
  )
  if (STRING.SCAN("&clk", "*", 1)==(STRING.LENGTH("&clk")-1))
  (
    &wild_tail=1
  )

  if ((&wild_head==1)&&(&wild_tail==1))
  (
    if (STRING.SCAN("xo_clk_src", STRING.MID("&clk", 1, &clk_input_length-2), 0)!=-1)
    ( 
      &match=1
    )
  )
  else if (&wild_head==1)
  (
    if (STRING.MID("xo_clk_src", &clk_itr_length-&clk_input_length+1, &clk_input_length-1)==STRING.CUT("&clk", 1))
    ( 
      &match=1
    )
  )
  else if (&wild_tail==1)
  (
    if (STRING.MID("xo_clk_src", 0, &clk_input_length-1)==STRING.CUT("&clk", -1))
    ( 
      &match=1
    )
  )
  else if ("xo_clk_src"=="&clk")
  (
    &match=1
  )
  
  if (&match==1)
  (
    &clk_test=&CLK_TEST_XO_CLK_SRC
    &clk_reg=0
    &clk_reg_name="No CBCR"
    &clk_name="xo_clk_src"
    &clk_reg_cbcr_type=""
    &clk_vote_bit=-1.
    &clk_multiplier=4.
    &clk_access_mode="&CDSP_access_mode"

    gosub Print_Clk_Info_Line
  )

  &match=0
  &wild_head=0
  &wild_tail=0
  &clk_input_length=STRING.LENGTH("&clk")
  &clk_itr_length=STRING.LENGTH("audio_core_gdsc_xo_clk")

  if (STRING.SCAN("&clk", "*", 0)==0)
  (
    &wild_head=1
  )
  if (STRING.SCAN("&clk", "*", 1)==(STRING.LENGTH("&clk")-1))
  (
    &wild_tail=1
  )

  if ((&wild_head==1)&&(&wild_tail==1))
  (
    if (STRING.SCAN("audio_core_gdsc_xo_clk", STRING.MID("&clk", 1, &clk_input_length-2), 0)!=-1)
    ( 
      &match=1
    )
  )
  else if (&wild_head==1)
  (
    if (STRING.MID("audio_core_gdsc_xo_clk", &clk_itr_length-&clk_input_length+1, &clk_input_length-1)==STRING.CUT("&clk", 1))
    ( 
      &match=1
    )
  )
  else if (&wild_tail==1)
  (
    if (STRING.MID("audio_core_gdsc_xo_clk", 0, &clk_input_length-1)==STRING.CUT("&clk", -1))
    ( 
      &match=1
    )
  )
  else if ("audio_core_gdsc_xo_clk"=="&clk")
  (
    &match=1
  )
  
  if (&match==1)
  (
    &clk_test=&CLK_TEST_AUDIO_CORE_GDSC_XO_CLK
    &clk_reg=0
    &clk_reg_name="No CBCR"
    &clk_name="audio_core_gdsc_xo_clk"
    &clk_reg_cbcr_type=""
    &clk_vote_bit=-1.
    &clk_multiplier=4.
    &clk_access_mode="&CDSP_access_mode"

    gosub Print_Clk_Info_Line
  )

  &match=0
  &wild_head=0
  &wild_tail=0
  &clk_input_length=STRING.LENGTH("&clk")
  &clk_itr_length=STRING.LENGTH("q6ss_xo_clk")

  if (STRING.SCAN("&clk", "*", 0)==0)
  (
    &wild_head=1
  )
  if (STRING.SCAN("&clk", "*", 1)==(STRING.LENGTH("&clk")-1))
  (
    &wild_tail=1
  )

  if ((&wild_head==1)&&(&wild_tail==1))
  (
    if (STRING.SCAN("q6ss_xo_clk", STRING.MID("&clk", 1, &clk_input_length-2), 0)!=-1)
    ( 
      &match=1
    )
  )
  else if (&wild_head==1)
  (
    if (STRING.MID("q6ss_xo_clk", &clk_itr_length-&clk_input_length+1, &clk_input_length-1)==STRING.CUT("&clk", 1))
    ( 
      &match=1
    )
  )
  else if (&wild_tail==1)
  (
    if (STRING.MID("q6ss_xo_clk", 0, &clk_input_length-1)==STRING.CUT("&clk", -1))
    ( 
      &match=1
    )
  )
  else if ("q6ss_xo_clk"=="&clk")
  (
    &match=1
  )
  
  if (&match==1)
  (
    &clk_test=0
    &clk_reg=0
    &clk_reg_name="No CBCR"
    &clk_name="q6ss_xo_clk"
    &clk_reg_cbcr_type=""
    &clk_vote_bit=-1.
    &clk_multiplier=4.
    &clk_access_mode="&CDSP_access_mode"

    gosub Print_Clk_Info_Line
  )

  &match=0
  &wild_head=0
  &wild_tail=0
  &clk_input_length=STRING.LENGTH("&clk")
  &clk_itr_length=STRING.LENGTH("turing_wrapper_q6_smmu_gdsc_xo_clk")

  if (STRING.SCAN("&clk", "*", 0)==0)
  (
    &wild_head=1
  )
  if (STRING.SCAN("&clk", "*", 1)==(STRING.LENGTH("&clk")-1))
  (
    &wild_tail=1
  )

  if ((&wild_head==1)&&(&wild_tail==1))
  (
    if (STRING.SCAN("turing_wrapper_q6_smmu_gdsc_xo_clk", STRING.MID("&clk", 1, &clk_input_length-2), 0)!=-1)
    ( 
      &match=1
    )
  )
  else if (&wild_head==1)
  (
    if (STRING.MID("turing_wrapper_q6_smmu_gdsc_xo_clk", &clk_itr_length-&clk_input_length+1, &clk_input_length-1)==STRING.CUT("&clk", 1))
    ( 
      &match=1
    )
  )
  else if (&wild_tail==1)
  (
    if (STRING.MID("turing_wrapper_q6_smmu_gdsc_xo_clk", 0, &clk_input_length-1)==STRING.CUT("&clk", -1))
    ( 
      &match=1
    )
  )
  else if ("turing_wrapper_q6_smmu_gdsc_xo_clk"=="&clk")
  (
    &match=1
  )
  
  if (&match==1)
  (
    &clk_test=&CLK_TEST_TURING_WRAPPER_Q6_SMMU_GDSC_XO_CLK
    &clk_reg=0
    &clk_reg_name="No CBCR"
    &clk_name="turing_wrapper_q6_smmu_gdsc_xo_clk"
    &clk_reg_cbcr_type=""
    &clk_vote_bit=-1.
    &clk_multiplier=4.
    &clk_access_mode="&CDSP_access_mode"

    gosub Print_Clk_Info_Line
  )

  &match=0
  &wild_head=0
  &wild_tail=0
  &clk_input_length=STRING.LENGTH("&clk")
  &clk_itr_length=STRING.LENGTH("turing_wrapper_qos_xo_lat_counter_clk")

  if (STRING.SCAN("&clk", "*", 0)==0)
  (
    &wild_head=1
  )
  if (STRING.SCAN("&clk", "*", 1)==(STRING.LENGTH("&clk")-1))
  (
    &wild_tail=1
  )

  if ((&wild_head==1)&&(&wild_tail==1))
  (
    if (STRING.SCAN("turing_wrapper_qos_xo_lat_counter_clk", STRING.MID("&clk", 1, &clk_input_length-2), 0)!=-1)
    ( 
      &match=1
    )
  )
  else if (&wild_head==1)
  (
    if (STRING.MID("turing_wrapper_qos_xo_lat_counter_clk", &clk_itr_length-&clk_input_length+1, &clk_input_length-1)==STRING.CUT("&clk", 1))
    ( 
      &match=1
    )
  )
  else if (&wild_tail==1)
  (
    if (STRING.MID("turing_wrapper_qos_xo_lat_counter_clk", 0, &clk_input_length-1)==STRING.CUT("&clk", -1))
    ( 
      &match=1
    )
  )
  else if ("turing_wrapper_qos_xo_lat_counter_clk"=="&clk")
  (
    &match=1
  )
  
  if (&match==1)
  (
    &clk_test=&CLK_TEST_TURING_WRAPPER_QOS_XO_LAT_COUNTER_CLK
    &clk_reg=0
    &clk_reg_name="No CBCR"
    &clk_name="turing_wrapper_qos_xo_lat_counter_clk"
    &clk_reg_cbcr_type=""
    &clk_vote_bit=-1.
    &clk_multiplier=4.
    &clk_access_mode="&CDSP_access_mode"

    gosub Print_Clk_Info_Line
  )

  &match=0
  &wild_head=0
  &wild_tail=0
  &clk_input_length=STRING.LENGTH("&clk")
  &clk_itr_length=STRING.LENGTH("ddrss_ch0_mc_clk")

  if (STRING.SCAN("&clk", "*", 0)==0)
  (
    &wild_head=1
  )
  if (STRING.SCAN("&clk", "*", 1)==(STRING.LENGTH("&clk")-1))
  (
    &wild_tail=1
  )

  if ((&wild_head==1)&&(&wild_tail==1))
  (
    if (STRING.SCAN("ddrss_ch0_mc_clk", STRING.MID("&clk", 1, &clk_input_length-2), 0)!=-1)
    ( 
      &match=1
    )
  )
  else if (&wild_head==1)
  (
    if (STRING.MID("ddrss_ch0_mc_clk", &clk_itr_length-&clk_input_length+1, &clk_input_length-1)==STRING.CUT("&clk", 1))
    ( 
      &match=1
    )
  )
  else if (&wild_tail==1)
  (
    if (STRING.MID("ddrss_ch0_mc_clk", 0, &clk_input_length-1)==STRING.CUT("&clk", -1))
    ( 
      &match=1
    )
  )
  else if ("ddrss_ch0_mc_clk"=="&clk")
  (
    &match=1
  )
  
  if (&match==1)
  (
    &clk_test=&CLK_TEST_DDRSS_CH0_MC_CLK
    &clk_reg=0
    &clk_reg_name="No CBCR"
    &clk_name="ddrss_ch0_mc_clk"
    &clk_reg_cbcr_type=""
    &clk_vote_bit=-1.
    &clk_multiplier=4.
    &clk_access_mode="&DDRSS_access_mode"

    gosub Print_Clk_Info_Line
  )

  &match=0
  &wild_head=0
  &wild_tail=0
  &clk_input_length=STRING.LENGTH("&clk")
  &clk_itr_length=STRING.LENGTH("ddrss_ch1_mc_clk")

  if (STRING.SCAN("&clk", "*", 0)==0)
  (
    &wild_head=1
  )
  if (STRING.SCAN("&clk", "*", 1)==(STRING.LENGTH("&clk")-1))
  (
    &wild_tail=1
  )

  if ((&wild_head==1)&&(&wild_tail==1))
  (
    if (STRING.SCAN("ddrss_ch1_mc_clk", STRING.MID("&clk", 1, &clk_input_length-2), 0)!=-1)
    ( 
      &match=1
    )
  )
  else if (&wild_head==1)
  (
    if (STRING.MID("ddrss_ch1_mc_clk", &clk_itr_length-&clk_input_length+1, &clk_input_length-1)==STRING.CUT("&clk", 1))
    ( 
      &match=1
    )
  )
  else if (&wild_tail==1)
  (
    if (STRING.MID("ddrss_ch1_mc_clk", 0, &clk_input_length-1)==STRING.CUT("&clk", -1))
    ( 
      &match=1
    )
  )
  else if ("ddrss_ch1_mc_clk"=="&clk")
  (
    &match=1
  )
  
  if (&match==1)
  (
    &clk_test=&CLK_TEST_DDRSS_CH1_MC_CLK
    &clk_reg=0
    &clk_reg_name="No CBCR"
    &clk_name="ddrss_ch1_mc_clk"
    &clk_reg_cbcr_type=""
    &clk_vote_bit=-1.
    &clk_multiplier=4.
    &clk_access_mode="&DDRSS_access_mode"

    gosub Print_Clk_Info_Line
  )

  &match=0
  &wild_head=0
  &wild_tail=0
  &clk_input_length=STRING.LENGTH("&clk")
  &clk_itr_length=STRING.LENGTH("gcc_sec_ctrl_acc_clk")

  if (STRING.SCAN("&clk", "*", 0)==0)
  (
    &wild_head=1
  )
  if (STRING.SCAN("&clk", "*", 1)==(STRING.LENGTH("&clk")-1))
  (
    &wild_tail=1
  )

  if ((&wild_head==1)&&(&wild_tail==1))
  (
    if (STRING.SCAN("gcc_sec_ctrl_acc_clk", STRING.MID("&clk", 1, &clk_input_length-2), 0)!=-1)
    ( 
      &match=1
    )
  )
  else if (&wild_head==1)
  (
    if (STRING.MID("gcc_sec_ctrl_acc_clk", &clk_itr_length-&clk_input_length+1, &clk_input_length-1)==STRING.CUT("&clk", 1))
    ( 
      &match=1
    )
  )
  else if (&wild_tail==1)
  (
    if (STRING.MID("gcc_sec_ctrl_acc_clk", 0, &clk_input_length-1)==STRING.CUT("&clk", -1))
    ( 
      &match=1
    )
  )
  else if ("gcc_sec_ctrl_acc_clk"=="&clk")
  (
    &match=1
  )
  
  if (&match==1)
  (
    &clk_test=&CLK_TEST_GCC_SEC_CTRL_ACC_CLK
    &clk_reg=&HWIO_GCC_SEC_CTRL_ACC_CBCR_ADDR
    &clk_reg_name="GCC_SEC_CTRL_ACC_CBCR"
    &clk_name="gcc_sec_ctrl_acc_clk"
    &clk_reg_cbcr_type="sm_pscbc"
    &clk_vote_bit=-1.
    &clk_multiplier=4.
    &clk_access_mode="&GCC_access_mode"

    gosub Print_Clk_Info_Line
  )

  &match=0
  &wild_head=0
  &wild_tail=0
  &clk_input_length=STRING.LENGTH("&clk")
  &clk_itr_length=STRING.LENGTH("gcc_apc0_vs_clk")

  if (STRING.SCAN("&clk", "*", 0)==0)
  (
    &wild_head=1
  )
  if (STRING.SCAN("&clk", "*", 1)==(STRING.LENGTH("&clk")-1))
  (
    &wild_tail=1
  )

  if ((&wild_head==1)&&(&wild_tail==1))
  (
    if (STRING.SCAN("gcc_apc0_vs_clk", STRING.MID("&clk", 1, &clk_input_length-2), 0)!=-1)
    ( 
      &match=1
    )
  )
  else if (&wild_head==1)
  (
    if (STRING.MID("gcc_apc0_vs_clk", &clk_itr_length-&clk_input_length+1, &clk_input_length-1)==STRING.CUT("&clk", 1))
    ( 
      &match=1
    )
  )
  else if (&wild_tail==1)
  (
    if (STRING.MID("gcc_apc0_vs_clk", 0, &clk_input_length-1)==STRING.CUT("&clk", -1))
    ( 
      &match=1
    )
  )
  else if ("gcc_apc0_vs_clk"=="&clk")
  (
    &match=1
  )
  
  if (&match==1)
  (
    &clk_test=&CLK_TEST_GCC_APC0_VS_CLK
    &clk_reg=&HWIO_GCC_APC0_VS_CBCR_ADDR
    &clk_reg_name="GCC_APC0_VS_CBCR"
    &clk_name="gcc_apc0_vs_clk"
    &clk_reg_cbcr_type="sm_cbc"
    &clk_vote_bit=-1.
    &clk_multiplier=4.
    &clk_access_mode="&GCC_access_mode"

    gosub Print_Clk_Info_Line
  )

  &match=0
  &wild_head=0
  &wild_tail=0
  &clk_input_length=STRING.LENGTH("&clk")
  &clk_itr_length=STRING.LENGTH("gcc_apc1_vs_clk")

  if (STRING.SCAN("&clk", "*", 0)==0)
  (
    &wild_head=1
  )
  if (STRING.SCAN("&clk", "*", 1)==(STRING.LENGTH("&clk")-1))
  (
    &wild_tail=1
  )

  if ((&wild_head==1)&&(&wild_tail==1))
  (
    if (STRING.SCAN("gcc_apc1_vs_clk", STRING.MID("&clk", 1, &clk_input_length-2), 0)!=-1)
    ( 
      &match=1
    )
  )
  else if (&wild_head==1)
  (
    if (STRING.MID("gcc_apc1_vs_clk", &clk_itr_length-&clk_input_length+1, &clk_input_length-1)==STRING.CUT("&clk", 1))
    ( 
      &match=1
    )
  )
  else if (&wild_tail==1)
  (
    if (STRING.MID("gcc_apc1_vs_clk", 0, &clk_input_length-1)==STRING.CUT("&clk", -1))
    ( 
      &match=1
    )
  )
  else if ("gcc_apc1_vs_clk"=="&clk")
  (
    &match=1
  )
  
  if (&match==1)
  (
    &clk_test=&CLK_TEST_GCC_APC1_VS_CLK
    &clk_reg=&HWIO_GCC_APC1_VS_CBCR_ADDR
    &clk_reg_name="GCC_APC1_VS_CBCR"
    &clk_name="gcc_apc1_vs_clk"
    &clk_reg_cbcr_type="sm_cbc"
    &clk_vote_bit=-1.
    &clk_multiplier=4.
    &clk_access_mode="&GCC_access_mode"

    gosub Print_Clk_Info_Line
  )

  &match=0
  &wild_head=0
  &wild_tail=0
  &clk_input_length=STRING.LENGTH("&clk")
  &clk_itr_length=STRING.LENGTH("gcc_bimc_clk")

  if (STRING.SCAN("&clk", "*", 0)==0)
  (
    &wild_head=1
  )
  if (STRING.SCAN("&clk", "*", 1)==(STRING.LENGTH("&clk")-1))
  (
    &wild_tail=1
  )

  if ((&wild_head==1)&&(&wild_tail==1))
  (
    if (STRING.SCAN("gcc_bimc_clk", STRING.MID("&clk", 1, &clk_input_length-2), 0)!=-1)
    ( 
      &match=1
    )
  )
  else if (&wild_head==1)
  (
    if (STRING.MID("gcc_bimc_clk", &clk_itr_length-&clk_input_length+1, &clk_input_length-1)==STRING.CUT("&clk", 1))
    ( 
      &match=1
    )
  )
  else if (&wild_tail==1)
  (
    if (STRING.MID("gcc_bimc_clk", 0, &clk_input_length-1)==STRING.CUT("&clk", -1))
    ( 
      &match=1
    )
  )
  else if ("gcc_bimc_clk"=="&clk")
  (
    &match=1
  )
  
  if (&match==1)
  (
    &clk_test=&CLK_TEST_GCC_BIMC_CLK
    &clk_reg=&HWIO_GCC_BIMC_CBCR_ADDR
    &clk_reg_name="GCC_BIMC_CBCR"
    &clk_name="gcc_bimc_clk"
    &clk_reg_cbcr_type="sm_cbc"
    &clk_vote_bit=-1.
    &clk_multiplier=4.
    &clk_access_mode="&GCC_access_mode"

    gosub Print_Clk_Info_Line
  )

  &match=0
  &wild_head=0
  &wild_tail=0
  &clk_input_length=STRING.LENGTH("&clk")
  &clk_itr_length=STRING.LENGTH("gcc_spdm_bimc_cy_clk")

  if (STRING.SCAN("&clk", "*", 0)==0)
  (
    &wild_head=1
  )
  if (STRING.SCAN("&clk", "*", 1)==(STRING.LENGTH("&clk")-1))
  (
    &wild_tail=1
  )

  if ((&wild_head==1)&&(&wild_tail==1))
  (
    if (STRING.SCAN("gcc_spdm_bimc_cy_clk", STRING.MID("&clk", 1, &clk_input_length-2), 0)!=-1)
    ( 
      &match=1
    )
  )
  else if (&wild_head==1)
  (
    if (STRING.MID("gcc_spdm_bimc_cy_clk", &clk_itr_length-&clk_input_length+1, &clk_input_length-1)==STRING.CUT("&clk", 1))
    ( 
      &match=1
    )
  )
  else if (&wild_tail==1)
  (
    if (STRING.MID("gcc_spdm_bimc_cy_clk", 0, &clk_input_length-1)==STRING.CUT("&clk", -1))
    ( 
      &match=1
    )
  )
  else if ("gcc_spdm_bimc_cy_clk"=="&clk")
  (
    &match=1
  )
  
  if (&match==1)
  (
    &clk_test=&CLK_TEST_GCC_SPDM_BIMC_CY_CLK
    &clk_reg=&HWIO_GCC_SPDM_BIMC_CY_CBCR_ADDR
    &clk_reg_name="GCC_SPDM_BIMC_CY_CBCR"
    &clk_name="gcc_spdm_bimc_cy_clk"
    &clk_reg_cbcr_type="sm_cbc"
    &clk_vote_bit=-1.
    &clk_multiplier=4.
    &clk_access_mode="&GCC_access_mode"

    gosub Print_Clk_Info_Line
  )

  &match=0
  &wild_head=0
  &wild_tail=0
  &clk_input_length=STRING.LENGTH("&clk")
  &clk_itr_length=STRING.LENGTH("gcc_bimc_ddr_cpll0_clk")

  if (STRING.SCAN("&clk", "*", 0)==0)
  (
    &wild_head=1
  )
  if (STRING.SCAN("&clk", "*", 1)==(STRING.LENGTH("&clk")-1))
  (
    &wild_tail=1
  )

  if ((&wild_head==1)&&(&wild_tail==1))
  (
    if (STRING.SCAN("gcc_bimc_ddr_cpll0_clk", STRING.MID("&clk", 1, &clk_input_length-2), 0)!=-1)
    ( 
      &match=1
    )
  )
  else if (&wild_head==1)
  (
    if (STRING.MID("gcc_bimc_ddr_cpll0_clk", &clk_itr_length-&clk_input_length+1, &clk_input_length-1)==STRING.CUT("&clk", 1))
    ( 
      &match=1
    )
  )
  else if (&wild_tail==1)
  (
    if (STRING.MID("gcc_bimc_ddr_cpll0_clk", 0, &clk_input_length-1)==STRING.CUT("&clk", -1))
    ( 
      &match=1
    )
  )
  else if ("gcc_bimc_ddr_cpll0_clk"=="&clk")
  (
    &match=1
  )
  
  if (&match==1)
  (
    &clk_test=&CLK_TEST_GCC_BIMC_DDR_CPLL0_CLK
    &clk_reg=&HWIO_GCC_BIMC_DDR_CPLL0_CBCR_ADDR
    &clk_reg_name="GCC_BIMC_DDR_CPLL0_CBCR"
    &clk_name="gcc_bimc_ddr_cpll0_clk"
    &clk_reg_cbcr_type="sm_cbc"
    &clk_vote_bit=-1.
    &clk_multiplier=4.
    &clk_access_mode="&GCC_access_mode"

    gosub Print_Clk_Info_Line
  )

  &match=0
  &wild_head=0
  &wild_tail=0
  &clk_input_length=STRING.LENGTH("&clk")
  &clk_itr_length=STRING.LENGTH("gcc_bimc_ddr_cpll1_clk")

  if (STRING.SCAN("&clk", "*", 0)==0)
  (
    &wild_head=1
  )
  if (STRING.SCAN("&clk", "*", 1)==(STRING.LENGTH("&clk")-1))
  (
    &wild_tail=1
  )

  if ((&wild_head==1)&&(&wild_tail==1))
  (
    if (STRING.SCAN("gcc_bimc_ddr_cpll1_clk", STRING.MID("&clk", 1, &clk_input_length-2), 0)!=-1)
    ( 
      &match=1
    )
  )
  else if (&wild_head==1)
  (
    if (STRING.MID("gcc_bimc_ddr_cpll1_clk", &clk_itr_length-&clk_input_length+1, &clk_input_length-1)==STRING.CUT("&clk", 1))
    ( 
      &match=1
    )
  )
  else if (&wild_tail==1)
  (
    if (STRING.MID("gcc_bimc_ddr_cpll1_clk", 0, &clk_input_length-1)==STRING.CUT("&clk", -1))
    ( 
      &match=1
    )
  )
  else if ("gcc_bimc_ddr_cpll1_clk"=="&clk")
  (
    &match=1
  )
  
  if (&match==1)
  (
    &clk_test=&CLK_TEST_GCC_BIMC_DDR_CPLL1_CLK
    &clk_reg=&HWIO_GCC_BIMC_DDR_CPLL1_CBCR_ADDR
    &clk_reg_name="GCC_BIMC_DDR_CPLL1_CBCR"
    &clk_name="gcc_bimc_ddr_cpll1_clk"
    &clk_reg_cbcr_type="sm_cbc"
    &clk_vote_bit=-1.
    &clk_multiplier=4.
    &clk_access_mode="&GCC_access_mode"

    gosub Print_Clk_Info_Line
  )

  &match=0
  &wild_head=0
  &wild_tail=0
  &clk_input_length=STRING.LENGTH("&clk")
  &clk_itr_length=STRING.LENGTH("gcc_bimc_dtts_xo_clk")

  if (STRING.SCAN("&clk", "*", 0)==0)
  (
    &wild_head=1
  )
  if (STRING.SCAN("&clk", "*", 1)==(STRING.LENGTH("&clk")-1))
  (
    &wild_tail=1
  )

  if ((&wild_head==1)&&(&wild_tail==1))
  (
    if (STRING.SCAN("gcc_bimc_dtts_xo_clk", STRING.MID("&clk", 1, &clk_input_length-2), 0)!=-1)
    ( 
      &match=1
    )
  )
  else if (&wild_head==1)
  (
    if (STRING.MID("gcc_bimc_dtts_xo_clk", &clk_itr_length-&clk_input_length+1, &clk_input_length-1)==STRING.CUT("&clk", 1))
    ( 
      &match=1
    )
  )
  else if (&wild_tail==1)
  (
    if (STRING.MID("gcc_bimc_dtts_xo_clk", 0, &clk_input_length-1)==STRING.CUT("&clk", -1))
    ( 
      &match=1
    )
  )
  else if ("gcc_bimc_dtts_xo_clk"=="&clk")
  (
    &match=1
  )
  
  if (&match==1)
  (
    &clk_test=&CLK_TEST_GCC_BIMC_DTTS_XO_CLK
    &clk_reg=&HWIO_GCC_BIMC_DTTS_XO_CBCR_ADDR
    &clk_reg_name="GCC_BIMC_DTTS_XO_CBCR"
    &clk_name="gcc_bimc_dtts_xo_clk"
    &clk_reg_cbcr_type="sm_cbc"
    &clk_vote_bit=-1.
    &clk_multiplier=4.
    &clk_access_mode="&GCC_access_mode"

    gosub Print_Clk_Info_Line
  )

  &match=0
  &wild_head=0
  &wild_tail=0
  &clk_input_length=STRING.LENGTH("&clk")
  &clk_itr_length=STRING.LENGTH("gcc_bimc_xo_clk")

  if (STRING.SCAN("&clk", "*", 0)==0)
  (
    &wild_head=1
  )
  if (STRING.SCAN("&clk", "*", 1)==(STRING.LENGTH("&clk")-1))
  (
    &wild_tail=1
  )

  if ((&wild_head==1)&&(&wild_tail==1))
  (
    if (STRING.SCAN("gcc_bimc_xo_clk", STRING.MID("&clk", 1, &clk_input_length-2), 0)!=-1)
    ( 
      &match=1
    )
  )
  else if (&wild_head==1)
  (
    if (STRING.MID("gcc_bimc_xo_clk", &clk_itr_length-&clk_input_length+1, &clk_input_length-1)==STRING.CUT("&clk", 1))
    ( 
      &match=1
    )
  )
  else if (&wild_tail==1)
  (
    if (STRING.MID("gcc_bimc_xo_clk", 0, &clk_input_length-1)==STRING.CUT("&clk", -1))
    ( 
      &match=1
    )
  )
  else if ("gcc_bimc_xo_clk"=="&clk")
  (
    &match=1
  )
  
  if (&match==1)
  (
    &clk_test=&CLK_TEST_GCC_BIMC_XO_CLK
    &clk_reg=&HWIO_GCC_BIMC_XO_CBCR_ADDR
    &clk_reg_name="GCC_BIMC_XO_CBCR"
    &clk_name="gcc_bimc_xo_clk"
    &clk_reg_cbcr_type="sm_cbc"
    &clk_vote_bit=-1.
    &clk_multiplier=4.
    &clk_access_mode="&GCC_access_mode"

    gosub Print_Clk_Info_Line
  )

  &match=0
  &wild_head=0
  &wild_tail=0
  &clk_input_length=STRING.LENGTH("&clk")
  &clk_itr_length=STRING.LENGTH("gcc_cfg_noc_ddr_cfg_clk")

  if (STRING.SCAN("&clk", "*", 0)==0)
  (
    &wild_head=1
  )
  if (STRING.SCAN("&clk", "*", 1)==(STRING.LENGTH("&clk")-1))
  (
    &wild_tail=1
  )

  if ((&wild_head==1)&&(&wild_tail==1))
  (
    if (STRING.SCAN("gcc_cfg_noc_ddr_cfg_clk", STRING.MID("&clk", 1, &clk_input_length-2), 0)!=-1)
    ( 
      &match=1
    )
  )
  else if (&wild_head==1)
  (
    if (STRING.MID("gcc_cfg_noc_ddr_cfg_clk", &clk_itr_length-&clk_input_length+1, &clk_input_length-1)==STRING.CUT("&clk", 1))
    ( 
      &match=1
    )
  )
  else if (&wild_tail==1)
  (
    if (STRING.MID("gcc_cfg_noc_ddr_cfg_clk", 0, &clk_input_length-1)==STRING.CUT("&clk", -1))
    ( 
      &match=1
    )
  )
  else if ("gcc_cfg_noc_ddr_cfg_clk"=="&clk")
  (
    &match=1
  )
  
  if (&match==1)
  (
    &clk_test=&CLK_TEST_GCC_CFG_NOC_DDR_CFG_CLK
    &clk_reg=&HWIO_GCC_CFG_NOC_DDR_CFG_CBCR_ADDR
    &clk_reg_name="GCC_CFG_NOC_DDR_CFG_CBCR"
    &clk_name="gcc_cfg_noc_ddr_cfg_clk"
    &clk_reg_cbcr_type="sm_cbc"
    &clk_vote_bit=-1.
    &clk_multiplier=4.
    &clk_access_mode="&GCC_access_mode"

    gosub Print_Clk_Info_Line
  )

  &match=0
  &wild_head=0
  &wild_tail=0
  &clk_input_length=STRING.LENGTH("&clk")
  &clk_itr_length=STRING.LENGTH("gcc_cnoc_bus_timeout5_ahb_clk")

  if (STRING.SCAN("&clk", "*", 0)==0)
  (
    &wild_head=1
  )
  if (STRING.SCAN("&clk", "*", 1)==(STRING.LENGTH("&clk")-1))
  (
    &wild_tail=1
  )

  if ((&wild_head==1)&&(&wild_tail==1))
  (
    if (STRING.SCAN("gcc_cnoc_bus_timeout5_ahb_clk", STRING.MID("&clk", 1, &clk_input_length-2), 0)!=-1)
    ( 
      &match=1
    )
  )
  else if (&wild_head==1)
  (
    if (STRING.MID("gcc_cnoc_bus_timeout5_ahb_clk", &clk_itr_length-&clk_input_length+1, &clk_input_length-1)==STRING.CUT("&clk", 1))
    ( 
      &match=1
    )
  )
  else if (&wild_tail==1)
  (
    if (STRING.MID("gcc_cnoc_bus_timeout5_ahb_clk", 0, &clk_input_length-1)==STRING.CUT("&clk", -1))
    ( 
      &match=1
    )
  )
  else if ("gcc_cnoc_bus_timeout5_ahb_clk"=="&clk")
  (
    &match=1
  )
  
  if (&match==1)
  (
    &clk_test=&CLK_TEST_GCC_CNOC_BUS_TIMEOUT5_AHB_CLK
    &clk_reg=&HWIO_GCC_CNOC_BUS_TIMEOUT5_AHB_CBCR_ADDR
    &clk_reg_name="GCC_CNOC_BUS_TIMEOUT5_AHB_CBCR"
    &clk_name="gcc_cnoc_bus_timeout5_ahb_clk"
    &clk_reg_cbcr_type="sm_cbc"
    &clk_vote_bit=-1.
    &clk_multiplier=4.
    &clk_access_mode="&GCC_access_mode"

    gosub Print_Clk_Info_Line
  )

  &match=0
  &wild_head=0
  &wild_tail=0
  &clk_input_length=STRING.LENGTH("&clk")
  &clk_itr_length=STRING.LENGTH("gcc_ddr_dim_cfg_clk")

  if (STRING.SCAN("&clk", "*", 0)==0)
  (
    &wild_head=1
  )
  if (STRING.SCAN("&clk", "*", 1)==(STRING.LENGTH("&clk")-1))
  (
    &wild_tail=1
  )

  if ((&wild_head==1)&&(&wild_tail==1))
  (
    if (STRING.SCAN("gcc_ddr_dim_cfg_clk", STRING.MID("&clk", 1, &clk_input_length-2), 0)!=-1)
    ( 
      &match=1
    )
  )
  else if (&wild_head==1)
  (
    if (STRING.MID("gcc_ddr_dim_cfg_clk", &clk_itr_length-&clk_input_length+1, &clk_input_length-1)==STRING.CUT("&clk", 1))
    ( 
      &match=1
    )
  )
  else if (&wild_tail==1)
  (
    if (STRING.MID("gcc_ddr_dim_cfg_clk", 0, &clk_input_length-1)==STRING.CUT("&clk", -1))
    ( 
      &match=1
    )
  )
  else if ("gcc_ddr_dim_cfg_clk"=="&clk")
  (
    &match=1
  )
  
  if (&match==1)
  (
    &clk_test=&CLK_TEST_GCC_DDR_DIM_CFG_CLK
    &clk_reg=&HWIO_GCC_DDR_DIM_CFG_CBCR_ADDR
    &clk_reg_name="GCC_DDR_DIM_CFG_CBCR"
    &clk_name="gcc_ddr_dim_cfg_clk"
    &clk_reg_cbcr_type="sm_cbc"
    &clk_vote_bit=-1.
    &clk_multiplier=4.
    &clk_access_mode="&GCC_access_mode"

    gosub Print_Clk_Info_Line
  )

  &match=0
  &wild_head=0
  &wild_tail=0
  &clk_input_length=STRING.LENGTH("&clk")
  &clk_itr_length=STRING.LENGTH("gcc_bimc_hmss_axi_clk")

  if (STRING.SCAN("&clk", "*", 0)==0)
  (
    &wild_head=1
  )
  if (STRING.SCAN("&clk", "*", 1)==(STRING.LENGTH("&clk")-1))
  (
    &wild_tail=1
  )

  if ((&wild_head==1)&&(&wild_tail==1))
  (
    if (STRING.SCAN("gcc_bimc_hmss_axi_clk", STRING.MID("&clk", 1, &clk_input_length-2), 0)!=-1)
    ( 
      &match=1
    )
  )
  else if (&wild_head==1)
  (
    if (STRING.MID("gcc_bimc_hmss_axi_clk", &clk_itr_length-&clk_input_length+1, &clk_input_length-1)==STRING.CUT("&clk", 1))
    ( 
      &match=1
    )
  )
  else if (&wild_tail==1)
  (
    if (STRING.MID("gcc_bimc_hmss_axi_clk", 0, &clk_input_length-1)==STRING.CUT("&clk", -1))
    ( 
      &match=1
    )
  )
  else if ("gcc_bimc_hmss_axi_clk"=="&clk")
  (
    &match=1
  )
  
  if (&match==1)
  (
    &clk_test=&CLK_TEST_GCC_BIMC_HMSS_AXI_CLK
    &clk_reg=&HWIO_GCC_BIMC_HMSS_AXI_CBCR_ADDR
    &clk_reg_name="GCC_BIMC_HMSS_AXI_CBCR"
    &clk_name="gcc_bimc_hmss_axi_clk"
    &clk_reg_cbcr_type="sm_cbc"
    &clk_vote_bit=22.
    &clk_multiplier=4.
    &clk_access_mode="&GCC_access_mode"

    gosub Print_Clk_Info_Line
  )

  &match=0
  &wild_head=0
  &wild_tail=0
  &clk_input_length=STRING.LENGTH("&clk")
  &clk_itr_length=STRING.LENGTH("gcc_blsp1_qup1_i2c_apps_clk")

  if (STRING.SCAN("&clk", "*", 0)==0)
  (
    &wild_head=1
  )
  if (STRING.SCAN("&clk", "*", 1)==(STRING.LENGTH("&clk")-1))
  (
    &wild_tail=1
  )

  if ((&wild_head==1)&&(&wild_tail==1))
  (
    if (STRING.SCAN("gcc_blsp1_qup1_i2c_apps_clk", STRING.MID("&clk", 1, &clk_input_length-2), 0)!=-1)
    ( 
      &match=1
    )
  )
  else if (&wild_head==1)
  (
    if (STRING.MID("gcc_blsp1_qup1_i2c_apps_clk", &clk_itr_length-&clk_input_length+1, &clk_input_length-1)==STRING.CUT("&clk", 1))
    ( 
      &match=1
    )
  )
  else if (&wild_tail==1)
  (
    if (STRING.MID("gcc_blsp1_qup1_i2c_apps_clk", 0, &clk_input_length-1)==STRING.CUT("&clk", -1))
    ( 
      &match=1
    )
  )
  else if ("gcc_blsp1_qup1_i2c_apps_clk"=="&clk")
  (
    &match=1
  )
  
  if (&match==1)
  (
    &clk_test=&CLK_TEST_GCC_BLSP1_QUP1_I2C_APPS_CLK
    &clk_reg=&HWIO_GCC_BLSP1_QUP1_I2C_APPS_CBCR_ADDR
    &clk_reg_name="GCC_BLSP1_QUP1_I2C_APPS_CBCR"
    &clk_name="gcc_blsp1_qup1_i2c_apps_clk"
    &clk_reg_cbcr_type="sm_cbc"
    &clk_vote_bit=-1.
    &clk_multiplier=4.
    &clk_access_mode="&GCC_access_mode"

    gosub Print_Clk_Info_Line
  )

  &match=0
  &wild_head=0
  &wild_tail=0
  &clk_input_length=STRING.LENGTH("&clk")
  &clk_itr_length=STRING.LENGTH("gcc_blsp1_qup1_spi_apps_clk")

  if (STRING.SCAN("&clk", "*", 0)==0)
  (
    &wild_head=1
  )
  if (STRING.SCAN("&clk", "*", 1)==(STRING.LENGTH("&clk")-1))
  (
    &wild_tail=1
  )

  if ((&wild_head==1)&&(&wild_tail==1))
  (
    if (STRING.SCAN("gcc_blsp1_qup1_spi_apps_clk", STRING.MID("&clk", 1, &clk_input_length-2), 0)!=-1)
    ( 
      &match=1
    )
  )
  else if (&wild_head==1)
  (
    if (STRING.MID("gcc_blsp1_qup1_spi_apps_clk", &clk_itr_length-&clk_input_length+1, &clk_input_length-1)==STRING.CUT("&clk", 1))
    ( 
      &match=1
    )
  )
  else if (&wild_tail==1)
  (
    if (STRING.MID("gcc_blsp1_qup1_spi_apps_clk", 0, &clk_input_length-1)==STRING.CUT("&clk", -1))
    ( 
      &match=1
    )
  )
  else if ("gcc_blsp1_qup1_spi_apps_clk"=="&clk")
  (
    &match=1
  )
  
  if (&match==1)
  (
    &clk_test=&CLK_TEST_GCC_BLSP1_QUP1_SPI_APPS_CLK
    &clk_reg=&HWIO_GCC_BLSP1_QUP1_SPI_APPS_CBCR_ADDR
    &clk_reg_name="GCC_BLSP1_QUP1_SPI_APPS_CBCR"
    &clk_name="gcc_blsp1_qup1_spi_apps_clk"
    &clk_reg_cbcr_type="sm_cbc"
    &clk_vote_bit=-1.
    &clk_multiplier=4.
    &clk_access_mode="&GCC_access_mode"

    gosub Print_Clk_Info_Line
  )

  &match=0
  &wild_head=0
  &wild_tail=0
  &clk_input_length=STRING.LENGTH("&clk")
  &clk_itr_length=STRING.LENGTH("gcc_blsp1_qup2_i2c_apps_clk")

  if (STRING.SCAN("&clk", "*", 0)==0)
  (
    &wild_head=1
  )
  if (STRING.SCAN("&clk", "*", 1)==(STRING.LENGTH("&clk")-1))
  (
    &wild_tail=1
  )

  if ((&wild_head==1)&&(&wild_tail==1))
  (
    if (STRING.SCAN("gcc_blsp1_qup2_i2c_apps_clk", STRING.MID("&clk", 1, &clk_input_length-2), 0)!=-1)
    ( 
      &match=1
    )
  )
  else if (&wild_head==1)
  (
    if (STRING.MID("gcc_blsp1_qup2_i2c_apps_clk", &clk_itr_length-&clk_input_length+1, &clk_input_length-1)==STRING.CUT("&clk", 1))
    ( 
      &match=1
    )
  )
  else if (&wild_tail==1)
  (
    if (STRING.MID("gcc_blsp1_qup2_i2c_apps_clk", 0, &clk_input_length-1)==STRING.CUT("&clk", -1))
    ( 
      &match=1
    )
  )
  else if ("gcc_blsp1_qup2_i2c_apps_clk"=="&clk")
  (
    &match=1
  )
  
  if (&match==1)
  (
    &clk_test=&CLK_TEST_GCC_BLSP1_QUP2_I2C_APPS_CLK
    &clk_reg=&HWIO_GCC_BLSP1_QUP2_I2C_APPS_CBCR_ADDR
    &clk_reg_name="GCC_BLSP1_QUP2_I2C_APPS_CBCR"
    &clk_name="gcc_blsp1_qup2_i2c_apps_clk"
    &clk_reg_cbcr_type="sm_cbc"
    &clk_vote_bit=-1.
    &clk_multiplier=4.
    &clk_access_mode="&GCC_access_mode"

    gosub Print_Clk_Info_Line
  )

  &match=0
  &wild_head=0
  &wild_tail=0
  &clk_input_length=STRING.LENGTH("&clk")
  &clk_itr_length=STRING.LENGTH("gcc_blsp1_qup2_spi_apps_clk")

  if (STRING.SCAN("&clk", "*", 0)==0)
  (
    &wild_head=1
  )
  if (STRING.SCAN("&clk", "*", 1)==(STRING.LENGTH("&clk")-1))
  (
    &wild_tail=1
  )

  if ((&wild_head==1)&&(&wild_tail==1))
  (
    if (STRING.SCAN("gcc_blsp1_qup2_spi_apps_clk", STRING.MID("&clk", 1, &clk_input_length-2), 0)!=-1)
    ( 
      &match=1
    )
  )
  else if (&wild_head==1)
  (
    if (STRING.MID("gcc_blsp1_qup2_spi_apps_clk", &clk_itr_length-&clk_input_length+1, &clk_input_length-1)==STRING.CUT("&clk", 1))
    ( 
      &match=1
    )
  )
  else if (&wild_tail==1)
  (
    if (STRING.MID("gcc_blsp1_qup2_spi_apps_clk", 0, &clk_input_length-1)==STRING.CUT("&clk", -1))
    ( 
      &match=1
    )
  )
  else if ("gcc_blsp1_qup2_spi_apps_clk"=="&clk")
  (
    &match=1
  )
  
  if (&match==1)
  (
    &clk_test=&CLK_TEST_GCC_BLSP1_QUP2_SPI_APPS_CLK
    &clk_reg=&HWIO_GCC_BLSP1_QUP2_SPI_APPS_CBCR_ADDR
    &clk_reg_name="GCC_BLSP1_QUP2_SPI_APPS_CBCR"
    &clk_name="gcc_blsp1_qup2_spi_apps_clk"
    &clk_reg_cbcr_type="sm_cbc"
    &clk_vote_bit=-1.
    &clk_multiplier=4.
    &clk_access_mode="&GCC_access_mode"

    gosub Print_Clk_Info_Line
  )

  &match=0
  &wild_head=0
  &wild_tail=0
  &clk_input_length=STRING.LENGTH("&clk")
  &clk_itr_length=STRING.LENGTH("gcc_blsp1_qup3_i2c_apps_clk")

  if (STRING.SCAN("&clk", "*", 0)==0)
  (
    &wild_head=1
  )
  if (STRING.SCAN("&clk", "*", 1)==(STRING.LENGTH("&clk")-1))
  (
    &wild_tail=1
  )

  if ((&wild_head==1)&&(&wild_tail==1))
  (
    if (STRING.SCAN("gcc_blsp1_qup3_i2c_apps_clk", STRING.MID("&clk", 1, &clk_input_length-2), 0)!=-1)
    ( 
      &match=1
    )
  )
  else if (&wild_head==1)
  (
    if (STRING.MID("gcc_blsp1_qup3_i2c_apps_clk", &clk_itr_length-&clk_input_length+1, &clk_input_length-1)==STRING.CUT("&clk", 1))
    ( 
      &match=1
    )
  )
  else if (&wild_tail==1)
  (
    if (STRING.MID("gcc_blsp1_qup3_i2c_apps_clk", 0, &clk_input_length-1)==STRING.CUT("&clk", -1))
    ( 
      &match=1
    )
  )
  else if ("gcc_blsp1_qup3_i2c_apps_clk"=="&clk")
  (
    &match=1
  )
  
  if (&match==1)
  (
    &clk_test=&CLK_TEST_GCC_BLSP1_QUP3_I2C_APPS_CLK
    &clk_reg=&HWIO_GCC_BLSP1_QUP3_I2C_APPS_CBCR_ADDR
    &clk_reg_name="GCC_BLSP1_QUP3_I2C_APPS_CBCR"
    &clk_name="gcc_blsp1_qup3_i2c_apps_clk"
    &clk_reg_cbcr_type="sm_cbc"
    &clk_vote_bit=-1.
    &clk_multiplier=4.
    &clk_access_mode="&GCC_access_mode"

    gosub Print_Clk_Info_Line
  )

  &match=0
  &wild_head=0
  &wild_tail=0
  &clk_input_length=STRING.LENGTH("&clk")
  &clk_itr_length=STRING.LENGTH("gcc_blsp1_qup3_spi_apps_clk")

  if (STRING.SCAN("&clk", "*", 0)==0)
  (
    &wild_head=1
  )
  if (STRING.SCAN("&clk", "*", 1)==(STRING.LENGTH("&clk")-1))
  (
    &wild_tail=1
  )

  if ((&wild_head==1)&&(&wild_tail==1))
  (
    if (STRING.SCAN("gcc_blsp1_qup3_spi_apps_clk", STRING.MID("&clk", 1, &clk_input_length-2), 0)!=-1)
    ( 
      &match=1
    )
  )
  else if (&wild_head==1)
  (
    if (STRING.MID("gcc_blsp1_qup3_spi_apps_clk", &clk_itr_length-&clk_input_length+1, &clk_input_length-1)==STRING.CUT("&clk", 1))
    ( 
      &match=1
    )
  )
  else if (&wild_tail==1)
  (
    if (STRING.MID("gcc_blsp1_qup3_spi_apps_clk", 0, &clk_input_length-1)==STRING.CUT("&clk", -1))
    ( 
      &match=1
    )
  )
  else if ("gcc_blsp1_qup3_spi_apps_clk"=="&clk")
  (
    &match=1
  )
  
  if (&match==1)
  (
    &clk_test=&CLK_TEST_GCC_BLSP1_QUP3_SPI_APPS_CLK
    &clk_reg=&HWIO_GCC_BLSP1_QUP3_SPI_APPS_CBCR_ADDR
    &clk_reg_name="GCC_BLSP1_QUP3_SPI_APPS_CBCR"
    &clk_name="gcc_blsp1_qup3_spi_apps_clk"
    &clk_reg_cbcr_type="sm_cbc"
    &clk_vote_bit=-1.
    &clk_multiplier=4.
    &clk_access_mode="&GCC_access_mode"

    gosub Print_Clk_Info_Line
  )

  &match=0
  &wild_head=0
  &wild_tail=0
  &clk_input_length=STRING.LENGTH("&clk")
  &clk_itr_length=STRING.LENGTH("gcc_blsp1_qup4_i2c_apps_clk")

  if (STRING.SCAN("&clk", "*", 0)==0)
  (
    &wild_head=1
  )
  if (STRING.SCAN("&clk", "*", 1)==(STRING.LENGTH("&clk")-1))
  (
    &wild_tail=1
  )

  if ((&wild_head==1)&&(&wild_tail==1))
  (
    if (STRING.SCAN("gcc_blsp1_qup4_i2c_apps_clk", STRING.MID("&clk", 1, &clk_input_length-2), 0)!=-1)
    ( 
      &match=1
    )
  )
  else if (&wild_head==1)
  (
    if (STRING.MID("gcc_blsp1_qup4_i2c_apps_clk", &clk_itr_length-&clk_input_length+1, &clk_input_length-1)==STRING.CUT("&clk", 1))
    ( 
      &match=1
    )
  )
  else if (&wild_tail==1)
  (
    if (STRING.MID("gcc_blsp1_qup4_i2c_apps_clk", 0, &clk_input_length-1)==STRING.CUT("&clk", -1))
    ( 
      &match=1
    )
  )
  else if ("gcc_blsp1_qup4_i2c_apps_clk"=="&clk")
  (
    &match=1
  )
  
  if (&match==1)
  (
    &clk_test=&CLK_TEST_GCC_BLSP1_QUP4_I2C_APPS_CLK
    &clk_reg=&HWIO_GCC_BLSP1_QUP4_I2C_APPS_CBCR_ADDR
    &clk_reg_name="GCC_BLSP1_QUP4_I2C_APPS_CBCR"
    &clk_name="gcc_blsp1_qup4_i2c_apps_clk"
    &clk_reg_cbcr_type="sm_cbc"
    &clk_vote_bit=-1.
    &clk_multiplier=4.
    &clk_access_mode="&GCC_access_mode"

    gosub Print_Clk_Info_Line
  )

  &match=0
  &wild_head=0
  &wild_tail=0
  &clk_input_length=STRING.LENGTH("&clk")
  &clk_itr_length=STRING.LENGTH("gcc_blsp1_qup4_spi_apps_clk")

  if (STRING.SCAN("&clk", "*", 0)==0)
  (
    &wild_head=1
  )
  if (STRING.SCAN("&clk", "*", 1)==(STRING.LENGTH("&clk")-1))
  (
    &wild_tail=1
  )

  if ((&wild_head==1)&&(&wild_tail==1))
  (
    if (STRING.SCAN("gcc_blsp1_qup4_spi_apps_clk", STRING.MID("&clk", 1, &clk_input_length-2), 0)!=-1)
    ( 
      &match=1
    )
  )
  else if (&wild_head==1)
  (
    if (STRING.MID("gcc_blsp1_qup4_spi_apps_clk", &clk_itr_length-&clk_input_length+1, &clk_input_length-1)==STRING.CUT("&clk", 1))
    ( 
      &match=1
    )
  )
  else if (&wild_tail==1)
  (
    if (STRING.MID("gcc_blsp1_qup4_spi_apps_clk", 0, &clk_input_length-1)==STRING.CUT("&clk", -1))
    ( 
      &match=1
    )
  )
  else if ("gcc_blsp1_qup4_spi_apps_clk"=="&clk")
  (
    &match=1
  )
  
  if (&match==1)
  (
    &clk_test=&CLK_TEST_GCC_BLSP1_QUP4_SPI_APPS_CLK
    &clk_reg=&HWIO_GCC_BLSP1_QUP4_SPI_APPS_CBCR_ADDR
    &clk_reg_name="GCC_BLSP1_QUP4_SPI_APPS_CBCR"
    &clk_name="gcc_blsp1_qup4_spi_apps_clk"
    &clk_reg_cbcr_type="sm_cbc"
    &clk_vote_bit=-1.
    &clk_multiplier=4.
    &clk_access_mode="&GCC_access_mode"

    gosub Print_Clk_Info_Line
  )

  &match=0
  &wild_head=0
  &wild_tail=0
  &clk_input_length=STRING.LENGTH("&clk")
  &clk_itr_length=STRING.LENGTH("gcc_blsp1_uart1_apps_clk")

  if (STRING.SCAN("&clk", "*", 0)==0)
  (
    &wild_head=1
  )
  if (STRING.SCAN("&clk", "*", 1)==(STRING.LENGTH("&clk")-1))
  (
    &wild_tail=1
  )

  if ((&wild_head==1)&&(&wild_tail==1))
  (
    if (STRING.SCAN("gcc_blsp1_uart1_apps_clk", STRING.MID("&clk", 1, &clk_input_length-2), 0)!=-1)
    ( 
      &match=1
    )
  )
  else if (&wild_head==1)
  (
    if (STRING.MID("gcc_blsp1_uart1_apps_clk", &clk_itr_length-&clk_input_length+1, &clk_input_length-1)==STRING.CUT("&clk", 1))
    ( 
      &match=1
    )
  )
  else if (&wild_tail==1)
  (
    if (STRING.MID("gcc_blsp1_uart1_apps_clk", 0, &clk_input_length-1)==STRING.CUT("&clk", -1))
    ( 
      &match=1
    )
  )
  else if ("gcc_blsp1_uart1_apps_clk"=="&clk")
  (
    &match=1
  )
  
  if (&match==1)
  (
    &clk_test=&CLK_TEST_GCC_BLSP1_UART1_APPS_CLK
    &clk_reg=&HWIO_GCC_BLSP1_UART1_APPS_CBCR_ADDR
    &clk_reg_name="GCC_BLSP1_UART1_APPS_CBCR"
    &clk_name="gcc_blsp1_uart1_apps_clk"
    &clk_reg_cbcr_type="sm_cbc"
    &clk_vote_bit=-1.
    &clk_multiplier=4.
    &clk_access_mode="&GCC_access_mode"

    gosub Print_Clk_Info_Line
  )

  &match=0
  &wild_head=0
  &wild_tail=0
  &clk_input_length=STRING.LENGTH("&clk")
  &clk_itr_length=STRING.LENGTH("gcc_blsp1_uart2_apps_clk")

  if (STRING.SCAN("&clk", "*", 0)==0)
  (
    &wild_head=1
  )
  if (STRING.SCAN("&clk", "*", 1)==(STRING.LENGTH("&clk")-1))
  (
    &wild_tail=1
  )

  if ((&wild_head==1)&&(&wild_tail==1))
  (
    if (STRING.SCAN("gcc_blsp1_uart2_apps_clk", STRING.MID("&clk", 1, &clk_input_length-2), 0)!=-1)
    ( 
      &match=1
    )
  )
  else if (&wild_head==1)
  (
    if (STRING.MID("gcc_blsp1_uart2_apps_clk", &clk_itr_length-&clk_input_length+1, &clk_input_length-1)==STRING.CUT("&clk", 1))
    ( 
      &match=1
    )
  )
  else if (&wild_tail==1)
  (
    if (STRING.MID("gcc_blsp1_uart2_apps_clk", 0, &clk_input_length-1)==STRING.CUT("&clk", -1))
    ( 
      &match=1
    )
  )
  else if ("gcc_blsp1_uart2_apps_clk"=="&clk")
  (
    &match=1
  )
  
  if (&match==1)
  (
    &clk_test=&CLK_TEST_GCC_BLSP1_UART2_APPS_CLK
    &clk_reg=&HWIO_GCC_BLSP1_UART2_APPS_CBCR_ADDR
    &clk_reg_name="GCC_BLSP1_UART2_APPS_CBCR"
    &clk_name="gcc_blsp1_uart2_apps_clk"
    &clk_reg_cbcr_type="sm_cbc"
    &clk_vote_bit=-1.
    &clk_multiplier=4.
    &clk_access_mode="&GCC_access_mode"

    gosub Print_Clk_Info_Line
  )

  &match=0
  &wild_head=0
  &wild_tail=0
  &clk_input_length=STRING.LENGTH("&clk")
  &clk_itr_length=STRING.LENGTH("gcc_blsp2_qup1_i2c_apps_clk")

  if (STRING.SCAN("&clk", "*", 0)==0)
  (
    &wild_head=1
  )
  if (STRING.SCAN("&clk", "*", 1)==(STRING.LENGTH("&clk")-1))
  (
    &wild_tail=1
  )

  if ((&wild_head==1)&&(&wild_tail==1))
  (
    if (STRING.SCAN("gcc_blsp2_qup1_i2c_apps_clk", STRING.MID("&clk", 1, &clk_input_length-2), 0)!=-1)
    ( 
      &match=1
    )
  )
  else if (&wild_head==1)
  (
    if (STRING.MID("gcc_blsp2_qup1_i2c_apps_clk", &clk_itr_length-&clk_input_length+1, &clk_input_length-1)==STRING.CUT("&clk", 1))
    ( 
      &match=1
    )
  )
  else if (&wild_tail==1)
  (
    if (STRING.MID("gcc_blsp2_qup1_i2c_apps_clk", 0, &clk_input_length-1)==STRING.CUT("&clk", -1))
    ( 
      &match=1
    )
  )
  else if ("gcc_blsp2_qup1_i2c_apps_clk"=="&clk")
  (
    &match=1
  )
  
  if (&match==1)
  (
    &clk_test=&CLK_TEST_GCC_BLSP2_QUP1_I2C_APPS_CLK
    &clk_reg=&HWIO_GCC_BLSP2_QUP1_I2C_APPS_CBCR_ADDR
    &clk_reg_name="GCC_BLSP2_QUP1_I2C_APPS_CBCR"
    &clk_name="gcc_blsp2_qup1_i2c_apps_clk"
    &clk_reg_cbcr_type="sm_cbc"
    &clk_vote_bit=-1.
    &clk_multiplier=4.
    &clk_access_mode="&GCC_access_mode"

    gosub Print_Clk_Info_Line
  )

  &match=0
  &wild_head=0
  &wild_tail=0
  &clk_input_length=STRING.LENGTH("&clk")
  &clk_itr_length=STRING.LENGTH("gcc_blsp2_qup1_spi_apps_clk")

  if (STRING.SCAN("&clk", "*", 0)==0)
  (
    &wild_head=1
  )
  if (STRING.SCAN("&clk", "*", 1)==(STRING.LENGTH("&clk")-1))
  (
    &wild_tail=1
  )

  if ((&wild_head==1)&&(&wild_tail==1))
  (
    if (STRING.SCAN("gcc_blsp2_qup1_spi_apps_clk", STRING.MID("&clk", 1, &clk_input_length-2), 0)!=-1)
    ( 
      &match=1
    )
  )
  else if (&wild_head==1)
  (
    if (STRING.MID("gcc_blsp2_qup1_spi_apps_clk", &clk_itr_length-&clk_input_length+1, &clk_input_length-1)==STRING.CUT("&clk", 1))
    ( 
      &match=1
    )
  )
  else if (&wild_tail==1)
  (
    if (STRING.MID("gcc_blsp2_qup1_spi_apps_clk", 0, &clk_input_length-1)==STRING.CUT("&clk", -1))
    ( 
      &match=1
    )
  )
  else if ("gcc_blsp2_qup1_spi_apps_clk"=="&clk")
  (
    &match=1
  )
  
  if (&match==1)
  (
    &clk_test=&CLK_TEST_GCC_BLSP2_QUP1_SPI_APPS_CLK
    &clk_reg=&HWIO_GCC_BLSP2_QUP1_SPI_APPS_CBCR_ADDR
    &clk_reg_name="GCC_BLSP2_QUP1_SPI_APPS_CBCR"
    &clk_name="gcc_blsp2_qup1_spi_apps_clk"
    &clk_reg_cbcr_type="sm_cbc"
    &clk_vote_bit=-1.
    &clk_multiplier=4.
    &clk_access_mode="&GCC_access_mode"

    gosub Print_Clk_Info_Line
  )

  &match=0
  &wild_head=0
  &wild_tail=0
  &clk_input_length=STRING.LENGTH("&clk")
  &clk_itr_length=STRING.LENGTH("gcc_blsp2_qup2_i2c_apps_clk")

  if (STRING.SCAN("&clk", "*", 0)==0)
  (
    &wild_head=1
  )
  if (STRING.SCAN("&clk", "*", 1)==(STRING.LENGTH("&clk")-1))
  (
    &wild_tail=1
  )

  if ((&wild_head==1)&&(&wild_tail==1))
  (
    if (STRING.SCAN("gcc_blsp2_qup2_i2c_apps_clk", STRING.MID("&clk", 1, &clk_input_length-2), 0)!=-1)
    ( 
      &match=1
    )
  )
  else if (&wild_head==1)
  (
    if (STRING.MID("gcc_blsp2_qup2_i2c_apps_clk", &clk_itr_length-&clk_input_length+1, &clk_input_length-1)==STRING.CUT("&clk", 1))
    ( 
      &match=1
    )
  )
  else if (&wild_tail==1)
  (
    if (STRING.MID("gcc_blsp2_qup2_i2c_apps_clk", 0, &clk_input_length-1)==STRING.CUT("&clk", -1))
    ( 
      &match=1
    )
  )
  else if ("gcc_blsp2_qup2_i2c_apps_clk"=="&clk")
  (
    &match=1
  )
  
  if (&match==1)
  (
    &clk_test=&CLK_TEST_GCC_BLSP2_QUP2_I2C_APPS_CLK
    &clk_reg=&HWIO_GCC_BLSP2_QUP2_I2C_APPS_CBCR_ADDR
    &clk_reg_name="GCC_BLSP2_QUP2_I2C_APPS_CBCR"
    &clk_name="gcc_blsp2_qup2_i2c_apps_clk"
    &clk_reg_cbcr_type="sm_cbc"
    &clk_vote_bit=-1.
    &clk_multiplier=4.
    &clk_access_mode="&GCC_access_mode"

    gosub Print_Clk_Info_Line
  )

  &match=0
  &wild_head=0
  &wild_tail=0
  &clk_input_length=STRING.LENGTH("&clk")
  &clk_itr_length=STRING.LENGTH("gcc_blsp2_qup2_spi_apps_clk")

  if (STRING.SCAN("&clk", "*", 0)==0)
  (
    &wild_head=1
  )
  if (STRING.SCAN("&clk", "*", 1)==(STRING.LENGTH("&clk")-1))
  (
    &wild_tail=1
  )

  if ((&wild_head==1)&&(&wild_tail==1))
  (
    if (STRING.SCAN("gcc_blsp2_qup2_spi_apps_clk", STRING.MID("&clk", 1, &clk_input_length-2), 0)!=-1)
    ( 
      &match=1
    )
  )
  else if (&wild_head==1)
  (
    if (STRING.MID("gcc_blsp2_qup2_spi_apps_clk", &clk_itr_length-&clk_input_length+1, &clk_input_length-1)==STRING.CUT("&clk", 1))
    ( 
      &match=1
    )
  )
  else if (&wild_tail==1)
  (
    if (STRING.MID("gcc_blsp2_qup2_spi_apps_clk", 0, &clk_input_length-1)==STRING.CUT("&clk", -1))
    ( 
      &match=1
    )
  )
  else if ("gcc_blsp2_qup2_spi_apps_clk"=="&clk")
  (
    &match=1
  )
  
  if (&match==1)
  (
    &clk_test=&CLK_TEST_GCC_BLSP2_QUP2_SPI_APPS_CLK
    &clk_reg=&HWIO_GCC_BLSP2_QUP2_SPI_APPS_CBCR_ADDR
    &clk_reg_name="GCC_BLSP2_QUP2_SPI_APPS_CBCR"
    &clk_name="gcc_blsp2_qup2_spi_apps_clk"
    &clk_reg_cbcr_type="sm_cbc"
    &clk_vote_bit=-1.
    &clk_multiplier=4.
    &clk_access_mode="&GCC_access_mode"

    gosub Print_Clk_Info_Line
  )

  &match=0
  &wild_head=0
  &wild_tail=0
  &clk_input_length=STRING.LENGTH("&clk")
  &clk_itr_length=STRING.LENGTH("gcc_blsp2_qup3_i2c_apps_clk")

  if (STRING.SCAN("&clk", "*", 0)==0)
  (
    &wild_head=1
  )
  if (STRING.SCAN("&clk", "*", 1)==(STRING.LENGTH("&clk")-1))
  (
    &wild_tail=1
  )

  if ((&wild_head==1)&&(&wild_tail==1))
  (
    if (STRING.SCAN("gcc_blsp2_qup3_i2c_apps_clk", STRING.MID("&clk", 1, &clk_input_length-2), 0)!=-1)
    ( 
      &match=1
    )
  )
  else if (&wild_head==1)
  (
    if (STRING.MID("gcc_blsp2_qup3_i2c_apps_clk", &clk_itr_length-&clk_input_length+1, &clk_input_length-1)==STRING.CUT("&clk", 1))
    ( 
      &match=1
    )
  )
  else if (&wild_tail==1)
  (
    if (STRING.MID("gcc_blsp2_qup3_i2c_apps_clk", 0, &clk_input_length-1)==STRING.CUT("&clk", -1))
    ( 
      &match=1
    )
  )
  else if ("gcc_blsp2_qup3_i2c_apps_clk"=="&clk")
  (
    &match=1
  )
  
  if (&match==1)
  (
    &clk_test=&CLK_TEST_GCC_BLSP2_QUP3_I2C_APPS_CLK
    &clk_reg=&HWIO_GCC_BLSP2_QUP3_I2C_APPS_CBCR_ADDR
    &clk_reg_name="GCC_BLSP2_QUP3_I2C_APPS_CBCR"
    &clk_name="gcc_blsp2_qup3_i2c_apps_clk"
    &clk_reg_cbcr_type="sm_cbc"
    &clk_vote_bit=-1.
    &clk_multiplier=4.
    &clk_access_mode="&GCC_access_mode"

    gosub Print_Clk_Info_Line
  )

  &match=0
  &wild_head=0
  &wild_tail=0
  &clk_input_length=STRING.LENGTH("&clk")
  &clk_itr_length=STRING.LENGTH("gcc_blsp2_qup3_spi_apps_clk")

  if (STRING.SCAN("&clk", "*", 0)==0)
  (
    &wild_head=1
  )
  if (STRING.SCAN("&clk", "*", 1)==(STRING.LENGTH("&clk")-1))
  (
    &wild_tail=1
  )

  if ((&wild_head==1)&&(&wild_tail==1))
  (
    if (STRING.SCAN("gcc_blsp2_qup3_spi_apps_clk", STRING.MID("&clk", 1, &clk_input_length-2), 0)!=-1)
    ( 
      &match=1
    )
  )
  else if (&wild_head==1)
  (
    if (STRING.MID("gcc_blsp2_qup3_spi_apps_clk", &clk_itr_length-&clk_input_length+1, &clk_input_length-1)==STRING.CUT("&clk", 1))
    ( 
      &match=1
    )
  )
  else if (&wild_tail==1)
  (
    if (STRING.MID("gcc_blsp2_qup3_spi_apps_clk", 0, &clk_input_length-1)==STRING.CUT("&clk", -1))
    ( 
      &match=1
    )
  )
  else if ("gcc_blsp2_qup3_spi_apps_clk"=="&clk")
  (
    &match=1
  )
  
  if (&match==1)
  (
    &clk_test=&CLK_TEST_GCC_BLSP2_QUP3_SPI_APPS_CLK
    &clk_reg=&HWIO_GCC_BLSP2_QUP3_SPI_APPS_CBCR_ADDR
    &clk_reg_name="GCC_BLSP2_QUP3_SPI_APPS_CBCR"
    &clk_name="gcc_blsp2_qup3_spi_apps_clk"
    &clk_reg_cbcr_type="sm_cbc"
    &clk_vote_bit=-1.
    &clk_multiplier=4.
    &clk_access_mode="&GCC_access_mode"

    gosub Print_Clk_Info_Line
  )

  &match=0
  &wild_head=0
  &wild_tail=0
  &clk_input_length=STRING.LENGTH("&clk")
  &clk_itr_length=STRING.LENGTH("gcc_blsp2_qup4_i2c_apps_clk")

  if (STRING.SCAN("&clk", "*", 0)==0)
  (
    &wild_head=1
  )
  if (STRING.SCAN("&clk", "*", 1)==(STRING.LENGTH("&clk")-1))
  (
    &wild_tail=1
  )

  if ((&wild_head==1)&&(&wild_tail==1))
  (
    if (STRING.SCAN("gcc_blsp2_qup4_i2c_apps_clk", STRING.MID("&clk", 1, &clk_input_length-2), 0)!=-1)
    ( 
      &match=1
    )
  )
  else if (&wild_head==1)
  (
    if (STRING.MID("gcc_blsp2_qup4_i2c_apps_clk", &clk_itr_length-&clk_input_length+1, &clk_input_length-1)==STRING.CUT("&clk", 1))
    ( 
      &match=1
    )
  )
  else if (&wild_tail==1)
  (
    if (STRING.MID("gcc_blsp2_qup4_i2c_apps_clk", 0, &clk_input_length-1)==STRING.CUT("&clk", -1))
    ( 
      &match=1
    )
  )
  else if ("gcc_blsp2_qup4_i2c_apps_clk"=="&clk")
  (
    &match=1
  )
  
  if (&match==1)
  (
    &clk_test=&CLK_TEST_GCC_BLSP2_QUP4_I2C_APPS_CLK
    &clk_reg=&HWIO_GCC_BLSP2_QUP4_I2C_APPS_CBCR_ADDR
    &clk_reg_name="GCC_BLSP2_QUP4_I2C_APPS_CBCR"
    &clk_name="gcc_blsp2_qup4_i2c_apps_clk"
    &clk_reg_cbcr_type="sm_cbc"
    &clk_vote_bit=-1.
    &clk_multiplier=4.
    &clk_access_mode="&GCC_access_mode"

    gosub Print_Clk_Info_Line
  )

  &match=0
  &wild_head=0
  &wild_tail=0
  &clk_input_length=STRING.LENGTH("&clk")
  &clk_itr_length=STRING.LENGTH("gcc_blsp2_qup4_spi_apps_clk")

  if (STRING.SCAN("&clk", "*", 0)==0)
  (
    &wild_head=1
  )
  if (STRING.SCAN("&clk", "*", 1)==(STRING.LENGTH("&clk")-1))
  (
    &wild_tail=1
  )

  if ((&wild_head==1)&&(&wild_tail==1))
  (
    if (STRING.SCAN("gcc_blsp2_qup4_spi_apps_clk", STRING.MID("&clk", 1, &clk_input_length-2), 0)!=-1)
    ( 
      &match=1
    )
  )
  else if (&wild_head==1)
  (
    if (STRING.MID("gcc_blsp2_qup4_spi_apps_clk", &clk_itr_length-&clk_input_length+1, &clk_input_length-1)==STRING.CUT("&clk", 1))
    ( 
      &match=1
    )
  )
  else if (&wild_tail==1)
  (
    if (STRING.MID("gcc_blsp2_qup4_spi_apps_clk", 0, &clk_input_length-1)==STRING.CUT("&clk", -1))
    ( 
      &match=1
    )
  )
  else if ("gcc_blsp2_qup4_spi_apps_clk"=="&clk")
  (
    &match=1
  )
  
  if (&match==1)
  (
    &clk_test=&CLK_TEST_GCC_BLSP2_QUP4_SPI_APPS_CLK
    &clk_reg=&HWIO_GCC_BLSP2_QUP4_SPI_APPS_CBCR_ADDR
    &clk_reg_name="GCC_BLSP2_QUP4_SPI_APPS_CBCR"
    &clk_name="gcc_blsp2_qup4_spi_apps_clk"
    &clk_reg_cbcr_type="sm_cbc"
    &clk_vote_bit=-1.
    &clk_multiplier=4.
    &clk_access_mode="&GCC_access_mode"

    gosub Print_Clk_Info_Line
  )

  &match=0
  &wild_head=0
  &wild_tail=0
  &clk_input_length=STRING.LENGTH("&clk")
  &clk_itr_length=STRING.LENGTH("gcc_blsp2_uart1_apps_clk")

  if (STRING.SCAN("&clk", "*", 0)==0)
  (
    &wild_head=1
  )
  if (STRING.SCAN("&clk", "*", 1)==(STRING.LENGTH("&clk")-1))
  (
    &wild_tail=1
  )

  if ((&wild_head==1)&&(&wild_tail==1))
  (
    if (STRING.SCAN("gcc_blsp2_uart1_apps_clk", STRING.MID("&clk", 1, &clk_input_length-2), 0)!=-1)
    ( 
      &match=1
    )
  )
  else if (&wild_head==1)
  (
    if (STRING.MID("gcc_blsp2_uart1_apps_clk", &clk_itr_length-&clk_input_length+1, &clk_input_length-1)==STRING.CUT("&clk", 1))
    ( 
      &match=1
    )
  )
  else if (&wild_tail==1)
  (
    if (STRING.MID("gcc_blsp2_uart1_apps_clk", 0, &clk_input_length-1)==STRING.CUT("&clk", -1))
    ( 
      &match=1
    )
  )
  else if ("gcc_blsp2_uart1_apps_clk"=="&clk")
  (
    &match=1
  )
  
  if (&match==1)
  (
    &clk_test=&CLK_TEST_GCC_BLSP2_UART1_APPS_CLK
    &clk_reg=&HWIO_GCC_BLSP2_UART1_APPS_CBCR_ADDR
    &clk_reg_name="GCC_BLSP2_UART1_APPS_CBCR"
    &clk_name="gcc_blsp2_uart1_apps_clk"
    &clk_reg_cbcr_type="sm_cbc"
    &clk_vote_bit=-1.
    &clk_multiplier=4.
    &clk_access_mode="&GCC_access_mode"

    gosub Print_Clk_Info_Line
  )

  &match=0
  &wild_head=0
  &wild_tail=0
  &clk_input_length=STRING.LENGTH("&clk")
  &clk_itr_length=STRING.LENGTH("gcc_blsp2_uart2_apps_clk")

  if (STRING.SCAN("&clk", "*", 0)==0)
  (
    &wild_head=1
  )
  if (STRING.SCAN("&clk", "*", 1)==(STRING.LENGTH("&clk")-1))
  (
    &wild_tail=1
  )

  if ((&wild_head==1)&&(&wild_tail==1))
  (
    if (STRING.SCAN("gcc_blsp2_uart2_apps_clk", STRING.MID("&clk", 1, &clk_input_length-2), 0)!=-1)
    ( 
      &match=1
    )
  )
  else if (&wild_head==1)
  (
    if (STRING.MID("gcc_blsp2_uart2_apps_clk", &clk_itr_length-&clk_input_length+1, &clk_input_length-1)==STRING.CUT("&clk", 1))
    ( 
      &match=1
    )
  )
  else if (&wild_tail==1)
  (
    if (STRING.MID("gcc_blsp2_uart2_apps_clk", 0, &clk_input_length-1)==STRING.CUT("&clk", -1))
    ( 
      &match=1
    )
  )
  else if ("gcc_blsp2_uart2_apps_clk"=="&clk")
  (
    &match=1
  )
  
  if (&match==1)
  (
    &clk_test=&CLK_TEST_GCC_BLSP2_UART2_APPS_CLK
    &clk_reg=&HWIO_GCC_BLSP2_UART2_APPS_CBCR_ADDR
    &clk_reg_name="GCC_BLSP2_UART2_APPS_CBCR"
    &clk_name="gcc_blsp2_uart2_apps_clk"
    &clk_reg_cbcr_type="sm_cbc"
    &clk_vote_bit=-1.
    &clk_multiplier=4.
    &clk_access_mode="&GCC_access_mode"

    gosub Print_Clk_Info_Line
  )

  &match=0
  &wild_head=0
  &wild_tail=0
  &clk_input_length=STRING.LENGTH("&clk")
  &clk_itr_length=STRING.LENGTH("gcc_blsp1_uart1_sim_clk")

  if (STRING.SCAN("&clk", "*", 0)==0)
  (
    &wild_head=1
  )
  if (STRING.SCAN("&clk", "*", 1)==(STRING.LENGTH("&clk")-1))
  (
    &wild_tail=1
  )

  if ((&wild_head==1)&&(&wild_tail==1))
  (
    if (STRING.SCAN("gcc_blsp1_uart1_sim_clk", STRING.MID("&clk", 1, &clk_input_length-2), 0)!=-1)
    ( 
      &match=1
    )
  )
  else if (&wild_head==1)
  (
    if (STRING.MID("gcc_blsp1_uart1_sim_clk", &clk_itr_length-&clk_input_length+1, &clk_input_length-1)==STRING.CUT("&clk", 1))
    ( 
      &match=1
    )
  )
  else if (&wild_tail==1)
  (
    if (STRING.MID("gcc_blsp1_uart1_sim_clk", 0, &clk_input_length-1)==STRING.CUT("&clk", -1))
    ( 
      &match=1
    )
  )
  else if ("gcc_blsp1_uart1_sim_clk"=="&clk")
  (
    &match=1
  )
  
  if (&match==1)
  (
    &clk_test=&CLK_TEST_GCC_BLSP1_UART1_SIM_CLK
    &clk_reg=&HWIO_GCC_BLSP1_UART1_SIM_CBCR_ADDR
    &clk_reg_name="GCC_BLSP1_UART1_SIM_CBCR"
    &clk_name="gcc_blsp1_uart1_sim_clk"
    &clk_reg_cbcr_type="sm_cbc"
    &clk_vote_bit=-1.
    &clk_multiplier=4.
    &clk_access_mode="&GCC_access_mode"

    gosub Print_Clk_Info_Line
  )

  &match=0
  &wild_head=0
  &wild_tail=0
  &clk_input_length=STRING.LENGTH("&clk")
  &clk_itr_length=STRING.LENGTH("gcc_blsp1_uart2_sim_clk")

  if (STRING.SCAN("&clk", "*", 0)==0)
  (
    &wild_head=1
  )
  if (STRING.SCAN("&clk", "*", 1)==(STRING.LENGTH("&clk")-1))
  (
    &wild_tail=1
  )

  if ((&wild_head==1)&&(&wild_tail==1))
  (
    if (STRING.SCAN("gcc_blsp1_uart2_sim_clk", STRING.MID("&clk", 1, &clk_input_length-2), 0)!=-1)
    ( 
      &match=1
    )
  )
  else if (&wild_head==1)
  (
    if (STRING.MID("gcc_blsp1_uart2_sim_clk", &clk_itr_length-&clk_input_length+1, &clk_input_length-1)==STRING.CUT("&clk", 1))
    ( 
      &match=1
    )
  )
  else if (&wild_tail==1)
  (
    if (STRING.MID("gcc_blsp1_uart2_sim_clk", 0, &clk_input_length-1)==STRING.CUT("&clk", -1))
    ( 
      &match=1
    )
  )
  else if ("gcc_blsp1_uart2_sim_clk"=="&clk")
  (
    &match=1
  )
  
  if (&match==1)
  (
    &clk_test=&CLK_TEST_GCC_BLSP1_UART2_SIM_CLK
    &clk_reg=&HWIO_GCC_BLSP1_UART2_SIM_CBCR_ADDR
    &clk_reg_name="GCC_BLSP1_UART2_SIM_CBCR"
    &clk_name="gcc_blsp1_uart2_sim_clk"
    &clk_reg_cbcr_type="sm_cbc"
    &clk_vote_bit=-1.
    &clk_multiplier=4.
    &clk_access_mode="&GCC_access_mode"

    gosub Print_Clk_Info_Line
  )

  &match=0
  &wild_head=0
  &wild_tail=0
  &clk_input_length=STRING.LENGTH("&clk")
  &clk_itr_length=STRING.LENGTH("gcc_blsp2_uart1_sim_clk")

  if (STRING.SCAN("&clk", "*", 0)==0)
  (
    &wild_head=1
  )
  if (STRING.SCAN("&clk", "*", 1)==(STRING.LENGTH("&clk")-1))
  (
    &wild_tail=1
  )

  if ((&wild_head==1)&&(&wild_tail==1))
  (
    if (STRING.SCAN("gcc_blsp2_uart1_sim_clk", STRING.MID("&clk", 1, &clk_input_length-2), 0)!=-1)
    ( 
      &match=1
    )
  )
  else if (&wild_head==1)
  (
    if (STRING.MID("gcc_blsp2_uart1_sim_clk", &clk_itr_length-&clk_input_length+1, &clk_input_length-1)==STRING.CUT("&clk", 1))
    ( 
      &match=1
    )
  )
  else if (&wild_tail==1)
  (
    if (STRING.MID("gcc_blsp2_uart1_sim_clk", 0, &clk_input_length-1)==STRING.CUT("&clk", -1))
    ( 
      &match=1
    )
  )
  else if ("gcc_blsp2_uart1_sim_clk"=="&clk")
  (
    &match=1
  )
  
  if (&match==1)
  (
    &clk_test=&CLK_TEST_GCC_BLSP2_UART1_SIM_CLK
    &clk_reg=&HWIO_GCC_BLSP2_UART1_SIM_CBCR_ADDR
    &clk_reg_name="GCC_BLSP2_UART1_SIM_CBCR"
    &clk_name="gcc_blsp2_uart1_sim_clk"
    &clk_reg_cbcr_type="sm_cbc"
    &clk_vote_bit=-1.
    &clk_multiplier=4.
    &clk_access_mode="&GCC_access_mode"

    gosub Print_Clk_Info_Line
  )

  &match=0
  &wild_head=0
  &wild_tail=0
  &clk_input_length=STRING.LENGTH("&clk")
  &clk_itr_length=STRING.LENGTH("gcc_blsp2_uart2_sim_clk")

  if (STRING.SCAN("&clk", "*", 0)==0)
  (
    &wild_head=1
  )
  if (STRING.SCAN("&clk", "*", 1)==(STRING.LENGTH("&clk")-1))
  (
    &wild_tail=1
  )

  if ((&wild_head==1)&&(&wild_tail==1))
  (
    if (STRING.SCAN("gcc_blsp2_uart2_sim_clk", STRING.MID("&clk", 1, &clk_input_length-2), 0)!=-1)
    ( 
      &match=1
    )
  )
  else if (&wild_head==1)
  (
    if (STRING.MID("gcc_blsp2_uart2_sim_clk", &clk_itr_length-&clk_input_length+1, &clk_input_length-1)==STRING.CUT("&clk", 1))
    ( 
      &match=1
    )
  )
  else if (&wild_tail==1)
  (
    if (STRING.MID("gcc_blsp2_uart2_sim_clk", 0, &clk_input_length-1)==STRING.CUT("&clk", -1))
    ( 
      &match=1
    )
  )
  else if ("gcc_blsp2_uart2_sim_clk"=="&clk")
  (
    &match=1
  )
  
  if (&match==1)
  (
    &clk_test=&CLK_TEST_GCC_BLSP2_UART2_SIM_CLK
    &clk_reg=&HWIO_GCC_BLSP2_UART2_SIM_CBCR_ADDR
    &clk_reg_name="GCC_BLSP2_UART2_SIM_CBCR"
    &clk_name="gcc_blsp2_uart2_sim_clk"
    &clk_reg_cbcr_type="sm_cbc"
    &clk_vote_bit=-1.
    &clk_multiplier=4.
    &clk_access_mode="&GCC_access_mode"

    gosub Print_Clk_Info_Line
  )

  &match=0
  &wild_head=0
  &wild_tail=0
  &clk_input_length=STRING.LENGTH("&clk")
  &clk_itr_length=STRING.LENGTH("gcc_cdsp_bimc_clk")

  if (STRING.SCAN("&clk", "*", 0)==0)
  (
    &wild_head=1
  )
  if (STRING.SCAN("&clk", "*", 1)==(STRING.LENGTH("&clk")-1))
  (
    &wild_tail=1
  )

  if ((&wild_head==1)&&(&wild_tail==1))
  (
    if (STRING.SCAN("gcc_cdsp_bimc_clk", STRING.MID("&clk", 1, &clk_input_length-2), 0)!=-1)
    ( 
      &match=1
    )
  )
  else if (&wild_head==1)
  (
    if (STRING.MID("gcc_cdsp_bimc_clk", &clk_itr_length-&clk_input_length+1, &clk_input_length-1)==STRING.CUT("&clk", 1))
    ( 
      &match=1
    )
  )
  else if (&wild_tail==1)
  (
    if (STRING.MID("gcc_cdsp_bimc_clk", 0, &clk_input_length-1)==STRING.CUT("&clk", -1))
    ( 
      &match=1
    )
  )
  else if ("gcc_cdsp_bimc_clk"=="&clk")
  (
    &match=1
  )
  
  if (&match==1)
  (
    &clk_test=&CLK_TEST_GCC_CDSP_BIMC_CLK
    &clk_reg=&HWIO_GCC_CDSP_BIMC_CBCR_ADDR
    &clk_reg_name="GCC_CDSP_BIMC_CBCR"
    &clk_name="gcc_cdsp_bimc_clk"
    &clk_reg_cbcr_type="sm_cbc"
    &clk_vote_bit=-1.
    &clk_multiplier=4.
    &clk_access_mode="&GCC_access_mode"

    gosub Print_Clk_Info_Line
  )

  &match=0
  &wild_head=0
  &wild_tail=0
  &clk_input_length=STRING.LENGTH("&clk")
  &clk_itr_length=STRING.LENGTH("gcc_sys_noc_cdsp_clk")

  if (STRING.SCAN("&clk", "*", 0)==0)
  (
    &wild_head=1
  )
  if (STRING.SCAN("&clk", "*", 1)==(STRING.LENGTH("&clk")-1))
  (
    &wild_tail=1
  )

  if ((&wild_head==1)&&(&wild_tail==1))
  (
    if (STRING.SCAN("gcc_sys_noc_cdsp_clk", STRING.MID("&clk", 1, &clk_input_length-2), 0)!=-1)
    ( 
      &match=1
    )
  )
  else if (&wild_head==1)
  (
    if (STRING.MID("gcc_sys_noc_cdsp_clk", &clk_itr_length-&clk_input_length+1, &clk_input_length-1)==STRING.CUT("&clk", 1))
    ( 
      &match=1
    )
  )
  else if (&wild_tail==1)
  (
    if (STRING.MID("gcc_sys_noc_cdsp_clk", 0, &clk_input_length-1)==STRING.CUT("&clk", -1))
    ( 
      &match=1
    )
  )
  else if ("gcc_sys_noc_cdsp_clk"=="&clk")
  (
    &match=1
  )
  
  if (&match==1)
  (
    &clk_test=&CLK_TEST_GCC_SYS_NOC_CDSP_CLK
    &clk_reg=&HWIO_GCC_SYS_NOC_CDSP_CBCR_ADDR
    &clk_reg_name="GCC_SYS_NOC_CDSP_CBCR"
    &clk_name="gcc_sys_noc_cdsp_clk"
    &clk_reg_cbcr_type="sm_cbc"
    &clk_vote_bit=-1.
    &clk_multiplier=4.
    &clk_access_mode="&GCC_access_mode"

    gosub Print_Clk_Info_Line
  )

  &match=0
  &wild_head=0
  &wild_tail=0
  &clk_input_length=STRING.LENGTH("&clk")
  &clk_itr_length=STRING.LENGTH("gcc_turing_q6_axi_clk")

  if (STRING.SCAN("&clk", "*", 0)==0)
  (
    &wild_head=1
  )
  if (STRING.SCAN("&clk", "*", 1)==(STRING.LENGTH("&clk")-1))
  (
    &wild_tail=1
  )

  if ((&wild_head==1)&&(&wild_tail==1))
  (
    if (STRING.SCAN("gcc_turing_q6_axi_clk", STRING.MID("&clk", 1, &clk_input_length-2), 0)!=-1)
    ( 
      &match=1
    )
  )
  else if (&wild_head==1)
  (
    if (STRING.MID("gcc_turing_q6_axi_clk", &clk_itr_length-&clk_input_length+1, &clk_input_length-1)==STRING.CUT("&clk", 1))
    ( 
      &match=1
    )
  )
  else if (&wild_tail==1)
  (
    if (STRING.MID("gcc_turing_q6_axi_clk", 0, &clk_input_length-1)==STRING.CUT("&clk", -1))
    ( 
      &match=1
    )
  )
  else if ("gcc_turing_q6_axi_clk"=="&clk")
  (
    &match=1
  )
  
  if (&match==1)
  (
    &clk_test=&CLK_TEST_GCC_TURING_Q6_AXI_CLK
    &clk_reg=&HWIO_GCC_TURING_Q6_AXI_CBCR_ADDR
    &clk_reg_name="GCC_TURING_Q6_AXI_CBCR"
    &clk_name="gcc_turing_q6_axi_clk"
    &clk_reg_cbcr_type="sm_cbc"
    &clk_vote_bit=-1.
    &clk_multiplier=4.
    &clk_access_mode="&GCC_access_mode"

    gosub Print_Clk_Info_Line
  )

  &match=0
  &wild_head=0
  &wild_tail=0
  &clk_input_length=STRING.LENGTH("&clk")
  &clk_itr_length=STRING.LENGTH("gcc_turing_q6_smmu_axi_clk")

  if (STRING.SCAN("&clk", "*", 0)==0)
  (
    &wild_head=1
  )
  if (STRING.SCAN("&clk", "*", 1)==(STRING.LENGTH("&clk")-1))
  (
    &wild_tail=1
  )

  if ((&wild_head==1)&&(&wild_tail==1))
  (
    if (STRING.SCAN("gcc_turing_q6_smmu_axi_clk", STRING.MID("&clk", 1, &clk_input_length-2), 0)!=-1)
    ( 
      &match=1
    )
  )
  else if (&wild_head==1)
  (
    if (STRING.MID("gcc_turing_q6_smmu_axi_clk", &clk_itr_length-&clk_input_length+1, &clk_input_length-1)==STRING.CUT("&clk", 1))
    ( 
      &match=1
    )
  )
  else if (&wild_tail==1)
  (
    if (STRING.MID("gcc_turing_q6_smmu_axi_clk", 0, &clk_input_length-1)==STRING.CUT("&clk", -1))
    ( 
      &match=1
    )
  )
  else if ("gcc_turing_q6_smmu_axi_clk"=="&clk")
  (
    &match=1
  )
  
  if (&match==1)
  (
    &clk_test=&CLK_TEST_GCC_TURING_Q6_SMMU_AXI_CLK
    &clk_reg=&HWIO_GCC_TURING_Q6_SMMU_AXI_CBCR_ADDR
    &clk_reg_name="GCC_TURING_Q6_SMMU_AXI_CBCR"
    &clk_name="gcc_turing_q6_smmu_axi_clk"
    &clk_reg_cbcr_type="sm_cbc"
    &clk_vote_bit=-1.
    &clk_multiplier=4.
    &clk_access_mode="&GCC_access_mode"

    gosub Print_Clk_Info_Line
  )

  &match=0
  &wild_head=0
  &wild_tail=0
  &clk_input_length=STRING.LENGTH("&clk")
  &clk_itr_length=STRING.LENGTH("gcc_turing_q6_smmu_axi_src_clk")

  if (STRING.SCAN("&clk", "*", 0)==0)
  (
    &wild_head=1
  )
  if (STRING.SCAN("&clk", "*", 1)==(STRING.LENGTH("&clk")-1))
  (
    &wild_tail=1
  )

  if ((&wild_head==1)&&(&wild_tail==1))
  (
    if (STRING.SCAN("gcc_turing_q6_smmu_axi_src_clk", STRING.MID("&clk", 1, &clk_input_length-2), 0)!=-1)
    ( 
      &match=1
    )
  )
  else if (&wild_head==1)
  (
    if (STRING.MID("gcc_turing_q6_smmu_axi_src_clk", &clk_itr_length-&clk_input_length+1, &clk_input_length-1)==STRING.CUT("&clk", 1))
    ( 
      &match=1
    )
  )
  else if (&wild_tail==1)
  (
    if (STRING.MID("gcc_turing_q6_smmu_axi_src_clk", 0, &clk_input_length-1)==STRING.CUT("&clk", -1))
    ( 
      &match=1
    )
  )
  else if ("gcc_turing_q6_smmu_axi_src_clk"=="&clk")
  (
    &match=1
  )
  
  if (&match==1)
  (
    &clk_test=&CLK_TEST_GCC_TURING_Q6_SMMU_AXI_SRC_CLK
    &clk_reg=&HWIO_GCC_TURING_Q6_SMMU_AXI_SRC_CBCR_ADDR
    &clk_reg_name="GCC_TURING_Q6_SMMU_AXI_SRC_CBCR"
    &clk_name="gcc_turing_q6_smmu_axi_src_clk"
    &clk_reg_cbcr_type="sm_pscbc"
    &clk_vote_bit=-1.
    &clk_multiplier=4.
    &clk_access_mode="&GCC_access_mode"

    gosub Print_Clk_Info_Line
  )

  &match=0
  &wild_head=0
  &wild_tail=0
  &clk_input_length=STRING.LENGTH("&clk")
  &clk_itr_length=STRING.LENGTH("gcc_ce1_clk")

  if (STRING.SCAN("&clk", "*", 0)==0)
  (
    &wild_head=1
  )
  if (STRING.SCAN("&clk", "*", 1)==(STRING.LENGTH("&clk")-1))
  (
    &wild_tail=1
  )

  if ((&wild_head==1)&&(&wild_tail==1))
  (
    if (STRING.SCAN("gcc_ce1_clk", STRING.MID("&clk", 1, &clk_input_length-2), 0)!=-1)
    ( 
      &match=1
    )
  )
  else if (&wild_head==1)
  (
    if (STRING.MID("gcc_ce1_clk", &clk_itr_length-&clk_input_length+1, &clk_input_length-1)==STRING.CUT("&clk", 1))
    ( 
      &match=1
    )
  )
  else if (&wild_tail==1)
  (
    if (STRING.MID("gcc_ce1_clk", 0, &clk_input_length-1)==STRING.CUT("&clk", -1))
    ( 
      &match=1
    )
  )
  else if ("gcc_ce1_clk"=="&clk")
  (
    &match=1
  )
  
  if (&match==1)
  (
    &clk_test=&CLK_TEST_GCC_CE1_CLK
    &clk_reg=&HWIO_GCC_CE1_CBCR_ADDR
    &clk_reg_name="GCC_CE1_CBCR"
    &clk_name="gcc_ce1_clk"
    &clk_reg_cbcr_type="sm_pscbc"
    &clk_vote_bit=5.
    &clk_multiplier=4.
    &clk_access_mode="&GCC_access_mode"

    gosub Print_Clk_Info_Line
  )

  &match=0
  &wild_head=0
  &wild_tail=0
  &clk_input_length=STRING.LENGTH("&clk")
  &clk_itr_length=STRING.LENGTH("gcc_aggre2_cnoc_north_periph_ahb_clk")

  if (STRING.SCAN("&clk", "*", 0)==0)
  (
    &wild_head=1
  )
  if (STRING.SCAN("&clk", "*", 1)==(STRING.LENGTH("&clk")-1))
  (
    &wild_tail=1
  )

  if ((&wild_head==1)&&(&wild_tail==1))
  (
    if (STRING.SCAN("gcc_aggre2_cnoc_north_periph_ahb_clk", STRING.MID("&clk", 1, &clk_input_length-2), 0)!=-1)
    ( 
      &match=1
    )
  )
  else if (&wild_head==1)
  (
    if (STRING.MID("gcc_aggre2_cnoc_north_periph_ahb_clk", &clk_itr_length-&clk_input_length+1, &clk_input_length-1)==STRING.CUT("&clk", 1))
    ( 
      &match=1
    )
  )
  else if (&wild_tail==1)
  (
    if (STRING.MID("gcc_aggre2_cnoc_north_periph_ahb_clk", 0, &clk_input_length-1)==STRING.CUT("&clk", -1))
    ( 
      &match=1
    )
  )
  else if ("gcc_aggre2_cnoc_north_periph_ahb_clk"=="&clk")
  (
    &match=1
  )
  
  if (&match==1)
  (
    &clk_test=&CLK_TEST_GCC_AGGRE2_CNOC_NORTH_PERIPH_AHB_CLK
    &clk_reg=&HWIO_GCC_AGGRE2_CNOC_NORTH_PERIPH_AHB_CBCR_ADDR
    &clk_reg_name="GCC_AGGRE2_CNOC_NORTH_PERIPH_AHB_CBCR"
    &clk_name="gcc_aggre2_cnoc_north_periph_ahb_clk"
    &clk_reg_cbcr_type="sm_cbc"
    &clk_vote_bit=-1.
    &clk_multiplier=4.
    &clk_access_mode="&GCC_access_mode"

    gosub Print_Clk_Info_Line
  )

  &match=0
  &wild_head=0
  &wild_tail=0
  &clk_input_length=STRING.LENGTH("&clk")
  &clk_itr_length=STRING.LENGTH("gcc_aggre2_cnoc_periph_ahb_clk")

  if (STRING.SCAN("&clk", "*", 0)==0)
  (
    &wild_head=1
  )
  if (STRING.SCAN("&clk", "*", 1)==(STRING.LENGTH("&clk")-1))
  (
    &wild_tail=1
  )

  if ((&wild_head==1)&&(&wild_tail==1))
  (
    if (STRING.SCAN("gcc_aggre2_cnoc_periph_ahb_clk", STRING.MID("&clk", 1, &clk_input_length-2), 0)!=-1)
    ( 
      &match=1
    )
  )
  else if (&wild_head==1)
  (
    if (STRING.MID("gcc_aggre2_cnoc_periph_ahb_clk", &clk_itr_length-&clk_input_length+1, &clk_input_length-1)==STRING.CUT("&clk", 1))
    ( 
      &match=1
    )
  )
  else if (&wild_tail==1)
  (
    if (STRING.MID("gcc_aggre2_cnoc_periph_ahb_clk", 0, &clk_input_length-1)==STRING.CUT("&clk", -1))
    ( 
      &match=1
    )
  )
  else if ("gcc_aggre2_cnoc_periph_ahb_clk"=="&clk")
  (
    &match=1
  )
  
  if (&match==1)
  (
    &clk_test=&CLK_TEST_GCC_AGGRE2_CNOC_PERIPH_AHB_CLK
    &clk_reg=&HWIO_GCC_AGGRE2_CNOC_PERIPH_AHB_CBCR_ADDR
    &clk_reg_name="GCC_AGGRE2_CNOC_PERIPH_AHB_CBCR"
    &clk_name="gcc_aggre2_cnoc_periph_ahb_clk"
    &clk_reg_cbcr_type="sm_cbc"
    &clk_vote_bit=-1.
    &clk_multiplier=4.
    &clk_access_mode="&GCC_access_mode"

    gosub Print_Clk_Info_Line
  )

  &match=0
  &wild_head=0
  &wild_tail=0
  &clk_input_length=STRING.LENGTH("&clk")
  &clk_itr_length=STRING.LENGTH("gcc_aggre2_cnoc_south_periph_ahb_clk")

  if (STRING.SCAN("&clk", "*", 0)==0)
  (
    &wild_head=1
  )
  if (STRING.SCAN("&clk", "*", 1)==(STRING.LENGTH("&clk")-1))
  (
    &wild_tail=1
  )

  if ((&wild_head==1)&&(&wild_tail==1))
  (
    if (STRING.SCAN("gcc_aggre2_cnoc_south_periph_ahb_clk", STRING.MID("&clk", 1, &clk_input_length-2), 0)!=-1)
    ( 
      &match=1
    )
  )
  else if (&wild_head==1)
  (
    if (STRING.MID("gcc_aggre2_cnoc_south_periph_ahb_clk", &clk_itr_length-&clk_input_length+1, &clk_input_length-1)==STRING.CUT("&clk", 1))
    ( 
      &match=1
    )
  )
  else if (&wild_tail==1)
  (
    if (STRING.MID("gcc_aggre2_cnoc_south_periph_ahb_clk", 0, &clk_input_length-1)==STRING.CUT("&clk", -1))
    ( 
      &match=1
    )
  )
  else if ("gcc_aggre2_cnoc_south_periph_ahb_clk"=="&clk")
  (
    &match=1
  )
  
  if (&match==1)
  (
    &clk_test=&CLK_TEST_GCC_AGGRE2_CNOC_SOUTH_PERIPH_AHB_CLK
    &clk_reg=&HWIO_GCC_AGGRE2_CNOC_SOUTH_PERIPH_AHB_CBCR_ADDR
    &clk_reg_name="GCC_AGGRE2_CNOC_SOUTH_PERIPH_AHB_CBCR"
    &clk_name="gcc_aggre2_cnoc_south_periph_ahb_clk"
    &clk_reg_cbcr_type="sm_cbc"
    &clk_vote_bit=-1.
    &clk_multiplier=4.
    &clk_access_mode="&GCC_access_mode"

    gosub Print_Clk_Info_Line
  )

  &match=0
  &wild_head=0
  &wild_tail=0
  &clk_input_length=STRING.LENGTH("&clk")
  &clk_itr_length=STRING.LENGTH("gcc_blsp1_ahb_clk")

  if (STRING.SCAN("&clk", "*", 0)==0)
  (
    &wild_head=1
  )
  if (STRING.SCAN("&clk", "*", 1)==(STRING.LENGTH("&clk")-1))
  (
    &wild_tail=1
  )

  if ((&wild_head==1)&&(&wild_tail==1))
  (
    if (STRING.SCAN("gcc_blsp1_ahb_clk", STRING.MID("&clk", 1, &clk_input_length-2), 0)!=-1)
    ( 
      &match=1
    )
  )
  else if (&wild_head==1)
  (
    if (STRING.MID("gcc_blsp1_ahb_clk", &clk_itr_length-&clk_input_length+1, &clk_input_length-1)==STRING.CUT("&clk", 1))
    ( 
      &match=1
    )
  )
  else if (&wild_tail==1)
  (
    if (STRING.MID("gcc_blsp1_ahb_clk", 0, &clk_input_length-1)==STRING.CUT("&clk", -1))
    ( 
      &match=1
    )
  )
  else if ("gcc_blsp1_ahb_clk"=="&clk")
  (
    &match=1
  )
  
  if (&match==1)
  (
    &clk_test=&CLK_TEST_GCC_BLSP1_AHB_CLK
    &clk_reg=&HWIO_GCC_BLSP1_AHB_CBCR_ADDR
    &clk_reg_name="GCC_BLSP1_AHB_CBCR"
    &clk_name="gcc_blsp1_ahb_clk"
    &clk_reg_cbcr_type="sm_pscbc"
    &clk_vote_bit=17.
    &clk_multiplier=4.
    &clk_access_mode="&GCC_access_mode"

    gosub Print_Clk_Info_Line
  )

  &match=0
  &wild_head=0
  &wild_tail=0
  &clk_input_length=STRING.LENGTH("&clk")
  &clk_itr_length=STRING.LENGTH("gcc_blsp2_ahb_clk")

  if (STRING.SCAN("&clk", "*", 0)==0)
  (
    &wild_head=1
  )
  if (STRING.SCAN("&clk", "*", 1)==(STRING.LENGTH("&clk")-1))
  (
    &wild_tail=1
  )

  if ((&wild_head==1)&&(&wild_tail==1))
  (
    if (STRING.SCAN("gcc_blsp2_ahb_clk", STRING.MID("&clk", 1, &clk_input_length-2), 0)!=-1)
    ( 
      &match=1
    )
  )
  else if (&wild_head==1)
  (
    if (STRING.MID("gcc_blsp2_ahb_clk", &clk_itr_length-&clk_input_length+1, &clk_input_length-1)==STRING.CUT("&clk", 1))
    ( 
      &match=1
    )
  )
  else if (&wild_tail==1)
  (
    if (STRING.MID("gcc_blsp2_ahb_clk", 0, &clk_input_length-1)==STRING.CUT("&clk", -1))
    ( 
      &match=1
    )
  )
  else if ("gcc_blsp2_ahb_clk"=="&clk")
  (
    &match=1
  )
  
  if (&match==1)
  (
    &clk_test=&CLK_TEST_GCC_BLSP2_AHB_CLK
    &clk_reg=&HWIO_GCC_BLSP2_AHB_CBCR_ADDR
    &clk_reg_name="GCC_BLSP2_AHB_CBCR"
    &clk_name="gcc_blsp2_ahb_clk"
    &clk_reg_cbcr_type="sm_pscbc"
    &clk_vote_bit=15.
    &clk_multiplier=4.
    &clk_access_mode="&GCC_access_mode"

    gosub Print_Clk_Info_Line
  )

  &match=0
  &wild_head=0
  &wild_tail=0
  &clk_input_length=STRING.LENGTH("&clk")
  &clk_itr_length=STRING.LENGTH("gcc_cnoc_bus_timeout0_ahb_clk")

  if (STRING.SCAN("&clk", "*", 0)==0)
  (
    &wild_head=1
  )
  if (STRING.SCAN("&clk", "*", 1)==(STRING.LENGTH("&clk")-1))
  (
    &wild_tail=1
  )

  if ((&wild_head==1)&&(&wild_tail==1))
  (
    if (STRING.SCAN("gcc_cnoc_bus_timeout0_ahb_clk", STRING.MID("&clk", 1, &clk_input_length-2), 0)!=-1)
    ( 
      &match=1
    )
  )
  else if (&wild_head==1)
  (
    if (STRING.MID("gcc_cnoc_bus_timeout0_ahb_clk", &clk_itr_length-&clk_input_length+1, &clk_input_length-1)==STRING.CUT("&clk", 1))
    ( 
      &match=1
    )
  )
  else if (&wild_tail==1)
  (
    if (STRING.MID("gcc_cnoc_bus_timeout0_ahb_clk", 0, &clk_input_length-1)==STRING.CUT("&clk", -1))
    ( 
      &match=1
    )
  )
  else if ("gcc_cnoc_bus_timeout0_ahb_clk"=="&clk")
  (
    &match=1
  )
  
  if (&match==1)
  (
    &clk_test=&CLK_TEST_GCC_CNOC_BUS_TIMEOUT0_AHB_CLK
    &clk_reg=&HWIO_GCC_CNOC_BUS_TIMEOUT0_AHB_CBCR_ADDR
    &clk_reg_name="GCC_CNOC_BUS_TIMEOUT0_AHB_CBCR"
    &clk_name="gcc_cnoc_bus_timeout0_ahb_clk"
    &clk_reg_cbcr_type="sm_cbc"
    &clk_vote_bit=-1.
    &clk_multiplier=4.
    &clk_access_mode="&GCC_access_mode"

    gosub Print_Clk_Info_Line
  )

  &match=0
  &wild_head=0
  &wild_tail=0
  &clk_input_length=STRING.LENGTH("&clk")
  &clk_itr_length=STRING.LENGTH("gcc_cnoc_periph_ahb_clk")

  if (STRING.SCAN("&clk", "*", 0)==0)
  (
    &wild_head=1
  )
  if (STRING.SCAN("&clk", "*", 1)==(STRING.LENGTH("&clk")-1))
  (
    &wild_tail=1
  )

  if ((&wild_head==1)&&(&wild_tail==1))
  (
    if (STRING.SCAN("gcc_cnoc_periph_ahb_clk", STRING.MID("&clk", 1, &clk_input_length-2), 0)!=-1)
    ( 
      &match=1
    )
  )
  else if (&wild_head==1)
  (
    if (STRING.MID("gcc_cnoc_periph_ahb_clk", &clk_itr_length-&clk_input_length+1, &clk_input_length-1)==STRING.CUT("&clk", 1))
    ( 
      &match=1
    )
  )
  else if (&wild_tail==1)
  (
    if (STRING.MID("gcc_cnoc_periph_ahb_clk", 0, &clk_input_length-1)==STRING.CUT("&clk", -1))
    ( 
      &match=1
    )
  )
  else if ("gcc_cnoc_periph_ahb_clk"=="&clk")
  (
    &match=1
  )
  
  if (&match==1)
  (
    &clk_test=&CLK_TEST_GCC_CNOC_PERIPH_AHB_CLK
    &clk_reg=&HWIO_GCC_CNOC_PERIPH_AHB_CBCR_ADDR
    &clk_reg_name="GCC_CNOC_PERIPH_AHB_CBCR"
    &clk_name="gcc_cnoc_periph_ahb_clk"
    &clk_reg_cbcr_type="sm_cbc"
    &clk_vote_bit=-1.
    &clk_multiplier=4.
    &clk_access_mode="&GCC_access_mode"

    gosub Print_Clk_Info_Line
  )

  &match=0
  &wild_head=0
  &wild_tail=0
  &clk_input_length=STRING.LENGTH("&clk")
  &clk_itr_length=STRING.LENGTH("gcc_cnoc_periph_bus_timeout1_ahb_clk")

  if (STRING.SCAN("&clk", "*", 0)==0)
  (
    &wild_head=1
  )
  if (STRING.SCAN("&clk", "*", 1)==(STRING.LENGTH("&clk")-1))
  (
    &wild_tail=1
  )

  if ((&wild_head==1)&&(&wild_tail==1))
  (
    if (STRING.SCAN("gcc_cnoc_periph_bus_timeout1_ahb_clk", STRING.MID("&clk", 1, &clk_input_length-2), 0)!=-1)
    ( 
      &match=1
    )
  )
  else if (&wild_head==1)
  (
    if (STRING.MID("gcc_cnoc_periph_bus_timeout1_ahb_clk", &clk_itr_length-&clk_input_length+1, &clk_input_length-1)==STRING.CUT("&clk", 1))
    ( 
      &match=1
    )
  )
  else if (&wild_tail==1)
  (
    if (STRING.MID("gcc_cnoc_periph_bus_timeout1_ahb_clk", 0, &clk_input_length-1)==STRING.CUT("&clk", -1))
    ( 
      &match=1
    )
  )
  else if ("gcc_cnoc_periph_bus_timeout1_ahb_clk"=="&clk")
  (
    &match=1
  )
  
  if (&match==1)
  (
    &clk_test=&CLK_TEST_GCC_CNOC_PERIPH_BUS_TIMEOUT1_AHB_CLK
    &clk_reg=&HWIO_GCC_CNOC_PERIPH_BUS_TIMEOUT1_AHB_CBCR_ADDR
    &clk_reg_name="GCC_CNOC_PERIPH_BUS_TIMEOUT1_AHB_CBCR"
    &clk_name="gcc_cnoc_periph_bus_timeout1_ahb_clk"
    &clk_reg_cbcr_type="sm_cbc"
    &clk_vote_bit=-1.
    &clk_multiplier=4.
    &clk_access_mode="&GCC_access_mode"

    gosub Print_Clk_Info_Line
  )

  &match=0
  &wild_head=0
  &wild_tail=0
  &clk_input_length=STRING.LENGTH("&clk")
  &clk_itr_length=STRING.LENGTH("gcc_cnoc_periph_bus_timeout2_ahb_clk")

  if (STRING.SCAN("&clk", "*", 0)==0)
  (
    &wild_head=1
  )
  if (STRING.SCAN("&clk", "*", 1)==(STRING.LENGTH("&clk")-1))
  (
    &wild_tail=1
  )

  if ((&wild_head==1)&&(&wild_tail==1))
  (
    if (STRING.SCAN("gcc_cnoc_periph_bus_timeout2_ahb_clk", STRING.MID("&clk", 1, &clk_input_length-2), 0)!=-1)
    ( 
      &match=1
    )
  )
  else if (&wild_head==1)
  (
    if (STRING.MID("gcc_cnoc_periph_bus_timeout2_ahb_clk", &clk_itr_length-&clk_input_length+1, &clk_input_length-1)==STRING.CUT("&clk", 1))
    ( 
      &match=1
    )
  )
  else if (&wild_tail==1)
  (
    if (STRING.MID("gcc_cnoc_periph_bus_timeout2_ahb_clk", 0, &clk_input_length-1)==STRING.CUT("&clk", -1))
    ( 
      &match=1
    )
  )
  else if ("gcc_cnoc_periph_bus_timeout2_ahb_clk"=="&clk")
  (
    &match=1
  )
  
  if (&match==1)
  (
    &clk_test=&CLK_TEST_GCC_CNOC_PERIPH_BUS_TIMEOUT2_AHB_CLK
    &clk_reg=&HWIO_GCC_CNOC_PERIPH_BUS_TIMEOUT2_AHB_CBCR_ADDR
    &clk_reg_name="GCC_CNOC_PERIPH_BUS_TIMEOUT2_AHB_CBCR"
    &clk_name="gcc_cnoc_periph_bus_timeout2_ahb_clk"
    &clk_reg_cbcr_type="sm_cbc"
    &clk_vote_bit=-1.
    &clk_multiplier=4.
    &clk_access_mode="&GCC_access_mode"

    gosub Print_Clk_Info_Line
  )

  &match=0
  &wild_head=0
  &wild_tail=0
  &clk_input_length=STRING.LENGTH("&clk")
  &clk_itr_length=STRING.LENGTH("gcc_cnoc_periph_north_ahb_clk")

  if (STRING.SCAN("&clk", "*", 0)==0)
  (
    &wild_head=1
  )
  if (STRING.SCAN("&clk", "*", 1)==(STRING.LENGTH("&clk")-1))
  (
    &wild_tail=1
  )

  if ((&wild_head==1)&&(&wild_tail==1))
  (
    if (STRING.SCAN("gcc_cnoc_periph_north_ahb_clk", STRING.MID("&clk", 1, &clk_input_length-2), 0)!=-1)
    ( 
      &match=1
    )
  )
  else if (&wild_head==1)
  (
    if (STRING.MID("gcc_cnoc_periph_north_ahb_clk", &clk_itr_length-&clk_input_length+1, &clk_input_length-1)==STRING.CUT("&clk", 1))
    ( 
      &match=1
    )
  )
  else if (&wild_tail==1)
  (
    if (STRING.MID("gcc_cnoc_periph_north_ahb_clk", 0, &clk_input_length-1)==STRING.CUT("&clk", -1))
    ( 
      &match=1
    )
  )
  else if ("gcc_cnoc_periph_north_ahb_clk"=="&clk")
  (
    &match=1
  )
  
  if (&match==1)
  (
    &clk_test=&CLK_TEST_GCC_CNOC_PERIPH_NORTH_AHB_CLK
    &clk_reg=&HWIO_GCC_CNOC_PERIPH_NORTH_AHB_CBCR_ADDR
    &clk_reg_name="GCC_CNOC_PERIPH_NORTH_AHB_CBCR"
    &clk_name="gcc_cnoc_periph_north_ahb_clk"
    &clk_reg_cbcr_type="sm_cbc"
    &clk_vote_bit=-1.
    &clk_multiplier=4.
    &clk_access_mode="&GCC_access_mode"

    gosub Print_Clk_Info_Line
  )

  &match=0
  &wild_head=0
  &wild_tail=0
  &clk_input_length=STRING.LENGTH("&clk")
  &clk_itr_length=STRING.LENGTH("gcc_cnoc_periph_south_ahb_clk")

  if (STRING.SCAN("&clk", "*", 0)==0)
  (
    &wild_head=1
  )
  if (STRING.SCAN("&clk", "*", 1)==(STRING.LENGTH("&clk")-1))
  (
    &wild_tail=1
  )

  if ((&wild_head==1)&&(&wild_tail==1))
  (
    if (STRING.SCAN("gcc_cnoc_periph_south_ahb_clk", STRING.MID("&clk", 1, &clk_input_length-2), 0)!=-1)
    ( 
      &match=1
    )
  )
  else if (&wild_head==1)
  (
    if (STRING.MID("gcc_cnoc_periph_south_ahb_clk", &clk_itr_length-&clk_input_length+1, &clk_input_length-1)==STRING.CUT("&clk", 1))
    ( 
      &match=1
    )
  )
  else if (&wild_tail==1)
  (
    if (STRING.MID("gcc_cnoc_periph_south_ahb_clk", 0, &clk_input_length-1)==STRING.CUT("&clk", -1))
    ( 
      &match=1
    )
  )
  else if ("gcc_cnoc_periph_south_ahb_clk"=="&clk")
  (
    &match=1
  )
  
  if (&match==1)
  (
    &clk_test=&CLK_TEST_GCC_CNOC_PERIPH_SOUTH_AHB_CLK
    &clk_reg=&HWIO_GCC_CNOC_PERIPH_SOUTH_AHB_CBCR_ADDR
    &clk_reg_name="GCC_CNOC_PERIPH_SOUTH_AHB_CBCR"
    &clk_name="gcc_cnoc_periph_south_ahb_clk"
    &clk_reg_cbcr_type="sm_cbc"
    &clk_vote_bit=-1.
    &clk_multiplier=4.
    &clk_access_mode="&GCC_access_mode"

    gosub Print_Clk_Info_Line
  )

  &match=0
  &wild_head=0
  &wild_tail=0
  &clk_input_length=STRING.LENGTH("&clk")
  &clk_itr_length=STRING.LENGTH("gcc_pdm_ahb_clk")

  if (STRING.SCAN("&clk", "*", 0)==0)
  (
    &wild_head=1
  )
  if (STRING.SCAN("&clk", "*", 1)==(STRING.LENGTH("&clk")-1))
  (
    &wild_tail=1
  )

  if ((&wild_head==1)&&(&wild_tail==1))
  (
    if (STRING.SCAN("gcc_pdm_ahb_clk", STRING.MID("&clk", 1, &clk_input_length-2), 0)!=-1)
    ( 
      &match=1
    )
  )
  else if (&wild_head==1)
  (
    if (STRING.MID("gcc_pdm_ahb_clk", &clk_itr_length-&clk_input_length+1, &clk_input_length-1)==STRING.CUT("&clk", 1))
    ( 
      &match=1
    )
  )
  else if (&wild_tail==1)
  (
    if (STRING.MID("gcc_pdm_ahb_clk", 0, &clk_input_length-1)==STRING.CUT("&clk", -1))
    ( 
      &match=1
    )
  )
  else if ("gcc_pdm_ahb_clk"=="&clk")
  (
    &match=1
  )
  
  if (&match==1)
  (
    &clk_test=&CLK_TEST_GCC_PDM_AHB_CLK
    &clk_reg=&HWIO_GCC_PDM_AHB_CBCR_ADDR
    &clk_reg_name="GCC_PDM_AHB_CBCR"
    &clk_name="gcc_pdm_ahb_clk"
    &clk_reg_cbcr_type="sm_cbc"
    &clk_vote_bit=-1.
    &clk_multiplier=4.
    &clk_access_mode="&GCC_access_mode"

    gosub Print_Clk_Info_Line
  )

  &match=0
  &wild_head=0
  &wild_tail=0
  &clk_input_length=STRING.LENGTH("&clk")
  &clk_itr_length=STRING.LENGTH("gcc_qspi_ahb_clk")

  if (STRING.SCAN("&clk", "*", 0)==0)
  (
    &wild_head=1
  )
  if (STRING.SCAN("&clk", "*", 1)==(STRING.LENGTH("&clk")-1))
  (
    &wild_tail=1
  )

  if ((&wild_head==1)&&(&wild_tail==1))
  (
    if (STRING.SCAN("gcc_qspi_ahb_clk", STRING.MID("&clk", 1, &clk_input_length-2), 0)!=-1)
    ( 
      &match=1
    )
  )
  else if (&wild_head==1)
  (
    if (STRING.MID("gcc_qspi_ahb_clk", &clk_itr_length-&clk_input_length+1, &clk_input_length-1)==STRING.CUT("&clk", 1))
    ( 
      &match=1
    )
  )
  else if (&wild_tail==1)
  (
    if (STRING.MID("gcc_qspi_ahb_clk", 0, &clk_input_length-1)==STRING.CUT("&clk", -1))
    ( 
      &match=1
    )
  )
  else if ("gcc_qspi_ahb_clk"=="&clk")
  (
    &match=1
  )
  
  if (&match==1)
  (
    &clk_test=&CLK_TEST_GCC_QSPI_AHB_CLK
    &clk_reg=&HWIO_GCC_QSPI_AHB_CBCR_ADDR
    &clk_reg_name="GCC_QSPI_AHB_CBCR"
    &clk_name="gcc_qspi_ahb_clk"
    &clk_reg_cbcr_type="sm_cbc"
    &clk_vote_bit=-1.
    &clk_multiplier=4.
    &clk_access_mode="&GCC_access_mode"

    gosub Print_Clk_Info_Line
  )

  &match=0
  &wild_head=0
  &wild_tail=0
  &clk_input_length=STRING.LENGTH("&clk")
  &clk_itr_length=STRING.LENGTH("gcc_sdcc1_ahb_clk")

  if (STRING.SCAN("&clk", "*", 0)==0)
  (
    &wild_head=1
  )
  if (STRING.SCAN("&clk", "*", 1)==(STRING.LENGTH("&clk")-1))
  (
    &wild_tail=1
  )

  if ((&wild_head==1)&&(&wild_tail==1))
  (
    if (STRING.SCAN("gcc_sdcc1_ahb_clk", STRING.MID("&clk", 1, &clk_input_length-2), 0)!=-1)
    ( 
      &match=1
    )
  )
  else if (&wild_head==1)
  (
    if (STRING.MID("gcc_sdcc1_ahb_clk", &clk_itr_length-&clk_input_length+1, &clk_input_length-1)==STRING.CUT("&clk", 1))
    ( 
      &match=1
    )
  )
  else if (&wild_tail==1)
  (
    if (STRING.MID("gcc_sdcc1_ahb_clk", 0, &clk_input_length-1)==STRING.CUT("&clk", -1))
    ( 
      &match=1
    )
  )
  else if ("gcc_sdcc1_ahb_clk"=="&clk")
  (
    &match=1
  )
  
  if (&match==1)
  (
    &clk_test=&CLK_TEST_GCC_SDCC1_AHB_CLK
    &clk_reg=&HWIO_GCC_SDCC1_AHB_CBCR_ADDR
    &clk_reg_name="GCC_SDCC1_AHB_CBCR"
    &clk_name="gcc_sdcc1_ahb_clk"
    &clk_reg_cbcr_type="sm_cbc"
    &clk_vote_bit=-1.
    &clk_multiplier=4.
    &clk_access_mode="&GCC_access_mode"

    gosub Print_Clk_Info_Line
  )

  &match=0
  &wild_head=0
  &wild_tail=0
  &clk_input_length=STRING.LENGTH("&clk")
  &clk_itr_length=STRING.LENGTH("gcc_sdcc2_ahb_clk")

  if (STRING.SCAN("&clk", "*", 0)==0)
  (
    &wild_head=1
  )
  if (STRING.SCAN("&clk", "*", 1)==(STRING.LENGTH("&clk")-1))
  (
    &wild_tail=1
  )

  if ((&wild_head==1)&&(&wild_tail==1))
  (
    if (STRING.SCAN("gcc_sdcc2_ahb_clk", STRING.MID("&clk", 1, &clk_input_length-2), 0)!=-1)
    ( 
      &match=1
    )
  )
  else if (&wild_head==1)
  (
    if (STRING.MID("gcc_sdcc2_ahb_clk", &clk_itr_length-&clk_input_length+1, &clk_input_length-1)==STRING.CUT("&clk", 1))
    ( 
      &match=1
    )
  )
  else if (&wild_tail==1)
  (
    if (STRING.MID("gcc_sdcc2_ahb_clk", 0, &clk_input_length-1)==STRING.CUT("&clk", -1))
    ( 
      &match=1
    )
  )
  else if ("gcc_sdcc2_ahb_clk"=="&clk")
  (
    &match=1
  )
  
  if (&match==1)
  (
    &clk_test=&CLK_TEST_GCC_SDCC2_AHB_CLK
    &clk_reg=&HWIO_GCC_SDCC2_AHB_CBCR_ADDR
    &clk_reg_name="GCC_SDCC2_AHB_CBCR"
    &clk_name="gcc_sdcc2_ahb_clk"
    &clk_reg_cbcr_type="sm_cbc"
    &clk_vote_bit=-1.
    &clk_multiplier=4.
    &clk_access_mode="&GCC_access_mode"

    gosub Print_Clk_Info_Line
  )

  &match=0
  &wild_head=0
  &wild_tail=0
  &clk_input_length=STRING.LENGTH("&clk")
  &clk_itr_length=STRING.LENGTH("gcc_spdm_pnoc_cy_clk")

  if (STRING.SCAN("&clk", "*", 0)==0)
  (
    &wild_head=1
  )
  if (STRING.SCAN("&clk", "*", 1)==(STRING.LENGTH("&clk")-1))
  (
    &wild_tail=1
  )

  if ((&wild_head==1)&&(&wild_tail==1))
  (
    if (STRING.SCAN("gcc_spdm_pnoc_cy_clk", STRING.MID("&clk", 1, &clk_input_length-2), 0)!=-1)
    ( 
      &match=1
    )
  )
  else if (&wild_head==1)
  (
    if (STRING.MID("gcc_spdm_pnoc_cy_clk", &clk_itr_length-&clk_input_length+1, &clk_input_length-1)==STRING.CUT("&clk", 1))
    ( 
      &match=1
    )
  )
  else if (&wild_tail==1)
  (
    if (STRING.MID("gcc_spdm_pnoc_cy_clk", 0, &clk_input_length-1)==STRING.CUT("&clk", -1))
    ( 
      &match=1
    )
  )
  else if ("gcc_spdm_pnoc_cy_clk"=="&clk")
  (
    &match=1
  )
  
  if (&match==1)
  (
    &clk_test=&CLK_TEST_GCC_SPDM_PNOC_CY_CLK
    &clk_reg=&HWIO_GCC_SPDM_PNOC_CY_CBCR_ADDR
    &clk_reg_name="GCC_SPDM_PNOC_CY_CBCR"
    &clk_name="gcc_spdm_pnoc_cy_clk"
    &clk_reg_cbcr_type="sm_cbc"
    &clk_vote_bit=-1.
    &clk_multiplier=4.
    &clk_access_mode="&GCC_access_mode"

    gosub Print_Clk_Info_Line
  )

  &match=0
  &wild_head=0
  &wild_tail=0
  &clk_input_length=STRING.LENGTH("&clk")
  &clk_itr_length=STRING.LENGTH("gcc_a2noc_throttle_cfg_clk")

  if (STRING.SCAN("&clk", "*", 0)==0)
  (
    &wild_head=1
  )
  if (STRING.SCAN("&clk", "*", 1)==(STRING.LENGTH("&clk")-1))
  (
    &wild_tail=1
  )

  if ((&wild_head==1)&&(&wild_tail==1))
  (
    if (STRING.SCAN("gcc_a2noc_throttle_cfg_clk", STRING.MID("&clk", 1, &clk_input_length-2), 0)!=-1)
    ( 
      &match=1
    )
  )
  else if (&wild_head==1)
  (
    if (STRING.MID("gcc_a2noc_throttle_cfg_clk", &clk_itr_length-&clk_input_length+1, &clk_input_length-1)==STRING.CUT("&clk", 1))
    ( 
      &match=1
    )
  )
  else if (&wild_tail==1)
  (
    if (STRING.MID("gcc_a2noc_throttle_cfg_clk", 0, &clk_input_length-1)==STRING.CUT("&clk", -1))
    ( 
      &match=1
    )
  )
  else if ("gcc_a2noc_throttle_cfg_clk"=="&clk")
  (
    &match=1
  )
  
  if (&match==1)
  (
    &clk_test=&CLK_TEST_GCC_A2NOC_THROTTLE_CFG_CLK
    &clk_reg=&HWIO_GCC_A2NOC_THROTTLE_CFG_CBCR_ADDR
    &clk_reg_name="GCC_A2NOC_THROTTLE_CFG_CBCR"
    &clk_name="gcc_a2noc_throttle_cfg_clk"
    &clk_reg_cbcr_type="sm_cbc"
    &clk_vote_bit=-1.
    &clk_multiplier=4.
    &clk_access_mode="&GCC_access_mode"

    gosub Print_Clk_Info_Line
  )

  &match=0
  &wild_head=0
  &wild_tail=0
  &clk_input_length=STRING.LENGTH("&clk")
  &clk_itr_length=STRING.LENGTH("gcc_aggre2_cnoc_ahb_clk")

  if (STRING.SCAN("&clk", "*", 0)==0)
  (
    &wild_head=1
  )
  if (STRING.SCAN("&clk", "*", 1)==(STRING.LENGTH("&clk")-1))
  (
    &wild_tail=1
  )

  if ((&wild_head==1)&&(&wild_tail==1))
  (
    if (STRING.SCAN("gcc_aggre2_cnoc_ahb_clk", STRING.MID("&clk", 1, &clk_input_length-2), 0)!=-1)
    ( 
      &match=1
    )
  )
  else if (&wild_head==1)
  (
    if (STRING.MID("gcc_aggre2_cnoc_ahb_clk", &clk_itr_length-&clk_input_length+1, &clk_input_length-1)==STRING.CUT("&clk", 1))
    ( 
      &match=1
    )
  )
  else if (&wild_tail==1)
  (
    if (STRING.MID("gcc_aggre2_cnoc_ahb_clk", 0, &clk_input_length-1)==STRING.CUT("&clk", -1))
    ( 
      &match=1
    )
  )
  else if ("gcc_aggre2_cnoc_ahb_clk"=="&clk")
  (
    &match=1
  )
  
  if (&match==1)
  (
    &clk_test=&CLK_TEST_GCC_AGGRE2_CNOC_AHB_CLK
    &clk_reg=&HWIO_GCC_AGGRE2_CNOC_AHB_CBCR_ADDR
    &clk_reg_name="GCC_AGGRE2_CNOC_AHB_CBCR"
    &clk_name="gcc_aggre2_cnoc_ahb_clk"
    &clk_reg_cbcr_type="sm_cbc"
    &clk_vote_bit=-1.
    &clk_multiplier=4.
    &clk_access_mode="&GCC_access_mode"

    gosub Print_Clk_Info_Line
  )

  &match=0
  &wild_head=0
  &wild_tail=0
  &clk_input_length=STRING.LENGTH("&clk")
  &clk_itr_length=STRING.LENGTH("gcc_aggre2_noc_msmpu_cfg_ahb_clk")

  if (STRING.SCAN("&clk", "*", 0)==0)
  (
    &wild_head=1
  )
  if (STRING.SCAN("&clk", "*", 1)==(STRING.LENGTH("&clk")-1))
  (
    &wild_tail=1
  )

  if ((&wild_head==1)&&(&wild_tail==1))
  (
    if (STRING.SCAN("gcc_aggre2_noc_msmpu_cfg_ahb_clk", STRING.MID("&clk", 1, &clk_input_length-2), 0)!=-1)
    ( 
      &match=1
    )
  )
  else if (&wild_head==1)
  (
    if (STRING.MID("gcc_aggre2_noc_msmpu_cfg_ahb_clk", &clk_itr_length-&clk_input_length+1, &clk_input_length-1)==STRING.CUT("&clk", 1))
    ( 
      &match=1
    )
  )
  else if (&wild_tail==1)
  (
    if (STRING.MID("gcc_aggre2_noc_msmpu_cfg_ahb_clk", 0, &clk_input_length-1)==STRING.CUT("&clk", -1))
    ( 
      &match=1
    )
  )
  else if ("gcc_aggre2_noc_msmpu_cfg_ahb_clk"=="&clk")
  (
    &match=1
  )
  
  if (&match==1)
  (
    &clk_test=&CLK_TEST_GCC_AGGRE2_NOC_MSMPU_CFG_AHB_CLK
    &clk_reg=&HWIO_GCC_AGGRE2_NOC_MSMPU_CFG_AHB_CBCR_ADDR
    &clk_reg_name="GCC_AGGRE2_NOC_MSMPU_CFG_AHB_CBCR"
    &clk_name="gcc_aggre2_noc_msmpu_cfg_ahb_clk"
    &clk_reg_cbcr_type="sm_cbc"
    &clk_vote_bit=-1.
    &clk_multiplier=4.
    &clk_access_mode="&GCC_access_mode"

    gosub Print_Clk_Info_Line
  )

  &match=0
  &wild_head=0
  &wild_tail=0
  &clk_input_length=STRING.LENGTH("&clk")
  &clk_itr_length=STRING.LENGTH("gcc_ahb_clk")

  if (STRING.SCAN("&clk", "*", 0)==0)
  (
    &wild_head=1
  )
  if (STRING.SCAN("&clk", "*", 1)==(STRING.LENGTH("&clk")-1))
  (
    &wild_tail=1
  )

  if ((&wild_head==1)&&(&wild_tail==1))
  (
    if (STRING.SCAN("gcc_ahb_clk", STRING.MID("&clk", 1, &clk_input_length-2), 0)!=-1)
    ( 
      &match=1
    )
  )
  else if (&wild_head==1)
  (
    if (STRING.MID("gcc_ahb_clk", &clk_itr_length-&clk_input_length+1, &clk_input_length-1)==STRING.CUT("&clk", 1))
    ( 
      &match=1
    )
  )
  else if (&wild_tail==1)
  (
    if (STRING.MID("gcc_ahb_clk", 0, &clk_input_length-1)==STRING.CUT("&clk", -1))
    ( 
      &match=1
    )
  )
  else if ("gcc_ahb_clk"=="&clk")
  (
    &match=1
  )
  
  if (&match==1)
  (
    &clk_test=&CLK_TEST_GCC_AHB_CLK
    &clk_reg=&HWIO_GCC_GCC_AHB_CBCR_ADDR
    &clk_reg_name="GCC_GCC_AHB_CBCR"
    &clk_name="gcc_ahb_clk"
    &clk_reg_cbcr_type="sm_cbc"
    &clk_vote_bit=-1.
    &clk_multiplier=4.
    &clk_access_mode="&GCC_access_mode"

    gosub Print_Clk_Info_Line
  )

  &match=0
  &wild_head=0
  &wild_tail=0
  &clk_input_length=STRING.LENGTH("&clk")
  &clk_itr_length=STRING.LENGTH("gcc_bimc_cfg_ahb_clk")

  if (STRING.SCAN("&clk", "*", 0)==0)
  (
    &wild_head=1
  )
  if (STRING.SCAN("&clk", "*", 1)==(STRING.LENGTH("&clk")-1))
  (
    &wild_tail=1
  )

  if ((&wild_head==1)&&(&wild_tail==1))
  (
    if (STRING.SCAN("gcc_bimc_cfg_ahb_clk", STRING.MID("&clk", 1, &clk_input_length-2), 0)!=-1)
    ( 
      &match=1
    )
  )
  else if (&wild_head==1)
  (
    if (STRING.MID("gcc_bimc_cfg_ahb_clk", &clk_itr_length-&clk_input_length+1, &clk_input_length-1)==STRING.CUT("&clk", 1))
    ( 
      &match=1
    )
  )
  else if (&wild_tail==1)
  (
    if (STRING.MID("gcc_bimc_cfg_ahb_clk", 0, &clk_input_length-1)==STRING.CUT("&clk", -1))
    ( 
      &match=1
    )
  )
  else if ("gcc_bimc_cfg_ahb_clk"=="&clk")
  (
    &match=1
  )
  
  if (&match==1)
  (
    &clk_test=&CLK_TEST_GCC_BIMC_CFG_AHB_CLK
    &clk_reg=&HWIO_GCC_BIMC_CFG_AHB_CBCR_ADDR
    &clk_reg_name="GCC_BIMC_CFG_AHB_CBCR"
    &clk_name="gcc_bimc_cfg_ahb_clk"
    &clk_reg_cbcr_type="sm_cbc"
    &clk_vote_bit=-1.
    &clk_multiplier=4.
    &clk_access_mode="&GCC_access_mode"

    gosub Print_Clk_Info_Line
  )

  &match=0
  &wild_head=0
  &wild_tail=0
  &clk_input_length=STRING.LENGTH("&clk")
  &clk_itr_length=STRING.LENGTH("gcc_bimc_nius_cfg_ahb_clk")

  if (STRING.SCAN("&clk", "*", 0)==0)
  (
    &wild_head=1
  )
  if (STRING.SCAN("&clk", "*", 1)==(STRING.LENGTH("&clk")-1))
  (
    &wild_tail=1
  )

  if ((&wild_head==1)&&(&wild_tail==1))
  (
    if (STRING.SCAN("gcc_bimc_nius_cfg_ahb_clk", STRING.MID("&clk", 1, &clk_input_length-2), 0)!=-1)
    ( 
      &match=1
    )
  )
  else if (&wild_head==1)
  (
    if (STRING.MID("gcc_bimc_nius_cfg_ahb_clk", &clk_itr_length-&clk_input_length+1, &clk_input_length-1)==STRING.CUT("&clk", 1))
    ( 
      &match=1
    )
  )
  else if (&wild_tail==1)
  (
    if (STRING.MID("gcc_bimc_nius_cfg_ahb_clk", 0, &clk_input_length-1)==STRING.CUT("&clk", -1))
    ( 
      &match=1
    )
  )
  else if ("gcc_bimc_nius_cfg_ahb_clk"=="&clk")
  (
    &match=1
  )
  
  if (&match==1)
  (
    &clk_test=&CLK_TEST_GCC_BIMC_NIUS_CFG_AHB_CLK
    &clk_reg=&HWIO_GCC_BIMC_NIUS_CFG_AHB_CBCR_ADDR
    &clk_reg_name="GCC_BIMC_NIUS_CFG_AHB_CBCR"
    &clk_name="gcc_bimc_nius_cfg_ahb_clk"
    &clk_reg_cbcr_type="sm_cbc"
    &clk_vote_bit=-1.
    &clk_multiplier=4.
    &clk_access_mode="&GCC_access_mode"

    gosub Print_Clk_Info_Line
  )

  &match=0
  &wild_head=0
  &wild_tail=0
  &clk_input_length=STRING.LENGTH("&clk")
  &clk_itr_length=STRING.LENGTH("gcc_boot_rom_ahb_clk")

  if (STRING.SCAN("&clk", "*", 0)==0)
  (
    &wild_head=1
  )
  if (STRING.SCAN("&clk", "*", 1)==(STRING.LENGTH("&clk")-1))
  (
    &wild_tail=1
  )

  if ((&wild_head==1)&&(&wild_tail==1))
  (
    if (STRING.SCAN("gcc_boot_rom_ahb_clk", STRING.MID("&clk", 1, &clk_input_length-2), 0)!=-1)
    ( 
      &match=1
    )
  )
  else if (&wild_head==1)
  (
    if (STRING.MID("gcc_boot_rom_ahb_clk", &clk_itr_length-&clk_input_length+1, &clk_input_length-1)==STRING.CUT("&clk", 1))
    ( 
      &match=1
    )
  )
  else if (&wild_tail==1)
  (
    if (STRING.MID("gcc_boot_rom_ahb_clk", 0, &clk_input_length-1)==STRING.CUT("&clk", -1))
    ( 
      &match=1
    )
  )
  else if ("gcc_boot_rom_ahb_clk"=="&clk")
  (
    &match=1
  )
  
  if (&match==1)
  (
    &clk_test=&CLK_TEST_GCC_BOOT_ROM_AHB_CLK
    &clk_reg=&HWIO_GCC_BOOT_ROM_AHB_CBCR_ADDR
    &clk_reg_name="GCC_BOOT_ROM_AHB_CBCR"
    &clk_name="gcc_boot_rom_ahb_clk"
    &clk_reg_cbcr_type="sm_pscbc"
    &clk_vote_bit=10.
    &clk_multiplier=4.
    &clk_access_mode="&GCC_access_mode"

    gosub Print_Clk_Info_Line
  )

  &match=0
  &wild_head=0
  &wild_tail=0
  &clk_input_length=STRING.LENGTH("&clk")
  &clk_itr_length=STRING.LENGTH("gcc_ce1_ahb_clk")

  if (STRING.SCAN("&clk", "*", 0)==0)
  (
    &wild_head=1
  )
  if (STRING.SCAN("&clk", "*", 1)==(STRING.LENGTH("&clk")-1))
  (
    &wild_tail=1
  )

  if ((&wild_head==1)&&(&wild_tail==1))
  (
    if (STRING.SCAN("gcc_ce1_ahb_clk", STRING.MID("&clk", 1, &clk_input_length-2), 0)!=-1)
    ( 
      &match=1
    )
  )
  else if (&wild_head==1)
  (
    if (STRING.MID("gcc_ce1_ahb_clk", &clk_itr_length-&clk_input_length+1, &clk_input_length-1)==STRING.CUT("&clk", 1))
    ( 
      &match=1
    )
  )
  else if (&wild_tail==1)
  (
    if (STRING.MID("gcc_ce1_ahb_clk", 0, &clk_input_length-1)==STRING.CUT("&clk", -1))
    ( 
      &match=1
    )
  )
  else if ("gcc_ce1_ahb_clk"=="&clk")
  (
    &match=1
  )
  
  if (&match==1)
  (
    &clk_test=&CLK_TEST_GCC_CE1_AHB_CLK
    &clk_reg=&HWIO_GCC_CE1_AHB_CBCR_ADDR
    &clk_reg_name="GCC_CE1_AHB_CBCR"
    &clk_name="gcc_ce1_ahb_clk"
    &clk_reg_cbcr_type="sm_cbc"
    &clk_vote_bit=3.
    &clk_multiplier=4.
    &clk_access_mode="&GCC_access_mode"

    gosub Print_Clk_Info_Line
  )

  &match=0
  &wild_head=0
  &wild_tail=0
  &clk_input_length=STRING.LENGTH("&clk")
  &clk_itr_length=STRING.LENGTH("gcc_cfg_noc_ahb_clk")

  if (STRING.SCAN("&clk", "*", 0)==0)
  (
    &wild_head=1
  )
  if (STRING.SCAN("&clk", "*", 1)==(STRING.LENGTH("&clk")-1))
  (
    &wild_tail=1
  )

  if ((&wild_head==1)&&(&wild_tail==1))
  (
    if (STRING.SCAN("gcc_cfg_noc_ahb_clk", STRING.MID("&clk", 1, &clk_input_length-2), 0)!=-1)
    ( 
      &match=1
    )
  )
  else if (&wild_head==1)
  (
    if (STRING.MID("gcc_cfg_noc_ahb_clk", &clk_itr_length-&clk_input_length+1, &clk_input_length-1)==STRING.CUT("&clk", 1))
    ( 
      &match=1
    )
  )
  else if (&wild_tail==1)
  (
    if (STRING.MID("gcc_cfg_noc_ahb_clk", 0, &clk_input_length-1)==STRING.CUT("&clk", -1))
    ( 
      &match=1
    )
  )
  else if ("gcc_cfg_noc_ahb_clk"=="&clk")
  (
    &match=1
  )
  
  if (&match==1)
  (
    &clk_test=&CLK_TEST_GCC_CFG_NOC_AHB_CLK
    &clk_reg=&HWIO_GCC_CFG_NOC_AHB_CBCR_ADDR
    &clk_reg_name="GCC_CFG_NOC_AHB_CBCR"
    &clk_name="gcc_cfg_noc_ahb_clk"
    &clk_reg_cbcr_type="sm_cbc"
    &clk_vote_bit=-1.
    &clk_multiplier=4.
    &clk_access_mode="&GCC_access_mode"

    gosub Print_Clk_Info_Line
  )

  &match=0
  &wild_head=0
  &wild_tail=0
  &clk_input_length=STRING.LENGTH("&clk")
  &clk_itr_length=STRING.LENGTH("gcc_cfg_noc_lpass_aon_ahb_clk")

  if (STRING.SCAN("&clk", "*", 0)==0)
  (
    &wild_head=1
  )
  if (STRING.SCAN("&clk", "*", 1)==(STRING.LENGTH("&clk")-1))
  (
    &wild_tail=1
  )

  if ((&wild_head==1)&&(&wild_tail==1))
  (
    if (STRING.SCAN("gcc_cfg_noc_lpass_aon_ahb_clk", STRING.MID("&clk", 1, &clk_input_length-2), 0)!=-1)
    ( 
      &match=1
    )
  )
  else if (&wild_head==1)
  (
    if (STRING.MID("gcc_cfg_noc_lpass_aon_ahb_clk", &clk_itr_length-&clk_input_length+1, &clk_input_length-1)==STRING.CUT("&clk", 1))
    ( 
      &match=1
    )
  )
  else if (&wild_tail==1)
  (
    if (STRING.MID("gcc_cfg_noc_lpass_aon_ahb_clk", 0, &clk_input_length-1)==STRING.CUT("&clk", -1))
    ( 
      &match=1
    )
  )
  else if ("gcc_cfg_noc_lpass_aon_ahb_clk"=="&clk")
  (
    &match=1
  )
  
  if (&match==1)
  (
    &clk_test=&CLK_TEST_GCC_CFG_NOC_LPASS_AON_AHB_CLK
    &clk_reg=&HWIO_GCC_CFG_NOC_LPASS_AON_AHB_CBCR_ADDR
    &clk_reg_name="GCC_CFG_NOC_LPASS_AON_AHB_CBCR"
    &clk_name="gcc_cfg_noc_lpass_aon_ahb_clk"
    &clk_reg_cbcr_type="sm_cbc"
    &clk_vote_bit=-1.
    &clk_multiplier=4.
    &clk_access_mode="&GCC_access_mode"

    gosub Print_Clk_Info_Line
  )

  &match=0
  &wild_head=0
  &wild_tail=0
  &clk_input_length=STRING.LENGTH("&clk")
  &clk_itr_length=STRING.LENGTH("gcc_cfg_noc_north_ahb_clk")

  if (STRING.SCAN("&clk", "*", 0)==0)
  (
    &wild_head=1
  )
  if (STRING.SCAN("&clk", "*", 1)==(STRING.LENGTH("&clk")-1))
  (
    &wild_tail=1
  )

  if ((&wild_head==1)&&(&wild_tail==1))
  (
    if (STRING.SCAN("gcc_cfg_noc_north_ahb_clk", STRING.MID("&clk", 1, &clk_input_length-2), 0)!=-1)
    ( 
      &match=1
    )
  )
  else if (&wild_head==1)
  (
    if (STRING.MID("gcc_cfg_noc_north_ahb_clk", &clk_itr_length-&clk_input_length+1, &clk_input_length-1)==STRING.CUT("&clk", 1))
    ( 
      &match=1
    )
  )
  else if (&wild_tail==1)
  (
    if (STRING.MID("gcc_cfg_noc_north_ahb_clk", 0, &clk_input_length-1)==STRING.CUT("&clk", -1))
    ( 
      &match=1
    )
  )
  else if ("gcc_cfg_noc_north_ahb_clk"=="&clk")
  (
    &match=1
  )
  
  if (&match==1)
  (
    &clk_test=&CLK_TEST_GCC_CFG_NOC_NORTH_AHB_CLK
    &clk_reg=&HWIO_GCC_CFG_NOC_NORTH_AHB_CBCR_ADDR
    &clk_reg_name="GCC_CFG_NOC_NORTH_AHB_CBCR"
    &clk_name="gcc_cfg_noc_north_ahb_clk"
    &clk_reg_cbcr_type="sm_cbc"
    &clk_vote_bit=-1.
    &clk_multiplier=4.
    &clk_access_mode="&GCC_access_mode"

    gosub Print_Clk_Info_Line
  )

  &match=0
  &wild_head=0
  &wild_tail=0
  &clk_input_length=STRING.LENGTH("&clk")
  &clk_itr_length=STRING.LENGTH("gcc_cfg_noc_south_ahb_clk")

  if (STRING.SCAN("&clk", "*", 0)==0)
  (
    &wild_head=1
  )
  if (STRING.SCAN("&clk", "*", 1)==(STRING.LENGTH("&clk")-1))
  (
    &wild_tail=1
  )

  if ((&wild_head==1)&&(&wild_tail==1))
  (
    if (STRING.SCAN("gcc_cfg_noc_south_ahb_clk", STRING.MID("&clk", 1, &clk_input_length-2), 0)!=-1)
    ( 
      &match=1
    )
  )
  else if (&wild_head==1)
  (
    if (STRING.MID("gcc_cfg_noc_south_ahb_clk", &clk_itr_length-&clk_input_length+1, &clk_input_length-1)==STRING.CUT("&clk", 1))
    ( 
      &match=1
    )
  )
  else if (&wild_tail==1)
  (
    if (STRING.MID("gcc_cfg_noc_south_ahb_clk", 0, &clk_input_length-1)==STRING.CUT("&clk", -1))
    ( 
      &match=1
    )
  )
  else if ("gcc_cfg_noc_south_ahb_clk"=="&clk")
  (
    &match=1
  )
  
  if (&match==1)
  (
    &clk_test=&CLK_TEST_GCC_CFG_NOC_SOUTH_AHB_CLK
    &clk_reg=&HWIO_GCC_CFG_NOC_SOUTH_AHB_CBCR_ADDR
    &clk_reg_name="GCC_CFG_NOC_SOUTH_AHB_CBCR"
    &clk_name="gcc_cfg_noc_south_ahb_clk"
    &clk_reg_cbcr_type="sm_cbc"
    &clk_vote_bit=-1.
    &clk_multiplier=4.
    &clk_access_mode="&GCC_access_mode"

    gosub Print_Clk_Info_Line
  )

  &match=0
  &wild_head=0
  &wild_tail=0
  &clk_input_length=STRING.LENGTH("&clk")
  &clk_itr_length=STRING.LENGTH("gcc_cfg_noc_turing_aon_ahb_clk")

  if (STRING.SCAN("&clk", "*", 0)==0)
  (
    &wild_head=1
  )
  if (STRING.SCAN("&clk", "*", 1)==(STRING.LENGTH("&clk")-1))
  (
    &wild_tail=1
  )

  if ((&wild_head==1)&&(&wild_tail==1))
  (
    if (STRING.SCAN("gcc_cfg_noc_turing_aon_ahb_clk", STRING.MID("&clk", 1, &clk_input_length-2), 0)!=-1)
    ( 
      &match=1
    )
  )
  else if (&wild_head==1)
  (
    if (STRING.MID("gcc_cfg_noc_turing_aon_ahb_clk", &clk_itr_length-&clk_input_length+1, &clk_input_length-1)==STRING.CUT("&clk", 1))
    ( 
      &match=1
    )
  )
  else if (&wild_tail==1)
  (
    if (STRING.MID("gcc_cfg_noc_turing_aon_ahb_clk", 0, &clk_input_length-1)==STRING.CUT("&clk", -1))
    ( 
      &match=1
    )
  )
  else if ("gcc_cfg_noc_turing_aon_ahb_clk"=="&clk")
  (
    &match=1
  )
  
  if (&match==1)
  (
    &clk_test=&CLK_TEST_GCC_CFG_NOC_TURING_AON_AHB_CLK
    &clk_reg=&HWIO_GCC_CFG_NOC_TURING_AON_AHB_CBCR_ADDR
    &clk_reg_name="GCC_CFG_NOC_TURING_AON_AHB_CBCR"
    &clk_name="gcc_cfg_noc_turing_aon_ahb_clk"
    &clk_reg_cbcr_type="sm_cbc"
    &clk_vote_bit=-1.
    &clk_multiplier=4.
    &clk_access_mode="&GCC_access_mode"

    gosub Print_Clk_Info_Line
  )

  &match=0
  &wild_head=0
  &wild_tail=0
  &clk_input_length=STRING.LENGTH("&clk")
  &clk_itr_length=STRING.LENGTH("gcc_cnoc_bus_timeout10_ahb_clk")

  if (STRING.SCAN("&clk", "*", 0)==0)
  (
    &wild_head=1
  )
  if (STRING.SCAN("&clk", "*", 1)==(STRING.LENGTH("&clk")-1))
  (
    &wild_tail=1
  )

  if ((&wild_head==1)&&(&wild_tail==1))
  (
    if (STRING.SCAN("gcc_cnoc_bus_timeout10_ahb_clk", STRING.MID("&clk", 1, &clk_input_length-2), 0)!=-1)
    ( 
      &match=1
    )
  )
  else if (&wild_head==1)
  (
    if (STRING.MID("gcc_cnoc_bus_timeout10_ahb_clk", &clk_itr_length-&clk_input_length+1, &clk_input_length-1)==STRING.CUT("&clk", 1))
    ( 
      &match=1
    )
  )
  else if (&wild_tail==1)
  (
    if (STRING.MID("gcc_cnoc_bus_timeout10_ahb_clk", 0, &clk_input_length-1)==STRING.CUT("&clk", -1))
    ( 
      &match=1
    )
  )
  else if ("gcc_cnoc_bus_timeout10_ahb_clk"=="&clk")
  (
    &match=1
  )
  
  if (&match==1)
  (
    &clk_test=&CLK_TEST_GCC_CNOC_BUS_TIMEOUT10_AHB_CLK
    &clk_reg=&HWIO_GCC_CNOC_BUS_TIMEOUT10_AHB_CBCR_ADDR
    &clk_reg_name="GCC_CNOC_BUS_TIMEOUT10_AHB_CBCR"
    &clk_name="gcc_cnoc_bus_timeout10_ahb_clk"
    &clk_reg_cbcr_type="sm_cbc"
    &clk_vote_bit=-1.
    &clk_multiplier=4.
    &clk_access_mode="&GCC_access_mode"

    gosub Print_Clk_Info_Line
  )

  &match=0
  &wild_head=0
  &wild_tail=0
  &clk_input_length=STRING.LENGTH("&clk")
  &clk_itr_length=STRING.LENGTH("gcc_cnoc_bus_timeout11_ahb_clk")

  if (STRING.SCAN("&clk", "*", 0)==0)
  (
    &wild_head=1
  )
  if (STRING.SCAN("&clk", "*", 1)==(STRING.LENGTH("&clk")-1))
  (
    &wild_tail=1
  )

  if ((&wild_head==1)&&(&wild_tail==1))
  (
    if (STRING.SCAN("gcc_cnoc_bus_timeout11_ahb_clk", STRING.MID("&clk", 1, &clk_input_length-2), 0)!=-1)
    ( 
      &match=1
    )
  )
  else if (&wild_head==1)
  (
    if (STRING.MID("gcc_cnoc_bus_timeout11_ahb_clk", &clk_itr_length-&clk_input_length+1, &clk_input_length-1)==STRING.CUT("&clk", 1))
    ( 
      &match=1
    )
  )
  else if (&wild_tail==1)
  (
    if (STRING.MID("gcc_cnoc_bus_timeout11_ahb_clk", 0, &clk_input_length-1)==STRING.CUT("&clk", -1))
    ( 
      &match=1
    )
  )
  else if ("gcc_cnoc_bus_timeout11_ahb_clk"=="&clk")
  (
    &match=1
  )
  
  if (&match==1)
  (
    &clk_test=&CLK_TEST_GCC_CNOC_BUS_TIMEOUT11_AHB_CLK
    &clk_reg=&HWIO_GCC_CNOC_BUS_TIMEOUT11_AHB_CBCR_ADDR
    &clk_reg_name="GCC_CNOC_BUS_TIMEOUT11_AHB_CBCR"
    &clk_name="gcc_cnoc_bus_timeout11_ahb_clk"
    &clk_reg_cbcr_type="sm_cbc"
    &clk_vote_bit=-1.
    &clk_multiplier=4.
    &clk_access_mode="&GCC_access_mode"

    gosub Print_Clk_Info_Line
  )

  &match=0
  &wild_head=0
  &wild_tail=0
  &clk_input_length=STRING.LENGTH("&clk")
  &clk_itr_length=STRING.LENGTH("gcc_cnoc_bus_timeout2_ahb_clk")

  if (STRING.SCAN("&clk", "*", 0)==0)
  (
    &wild_head=1
  )
  if (STRING.SCAN("&clk", "*", 1)==(STRING.LENGTH("&clk")-1))
  (
    &wild_tail=1
  )

  if ((&wild_head==1)&&(&wild_tail==1))
  (
    if (STRING.SCAN("gcc_cnoc_bus_timeout2_ahb_clk", STRING.MID("&clk", 1, &clk_input_length-2), 0)!=-1)
    ( 
      &match=1
    )
  )
  else if (&wild_head==1)
  (
    if (STRING.MID("gcc_cnoc_bus_timeout2_ahb_clk", &clk_itr_length-&clk_input_length+1, &clk_input_length-1)==STRING.CUT("&clk", 1))
    ( 
      &match=1
    )
  )
  else if (&wild_tail==1)
  (
    if (STRING.MID("gcc_cnoc_bus_timeout2_ahb_clk", 0, &clk_input_length-1)==STRING.CUT("&clk", -1))
    ( 
      &match=1
    )
  )
  else if ("gcc_cnoc_bus_timeout2_ahb_clk"=="&clk")
  (
    &match=1
  )
  
  if (&match==1)
  (
    &clk_test=&CLK_TEST_GCC_CNOC_BUS_TIMEOUT2_AHB_CLK
    &clk_reg=&HWIO_GCC_CNOC_BUS_TIMEOUT2_AHB_CBCR_ADDR
    &clk_reg_name="GCC_CNOC_BUS_TIMEOUT2_AHB_CBCR"
    &clk_name="gcc_cnoc_bus_timeout2_ahb_clk"
    &clk_reg_cbcr_type="sm_cbc"
    &clk_vote_bit=-1.
    &clk_multiplier=4.
    &clk_access_mode="&GCC_access_mode"

    gosub Print_Clk_Info_Line
  )

  &match=0
  &wild_head=0
  &wild_tail=0
  &clk_input_length=STRING.LENGTH("&clk")
  &clk_itr_length=STRING.LENGTH("gcc_cnoc_bus_timeout3_ahb_clk")

  if (STRING.SCAN("&clk", "*", 0)==0)
  (
    &wild_head=1
  )
  if (STRING.SCAN("&clk", "*", 1)==(STRING.LENGTH("&clk")-1))
  (
    &wild_tail=1
  )

  if ((&wild_head==1)&&(&wild_tail==1))
  (
    if (STRING.SCAN("gcc_cnoc_bus_timeout3_ahb_clk", STRING.MID("&clk", 1, &clk_input_length-2), 0)!=-1)
    ( 
      &match=1
    )
  )
  else if (&wild_head==1)
  (
    if (STRING.MID("gcc_cnoc_bus_timeout3_ahb_clk", &clk_itr_length-&clk_input_length+1, &clk_input_length-1)==STRING.CUT("&clk", 1))
    ( 
      &match=1
    )
  )
  else if (&wild_tail==1)
  (
    if (STRING.MID("gcc_cnoc_bus_timeout3_ahb_clk", 0, &clk_input_length-1)==STRING.CUT("&clk", -1))
    ( 
      &match=1
    )
  )
  else if ("gcc_cnoc_bus_timeout3_ahb_clk"=="&clk")
  (
    &match=1
  )
  
  if (&match==1)
  (
    &clk_test=&CLK_TEST_GCC_CNOC_BUS_TIMEOUT3_AHB_CLK
    &clk_reg=&HWIO_GCC_CNOC_BUS_TIMEOUT3_AHB_CBCR_ADDR
    &clk_reg_name="GCC_CNOC_BUS_TIMEOUT3_AHB_CBCR"
    &clk_name="gcc_cnoc_bus_timeout3_ahb_clk"
    &clk_reg_cbcr_type="sm_cbc"
    &clk_vote_bit=-1.
    &clk_multiplier=4.
    &clk_access_mode="&GCC_access_mode"

    gosub Print_Clk_Info_Line
  )

  &match=0
  &wild_head=0
  &wild_tail=0
  &clk_input_length=STRING.LENGTH("&clk")
  &clk_itr_length=STRING.LENGTH("gcc_cnoc_bus_timeout4_ahb_clk")

  if (STRING.SCAN("&clk", "*", 0)==0)
  (
    &wild_head=1
  )
  if (STRING.SCAN("&clk", "*", 1)==(STRING.LENGTH("&clk")-1))
  (
    &wild_tail=1
  )

  if ((&wild_head==1)&&(&wild_tail==1))
  (
    if (STRING.SCAN("gcc_cnoc_bus_timeout4_ahb_clk", STRING.MID("&clk", 1, &clk_input_length-2), 0)!=-1)
    ( 
      &match=1
    )
  )
  else if (&wild_head==1)
  (
    if (STRING.MID("gcc_cnoc_bus_timeout4_ahb_clk", &clk_itr_length-&clk_input_length+1, &clk_input_length-1)==STRING.CUT("&clk", 1))
    ( 
      &match=1
    )
  )
  else if (&wild_tail==1)
  (
    if (STRING.MID("gcc_cnoc_bus_timeout4_ahb_clk", 0, &clk_input_length-1)==STRING.CUT("&clk", -1))
    ( 
      &match=1
    )
  )
  else if ("gcc_cnoc_bus_timeout4_ahb_clk"=="&clk")
  (
    &match=1
  )
  
  if (&match==1)
  (
    &clk_test=&CLK_TEST_GCC_CNOC_BUS_TIMEOUT4_AHB_CLK
    &clk_reg=&HWIO_GCC_CNOC_BUS_TIMEOUT4_AHB_CBCR_ADDR
    &clk_reg_name="GCC_CNOC_BUS_TIMEOUT4_AHB_CBCR"
    &clk_name="gcc_cnoc_bus_timeout4_ahb_clk"
    &clk_reg_cbcr_type="sm_cbc"
    &clk_vote_bit=-1.
    &clk_multiplier=4.
    &clk_access_mode="&GCC_access_mode"

    gosub Print_Clk_Info_Line
  )

  &match=0
  &wild_head=0
  &wild_tail=0
  &clk_input_length=STRING.LENGTH("&clk")
  &clk_itr_length=STRING.LENGTH("gcc_cnoc_bus_timeout6_ahb_clk")

  if (STRING.SCAN("&clk", "*", 0)==0)
  (
    &wild_head=1
  )
  if (STRING.SCAN("&clk", "*", 1)==(STRING.LENGTH("&clk")-1))
  (
    &wild_tail=1
  )

  if ((&wild_head==1)&&(&wild_tail==1))
  (
    if (STRING.SCAN("gcc_cnoc_bus_timeout6_ahb_clk", STRING.MID("&clk", 1, &clk_input_length-2), 0)!=-1)
    ( 
      &match=1
    )
  )
  else if (&wild_head==1)
  (
    if (STRING.MID("gcc_cnoc_bus_timeout6_ahb_clk", &clk_itr_length-&clk_input_length+1, &clk_input_length-1)==STRING.CUT("&clk", 1))
    ( 
      &match=1
    )
  )
  else if (&wild_tail==1)
  (
    if (STRING.MID("gcc_cnoc_bus_timeout6_ahb_clk", 0, &clk_input_length-1)==STRING.CUT("&clk", -1))
    ( 
      &match=1
    )
  )
  else if ("gcc_cnoc_bus_timeout6_ahb_clk"=="&clk")
  (
    &match=1
  )
  
  if (&match==1)
  (
    &clk_test=&CLK_TEST_GCC_CNOC_BUS_TIMEOUT6_AHB_CLK
    &clk_reg=&HWIO_GCC_CNOC_BUS_TIMEOUT6_AHB_CBCR_ADDR
    &clk_reg_name="GCC_CNOC_BUS_TIMEOUT6_AHB_CBCR"
    &clk_name="gcc_cnoc_bus_timeout6_ahb_clk"
    &clk_reg_cbcr_type="sm_cbc"
    &clk_vote_bit=-1.
    &clk_multiplier=4.
    &clk_access_mode="&GCC_access_mode"

    gosub Print_Clk_Info_Line
  )

  &match=0
  &wild_head=0
  &wild_tail=0
  &clk_input_length=STRING.LENGTH("&clk")
  &clk_itr_length=STRING.LENGTH("gcc_cnoc_bus_timeout7_ahb_clk")

  if (STRING.SCAN("&clk", "*", 0)==0)
  (
    &wild_head=1
  )
  if (STRING.SCAN("&clk", "*", 1)==(STRING.LENGTH("&clk")-1))
  (
    &wild_tail=1
  )

  if ((&wild_head==1)&&(&wild_tail==1))
  (
    if (STRING.SCAN("gcc_cnoc_bus_timeout7_ahb_clk", STRING.MID("&clk", 1, &clk_input_length-2), 0)!=-1)
    ( 
      &match=1
    )
  )
  else if (&wild_head==1)
  (
    if (STRING.MID("gcc_cnoc_bus_timeout7_ahb_clk", &clk_itr_length-&clk_input_length+1, &clk_input_length-1)==STRING.CUT("&clk", 1))
    ( 
      &match=1
    )
  )
  else if (&wild_tail==1)
  (
    if (STRING.MID("gcc_cnoc_bus_timeout7_ahb_clk", 0, &clk_input_length-1)==STRING.CUT("&clk", -1))
    ( 
      &match=1
    )
  )
  else if ("gcc_cnoc_bus_timeout7_ahb_clk"=="&clk")
  (
    &match=1
  )
  
  if (&match==1)
  (
    &clk_test=&CLK_TEST_GCC_CNOC_BUS_TIMEOUT7_AHB_CLK
    &clk_reg=&HWIO_GCC_CNOC_BUS_TIMEOUT7_AHB_CBCR_ADDR
    &clk_reg_name="GCC_CNOC_BUS_TIMEOUT7_AHB_CBCR"
    &clk_name="gcc_cnoc_bus_timeout7_ahb_clk"
    &clk_reg_cbcr_type="sm_cbc"
    &clk_vote_bit=-1.
    &clk_multiplier=4.
    &clk_access_mode="&GCC_access_mode"

    gosub Print_Clk_Info_Line
  )

  &match=0
  &wild_head=0
  &wild_tail=0
  &clk_input_length=STRING.LENGTH("&clk")
  &clk_itr_length=STRING.LENGTH("gcc_cnoc_bus_timeout8_ahb_clk")

  if (STRING.SCAN("&clk", "*", 0)==0)
  (
    &wild_head=1
  )
  if (STRING.SCAN("&clk", "*", 1)==(STRING.LENGTH("&clk")-1))
  (
    &wild_tail=1
  )

  if ((&wild_head==1)&&(&wild_tail==1))
  (
    if (STRING.SCAN("gcc_cnoc_bus_timeout8_ahb_clk", STRING.MID("&clk", 1, &clk_input_length-2), 0)!=-1)
    ( 
      &match=1
    )
  )
  else if (&wild_head==1)
  (
    if (STRING.MID("gcc_cnoc_bus_timeout8_ahb_clk", &clk_itr_length-&clk_input_length+1, &clk_input_length-1)==STRING.CUT("&clk", 1))
    ( 
      &match=1
    )
  )
  else if (&wild_tail==1)
  (
    if (STRING.MID("gcc_cnoc_bus_timeout8_ahb_clk", 0, &clk_input_length-1)==STRING.CUT("&clk", -1))
    ( 
      &match=1
    )
  )
  else if ("gcc_cnoc_bus_timeout8_ahb_clk"=="&clk")
  (
    &match=1
  )
  
  if (&match==1)
  (
    &clk_test=&CLK_TEST_GCC_CNOC_BUS_TIMEOUT8_AHB_CLK
    &clk_reg=&HWIO_GCC_CNOC_BUS_TIMEOUT8_AHB_CBCR_ADDR
    &clk_reg_name="GCC_CNOC_BUS_TIMEOUT8_AHB_CBCR"
    &clk_name="gcc_cnoc_bus_timeout8_ahb_clk"
    &clk_reg_cbcr_type="sm_cbc"
    &clk_vote_bit=-1.
    &clk_multiplier=4.
    &clk_access_mode="&GCC_access_mode"

    gosub Print_Clk_Info_Line
  )

  &match=0
  &wild_head=0
  &wild_tail=0
  &clk_input_length=STRING.LENGTH("&clk")
  &clk_itr_length=STRING.LENGTH("gcc_cnoc_bus_timeout9_ahb_clk")

  if (STRING.SCAN("&clk", "*", 0)==0)
  (
    &wild_head=1
  )
  if (STRING.SCAN("&clk", "*", 1)==(STRING.LENGTH("&clk")-1))
  (
    &wild_tail=1
  )

  if ((&wild_head==1)&&(&wild_tail==1))
  (
    if (STRING.SCAN("gcc_cnoc_bus_timeout9_ahb_clk", STRING.MID("&clk", 1, &clk_input_length-2), 0)!=-1)
    ( 
      &match=1
    )
  )
  else if (&wild_head==1)
  (
    if (STRING.MID("gcc_cnoc_bus_timeout9_ahb_clk", &clk_itr_length-&clk_input_length+1, &clk_input_length-1)==STRING.CUT("&clk", 1))
    ( 
      &match=1
    )
  )
  else if (&wild_tail==1)
  (
    if (STRING.MID("gcc_cnoc_bus_timeout9_ahb_clk", 0, &clk_input_length-1)==STRING.CUT("&clk", -1))
    ( 
      &match=1
    )
  )
  else if ("gcc_cnoc_bus_timeout9_ahb_clk"=="&clk")
  (
    &match=1
  )
  
  if (&match==1)
  (
    &clk_test=&CLK_TEST_GCC_CNOC_BUS_TIMEOUT9_AHB_CLK
    &clk_reg=&HWIO_GCC_CNOC_BUS_TIMEOUT9_AHB_CBCR_ADDR
    &clk_reg_name="GCC_CNOC_BUS_TIMEOUT9_AHB_CBCR"
    &clk_name="gcc_cnoc_bus_timeout9_ahb_clk"
    &clk_reg_cbcr_type="sm_cbc"
    &clk_vote_bit=-1.
    &clk_multiplier=4.
    &clk_access_mode="&GCC_access_mode"

    gosub Print_Clk_Info_Line
  )

  &match=0
  &wild_head=0
  &wild_tail=0
  &clk_input_length=STRING.LENGTH("&clk")
  &clk_itr_length=STRING.LENGTH("gcc_cnoc_mst_rpm_ahb_clk")

  if (STRING.SCAN("&clk", "*", 0)==0)
  (
    &wild_head=1
  )
  if (STRING.SCAN("&clk", "*", 1)==(STRING.LENGTH("&clk")-1))
  (
    &wild_tail=1
  )

  if ((&wild_head==1)&&(&wild_tail==1))
  (
    if (STRING.SCAN("gcc_cnoc_mst_rpm_ahb_clk", STRING.MID("&clk", 1, &clk_input_length-2), 0)!=-1)
    ( 
      &match=1
    )
  )
  else if (&wild_head==1)
  (
    if (STRING.MID("gcc_cnoc_mst_rpm_ahb_clk", &clk_itr_length-&clk_input_length+1, &clk_input_length-1)==STRING.CUT("&clk", 1))
    ( 
      &match=1
    )
  )
  else if (&wild_tail==1)
  (
    if (STRING.MID("gcc_cnoc_mst_rpm_ahb_clk", 0, &clk_input_length-1)==STRING.CUT("&clk", -1))
    ( 
      &match=1
    )
  )
  else if ("gcc_cnoc_mst_rpm_ahb_clk"=="&clk")
  (
    &match=1
  )
  
  if (&match==1)
  (
    &clk_test=&CLK_TEST_GCC_CNOC_MST_RPM_AHB_CLK
    &clk_reg=&HWIO_GCC_CNOC_MST_RPM_AHB_CBCR_ADDR
    &clk_reg_name="GCC_CNOC_MST_RPM_AHB_CBCR"
    &clk_name="gcc_cnoc_mst_rpm_ahb_clk"
    &clk_reg_cbcr_type="sm_cbc"
    &clk_vote_bit=-1.
    &clk_multiplier=4.
    &clk_access_mode="&GCC_access_mode"

    gosub Print_Clk_Info_Line
  )

  &match=0
  &wild_head=0
  &wild_tail=0
  &clk_input_length=STRING.LENGTH("&clk")
  &clk_itr_length=STRING.LENGTH("gcc_dcc_ahb_clk")

  if (STRING.SCAN("&clk", "*", 0)==0)
  (
    &wild_head=1
  )
  if (STRING.SCAN("&clk", "*", 1)==(STRING.LENGTH("&clk")-1))
  (
    &wild_tail=1
  )

  if ((&wild_head==1)&&(&wild_tail==1))
  (
    if (STRING.SCAN("gcc_dcc_ahb_clk", STRING.MID("&clk", 1, &clk_input_length-2), 0)!=-1)
    ( 
      &match=1
    )
  )
  else if (&wild_head==1)
  (
    if (STRING.MID("gcc_dcc_ahb_clk", &clk_itr_length-&clk_input_length+1, &clk_input_length-1)==STRING.CUT("&clk", 1))
    ( 
      &match=1
    )
  )
  else if (&wild_tail==1)
  (
    if (STRING.MID("gcc_dcc_ahb_clk", 0, &clk_input_length-1)==STRING.CUT("&clk", -1))
    ( 
      &match=1
    )
  )
  else if ("gcc_dcc_ahb_clk"=="&clk")
  (
    &match=1
  )
  
  if (&match==1)
  (
    &clk_test=&CLK_TEST_GCC_DCC_AHB_CLK
    &clk_reg=&HWIO_GCC_DCC_AHB_CBCR_ADDR
    &clk_reg_name="GCC_DCC_AHB_CBCR"
    &clk_name="gcc_dcc_ahb_clk"
    &clk_reg_cbcr_type="sm_pscbc"
    &clk_vote_bit=-1.
    &clk_multiplier=4.
    &clk_access_mode="&GCC_access_mode"

    gosub Print_Clk_Info_Line
  )

  &match=0
  &wild_head=0
  &wild_tail=0
  &clk_input_length=STRING.LENGTH("&clk")
  &clk_itr_length=STRING.LENGTH("gcc_glm_ahb_clk")

  if (STRING.SCAN("&clk", "*", 0)==0)
  (
    &wild_head=1
  )
  if (STRING.SCAN("&clk", "*", 1)==(STRING.LENGTH("&clk")-1))
  (
    &wild_tail=1
  )

  if ((&wild_head==1)&&(&wild_tail==1))
  (
    if (STRING.SCAN("gcc_glm_ahb_clk", STRING.MID("&clk", 1, &clk_input_length-2), 0)!=-1)
    ( 
      &match=1
    )
  )
  else if (&wild_head==1)
  (
    if (STRING.MID("gcc_glm_ahb_clk", &clk_itr_length-&clk_input_length+1, &clk_input_length-1)==STRING.CUT("&clk", 1))
    ( 
      &match=1
    )
  )
  else if (&wild_tail==1)
  (
    if (STRING.MID("gcc_glm_ahb_clk", 0, &clk_input_length-1)==STRING.CUT("&clk", -1))
    ( 
      &match=1
    )
  )
  else if ("gcc_glm_ahb_clk"=="&clk")
  (
    &match=1
  )
  
  if (&match==1)
  (
    &clk_test=&CLK_TEST_GCC_GLM_AHB_CLK
    &clk_reg=&HWIO_GCC_GLM_AHB_CBCR_ADDR
    &clk_reg_name="GCC_GLM_AHB_CBCR"
    &clk_name="gcc_glm_ahb_clk"
    &clk_reg_cbcr_type="sm_cbc"
    &clk_vote_bit=-1.
    &clk_multiplier=4.
    &clk_access_mode="&GCC_access_mode"

    gosub Print_Clk_Info_Line
  )

  &match=0
  &wild_head=0
  &wild_tail=0
  &clk_input_length=STRING.LENGTH("&clk")
  &clk_itr_length=STRING.LENGTH("gcc_gpu_cfg_ahb_clk")

  if (STRING.SCAN("&clk", "*", 0)==0)
  (
    &wild_head=1
  )
  if (STRING.SCAN("&clk", "*", 1)==(STRING.LENGTH("&clk")-1))
  (
    &wild_tail=1
  )

  if ((&wild_head==1)&&(&wild_tail==1))
  (
    if (STRING.SCAN("gcc_gpu_cfg_ahb_clk", STRING.MID("&clk", 1, &clk_input_length-2), 0)!=-1)
    ( 
      &match=1
    )
  )
  else if (&wild_head==1)
  (
    if (STRING.MID("gcc_gpu_cfg_ahb_clk", &clk_itr_length-&clk_input_length+1, &clk_input_length-1)==STRING.CUT("&clk", 1))
    ( 
      &match=1
    )
  )
  else if (&wild_tail==1)
  (
    if (STRING.MID("gcc_gpu_cfg_ahb_clk", 0, &clk_input_length-1)==STRING.CUT("&clk", -1))
    ( 
      &match=1
    )
  )
  else if ("gcc_gpu_cfg_ahb_clk"=="&clk")
  (
    &match=1
  )
  
  if (&match==1)
  (
    &clk_test=&CLK_TEST_GCC_GPU_CFG_AHB_CLK
    &clk_reg=&HWIO_GCC_GPU_CFG_AHB_CBCR_ADDR
    &clk_reg_name="GCC_GPU_CFG_AHB_CBCR"
    &clk_name="gcc_gpu_cfg_ahb_clk"
    &clk_reg_cbcr_type="sm_cbc"
    &clk_vote_bit=-1.
    &clk_multiplier=4.
    &clk_access_mode="&GCC_access_mode"

    gosub Print_Clk_Info_Line
  )

  &match=0
  &wild_head=0
  &wild_tail=0
  &clk_input_length=STRING.LENGTH("&clk")
  &clk_itr_length=STRING.LENGTH("gcc_imem_cfg_ahb_clk")

  if (STRING.SCAN("&clk", "*", 0)==0)
  (
    &wild_head=1
  )
  if (STRING.SCAN("&clk", "*", 1)==(STRING.LENGTH("&clk")-1))
  (
    &wild_tail=1
  )

  if ((&wild_head==1)&&(&wild_tail==1))
  (
    if (STRING.SCAN("gcc_imem_cfg_ahb_clk", STRING.MID("&clk", 1, &clk_input_length-2), 0)!=-1)
    ( 
      &match=1
    )
  )
  else if (&wild_head==1)
  (
    if (STRING.MID("gcc_imem_cfg_ahb_clk", &clk_itr_length-&clk_input_length+1, &clk_input_length-1)==STRING.CUT("&clk", 1))
    ( 
      &match=1
    )
  )
  else if (&wild_tail==1)
  (
    if (STRING.MID("gcc_imem_cfg_ahb_clk", 0, &clk_input_length-1)==STRING.CUT("&clk", -1))
    ( 
      &match=1
    )
  )
  else if ("gcc_imem_cfg_ahb_clk"=="&clk")
  (
    &match=1
  )
  
  if (&match==1)
  (
    &clk_test=&CLK_TEST_GCC_IMEM_CFG_AHB_CLK
    &clk_reg=&HWIO_GCC_IMEM_CFG_AHB_CBCR_ADDR
    &clk_reg_name="GCC_IMEM_CFG_AHB_CBCR"
    &clk_name="gcc_imem_cfg_ahb_clk"
    &clk_reg_cbcr_type="sm_cbc"
    &clk_vote_bit=-1.
    &clk_multiplier=4.
    &clk_access_mode="&GCC_access_mode"

    gosub Print_Clk_Info_Line
  )

  &match=0
  &wild_head=0
  &wild_tail=0
  &clk_input_length=STRING.LENGTH("&clk")
  &clk_itr_length=STRING.LENGTH("gcc_ipa_ahb_clk")

  if (STRING.SCAN("&clk", "*", 0)==0)
  (
    &wild_head=1
  )
  if (STRING.SCAN("&clk", "*", 1)==(STRING.LENGTH("&clk")-1))
  (
    &wild_tail=1
  )

  if ((&wild_head==1)&&(&wild_tail==1))
  (
    if (STRING.SCAN("gcc_ipa_ahb_clk", STRING.MID("&clk", 1, &clk_input_length-2), 0)!=-1)
    ( 
      &match=1
    )
  )
  else if (&wild_head==1)
  (
    if (STRING.MID("gcc_ipa_ahb_clk", &clk_itr_length-&clk_input_length+1, &clk_input_length-1)==STRING.CUT("&clk", 1))
    ( 
      &match=1
    )
  )
  else if (&wild_tail==1)
  (
    if (STRING.MID("gcc_ipa_ahb_clk", 0, &clk_input_length-1)==STRING.CUT("&clk", -1))
    ( 
      &match=1
    )
  )
  else if ("gcc_ipa_ahb_clk"=="&clk")
  (
    &match=1
  )
  
  if (&match==1)
  (
    &clk_test=&CLK_TEST_GCC_IPA_AHB_CLK
    &clk_reg=&HWIO_GCC_IPA_AHB_CBCR_ADDR
    &clk_reg_name="GCC_IPA_AHB_CBCR"
    &clk_name="gcc_ipa_ahb_clk"
    &clk_reg_cbcr_type="sm_cbc"
    &clk_vote_bit=-1.
    &clk_multiplier=4.
    &clk_access_mode="&GCC_access_mode"

    gosub Print_Clk_Info_Line
  )

  &match=0
  &wild_head=0
  &wild_tail=0
  &clk_input_length=STRING.LENGTH("&clk")
  &clk_itr_length=STRING.LENGTH("gcc_lpass_cnoc_cfg_clk")

  if (STRING.SCAN("&clk", "*", 0)==0)
  (
    &wild_head=1
  )
  if (STRING.SCAN("&clk", "*", 1)==(STRING.LENGTH("&clk")-1))
  (
    &wild_tail=1
  )

  if ((&wild_head==1)&&(&wild_tail==1))
  (
    if (STRING.SCAN("gcc_lpass_cnoc_cfg_clk", STRING.MID("&clk", 1, &clk_input_length-2), 0)!=-1)
    ( 
      &match=1
    )
  )
  else if (&wild_head==1)
  (
    if (STRING.MID("gcc_lpass_cnoc_cfg_clk", &clk_itr_length-&clk_input_length+1, &clk_input_length-1)==STRING.CUT("&clk", 1))
    ( 
      &match=1
    )
  )
  else if (&wild_tail==1)
  (
    if (STRING.MID("gcc_lpass_cnoc_cfg_clk", 0, &clk_input_length-1)==STRING.CUT("&clk", -1))
    ( 
      &match=1
    )
  )
  else if ("gcc_lpass_cnoc_cfg_clk"=="&clk")
  (
    &match=1
  )
  
  if (&match==1)
  (
    &clk_test=&CLK_TEST_GCC_LPASS_CNOC_CFG_CLK
    &clk_reg=&HWIO_GCC_LPASS_CNOC_CFG_CBCR_ADDR
    &clk_reg_name="GCC_LPASS_CNOC_CFG_CBCR"
    &clk_name="gcc_lpass_cnoc_cfg_clk"
    &clk_reg_cbcr_type="sm_cbc"
    &clk_vote_bit=-1.
    &clk_multiplier=4.
    &clk_access_mode="&GCC_access_mode"

    gosub Print_Clk_Info_Line
  )

  &match=0
  &wild_head=0
  &wild_tail=0
  &clk_input_length=STRING.LENGTH("&clk")
  &clk_itr_length=STRING.LENGTH("gcc_lpass_q6_smmu_ahb_clk")

  if (STRING.SCAN("&clk", "*", 0)==0)
  (
    &wild_head=1
  )
  if (STRING.SCAN("&clk", "*", 1)==(STRING.LENGTH("&clk")-1))
  (
    &wild_tail=1
  )

  if ((&wild_head==1)&&(&wild_tail==1))
  (
    if (STRING.SCAN("gcc_lpass_q6_smmu_ahb_clk", STRING.MID("&clk", 1, &clk_input_length-2), 0)!=-1)
    ( 
      &match=1
    )
  )
  else if (&wild_head==1)
  (
    if (STRING.MID("gcc_lpass_q6_smmu_ahb_clk", &clk_itr_length-&clk_input_length+1, &clk_input_length-1)==STRING.CUT("&clk", 1))
    ( 
      &match=1
    )
  )
  else if (&wild_tail==1)
  (
    if (STRING.MID("gcc_lpass_q6_smmu_ahb_clk", 0, &clk_input_length-1)==STRING.CUT("&clk", -1))
    ( 
      &match=1
    )
  )
  else if ("gcc_lpass_q6_smmu_ahb_clk"=="&clk")
  (
    &match=1
  )
  
  if (&match==1)
  (
    &clk_test=&CLK_TEST_GCC_LPASS_Q6_SMMU_AHB_CLK
    &clk_reg=&HWIO_GCC_LPASS_Q6_SMMU_AHB_CBCR_ADDR
    &clk_reg_name="GCC_LPASS_Q6_SMMU_AHB_CBCR"
    &clk_name="gcc_lpass_q6_smmu_ahb_clk"
    &clk_reg_cbcr_type="sm_cbc"
    &clk_vote_bit=-1.
    &clk_multiplier=4.
    &clk_access_mode="&GCC_access_mode"

    gosub Print_Clk_Info_Line
  )

  &match=0
  &wild_head=0
  &wild_tail=0
  &clk_input_length=STRING.LENGTH("&clk")
  &clk_itr_length=STRING.LENGTH("gcc_lpass_q6_smmu_gds_cfg_clk")

  if (STRING.SCAN("&clk", "*", 0)==0)
  (
    &wild_head=1
  )
  if (STRING.SCAN("&clk", "*", 1)==(STRING.LENGTH("&clk")-1))
  (
    &wild_tail=1
  )

  if ((&wild_head==1)&&(&wild_tail==1))
  (
    if (STRING.SCAN("gcc_lpass_q6_smmu_gds_cfg_clk", STRING.MID("&clk", 1, &clk_input_length-2), 0)!=-1)
    ( 
      &match=1
    )
  )
  else if (&wild_head==1)
  (
    if (STRING.MID("gcc_lpass_q6_smmu_gds_cfg_clk", &clk_itr_length-&clk_input_length+1, &clk_input_length-1)==STRING.CUT("&clk", 1))
    ( 
      &match=1
    )
  )
  else if (&wild_tail==1)
  (
    if (STRING.MID("gcc_lpass_q6_smmu_gds_cfg_clk", 0, &clk_input_length-1)==STRING.CUT("&clk", -1))
    ( 
      &match=1
    )
  )
  else if ("gcc_lpass_q6_smmu_gds_cfg_clk"=="&clk")
  (
    &match=1
  )
  
  if (&match==1)
  (
    &clk_test=&CLK_TEST_GCC_LPASS_Q6_SMMU_GDS_CFG_CLK
    &clk_reg=&HWIO_GCC_LPASS_Q6_SMMU_GDS_CFG_CBCR_ADDR
    &clk_reg_name="GCC_LPASS_Q6_SMMU_GDS_CFG_CBCR"
    &clk_name="gcc_lpass_q6_smmu_gds_cfg_clk"
    &clk_reg_cbcr_type="sm_cbc"
    &clk_vote_bit=-1.
    &clk_multiplier=4.
    &clk_access_mode="&GCC_access_mode"

    gosub Print_Clk_Info_Line
  )

  &match=0
  &wild_head=0
  &wild_tail=0
  &clk_input_length=STRING.LENGTH("&clk")
  &clk_itr_length=STRING.LENGTH("gcc_mccc_cfg_ahb_clk")

  if (STRING.SCAN("&clk", "*", 0)==0)
  (
    &wild_head=1
  )
  if (STRING.SCAN("&clk", "*", 1)==(STRING.LENGTH("&clk")-1))
  (
    &wild_tail=1
  )

  if ((&wild_head==1)&&(&wild_tail==1))
  (
    if (STRING.SCAN("gcc_mccc_cfg_ahb_clk", STRING.MID("&clk", 1, &clk_input_length-2), 0)!=-1)
    ( 
      &match=1
    )
  )
  else if (&wild_head==1)
  (
    if (STRING.MID("gcc_mccc_cfg_ahb_clk", &clk_itr_length-&clk_input_length+1, &clk_input_length-1)==STRING.CUT("&clk", 1))
    ( 
      &match=1
    )
  )
  else if (&wild_tail==1)
  (
    if (STRING.MID("gcc_mccc_cfg_ahb_clk", 0, &clk_input_length-1)==STRING.CUT("&clk", -1))
    ( 
      &match=1
    )
  )
  else if ("gcc_mccc_cfg_ahb_clk"=="&clk")
  (
    &match=1
  )
  
  if (&match==1)
  (
    &clk_test=&CLK_TEST_GCC_MCCC_CFG_AHB_CLK
    &clk_reg=&HWIO_GCC_MCCC_CFG_AHB_CBCR_ADDR
    &clk_reg_name="GCC_MCCC_CFG_AHB_CBCR"
    &clk_name="gcc_mccc_cfg_ahb_clk"
    &clk_reg_cbcr_type="sm_cbc"
    &clk_vote_bit=-1.
    &clk_multiplier=4.
    &clk_access_mode="&GCC_access_mode"

    gosub Print_Clk_Info_Line
  )

  &match=0
  &wild_head=0
  &wild_tail=0
  &clk_input_length=STRING.LENGTH("&clk")
  &clk_itr_length=STRING.LENGTH("gcc_mmss_noc_cfg_ahb_clk")

  if (STRING.SCAN("&clk", "*", 0)==0)
  (
    &wild_head=1
  )
  if (STRING.SCAN("&clk", "*", 1)==(STRING.LENGTH("&clk")-1))
  (
    &wild_tail=1
  )

  if ((&wild_head==1)&&(&wild_tail==1))
  (
    if (STRING.SCAN("gcc_mmss_noc_cfg_ahb_clk", STRING.MID("&clk", 1, &clk_input_length-2), 0)!=-1)
    ( 
      &match=1
    )
  )
  else if (&wild_head==1)
  (
    if (STRING.MID("gcc_mmss_noc_cfg_ahb_clk", &clk_itr_length-&clk_input_length+1, &clk_input_length-1)==STRING.CUT("&clk", 1))
    ( 
      &match=1
    )
  )
  else if (&wild_tail==1)
  (
    if (STRING.MID("gcc_mmss_noc_cfg_ahb_clk", 0, &clk_input_length-1)==STRING.CUT("&clk", -1))
    ( 
      &match=1
    )
  )
  else if ("gcc_mmss_noc_cfg_ahb_clk"=="&clk")
  (
    &match=1
  )
  
  if (&match==1)
  (
    &clk_test=&CLK_TEST_GCC_MMSS_NOC_CFG_AHB_CLK
    &clk_reg=&HWIO_GCC_MMSS_NOC_CFG_AHB_CBCR_ADDR
    &clk_reg_name="GCC_MMSS_NOC_CFG_AHB_CBCR"
    &clk_name="gcc_mmss_noc_cfg_ahb_clk"
    &clk_reg_cbcr_type="sm_cbc"
    &clk_vote_bit=-1.
    &clk_multiplier=4.
    &clk_access_mode="&GCC_access_mode"

    gosub Print_Clk_Info_Line
  )

  &match=0
  &wild_head=0
  &wild_tail=0
  &clk_input_length=STRING.LENGTH("&clk")
  &clk_itr_length=STRING.LENGTH("gcc_mmss_qm_ahb_clk")

  if (STRING.SCAN("&clk", "*", 0)==0)
  (
    &wild_head=1
  )
  if (STRING.SCAN("&clk", "*", 1)==(STRING.LENGTH("&clk")-1))
  (
    &wild_tail=1
  )

  if ((&wild_head==1)&&(&wild_tail==1))
  (
    if (STRING.SCAN("gcc_mmss_qm_ahb_clk", STRING.MID("&clk", 1, &clk_input_length-2), 0)!=-1)
    ( 
      &match=1
    )
  )
  else if (&wild_head==1)
  (
    if (STRING.MID("gcc_mmss_qm_ahb_clk", &clk_itr_length-&clk_input_length+1, &clk_input_length-1)==STRING.CUT("&clk", 1))
    ( 
      &match=1
    )
  )
  else if (&wild_tail==1)
  (
    if (STRING.MID("gcc_mmss_qm_ahb_clk", 0, &clk_input_length-1)==STRING.CUT("&clk", -1))
    ( 
      &match=1
    )
  )
  else if ("gcc_mmss_qm_ahb_clk"=="&clk")
  (
    &match=1
  )
  
  if (&match==1)
  (
    &clk_test=&CLK_TEST_GCC_MMSS_QM_AHB_CLK
    &clk_reg=&HWIO_GCC_MMSS_QM_AHB_CBCR_ADDR
    &clk_reg_name="GCC_MMSS_QM_AHB_CBCR"
    &clk_name="gcc_mmss_qm_ahb_clk"
    &clk_reg_cbcr_type="sm_cbc"
    &clk_vote_bit=-1.
    &clk_multiplier=4.
    &clk_access_mode="&GCC_access_mode"

    gosub Print_Clk_Info_Line
  )

  &match=0
  &wild_head=0
  &wild_tail=0
  &clk_input_length=STRING.LENGTH("&clk")
  &clk_itr_length=STRING.LENGTH("gcc_mpm_ahb_clk")

  if (STRING.SCAN("&clk", "*", 0)==0)
  (
    &wild_head=1
  )
  if (STRING.SCAN("&clk", "*", 1)==(STRING.LENGTH("&clk")-1))
  (
    &wild_tail=1
  )

  if ((&wild_head==1)&&(&wild_tail==1))
  (
    if (STRING.SCAN("gcc_mpm_ahb_clk", STRING.MID("&clk", 1, &clk_input_length-2), 0)!=-1)
    ( 
      &match=1
    )
  )
  else if (&wild_head==1)
  (
    if (STRING.MID("gcc_mpm_ahb_clk", &clk_itr_length-&clk_input_length+1, &clk_input_length-1)==STRING.CUT("&clk", 1))
    ( 
      &match=1
    )
  )
  else if (&wild_tail==1)
  (
    if (STRING.MID("gcc_mpm_ahb_clk", 0, &clk_input_length-1)==STRING.CUT("&clk", -1))
    ( 
      &match=1
    )
  )
  else if ("gcc_mpm_ahb_clk"=="&clk")
  (
    &match=1
  )
  
  if (&match==1)
  (
    &clk_test=&CLK_TEST_GCC_MPM_AHB_CLK
    &clk_reg=&HWIO_GCC_MPM_AHB_CBCR_ADDR
    &clk_reg_name="GCC_MPM_AHB_CBCR"
    &clk_name="gcc_mpm_ahb_clk"
    &clk_reg_cbcr_type="sm_cbc"
    &clk_vote_bit=19.
    &clk_multiplier=4.
    &clk_access_mode="&GCC_access_mode"

    gosub Print_Clk_Info_Line
  )

  &match=0
  &wild_head=0
  &wild_tail=0
  &clk_input_length=STRING.LENGTH("&clk")
  &clk_itr_length=STRING.LENGTH("gcc_msg_ram_ahb_clk")

  if (STRING.SCAN("&clk", "*", 0)==0)
  (
    &wild_head=1
  )
  if (STRING.SCAN("&clk", "*", 1)==(STRING.LENGTH("&clk")-1))
  (
    &wild_tail=1
  )

  if ((&wild_head==1)&&(&wild_tail==1))
  (
    if (STRING.SCAN("gcc_msg_ram_ahb_clk", STRING.MID("&clk", 1, &clk_input_length-2), 0)!=-1)
    ( 
      &match=1
    )
  )
  else if (&wild_head==1)
  (
    if (STRING.MID("gcc_msg_ram_ahb_clk", &clk_itr_length-&clk_input_length+1, &clk_input_length-1)==STRING.CUT("&clk", 1))
    ( 
      &match=1
    )
  )
  else if (&wild_tail==1)
  (
    if (STRING.MID("gcc_msg_ram_ahb_clk", 0, &clk_input_length-1)==STRING.CUT("&clk", -1))
    ( 
      &match=1
    )
  )
  else if ("gcc_msg_ram_ahb_clk"=="&clk")
  (
    &match=1
  )
  
  if (&match==1)
  (
    &clk_test=&CLK_TEST_GCC_MSG_RAM_AHB_CLK
    &clk_reg=&HWIO_GCC_MSG_RAM_AHB_CBCR_ADDR
    &clk_reg_name="GCC_MSG_RAM_AHB_CBCR"
    &clk_name="gcc_msg_ram_ahb_clk"
    &clk_reg_cbcr_type="sm_pscbc"
    &clk_vote_bit=9.
    &clk_multiplier=4.
    &clk_access_mode="&GCC_access_mode"

    gosub Print_Clk_Info_Line
  )

  &match=0
  &wild_head=0
  &wild_tail=0
  &clk_input_length=STRING.LENGTH("&clk")
  &clk_itr_length=STRING.LENGTH("gcc_mss_cfg_ahb_clk")

  if (STRING.SCAN("&clk", "*", 0)==0)
  (
    &wild_head=1
  )
  if (STRING.SCAN("&clk", "*", 1)==(STRING.LENGTH("&clk")-1))
  (
    &wild_tail=1
  )

  if ((&wild_head==1)&&(&wild_tail==1))
  (
    if (STRING.SCAN("gcc_mss_cfg_ahb_clk", STRING.MID("&clk", 1, &clk_input_length-2), 0)!=-1)
    ( 
      &match=1
    )
  )
  else if (&wild_head==1)
  (
    if (STRING.MID("gcc_mss_cfg_ahb_clk", &clk_itr_length-&clk_input_length+1, &clk_input_length-1)==STRING.CUT("&clk", 1))
    ( 
      &match=1
    )
  )
  else if (&wild_tail==1)
  (
    if (STRING.MID("gcc_mss_cfg_ahb_clk", 0, &clk_input_length-1)==STRING.CUT("&clk", -1))
    ( 
      &match=1
    )
  )
  else if ("gcc_mss_cfg_ahb_clk"=="&clk")
  (
    &match=1
  )
  
  if (&match==1)
  (
    &clk_test=&CLK_TEST_GCC_MSS_CFG_AHB_CLK
    &clk_reg=&HWIO_GCC_MSS_CFG_AHB_CBCR_ADDR
    &clk_reg_name="GCC_MSS_CFG_AHB_CBCR"
    &clk_name="gcc_mss_cfg_ahb_clk"
    &clk_reg_cbcr_type="sm_cbc"
    &clk_vote_bit=-1.
    &clk_multiplier=4.
    &clk_access_mode="&GCC_access_mode"

    gosub Print_Clk_Info_Line
  )

  &match=0
  &wild_head=0
  &wild_tail=0
  &clk_input_length=STRING.LENGTH("&clk")
  &clk_itr_length=STRING.LENGTH("gcc_mss_msmpu_cfg_ahb_clk")

  if (STRING.SCAN("&clk", "*", 0)==0)
  (
    &wild_head=1
  )
  if (STRING.SCAN("&clk", "*", 1)==(STRING.LENGTH("&clk")-1))
  (
    &wild_tail=1
  )

  if ((&wild_head==1)&&(&wild_tail==1))
  (
    if (STRING.SCAN("gcc_mss_msmpu_cfg_ahb_clk", STRING.MID("&clk", 1, &clk_input_length-2), 0)!=-1)
    ( 
      &match=1
    )
  )
  else if (&wild_head==1)
  (
    if (STRING.MID("gcc_mss_msmpu_cfg_ahb_clk", &clk_itr_length-&clk_input_length+1, &clk_input_length-1)==STRING.CUT("&clk", 1))
    ( 
      &match=1
    )
  )
  else if (&wild_tail==1)
  (
    if (STRING.MID("gcc_mss_msmpu_cfg_ahb_clk", 0, &clk_input_length-1)==STRING.CUT("&clk", -1))
    ( 
      &match=1
    )
  )
  else if ("gcc_mss_msmpu_cfg_ahb_clk"=="&clk")
  (
    &match=1
  )
  
  if (&match==1)
  (
    &clk_test=&CLK_TEST_GCC_MSS_MSMPU_CFG_AHB_CLK
    &clk_reg=&HWIO_GCC_MSS_MSMPU_CFG_AHB_CBCR_ADDR
    &clk_reg_name="GCC_MSS_MSMPU_CFG_AHB_CBCR"
    &clk_name="gcc_mss_msmpu_cfg_ahb_clk"
    &clk_reg_cbcr_type="sm_cbc"
    &clk_vote_bit=-1.
    &clk_multiplier=4.
    &clk_access_mode="&GCC_access_mode"

    gosub Print_Clk_Info_Line
  )

  &match=0
  &wild_head=0
  &wild_tail=0
  &clk_input_length=STRING.LENGTH("&clk")
  &clk_itr_length=STRING.LENGTH("gcc_mss_q6_msmpu_cfg_ahb_clk")

  if (STRING.SCAN("&clk", "*", 0)==0)
  (
    &wild_head=1
  )
  if (STRING.SCAN("&clk", "*", 1)==(STRING.LENGTH("&clk")-1))
  (
    &wild_tail=1
  )

  if ((&wild_head==1)&&(&wild_tail==1))
  (
    if (STRING.SCAN("gcc_mss_q6_msmpu_cfg_ahb_clk", STRING.MID("&clk", 1, &clk_input_length-2), 0)!=-1)
    ( 
      &match=1
    )
  )
  else if (&wild_head==1)
  (
    if (STRING.MID("gcc_mss_q6_msmpu_cfg_ahb_clk", &clk_itr_length-&clk_input_length+1, &clk_input_length-1)==STRING.CUT("&clk", 1))
    ( 
      &match=1
    )
  )
  else if (&wild_tail==1)
  (
    if (STRING.MID("gcc_mss_q6_msmpu_cfg_ahb_clk", 0, &clk_input_length-1)==STRING.CUT("&clk", -1))
    ( 
      &match=1
    )
  )
  else if ("gcc_mss_q6_msmpu_cfg_ahb_clk"=="&clk")
  (
    &match=1
  )
  
  if (&match==1)
  (
    &clk_test=&CLK_TEST_GCC_MSS_Q6_MSMPU_CFG_AHB_CLK
    &clk_reg=&HWIO_GCC_MSS_Q6_MSMPU_CFG_AHB_CBCR_ADDR
    &clk_reg_name="GCC_MSS_Q6_MSMPU_CFG_AHB_CBCR"
    &clk_name="gcc_mss_q6_msmpu_cfg_ahb_clk"
    &clk_reg_cbcr_type="sm_cbc"
    &clk_vote_bit=-1.
    &clk_multiplier=4.
    &clk_access_mode="&GCC_access_mode"

    gosub Print_Clk_Info_Line
  )

  &match=0
  &wild_head=0
  &wild_tail=0
  &clk_input_length=STRING.LENGTH("&clk")
  &clk_itr_length=STRING.LENGTH("gcc_pimem_ahb_clk")

  if (STRING.SCAN("&clk", "*", 0)==0)
  (
    &wild_head=1
  )
  if (STRING.SCAN("&clk", "*", 1)==(STRING.LENGTH("&clk")-1))
  (
    &wild_tail=1
  )

  if ((&wild_head==1)&&(&wild_tail==1))
  (
    if (STRING.SCAN("gcc_pimem_ahb_clk", STRING.MID("&clk", 1, &clk_input_length-2), 0)!=-1)
    ( 
      &match=1
    )
  )
  else if (&wild_head==1)
  (
    if (STRING.MID("gcc_pimem_ahb_clk", &clk_itr_length-&clk_input_length+1, &clk_input_length-1)==STRING.CUT("&clk", 1))
    ( 
      &match=1
    )
  )
  else if (&wild_tail==1)
  (
    if (STRING.MID("gcc_pimem_ahb_clk", 0, &clk_input_length-1)==STRING.CUT("&clk", -1))
    ( 
      &match=1
    )
  )
  else if ("gcc_pimem_ahb_clk"=="&clk")
  (
    &match=1
  )
  
  if (&match==1)
  (
    &clk_test=&CLK_TEST_GCC_PIMEM_AHB_CLK
    &clk_reg=&HWIO_GCC_PIMEM_AHB_CBCR_ADDR
    &clk_reg_name="GCC_PIMEM_AHB_CBCR"
    &clk_name="gcc_pimem_ahb_clk"
    &clk_reg_cbcr_type="sm_cbc"
    &clk_vote_bit=-1.
    &clk_multiplier=4.
    &clk_access_mode="&GCC_access_mode"

    gosub Print_Clk_Info_Line
  )

  &match=0
  &wild_head=0
  &wild_tail=0
  &clk_input_length=STRING.LENGTH("&clk")
  &clk_itr_length=STRING.LENGTH("gcc_prng_ahb_clk")

  if (STRING.SCAN("&clk", "*", 0)==0)
  (
    &wild_head=1
  )
  if (STRING.SCAN("&clk", "*", 1)==(STRING.LENGTH("&clk")-1))
  (
    &wild_tail=1
  )

  if ((&wild_head==1)&&(&wild_tail==1))
  (
    if (STRING.SCAN("gcc_prng_ahb_clk", STRING.MID("&clk", 1, &clk_input_length-2), 0)!=-1)
    ( 
      &match=1
    )
  )
  else if (&wild_head==1)
  (
    if (STRING.MID("gcc_prng_ahb_clk", &clk_itr_length-&clk_input_length+1, &clk_input_length-1)==STRING.CUT("&clk", 1))
    ( 
      &match=1
    )
  )
  else if (&wild_tail==1)
  (
    if (STRING.MID("gcc_prng_ahb_clk", 0, &clk_input_length-1)==STRING.CUT("&clk", -1))
    ( 
      &match=1
    )
  )
  else if ("gcc_prng_ahb_clk"=="&clk")
  (
    &match=1
  )
  
  if (&match==1)
  (
    &clk_test=&CLK_TEST_GCC_PRNG_AHB_CLK
    &clk_reg=&HWIO_GCC_PRNG_AHB_CBCR_ADDR
    &clk_reg_name="GCC_PRNG_AHB_CBCR"
    &clk_name="gcc_prng_ahb_clk"
    &clk_reg_cbcr_type="sm_cbc"
    &clk_vote_bit=13.
    &clk_multiplier=4.
    &clk_access_mode="&GCC_access_mode"

    gosub Print_Clk_Info_Line
  )

  &match=0
  &wild_head=0
  &wild_tail=0
  &clk_input_length=STRING.LENGTH("&clk")
  &clk_itr_length=STRING.LENGTH("gcc_qdss_cfg_ahb_clk")

  if (STRING.SCAN("&clk", "*", 0)==0)
  (
    &wild_head=1
  )
  if (STRING.SCAN("&clk", "*", 1)==(STRING.LENGTH("&clk")-1))
  (
    &wild_tail=1
  )

  if ((&wild_head==1)&&(&wild_tail==1))
  (
    if (STRING.SCAN("gcc_qdss_cfg_ahb_clk", STRING.MID("&clk", 1, &clk_input_length-2), 0)!=-1)
    ( 
      &match=1
    )
  )
  else if (&wild_head==1)
  (
    if (STRING.MID("gcc_qdss_cfg_ahb_clk", &clk_itr_length-&clk_input_length+1, &clk_input_length-1)==STRING.CUT("&clk", 1))
    ( 
      &match=1
    )
  )
  else if (&wild_tail==1)
  (
    if (STRING.MID("gcc_qdss_cfg_ahb_clk", 0, &clk_input_length-1)==STRING.CUT("&clk", -1))
    ( 
      &match=1
    )
  )
  else if ("gcc_qdss_cfg_ahb_clk"=="&clk")
  (
    &match=1
  )
  
  if (&match==1)
  (
    &clk_test=&CLK_TEST_GCC_QDSS_CFG_AHB_CLK
    &clk_reg=&HWIO_GCC_QDSS_CFG_AHB_CBCR_ADDR
    &clk_reg_name="GCC_QDSS_CFG_AHB_CBCR"
    &clk_name="gcc_qdss_cfg_ahb_clk"
    &clk_reg_cbcr_type="sm_cbc"
    &clk_vote_bit=37.
    &clk_multiplier=4.
    &clk_access_mode="&GCC_access_mode"

    gosub Print_Clk_Info_Line
  )

  &match=0
  &wild_head=0
  &wild_tail=0
  &clk_input_length=STRING.LENGTH("&clk")
  &clk_itr_length=STRING.LENGTH("gcc_qdss_dap_ahb_clk")

  if (STRING.SCAN("&clk", "*", 0)==0)
  (
    &wild_head=1
  )
  if (STRING.SCAN("&clk", "*", 1)==(STRING.LENGTH("&clk")-1))
  (
    &wild_tail=1
  )

  if ((&wild_head==1)&&(&wild_tail==1))
  (
    if (STRING.SCAN("gcc_qdss_dap_ahb_clk", STRING.MID("&clk", 1, &clk_input_length-2), 0)!=-1)
    ( 
      &match=1
    )
  )
  else if (&wild_head==1)
  (
    if (STRING.MID("gcc_qdss_dap_ahb_clk", &clk_itr_length-&clk_input_length+1, &clk_input_length-1)==STRING.CUT("&clk", 1))
    ( 
      &match=1
    )
  )
  else if (&wild_tail==1)
  (
    if (STRING.MID("gcc_qdss_dap_ahb_clk", 0, &clk_input_length-1)==STRING.CUT("&clk", -1))
    ( 
      &match=1
    )
  )
  else if ("gcc_qdss_dap_ahb_clk"=="&clk")
  (
    &match=1
  )
  
  if (&match==1)
  (
    &clk_test=&CLK_TEST_GCC_QDSS_DAP_AHB_CLK
    &clk_reg=&HWIO_GCC_QDSS_DAP_AHB_CBCR_ADDR
    &clk_reg_name="GCC_QDSS_DAP_AHB_CBCR"
    &clk_name="gcc_qdss_dap_ahb_clk"
    &clk_reg_cbcr_type="sm_cbc"
    &clk_vote_bit=-1.
    &clk_multiplier=4.
    &clk_access_mode="&GCC_access_mode"

    gosub Print_Clk_Info_Line
  )

  &match=0
  &wild_head=0
  &wild_tail=0
  &clk_input_length=STRING.LENGTH("&clk")
  &clk_itr_length=STRING.LENGTH("gcc_rbcpr_cx_ahb_clk")

  if (STRING.SCAN("&clk", "*", 0)==0)
  (
    &wild_head=1
  )
  if (STRING.SCAN("&clk", "*", 1)==(STRING.LENGTH("&clk")-1))
  (
    &wild_tail=1
  )

  if ((&wild_head==1)&&(&wild_tail==1))
  (
    if (STRING.SCAN("gcc_rbcpr_cx_ahb_clk", STRING.MID("&clk", 1, &clk_input_length-2), 0)!=-1)
    ( 
      &match=1
    )
  )
  else if (&wild_head==1)
  (
    if (STRING.MID("gcc_rbcpr_cx_ahb_clk", &clk_itr_length-&clk_input_length+1, &clk_input_length-1)==STRING.CUT("&clk", 1))
    ( 
      &match=1
    )
  )
  else if (&wild_tail==1)
  (
    if (STRING.MID("gcc_rbcpr_cx_ahb_clk", 0, &clk_input_length-1)==STRING.CUT("&clk", -1))
    ( 
      &match=1
    )
  )
  else if ("gcc_rbcpr_cx_ahb_clk"=="&clk")
  (
    &match=1
  )
  
  if (&match==1)
  (
    &clk_test=&CLK_TEST_GCC_RBCPR_CX_AHB_CLK
    &clk_reg=&HWIO_GCC_RBCPR_CX_AHB_CBCR_ADDR
    &clk_reg_name="GCC_RBCPR_CX_AHB_CBCR"
    &clk_name="gcc_rbcpr_cx_ahb_clk"
    &clk_reg_cbcr_type="sm_cbc"
    &clk_vote_bit=-1.
    &clk_multiplier=4.
    &clk_access_mode="&GCC_access_mode"

    gosub Print_Clk_Info_Line
  )

  &match=0
  &wild_head=0
  &wild_tail=0
  &clk_input_length=STRING.LENGTH("&clk")
  &clk_itr_length=STRING.LENGTH("gcc_rbcpr_mx_ahb_clk")

  if (STRING.SCAN("&clk", "*", 0)==0)
  (
    &wild_head=1
  )
  if (STRING.SCAN("&clk", "*", 1)==(STRING.LENGTH("&clk")-1))
  (
    &wild_tail=1
  )

  if ((&wild_head==1)&&(&wild_tail==1))
  (
    if (STRING.SCAN("gcc_rbcpr_mx_ahb_clk", STRING.MID("&clk", 1, &clk_input_length-2), 0)!=-1)
    ( 
      &match=1
    )
  )
  else if (&wild_head==1)
  (
    if (STRING.MID("gcc_rbcpr_mx_ahb_clk", &clk_itr_length-&clk_input_length+1, &clk_input_length-1)==STRING.CUT("&clk", 1))
    ( 
      &match=1
    )
  )
  else if (&wild_tail==1)
  (
    if (STRING.MID("gcc_rbcpr_mx_ahb_clk", 0, &clk_input_length-1)==STRING.CUT("&clk", -1))
    ( 
      &match=1
    )
  )
  else if ("gcc_rbcpr_mx_ahb_clk"=="&clk")
  (
    &match=1
  )
  
  if (&match==1)
  (
    &clk_test=&CLK_TEST_GCC_RBCPR_MX_AHB_CLK
    &clk_reg=&HWIO_GCC_RBCPR_MX_AHB_CBCR_ADDR
    &clk_reg_name="GCC_RBCPR_MX_AHB_CBCR"
    &clk_name="gcc_rbcpr_mx_ahb_clk"
    &clk_reg_cbcr_type="sm_cbc"
    &clk_vote_bit=-1.
    &clk_multiplier=4.
    &clk_access_mode="&GCC_access_mode"

    gosub Print_Clk_Info_Line
  )

  &match=0
  &wild_head=0
  &wild_tail=0
  &clk_input_length=STRING.LENGTH("&clk")
  &clk_itr_length=STRING.LENGTH("gcc_rpm_mst_m2_cnoc_ahb_clk")

  if (STRING.SCAN("&clk", "*", 0)==0)
  (
    &wild_head=1
  )
  if (STRING.SCAN("&clk", "*", 1)==(STRING.LENGTH("&clk")-1))
  (
    &wild_tail=1
  )

  if ((&wild_head==1)&&(&wild_tail==1))
  (
    if (STRING.SCAN("gcc_rpm_mst_m2_cnoc_ahb_clk", STRING.MID("&clk", 1, &clk_input_length-2), 0)!=-1)
    ( 
      &match=1
    )
  )
  else if (&wild_head==1)
  (
    if (STRING.MID("gcc_rpm_mst_m2_cnoc_ahb_clk", &clk_itr_length-&clk_input_length+1, &clk_input_length-1)==STRING.CUT("&clk", 1))
    ( 
      &match=1
    )
  )
  else if (&wild_tail==1)
  (
    if (STRING.MID("gcc_rpm_mst_m2_cnoc_ahb_clk", 0, &clk_input_length-1)==STRING.CUT("&clk", -1))
    ( 
      &match=1
    )
  )
  else if ("gcc_rpm_mst_m2_cnoc_ahb_clk"=="&clk")
  (
    &match=1
  )
  
  if (&match==1)
  (
    &clk_test=&CLK_TEST_GCC_RPM_MST_M2_CNOC_AHB_CLK
    &clk_reg=&HWIO_GCC_RPM_MST_M2_CNOC_AHB_CBCR_ADDR
    &clk_reg_name="GCC_RPM_MST_M2_CNOC_AHB_CBCR"
    &clk_name="gcc_rpm_mst_m2_cnoc_ahb_clk"
    &clk_reg_cbcr_type="sm_cbc"
    &clk_vote_bit=-1.
    &clk_multiplier=4.
    &clk_access_mode="&GCC_access_mode"

    gosub Print_Clk_Info_Line
  )

  &match=0
  &wild_head=0
  &wild_tail=0
  &clk_input_length=STRING.LENGTH("&clk")
  &clk_itr_length=STRING.LENGTH("gcc_sec_ctrl_ahb_clk")

  if (STRING.SCAN("&clk", "*", 0)==0)
  (
    &wild_head=1
  )
  if (STRING.SCAN("&clk", "*", 1)==(STRING.LENGTH("&clk")-1))
  (
    &wild_tail=1
  )

  if ((&wild_head==1)&&(&wild_tail==1))
  (
    if (STRING.SCAN("gcc_sec_ctrl_ahb_clk", STRING.MID("&clk", 1, &clk_input_length-2), 0)!=-1)
    ( 
      &match=1
    )
  )
  else if (&wild_head==1)
  (
    if (STRING.MID("gcc_sec_ctrl_ahb_clk", &clk_itr_length-&clk_input_length+1, &clk_input_length-1)==STRING.CUT("&clk", 1))
    ( 
      &match=1
    )
  )
  else if (&wild_tail==1)
  (
    if (STRING.MID("gcc_sec_ctrl_ahb_clk", 0, &clk_input_length-1)==STRING.CUT("&clk", -1))
    ( 
      &match=1
    )
  )
  else if ("gcc_sec_ctrl_ahb_clk"=="&clk")
  (
    &match=1
  )
  
  if (&match==1)
  (
    &clk_test=&CLK_TEST_GCC_SEC_CTRL_AHB_CLK
    &clk_reg=&HWIO_GCC_SEC_CTRL_AHB_CBCR_ADDR
    &clk_reg_name="GCC_SEC_CTRL_AHB_CBCR"
    &clk_name="gcc_sec_ctrl_ahb_clk"
    &clk_reg_cbcr_type="sm_cbc"
    &clk_vote_bit=-1.
    &clk_multiplier=4.
    &clk_access_mode="&GCC_access_mode"

    gosub Print_Clk_Info_Line
  )

  &match=0
  &wild_head=0
  &wild_tail=0
  &clk_input_length=STRING.LENGTH("&clk")
  &clk_itr_length=STRING.LENGTH("gcc_sec_ctrl_boot_rom_patch_clk")

  if (STRING.SCAN("&clk", "*", 0)==0)
  (
    &wild_head=1
  )
  if (STRING.SCAN("&clk", "*", 1)==(STRING.LENGTH("&clk")-1))
  (
    &wild_tail=1
  )

  if ((&wild_head==1)&&(&wild_tail==1))
  (
    if (STRING.SCAN("gcc_sec_ctrl_boot_rom_patch_clk", STRING.MID("&clk", 1, &clk_input_length-2), 0)!=-1)
    ( 
      &match=1
    )
  )
  else if (&wild_head==1)
  (
    if (STRING.MID("gcc_sec_ctrl_boot_rom_patch_clk", &clk_itr_length-&clk_input_length+1, &clk_input_length-1)==STRING.CUT("&clk", 1))
    ( 
      &match=1
    )
  )
  else if (&wild_tail==1)
  (
    if (STRING.MID("gcc_sec_ctrl_boot_rom_patch_clk", 0, &clk_input_length-1)==STRING.CUT("&clk", -1))
    ( 
      &match=1
    )
  )
  else if ("gcc_sec_ctrl_boot_rom_patch_clk"=="&clk")
  (
    &match=1
  )
  
  if (&match==1)
  (
    &clk_test=&CLK_TEST_GCC_SEC_CTRL_BOOT_ROM_PATCH_CLK
    &clk_reg=&HWIO_GCC_SEC_CTRL_BOOT_ROM_PATCH_CBCR_ADDR
    &clk_reg_name="GCC_SEC_CTRL_BOOT_ROM_PATCH_CBCR"
    &clk_name="gcc_sec_ctrl_boot_rom_patch_clk"
    &clk_reg_cbcr_type="sm_cbc"
    &clk_vote_bit=-1.
    &clk_multiplier=4.
    &clk_access_mode="&GCC_access_mode"

    gosub Print_Clk_Info_Line
  )

  &match=0
  &wild_head=0
  &wild_tail=0
  &clk_input_length=STRING.LENGTH("&clk")
  &clk_itr_length=STRING.LENGTH("gcc_smmu_aggre2_ahb_clk")

  if (STRING.SCAN("&clk", "*", 0)==0)
  (
    &wild_head=1
  )
  if (STRING.SCAN("&clk", "*", 1)==(STRING.LENGTH("&clk")-1))
  (
    &wild_tail=1
  )

  if ((&wild_head==1)&&(&wild_tail==1))
  (
    if (STRING.SCAN("gcc_smmu_aggre2_ahb_clk", STRING.MID("&clk", 1, &clk_input_length-2), 0)!=-1)
    ( 
      &match=1
    )
  )
  else if (&wild_head==1)
  (
    if (STRING.MID("gcc_smmu_aggre2_ahb_clk", &clk_itr_length-&clk_input_length+1, &clk_input_length-1)==STRING.CUT("&clk", 1))
    ( 
      &match=1
    )
  )
  else if (&wild_tail==1)
  (
    if (STRING.MID("gcc_smmu_aggre2_ahb_clk", 0, &clk_input_length-1)==STRING.CUT("&clk", -1))
    ( 
      &match=1
    )
  )
  else if ("gcc_smmu_aggre2_ahb_clk"=="&clk")
  (
    &match=1
  )
  
  if (&match==1)
  (
    &clk_test=&CLK_TEST_GCC_SMMU_AGGRE2_AHB_CLK
    &clk_reg=&HWIO_GCC_SMMU_AGGRE2_AHB_CBCR_ADDR
    &clk_reg_name="GCC_SMMU_AGGRE2_AHB_CBCR"
    &clk_name="gcc_smmu_aggre2_ahb_clk"
    &clk_reg_cbcr_type="sm_cbc"
    &clk_vote_bit=-1.
    &clk_multiplier=4.
    &clk_access_mode="&GCC_access_mode"

    gosub Print_Clk_Info_Line
  )

  &match=0
  &wild_head=0
  &wild_tail=0
  &clk_input_length=STRING.LENGTH("&clk")
  &clk_itr_length=STRING.LENGTH("gcc_snoc_bus_timeout4_ahb_clk")

  if (STRING.SCAN("&clk", "*", 0)==0)
  (
    &wild_head=1
  )
  if (STRING.SCAN("&clk", "*", 1)==(STRING.LENGTH("&clk")-1))
  (
    &wild_tail=1
  )

  if ((&wild_head==1)&&(&wild_tail==1))
  (
    if (STRING.SCAN("gcc_snoc_bus_timeout4_ahb_clk", STRING.MID("&clk", 1, &clk_input_length-2), 0)!=-1)
    ( 
      &match=1
    )
  )
  else if (&wild_head==1)
  (
    if (STRING.MID("gcc_snoc_bus_timeout4_ahb_clk", &clk_itr_length-&clk_input_length+1, &clk_input_length-1)==STRING.CUT("&clk", 1))
    ( 
      &match=1
    )
  )
  else if (&wild_tail==1)
  (
    if (STRING.MID("gcc_snoc_bus_timeout4_ahb_clk", 0, &clk_input_length-1)==STRING.CUT("&clk", -1))
    ( 
      &match=1
    )
  )
  else if ("gcc_snoc_bus_timeout4_ahb_clk"=="&clk")
  (
    &match=1
  )
  
  if (&match==1)
  (
    &clk_test=&CLK_TEST_GCC_SNOC_BUS_TIMEOUT4_AHB_CLK
    &clk_reg=&HWIO_GCC_SNOC_BUS_TIMEOUT4_AHB_CBCR_ADDR
    &clk_reg_name="GCC_SNOC_BUS_TIMEOUT4_AHB_CBCR"
    &clk_name="gcc_snoc_bus_timeout4_ahb_clk"
    &clk_reg_cbcr_type="sm_cbc"
    &clk_vote_bit=-1.
    &clk_multiplier=4.
    &clk_access_mode="&GCC_access_mode"

    gosub Print_Clk_Info_Line
  )

  &match=0
  &wild_head=0
  &wild_tail=0
  &clk_input_length=STRING.LENGTH("&clk")
  &clk_itr_length=STRING.LENGTH("gcc_snoc_cnoc_ahb_clk")

  if (STRING.SCAN("&clk", "*", 0)==0)
  (
    &wild_head=1
  )
  if (STRING.SCAN("&clk", "*", 1)==(STRING.LENGTH("&clk")-1))
  (
    &wild_tail=1
  )

  if ((&wild_head==1)&&(&wild_tail==1))
  (
    if (STRING.SCAN("gcc_snoc_cnoc_ahb_clk", STRING.MID("&clk", 1, &clk_input_length-2), 0)!=-1)
    ( 
      &match=1
    )
  )
  else if (&wild_head==1)
  (
    if (STRING.MID("gcc_snoc_cnoc_ahb_clk", &clk_itr_length-&clk_input_length+1, &clk_input_length-1)==STRING.CUT("&clk", 1))
    ( 
      &match=1
    )
  )
  else if (&wild_tail==1)
  (
    if (STRING.MID("gcc_snoc_cnoc_ahb_clk", 0, &clk_input_length-1)==STRING.CUT("&clk", -1))
    ( 
      &match=1
    )
  )
  else if ("gcc_snoc_cnoc_ahb_clk"=="&clk")
  (
    &match=1
  )
  
  if (&match==1)
  (
    &clk_test=&CLK_TEST_GCC_SNOC_CNOC_AHB_CLK
    &clk_reg=&HWIO_GCC_SNOC_CNOC_AHB_CBCR_ADDR
    &clk_reg_name="GCC_SNOC_CNOC_AHB_CBCR"
    &clk_name="gcc_snoc_cnoc_ahb_clk"
    &clk_reg_cbcr_type="sm_cbc"
    &clk_vote_bit=-1.
    &clk_multiplier=4.
    &clk_access_mode="&GCC_access_mode"

    gosub Print_Clk_Info_Line
  )

  &match=0
  &wild_head=0
  &wild_tail=0
  &clk_input_length=STRING.LENGTH("&clk")
  &clk_itr_length=STRING.LENGTH("gcc_spdm_cfg_ahb_clk")

  if (STRING.SCAN("&clk", "*", 0)==0)
  (
    &wild_head=1
  )
  if (STRING.SCAN("&clk", "*", 1)==(STRING.LENGTH("&clk")-1))
  (
    &wild_tail=1
  )

  if ((&wild_head==1)&&(&wild_tail==1))
  (
    if (STRING.SCAN("gcc_spdm_cfg_ahb_clk", STRING.MID("&clk", 1, &clk_input_length-2), 0)!=-1)
    ( 
      &match=1
    )
  )
  else if (&wild_head==1)
  (
    if (STRING.MID("gcc_spdm_cfg_ahb_clk", &clk_itr_length-&clk_input_length+1, &clk_input_length-1)==STRING.CUT("&clk", 1))
    ( 
      &match=1
    )
  )
  else if (&wild_tail==1)
  (
    if (STRING.MID("gcc_spdm_cfg_ahb_clk", 0, &clk_input_length-1)==STRING.CUT("&clk", -1))
    ( 
      &match=1
    )
  )
  else if ("gcc_spdm_cfg_ahb_clk"=="&clk")
  (
    &match=1
  )
  
  if (&match==1)
  (
    &clk_test=&CLK_TEST_GCC_SPDM_CFG_AHB_CLK
    &clk_reg=&HWIO_GCC_SPDM_CFG_AHB_CBCR_ADDR
    &clk_reg_name="GCC_SPDM_CFG_AHB_CBCR"
    &clk_name="gcc_spdm_cfg_ahb_clk"
    &clk_reg_cbcr_type="sm_cbc"
    &clk_vote_bit=-1.
    &clk_multiplier=4.
    &clk_access_mode="&GCC_access_mode"

    gosub Print_Clk_Info_Line
  )

  &match=0
  &wild_head=0
  &wild_tail=0
  &clk_input_length=STRING.LENGTH("&clk")
  &clk_itr_length=STRING.LENGTH("gcc_spdm_mstr_ahb_clk")

  if (STRING.SCAN("&clk", "*", 0)==0)
  (
    &wild_head=1
  )
  if (STRING.SCAN("&clk", "*", 1)==(STRING.LENGTH("&clk")-1))
  (
    &wild_tail=1
  )

  if ((&wild_head==1)&&(&wild_tail==1))
  (
    if (STRING.SCAN("gcc_spdm_mstr_ahb_clk", STRING.MID("&clk", 1, &clk_input_length-2), 0)!=-1)
    ( 
      &match=1
    )
  )
  else if (&wild_head==1)
  (
    if (STRING.MID("gcc_spdm_mstr_ahb_clk", &clk_itr_length-&clk_input_length+1, &clk_input_length-1)==STRING.CUT("&clk", 1))
    ( 
      &match=1
    )
  )
  else if (&wild_tail==1)
  (
    if (STRING.MID("gcc_spdm_mstr_ahb_clk", 0, &clk_input_length-1)==STRING.CUT("&clk", -1))
    ( 
      &match=1
    )
  )
  else if ("gcc_spdm_mstr_ahb_clk"=="&clk")
  (
    &match=1
  )
  
  if (&match==1)
  (
    &clk_test=&CLK_TEST_GCC_SPDM_MSTR_AHB_CLK
    &clk_reg=&HWIO_GCC_SPDM_MSTR_AHB_CBCR_ADDR
    &clk_reg_name="GCC_SPDM_MSTR_AHB_CBCR"
    &clk_name="gcc_spdm_mstr_ahb_clk"
    &clk_reg_cbcr_type="sm_cbc"
    &clk_vote_bit=-1.
    &clk_multiplier=4.
    &clk_access_mode="&GCC_access_mode"

    gosub Print_Clk_Info_Line
  )

  &match=0
  &wild_head=0
  &wild_tail=0
  &clk_input_length=STRING.LENGTH("&clk")
  &clk_itr_length=STRING.LENGTH("gcc_spmi_cnoc_ahb_clk")

  if (STRING.SCAN("&clk", "*", 0)==0)
  (
    &wild_head=1
  )
  if (STRING.SCAN("&clk", "*", 1)==(STRING.LENGTH("&clk")-1))
  (
    &wild_tail=1
  )

  if ((&wild_head==1)&&(&wild_tail==1))
  (
    if (STRING.SCAN("gcc_spmi_cnoc_ahb_clk", STRING.MID("&clk", 1, &clk_input_length-2), 0)!=-1)
    ( 
      &match=1
    )
  )
  else if (&wild_head==1)
  (
    if (STRING.MID("gcc_spmi_cnoc_ahb_clk", &clk_itr_length-&clk_input_length+1, &clk_input_length-1)==STRING.CUT("&clk", 1))
    ( 
      &match=1
    )
  )
  else if (&wild_tail==1)
  (
    if (STRING.MID("gcc_spmi_cnoc_ahb_clk", 0, &clk_input_length-1)==STRING.CUT("&clk", -1))
    ( 
      &match=1
    )
  )
  else if ("gcc_spmi_cnoc_ahb_clk"=="&clk")
  (
    &match=1
  )
  
  if (&match==1)
  (
    &clk_test=&CLK_TEST_GCC_SPMI_CNOC_AHB_CLK
    &clk_reg=&HWIO_GCC_SPMI_CNOC_AHB_CBCR_ADDR
    &clk_reg_name="GCC_SPMI_CNOC_AHB_CBCR"
    &clk_name="gcc_spmi_cnoc_ahb_clk"
    &clk_reg_cbcr_type="sm_cbc"
    &clk_vote_bit=6.
    &clk_multiplier=4.
    &clk_access_mode="&GCC_access_mode"

    gosub Print_Clk_Info_Line
  )

  &match=0
  &wild_head=0
  &wild_tail=0
  &clk_input_length=STRING.LENGTH("&clk")
  &clk_itr_length=STRING.LENGTH("gcc_tcsr_ahb_clk")

  if (STRING.SCAN("&clk", "*", 0)==0)
  (
    &wild_head=1
  )
  if (STRING.SCAN("&clk", "*", 1)==(STRING.LENGTH("&clk")-1))
  (
    &wild_tail=1
  )

  if ((&wild_head==1)&&(&wild_tail==1))
  (
    if (STRING.SCAN("gcc_tcsr_ahb_clk", STRING.MID("&clk", 1, &clk_input_length-2), 0)!=-1)
    ( 
      &match=1
    )
  )
  else if (&wild_head==1)
  (
    if (STRING.MID("gcc_tcsr_ahb_clk", &clk_itr_length-&clk_input_length+1, &clk_input_length-1)==STRING.CUT("&clk", 1))
    ( 
      &match=1
    )
  )
  else if (&wild_tail==1)
  (
    if (STRING.MID("gcc_tcsr_ahb_clk", 0, &clk_input_length-1)==STRING.CUT("&clk", -1))
    ( 
      &match=1
    )
  )
  else if ("gcc_tcsr_ahb_clk"=="&clk")
  (
    &match=1
  )
  
  if (&match==1)
  (
    &clk_test=&CLK_TEST_GCC_TCSR_AHB_CLK
    &clk_reg=&HWIO_GCC_TCSR_AHB_CBCR_ADDR
    &clk_reg_name="GCC_TCSR_AHB_CBCR"
    &clk_name="gcc_tcsr_ahb_clk"
    &clk_reg_cbcr_type="sm_cbc"
    &clk_vote_bit=31.
    &clk_multiplier=4.
    &clk_access_mode="&GCC_access_mode"

    gosub Print_Clk_Info_Line
  )

  &match=0
  &wild_head=0
  &wild_tail=0
  &clk_input_length=STRING.LENGTH("&clk")
  &clk_itr_length=STRING.LENGTH("gcc_tic_cfg_ahb_clk")

  if (STRING.SCAN("&clk", "*", 0)==0)
  (
    &wild_head=1
  )
  if (STRING.SCAN("&clk", "*", 1)==(STRING.LENGTH("&clk")-1))
  (
    &wild_tail=1
  )

  if ((&wild_head==1)&&(&wild_tail==1))
  (
    if (STRING.SCAN("gcc_tic_cfg_ahb_clk", STRING.MID("&clk", 1, &clk_input_length-2), 0)!=-1)
    ( 
      &match=1
    )
  )
  else if (&wild_head==1)
  (
    if (STRING.MID("gcc_tic_cfg_ahb_clk", &clk_itr_length-&clk_input_length+1, &clk_input_length-1)==STRING.CUT("&clk", 1))
    ( 
      &match=1
    )
  )
  else if (&wild_tail==1)
  (
    if (STRING.MID("gcc_tic_cfg_ahb_clk", 0, &clk_input_length-1)==STRING.CUT("&clk", -1))
    ( 
      &match=1
    )
  )
  else if ("gcc_tic_cfg_ahb_clk"=="&clk")
  (
    &match=1
  )
  
  if (&match==1)
  (
    &clk_test=&CLK_TEST_GCC_TIC_CFG_AHB_CLK
    &clk_reg=&HWIO_GCC_TIC_CFG_AHB_CBCR_ADDR
    &clk_reg_name="GCC_TIC_CFG_AHB_CBCR"
    &clk_name="gcc_tic_cfg_ahb_clk"
    &clk_reg_cbcr_type="sm_pscbc"
    &clk_vote_bit=-1.
    &clk_multiplier=4.
    &clk_access_mode="&GCC_access_mode"

    gosub Print_Clk_Info_Line
  )

  &match=0
  &wild_head=0
  &wild_tail=0
  &clk_input_length=STRING.LENGTH("&clk")
  &clk_itr_length=STRING.LENGTH("gcc_tlmm_centre_ahb_clk")

  if (STRING.SCAN("&clk", "*", 0)==0)
  (
    &wild_head=1
  )
  if (STRING.SCAN("&clk", "*", 1)==(STRING.LENGTH("&clk")-1))
  (
    &wild_tail=1
  )

  if ((&wild_head==1)&&(&wild_tail==1))
  (
    if (STRING.SCAN("gcc_tlmm_centre_ahb_clk", STRING.MID("&clk", 1, &clk_input_length-2), 0)!=-1)
    ( 
      &match=1
    )
  )
  else if (&wild_head==1)
  (
    if (STRING.MID("gcc_tlmm_centre_ahb_clk", &clk_itr_length-&clk_input_length+1, &clk_input_length-1)==STRING.CUT("&clk", 1))
    ( 
      &match=1
    )
  )
  else if (&wild_tail==1)
  (
    if (STRING.MID("gcc_tlmm_centre_ahb_clk", 0, &clk_input_length-1)==STRING.CUT("&clk", -1))
    ( 
      &match=1
    )
  )
  else if ("gcc_tlmm_centre_ahb_clk"=="&clk")
  (
    &match=1
  )
  
  if (&match==1)
  (
    &clk_test=&CLK_TEST_GCC_TLMM_CENTRE_AHB_CLK
    &clk_reg=&HWIO_GCC_TLMM_CENTRE_AHB_CBCR_ADDR
    &clk_reg_name="GCC_TLMM_CENTRE_AHB_CBCR"
    &clk_name="gcc_tlmm_centre_ahb_clk"
    &clk_reg_cbcr_type="sm_cbc"
    &clk_vote_bit=12.
    &clk_multiplier=4.
    &clk_access_mode="&GCC_access_mode"

    gosub Print_Clk_Info_Line
  )

  &match=0
  &wild_head=0
  &wild_tail=0
  &clk_input_length=STRING.LENGTH("&clk")
  &clk_itr_length=STRING.LENGTH("gcc_tlmm_clk")

  if (STRING.SCAN("&clk", "*", 0)==0)
  (
    &wild_head=1
  )
  if (STRING.SCAN("&clk", "*", 1)==(STRING.LENGTH("&clk")-1))
  (
    &wild_tail=1
  )

  if ((&wild_head==1)&&(&wild_tail==1))
  (
    if (STRING.SCAN("gcc_tlmm_clk", STRING.MID("&clk", 1, &clk_input_length-2), 0)!=-1)
    ( 
      &match=1
    )
  )
  else if (&wild_head==1)
  (
    if (STRING.MID("gcc_tlmm_clk", &clk_itr_length-&clk_input_length+1, &clk_input_length-1)==STRING.CUT("&clk", 1))
    ( 
      &match=1
    )
  )
  else if (&wild_tail==1)
  (
    if (STRING.MID("gcc_tlmm_clk", 0, &clk_input_length-1)==STRING.CUT("&clk", -1))
    ( 
      &match=1
    )
  )
  else if ("gcc_tlmm_clk"=="&clk")
  (
    &match=1
  )
  
  if (&match==1)
  (
    &clk_test=&CLK_TEST_GCC_TLMM_CLK
    &clk_reg=&HWIO_GCC_TLMM_CBCR_ADDR
    &clk_reg_name="GCC_TLMM_CBCR"
    &clk_name="gcc_tlmm_clk"
    &clk_reg_cbcr_type="sm_cbc"
    &clk_vote_bit=7.
    &clk_multiplier=4.
    &clk_access_mode="&GCC_access_mode"

    gosub Print_Clk_Info_Line
  )

  &match=0
  &wild_head=0
  &wild_tail=0
  &clk_input_length=STRING.LENGTH("&clk")
  &clk_itr_length=STRING.LENGTH("gcc_tlmm_north_ahb_clk")

  if (STRING.SCAN("&clk", "*", 0)==0)
  (
    &wild_head=1
  )
  if (STRING.SCAN("&clk", "*", 1)==(STRING.LENGTH("&clk")-1))
  (
    &wild_tail=1
  )

  if ((&wild_head==1)&&(&wild_tail==1))
  (
    if (STRING.SCAN("gcc_tlmm_north_ahb_clk", STRING.MID("&clk", 1, &clk_input_length-2), 0)!=-1)
    ( 
      &match=1
    )
  )
  else if (&wild_head==1)
  (
    if (STRING.MID("gcc_tlmm_north_ahb_clk", &clk_itr_length-&clk_input_length+1, &clk_input_length-1)==STRING.CUT("&clk", 1))
    ( 
      &match=1
    )
  )
  else if (&wild_tail==1)
  (
    if (STRING.MID("gcc_tlmm_north_ahb_clk", 0, &clk_input_length-1)==STRING.CUT("&clk", -1))
    ( 
      &match=1
    )
  )
  else if ("gcc_tlmm_north_ahb_clk"=="&clk")
  (
    &match=1
  )
  
  if (&match==1)
  (
    &clk_test=&CLK_TEST_GCC_TLMM_NORTH_AHB_CLK
    &clk_reg=&HWIO_GCC_TLMM_NORTH_AHB_CBCR_ADDR
    &clk_reg_name="GCC_TLMM_NORTH_AHB_CBCR"
    &clk_name="gcc_tlmm_north_ahb_clk"
    &clk_reg_cbcr_type="sm_cbc"
    &clk_vote_bit=11.
    &clk_multiplier=4.
    &clk_access_mode="&GCC_access_mode"

    gosub Print_Clk_Info_Line
  )

  &match=0
  &wild_head=0
  &wild_tail=0
  &clk_input_length=STRING.LENGTH("&clk")
  &clk_itr_length=STRING.LENGTH("gcc_tlmm_south_ahb_clk")

  if (STRING.SCAN("&clk", "*", 0)==0)
  (
    &wild_head=1
  )
  if (STRING.SCAN("&clk", "*", 1)==(STRING.LENGTH("&clk")-1))
  (
    &wild_tail=1
  )

  if ((&wild_head==1)&&(&wild_tail==1))
  (
    if (STRING.SCAN("gcc_tlmm_south_ahb_clk", STRING.MID("&clk", 1, &clk_input_length-2), 0)!=-1)
    ( 
      &match=1
    )
  )
  else if (&wild_head==1)
  (
    if (STRING.MID("gcc_tlmm_south_ahb_clk", &clk_itr_length-&clk_input_length+1, &clk_input_length-1)==STRING.CUT("&clk", 1))
    ( 
      &match=1
    )
  )
  else if (&wild_tail==1)
  (
    if (STRING.MID("gcc_tlmm_south_ahb_clk", 0, &clk_input_length-1)==STRING.CUT("&clk", -1))
    ( 
      &match=1
    )
  )
  else if ("gcc_tlmm_south_ahb_clk"=="&clk")
  (
    &match=1
  )
  
  if (&match==1)
  (
    &clk_test=&CLK_TEST_GCC_TLMM_SOUTH_AHB_CLK
    &clk_reg=&HWIO_GCC_TLMM_SOUTH_AHB_CBCR_ADDR
    &clk_reg_name="GCC_TLMM_SOUTH_AHB_CBCR"
    &clk_name="gcc_tlmm_south_ahb_clk"
    &clk_reg_cbcr_type="sm_cbc"
    &clk_vote_bit=8.
    &clk_multiplier=4.
    &clk_access_mode="&GCC_access_mode"

    gosub Print_Clk_Info_Line
  )

  &match=0
  &wild_head=0
  &wild_tail=0
  &clk_input_length=STRING.LENGTH("&clk")
  &clk_itr_length=STRING.LENGTH("gcc_turing_q6_smmu_ahb_clk")

  if (STRING.SCAN("&clk", "*", 0)==0)
  (
    &wild_head=1
  )
  if (STRING.SCAN("&clk", "*", 1)==(STRING.LENGTH("&clk")-1))
  (
    &wild_tail=1
  )

  if ((&wild_head==1)&&(&wild_tail==1))
  (
    if (STRING.SCAN("gcc_turing_q6_smmu_ahb_clk", STRING.MID("&clk", 1, &clk_input_length-2), 0)!=-1)
    ( 
      &match=1
    )
  )
  else if (&wild_head==1)
  (
    if (STRING.MID("gcc_turing_q6_smmu_ahb_clk", &clk_itr_length-&clk_input_length+1, &clk_input_length-1)==STRING.CUT("&clk", 1))
    ( 
      &match=1
    )
  )
  else if (&wild_tail==1)
  (
    if (STRING.MID("gcc_turing_q6_smmu_ahb_clk", 0, &clk_input_length-1)==STRING.CUT("&clk", -1))
    ( 
      &match=1
    )
  )
  else if ("gcc_turing_q6_smmu_ahb_clk"=="&clk")
  (
    &match=1
  )
  
  if (&match==1)
  (
    &clk_test=&CLK_TEST_GCC_TURING_Q6_SMMU_AHB_CLK
    &clk_reg=&HWIO_GCC_TURING_Q6_SMMU_AHB_CBCR_ADDR
    &clk_reg_name="GCC_TURING_Q6_SMMU_AHB_CBCR"
    &clk_name="gcc_turing_q6_smmu_ahb_clk"
    &clk_reg_cbcr_type="sm_cbc"
    &clk_vote_bit=-1.
    &clk_multiplier=4.
    &clk_access_mode="&GCC_access_mode"

    gosub Print_Clk_Info_Line
  )

  &match=0
  &wild_head=0
  &wild_tail=0
  &clk_input_length=STRING.LENGTH("&clk")
  &clk_itr_length=STRING.LENGTH("gcc_ufs_ahb_clk")

  if (STRING.SCAN("&clk", "*", 0)==0)
  (
    &wild_head=1
  )
  if (STRING.SCAN("&clk", "*", 1)==(STRING.LENGTH("&clk")-1))
  (
    &wild_tail=1
  )

  if ((&wild_head==1)&&(&wild_tail==1))
  (
    if (STRING.SCAN("gcc_ufs_ahb_clk", STRING.MID("&clk", 1, &clk_input_length-2), 0)!=-1)
    ( 
      &match=1
    )
  )
  else if (&wild_head==1)
  (
    if (STRING.MID("gcc_ufs_ahb_clk", &clk_itr_length-&clk_input_length+1, &clk_input_length-1)==STRING.CUT("&clk", 1))
    ( 
      &match=1
    )
  )
  else if (&wild_tail==1)
  (
    if (STRING.MID("gcc_ufs_ahb_clk", 0, &clk_input_length-1)==STRING.CUT("&clk", -1))
    ( 
      &match=1
    )
  )
  else if ("gcc_ufs_ahb_clk"=="&clk")
  (
    &match=1
  )
  
  if (&match==1)
  (
    &clk_test=&CLK_TEST_GCC_UFS_AHB_CLK
    &clk_reg=&HWIO_GCC_UFS_AHB_CBCR_ADDR
    &clk_reg_name="GCC_UFS_AHB_CBCR"
    &clk_name="gcc_ufs_ahb_clk"
    &clk_reg_cbcr_type="sm_cbc"
    &clk_vote_bit=-1.
    &clk_multiplier=4.
    &clk_access_mode="&GCC_access_mode"

    gosub Print_Clk_Info_Line
  )

  &match=0
  &wild_head=0
  &wild_tail=0
  &clk_input_length=STRING.LENGTH("&clk")
  &clk_itr_length=STRING.LENGTH("gcc_usb_phy_cfg_ahb2phy_clk")

  if (STRING.SCAN("&clk", "*", 0)==0)
  (
    &wild_head=1
  )
  if (STRING.SCAN("&clk", "*", 1)==(STRING.LENGTH("&clk")-1))
  (
    &wild_tail=1
  )

  if ((&wild_head==1)&&(&wild_tail==1))
  (
    if (STRING.SCAN("gcc_usb_phy_cfg_ahb2phy_clk", STRING.MID("&clk", 1, &clk_input_length-2), 0)!=-1)
    ( 
      &match=1
    )
  )
  else if (&wild_head==1)
  (
    if (STRING.MID("gcc_usb_phy_cfg_ahb2phy_clk", &clk_itr_length-&clk_input_length+1, &clk_input_length-1)==STRING.CUT("&clk", 1))
    ( 
      &match=1
    )
  )
  else if (&wild_tail==1)
  (
    if (STRING.MID("gcc_usb_phy_cfg_ahb2phy_clk", 0, &clk_input_length-1)==STRING.CUT("&clk", -1))
    ( 
      &match=1
    )
  )
  else if ("gcc_usb_phy_cfg_ahb2phy_clk"=="&clk")
  (
    &match=1
  )
  
  if (&match==1)
  (
    &clk_test=&CLK_TEST_GCC_USB_PHY_CFG_AHB2PHY_CLK
    &clk_reg=&HWIO_GCC_USB_PHY_CFG_AHB2PHY_CBCR_ADDR
    &clk_reg_name="GCC_USB_PHY_CFG_AHB2PHY_CBCR"
    &clk_name="gcc_usb_phy_cfg_ahb2phy_clk"
    &clk_reg_cbcr_type="sm_cbc"
    &clk_vote_bit=-1.
    &clk_multiplier=4.
    &clk_access_mode="&GCC_access_mode"

    gosub Print_Clk_Info_Line
  )

  &match=0
  &wild_head=0
  &wild_tail=0
  &clk_input_length=STRING.LENGTH("&clk")
  &clk_itr_length=STRING.LENGTH("gcc_spdm_debug_cy_clk")

  if (STRING.SCAN("&clk", "*", 0)==0)
  (
    &wild_head=1
  )
  if (STRING.SCAN("&clk", "*", 1)==(STRING.LENGTH("&clk")-1))
  (
    &wild_tail=1
  )

  if ((&wild_head==1)&&(&wild_tail==1))
  (
    if (STRING.SCAN("gcc_spdm_debug_cy_clk", STRING.MID("&clk", 1, &clk_input_length-2), 0)!=-1)
    ( 
      &match=1
    )
  )
  else if (&wild_head==1)
  (
    if (STRING.MID("gcc_spdm_debug_cy_clk", &clk_itr_length-&clk_input_length+1, &clk_input_length-1)==STRING.CUT("&clk", 1))
    ( 
      &match=1
    )
  )
  else if (&wild_tail==1)
  (
    if (STRING.MID("gcc_spdm_debug_cy_clk", 0, &clk_input_length-1)==STRING.CUT("&clk", -1))
    ( 
      &match=1
    )
  )
  else if ("gcc_spdm_debug_cy_clk"=="&clk")
  (
    &match=1
  )
  
  if (&match==1)
  (
    &clk_test=0
    &clk_reg=&HWIO_GCC_SPDM_DEBUG_CY_CBCR_ADDR
    &clk_reg_name="GCC_SPDM_DEBUG_CY_CBCR"
    &clk_name="gcc_spdm_debug_cy_clk"
    &clk_reg_cbcr_type="sm_cbc"
    &clk_vote_bit=-1.
    &clk_multiplier=4.
    &clk_access_mode="&GCC_access_mode"

    gosub Print_Clk_Info_Line
  )

  &match=0
  &wild_head=0
  &wild_tail=0
  &clk_input_length=STRING.LENGTH("&clk")
  &clk_itr_length=STRING.LENGTH("gcc_bimc_sleep_clk")

  if (STRING.SCAN("&clk", "*", 0)==0)
  (
    &wild_head=1
  )
  if (STRING.SCAN("&clk", "*", 1)==(STRING.LENGTH("&clk")-1))
  (
    &wild_tail=1
  )

  if ((&wild_head==1)&&(&wild_tail==1))
  (
    if (STRING.SCAN("gcc_bimc_sleep_clk", STRING.MID("&clk", 1, &clk_input_length-2), 0)!=-1)
    ( 
      &match=1
    )
  )
  else if (&wild_head==1)
  (
    if (STRING.MID("gcc_bimc_sleep_clk", &clk_itr_length-&clk_input_length+1, &clk_input_length-1)==STRING.CUT("&clk", 1))
    ( 
      &match=1
    )
  )
  else if (&wild_tail==1)
  (
    if (STRING.MID("gcc_bimc_sleep_clk", 0, &clk_input_length-1)==STRING.CUT("&clk", -1))
    ( 
      &match=1
    )
  )
  else if ("gcc_bimc_sleep_clk"=="&clk")
  (
    &match=1
  )
  
  if (&match==1)
  (
    &clk_test=&CLK_TEST_GCC_BIMC_SLEEP_CLK
    &clk_reg=&HWIO_GCC_BIMC_SLEEP_CBCR_ADDR
    &clk_reg_name="GCC_BIMC_SLEEP_CBCR"
    &clk_name="gcc_bimc_sleep_clk"
    &clk_reg_cbcr_type="sm_cbc"
    &clk_vote_bit=-1.
    &clk_multiplier=4.
    &clk_access_mode="&GCC_access_mode"

    gosub Print_Clk_Info_Line
  )

  &match=0
  &wild_head=0
  &wild_tail=0
  &clk_input_length=STRING.LENGTH("&clk")
  &clk_itr_length=STRING.LENGTH("gcc_blsp1_sleep_clk")

  if (STRING.SCAN("&clk", "*", 0)==0)
  (
    &wild_head=1
  )
  if (STRING.SCAN("&clk", "*", 1)==(STRING.LENGTH("&clk")-1))
  (
    &wild_tail=1
  )

  if ((&wild_head==1)&&(&wild_tail==1))
  (
    if (STRING.SCAN("gcc_blsp1_sleep_clk", STRING.MID("&clk", 1, &clk_input_length-2), 0)!=-1)
    ( 
      &match=1
    )
  )
  else if (&wild_head==1)
  (
    if (STRING.MID("gcc_blsp1_sleep_clk", &clk_itr_length-&clk_input_length+1, &clk_input_length-1)==STRING.CUT("&clk", 1))
    ( 
      &match=1
    )
  )
  else if (&wild_tail==1)
  (
    if (STRING.MID("gcc_blsp1_sleep_clk", 0, &clk_input_length-1)==STRING.CUT("&clk", -1))
    ( 
      &match=1
    )
  )
  else if ("gcc_blsp1_sleep_clk"=="&clk")
  (
    &match=1
  )
  
  if (&match==1)
  (
    &clk_test=&CLK_TEST_GCC_BLSP1_SLEEP_CLK
    &clk_reg=&HWIO_GCC_BLSP1_SLEEP_CBCR_ADDR
    &clk_reg_name="GCC_BLSP1_SLEEP_CBCR"
    &clk_name="gcc_blsp1_sleep_clk"
    &clk_reg_cbcr_type="sm_cbc"
    &clk_vote_bit=16.
    &clk_multiplier=4.
    &clk_access_mode="&GCC_access_mode"

    gosub Print_Clk_Info_Line
  )

  &match=0
  &wild_head=0
  &wild_tail=0
  &clk_input_length=STRING.LENGTH("&clk")
  &clk_itr_length=STRING.LENGTH("gcc_blsp2_sleep_clk")

  if (STRING.SCAN("&clk", "*", 0)==0)
  (
    &wild_head=1
  )
  if (STRING.SCAN("&clk", "*", 1)==(STRING.LENGTH("&clk")-1))
  (
    &wild_tail=1
  )

  if ((&wild_head==1)&&(&wild_tail==1))
  (
    if (STRING.SCAN("gcc_blsp2_sleep_clk", STRING.MID("&clk", 1, &clk_input_length-2), 0)!=-1)
    ( 
      &match=1
    )
  )
  else if (&wild_head==1)
  (
    if (STRING.MID("gcc_blsp2_sleep_clk", &clk_itr_length-&clk_input_length+1, &clk_input_length-1)==STRING.CUT("&clk", 1))
    ( 
      &match=1
    )
  )
  else if (&wild_tail==1)
  (
    if (STRING.MID("gcc_blsp2_sleep_clk", 0, &clk_input_length-1)==STRING.CUT("&clk", -1))
    ( 
      &match=1
    )
  )
  else if ("gcc_blsp2_sleep_clk"=="&clk")
  (
    &match=1
  )
  
  if (&match==1)
  (
    &clk_test=&CLK_TEST_GCC_BLSP2_SLEEP_CLK
    &clk_reg=&HWIO_GCC_BLSP2_SLEEP_CBCR_ADDR
    &clk_reg_name="GCC_BLSP2_SLEEP_CBCR"
    &clk_name="gcc_blsp2_sleep_clk"
    &clk_reg_cbcr_type="sm_cbc"
    &clk_vote_bit=14.
    &clk_multiplier=4.
    &clk_access_mode="&GCC_access_mode"

    gosub Print_Clk_Info_Line
  )

  &match=0
  &wild_head=0
  &wild_tail=0
  &clk_input_length=STRING.LENGTH("&clk")
  &clk_itr_length=STRING.LENGTH("gcc_ddr_dim_sleep_clk")

  if (STRING.SCAN("&clk", "*", 0)==0)
  (
    &wild_head=1
  )
  if (STRING.SCAN("&clk", "*", 1)==(STRING.LENGTH("&clk")-1))
  (
    &wild_tail=1
  )

  if ((&wild_head==1)&&(&wild_tail==1))
  (
    if (STRING.SCAN("gcc_ddr_dim_sleep_clk", STRING.MID("&clk", 1, &clk_input_length-2), 0)!=-1)
    ( 
      &match=1
    )
  )
  else if (&wild_head==1)
  (
    if (STRING.MID("gcc_ddr_dim_sleep_clk", &clk_itr_length-&clk_input_length+1, &clk_input_length-1)==STRING.CUT("&clk", 1))
    ( 
      &match=1
    )
  )
  else if (&wild_tail==1)
  (
    if (STRING.MID("gcc_ddr_dim_sleep_clk", 0, &clk_input_length-1)==STRING.CUT("&clk", -1))
    ( 
      &match=1
    )
  )
  else if ("gcc_ddr_dim_sleep_clk"=="&clk")
  (
    &match=1
  )
  
  if (&match==1)
  (
    &clk_test=&CLK_TEST_GCC_DDR_DIM_SLEEP_CLK
    &clk_reg=&HWIO_GCC_DDR_DIM_SLEEP_CBCR_ADDR
    &clk_reg_name="GCC_DDR_DIM_SLEEP_CBCR"
    &clk_name="gcc_ddr_dim_sleep_clk"
    &clk_reg_cbcr_type="sm_cbc"
    &clk_vote_bit=-1.
    &clk_multiplier=4.
    &clk_access_mode="&GCC_access_mode"

    gosub Print_Clk_Info_Line
  )

  &match=0
  &wild_head=0
  &wild_tail=0
  &clk_input_length=STRING.LENGTH("&clk")
  &clk_itr_length=STRING.LENGTH("gcc_im_sleep_clk")

  if (STRING.SCAN("&clk", "*", 0)==0)
  (
    &wild_head=1
  )
  if (STRING.SCAN("&clk", "*", 1)==(STRING.LENGTH("&clk")-1))
  (
    &wild_tail=1
  )

  if ((&wild_head==1)&&(&wild_tail==1))
  (
    if (STRING.SCAN("gcc_im_sleep_clk", STRING.MID("&clk", 1, &clk_input_length-2), 0)!=-1)
    ( 
      &match=1
    )
  )
  else if (&wild_head==1)
  (
    if (STRING.MID("gcc_im_sleep_clk", &clk_itr_length-&clk_input_length+1, &clk_input_length-1)==STRING.CUT("&clk", 1))
    ( 
      &match=1
    )
  )
  else if (&wild_tail==1)
  (
    if (STRING.MID("gcc_im_sleep_clk", 0, &clk_input_length-1)==STRING.CUT("&clk", -1))
    ( 
      &match=1
    )
  )
  else if ("gcc_im_sleep_clk"=="&clk")
  (
    &match=1
  )
  
  if (&match==1)
  (
    &clk_test=&CLK_TEST_GCC_IM_SLEEP_CLK
    &clk_reg=&HWIO_GCC_GCC_IM_SLEEP_CBCR_ADDR
    &clk_reg_name="GCC_GCC_IM_SLEEP_CBCR"
    &clk_name="gcc_im_sleep_clk"
    &clk_reg_cbcr_type="sm_cbc"
    &clk_vote_bit=-1.
    &clk_multiplier=4.
    &clk_access_mode="&GCC_access_mode"

    gosub Print_Clk_Info_Line
  )

  &match=0
  &wild_head=0
  &wild_tail=0
  &clk_input_length=STRING.LENGTH("&clk")
  &clk_itr_length=STRING.LENGTH("gcc_ipa_sleep_clk")

  if (STRING.SCAN("&clk", "*", 0)==0)
  (
    &wild_head=1
  )
  if (STRING.SCAN("&clk", "*", 1)==(STRING.LENGTH("&clk")-1))
  (
    &wild_tail=1
  )

  if ((&wild_head==1)&&(&wild_tail==1))
  (
    if (STRING.SCAN("gcc_ipa_sleep_clk", STRING.MID("&clk", 1, &clk_input_length-2), 0)!=-1)
    ( 
      &match=1
    )
  )
  else if (&wild_head==1)
  (
    if (STRING.MID("gcc_ipa_sleep_clk", &clk_itr_length-&clk_input_length+1, &clk_input_length-1)==STRING.CUT("&clk", 1))
    ( 
      &match=1
    )
  )
  else if (&wild_tail==1)
  (
    if (STRING.MID("gcc_ipa_sleep_clk", 0, &clk_input_length-1)==STRING.CUT("&clk", -1))
    ( 
      &match=1
    )
  )
  else if ("gcc_ipa_sleep_clk"=="&clk")
  (
    &match=1
  )
  
  if (&match==1)
  (
    &clk_test=&CLK_TEST_GCC_IPA_SLEEP_CLK
    &clk_reg=&HWIO_GCC_IPA_SLEEP_CBCR_ADDR
    &clk_reg_name="GCC_IPA_SLEEP_CBCR"
    &clk_name="gcc_ipa_sleep_clk"
    &clk_reg_cbcr_type="sm_cbc"
    &clk_vote_bit=-1.
    &clk_multiplier=4.
    &clk_access_mode="&GCC_access_mode"

    gosub Print_Clk_Info_Line
  )

  &match=0
  &wild_head=0
  &wild_tail=0
  &clk_input_length=STRING.LENGTH("&clk")
  &clk_itr_length=STRING.LENGTH("gcc_rpm_sleep_clk")

  if (STRING.SCAN("&clk", "*", 0)==0)
  (
    &wild_head=1
  )
  if (STRING.SCAN("&clk", "*", 1)==(STRING.LENGTH("&clk")-1))
  (
    &wild_tail=1
  )

  if ((&wild_head==1)&&(&wild_tail==1))
  (
    if (STRING.SCAN("gcc_rpm_sleep_clk", STRING.MID("&clk", 1, &clk_input_length-2), 0)!=-1)
    ( 
      &match=1
    )
  )
  else if (&wild_head==1)
  (
    if (STRING.MID("gcc_rpm_sleep_clk", &clk_itr_length-&clk_input_length+1, &clk_input_length-1)==STRING.CUT("&clk", 1))
    ( 
      &match=1
    )
  )
  else if (&wild_tail==1)
  (
    if (STRING.MID("gcc_rpm_sleep_clk", 0, &clk_input_length-1)==STRING.CUT("&clk", -1))
    ( 
      &match=1
    )
  )
  else if ("gcc_rpm_sleep_clk"=="&clk")
  (
    &match=1
  )
  
  if (&match==1)
  (
    &clk_test=&CLK_TEST_GCC_RPM_SLEEP_CLK
    &clk_reg=&HWIO_GCC_RPM_SLEEP_CBCR_ADDR
    &clk_reg_name="GCC_RPM_SLEEP_CBCR"
    &clk_name="gcc_rpm_sleep_clk"
    &clk_reg_cbcr_type="sm_cbc"
    &clk_vote_bit=-1.
    &clk_multiplier=4.
    &clk_access_mode="&GCC_access_mode"

    gosub Print_Clk_Info_Line
  )

  &match=0
  &wild_head=0
  &wild_tail=0
  &clk_input_length=STRING.LENGTH("&clk")
  &clk_itr_length=STRING.LENGTH("gcc_usb20_sleep_clk")

  if (STRING.SCAN("&clk", "*", 0)==0)
  (
    &wild_head=1
  )
  if (STRING.SCAN("&clk", "*", 1)==(STRING.LENGTH("&clk")-1))
  (
    &wild_tail=1
  )

  if ((&wild_head==1)&&(&wild_tail==1))
  (
    if (STRING.SCAN("gcc_usb20_sleep_clk", STRING.MID("&clk", 1, &clk_input_length-2), 0)!=-1)
    ( 
      &match=1
    )
  )
  else if (&wild_head==1)
  (
    if (STRING.MID("gcc_usb20_sleep_clk", &clk_itr_length-&clk_input_length+1, &clk_input_length-1)==STRING.CUT("&clk", 1))
    ( 
      &match=1
    )
  )
  else if (&wild_tail==1)
  (
    if (STRING.MID("gcc_usb20_sleep_clk", 0, &clk_input_length-1)==STRING.CUT("&clk", -1))
    ( 
      &match=1
    )
  )
  else if ("gcc_usb20_sleep_clk"=="&clk")
  (
    &match=1
  )
  
  if (&match==1)
  (
    &clk_test=&CLK_TEST_GCC_USB20_SLEEP_CLK
    &clk_reg=&HWIO_GCC_USB20_SLEEP_CBCR_ADDR
    &clk_reg_name="GCC_USB20_SLEEP_CBCR"
    &clk_name="gcc_usb20_sleep_clk"
    &clk_reg_cbcr_type="sm_cbc"
    &clk_vote_bit=-1.
    &clk_multiplier=4.
    &clk_access_mode="&GCC_access_mode"

    gosub Print_Clk_Info_Line
  )

  &match=0
  &wild_head=0
  &wild_tail=0
  &clk_input_length=STRING.LENGTH("&clk")
  &clk_itr_length=STRING.LENGTH("gcc_usb30_sleep_clk")

  if (STRING.SCAN("&clk", "*", 0)==0)
  (
    &wild_head=1
  )
  if (STRING.SCAN("&clk", "*", 1)==(STRING.LENGTH("&clk")-1))
  (
    &wild_tail=1
  )

  if ((&wild_head==1)&&(&wild_tail==1))
  (
    if (STRING.SCAN("gcc_usb30_sleep_clk", STRING.MID("&clk", 1, &clk_input_length-2), 0)!=-1)
    ( 
      &match=1
    )
  )
  else if (&wild_head==1)
  (
    if (STRING.MID("gcc_usb30_sleep_clk", &clk_itr_length-&clk_input_length+1, &clk_input_length-1)==STRING.CUT("&clk", 1))
    ( 
      &match=1
    )
  )
  else if (&wild_tail==1)
  (
    if (STRING.MID("gcc_usb30_sleep_clk", 0, &clk_input_length-1)==STRING.CUT("&clk", -1))
    ( 
      &match=1
    )
  )
  else if ("gcc_usb30_sleep_clk"=="&clk")
  (
    &match=1
  )
  
  if (&match==1)
  (
    &clk_test=&CLK_TEST_GCC_USB30_SLEEP_CLK
    &clk_reg=&HWIO_GCC_USB30_SLEEP_CBCR_ADDR
    &clk_reg_name="GCC_USB30_SLEEP_CBCR"
    &clk_name="gcc_usb30_sleep_clk"
    &clk_reg_cbcr_type="sm_cbc"
    &clk_vote_bit=-1.
    &clk_multiplier=4.
    &clk_access_mode="&GCC_access_mode"

    gosub Print_Clk_Info_Line
  )

  &match=0
  &wild_head=0
  &wild_tail=0
  &clk_input_length=STRING.LENGTH("&clk")
  &clk_itr_length=STRING.LENGTH("gcc_a2noc_throttle_cxo_clk")

  if (STRING.SCAN("&clk", "*", 0)==0)
  (
    &wild_head=1
  )
  if (STRING.SCAN("&clk", "*", 1)==(STRING.LENGTH("&clk")-1))
  (
    &wild_tail=1
  )

  if ((&wild_head==1)&&(&wild_tail==1))
  (
    if (STRING.SCAN("gcc_a2noc_throttle_cxo_clk", STRING.MID("&clk", 1, &clk_input_length-2), 0)!=-1)
    ( 
      &match=1
    )
  )
  else if (&wild_head==1)
  (
    if (STRING.MID("gcc_a2noc_throttle_cxo_clk", &clk_itr_length-&clk_input_length+1, &clk_input_length-1)==STRING.CUT("&clk", 1))
    ( 
      &match=1
    )
  )
  else if (&wild_tail==1)
  (
    if (STRING.MID("gcc_a2noc_throttle_cxo_clk", 0, &clk_input_length-1)==STRING.CUT("&clk", -1))
    ( 
      &match=1
    )
  )
  else if ("gcc_a2noc_throttle_cxo_clk"=="&clk")
  (
    &match=1
  )
  
  if (&match==1)
  (
    &clk_test=&CLK_TEST_GCC_A2NOC_THROTTLE_CXO_CLK
    &clk_reg=&HWIO_GCC_A2NOC_THROTTLE_CXO_CBCR_ADDR
    &clk_reg_name="GCC_A2NOC_THROTTLE_CXO_CBCR"
    &clk_name="gcc_a2noc_throttle_cxo_clk"
    &clk_reg_cbcr_type="sm_cbc"
    &clk_vote_bit=-1.
    &clk_multiplier=4.
    &clk_access_mode="&GCC_access_mode"

    gosub Print_Clk_Info_Line
  )

  &match=0
  &wild_head=0
  &wild_tail=0
  &clk_input_length=STRING.LENGTH("&clk")
  &clk_itr_length=STRING.LENGTH("gcc_aggre2_noc_cxo_north_clk")

  if (STRING.SCAN("&clk", "*", 0)==0)
  (
    &wild_head=1
  )
  if (STRING.SCAN("&clk", "*", 1)==(STRING.LENGTH("&clk")-1))
  (
    &wild_tail=1
  )

  if ((&wild_head==1)&&(&wild_tail==1))
  (
    if (STRING.SCAN("gcc_aggre2_noc_cxo_north_clk", STRING.MID("&clk", 1, &clk_input_length-2), 0)!=-1)
    ( 
      &match=1
    )
  )
  else if (&wild_head==1)
  (
    if (STRING.MID("gcc_aggre2_noc_cxo_north_clk", &clk_itr_length-&clk_input_length+1, &clk_input_length-1)==STRING.CUT("&clk", 1))
    ( 
      &match=1
    )
  )
  else if (&wild_tail==1)
  (
    if (STRING.MID("gcc_aggre2_noc_cxo_north_clk", 0, &clk_input_length-1)==STRING.CUT("&clk", -1))
    ( 
      &match=1
    )
  )
  else if ("gcc_aggre2_noc_cxo_north_clk"=="&clk")
  (
    &match=1
  )
  
  if (&match==1)
  (
    &clk_test=&CLK_TEST_GCC_AGGRE2_NOC_CXO_NORTH_CLK
    &clk_reg=&HWIO_GCC_AGGRE2_NOC_CXO_NORTH_CBCR_ADDR
    &clk_reg_name="GCC_AGGRE2_NOC_CXO_NORTH_CBCR"
    &clk_name="gcc_aggre2_noc_cxo_north_clk"
    &clk_reg_cbcr_type="sm_cbc"
    &clk_vote_bit=-1.
    &clk_multiplier=4.
    &clk_access_mode="&GCC_access_mode"

    gosub Print_Clk_Info_Line
  )

  &match=0
  &wild_head=0
  &wild_tail=0
  &clk_input_length=STRING.LENGTH("&clk")
  &clk_itr_length=STRING.LENGTH("gcc_aggre2_noc_cxo_south_clk")

  if (STRING.SCAN("&clk", "*", 0)==0)
  (
    &wild_head=1
  )
  if (STRING.SCAN("&clk", "*", 1)==(STRING.LENGTH("&clk")-1))
  (
    &wild_tail=1
  )

  if ((&wild_head==1)&&(&wild_tail==1))
  (
    if (STRING.SCAN("gcc_aggre2_noc_cxo_south_clk", STRING.MID("&clk", 1, &clk_input_length-2), 0)!=-1)
    ( 
      &match=1
    )
  )
  else if (&wild_head==1)
  (
    if (STRING.MID("gcc_aggre2_noc_cxo_south_clk", &clk_itr_length-&clk_input_length+1, &clk_input_length-1)==STRING.CUT("&clk", 1))
    ( 
      &match=1
    )
  )
  else if (&wild_tail==1)
  (
    if (STRING.MID("gcc_aggre2_noc_cxo_south_clk", 0, &clk_input_length-1)==STRING.CUT("&clk", -1))
    ( 
      &match=1
    )
  )
  else if ("gcc_aggre2_noc_cxo_south_clk"=="&clk")
  (
    &match=1
  )
  
  if (&match==1)
  (
    &clk_test=&CLK_TEST_GCC_AGGRE2_NOC_CXO_SOUTH_CLK
    &clk_reg=&HWIO_GCC_AGGRE2_NOC_CXO_SOUTH_CBCR_ADDR
    &clk_reg_name="GCC_AGGRE2_NOC_CXO_SOUTH_CBCR"
    &clk_name="gcc_aggre2_noc_cxo_south_clk"
    &clk_reg_cbcr_type="sm_cbc"
    &clk_vote_bit=-1.
    &clk_multiplier=4.
    &clk_access_mode="&GCC_access_mode"

    gosub Print_Clk_Info_Line
  )

  &match=0
  &wild_head=0
  &wild_tail=0
  &clk_input_length=STRING.LENGTH("&clk")
  &clk_itr_length=STRING.LENGTH("gcc_ahb2phy_east_clk")

  if (STRING.SCAN("&clk", "*", 0)==0)
  (
    &wild_head=1
  )
  if (STRING.SCAN("&clk", "*", 1)==(STRING.LENGTH("&clk")-1))
  (
    &wild_tail=1
  )

  if ((&wild_head==1)&&(&wild_tail==1))
  (
    if (STRING.SCAN("gcc_ahb2phy_east_clk", STRING.MID("&clk", 1, &clk_input_length-2), 0)!=-1)
    ( 
      &match=1
    )
  )
  else if (&wild_head==1)
  (
    if (STRING.MID("gcc_ahb2phy_east_clk", &clk_itr_length-&clk_input_length+1, &clk_input_length-1)==STRING.CUT("&clk", 1))
    ( 
      &match=1
    )
  )
  else if (&wild_tail==1)
  (
    if (STRING.MID("gcc_ahb2phy_east_clk", 0, &clk_input_length-1)==STRING.CUT("&clk", -1))
    ( 
      &match=1
    )
  )
  else if ("gcc_ahb2phy_east_clk"=="&clk")
  (
    &match=1
  )
  
  if (&match==1)
  (
    &clk_test=&CLK_TEST_GCC_AHB2PHY_EAST_CLK
    &clk_reg=&HWIO_GCC_AHB2PHY_EAST_CBCR_ADDR
    &clk_reg_name="GCC_AHB2PHY_EAST_CBCR"
    &clk_name="gcc_ahb2phy_east_clk"
    &clk_reg_cbcr_type="sm_cbc"
    &clk_vote_bit=-1.
    &clk_multiplier=4.
    &clk_access_mode="&GCC_access_mode"

    gosub Print_Clk_Info_Line
  )

  &match=0
  &wild_head=0
  &wild_tail=0
  &clk_input_length=STRING.LENGTH("&clk")
  &clk_itr_length=STRING.LENGTH("gcc_cfg_noc_ah2phy_xo_clk")

  if (STRING.SCAN("&clk", "*", 0)==0)
  (
    &wild_head=1
  )
  if (STRING.SCAN("&clk", "*", 1)==(STRING.LENGTH("&clk")-1))
  (
    &wild_tail=1
  )

  if ((&wild_head==1)&&(&wild_tail==1))
  (
    if (STRING.SCAN("gcc_cfg_noc_ah2phy_xo_clk", STRING.MID("&clk", 1, &clk_input_length-2), 0)!=-1)
    ( 
      &match=1
    )
  )
  else if (&wild_head==1)
  (
    if (STRING.MID("gcc_cfg_noc_ah2phy_xo_clk", &clk_itr_length-&clk_input_length+1, &clk_input_length-1)==STRING.CUT("&clk", 1))
    ( 
      &match=1
    )
  )
  else if (&wild_tail==1)
  (
    if (STRING.MID("gcc_cfg_noc_ah2phy_xo_clk", 0, &clk_input_length-1)==STRING.CUT("&clk", -1))
    ( 
      &match=1
    )
  )
  else if ("gcc_cfg_noc_ah2phy_xo_clk"=="&clk")
  (
    &match=1
  )
  
  if (&match==1)
  (
    &clk_test=&CLK_TEST_GCC_CFG_NOC_AH2PHY_XO_CLK
    &clk_reg=&HWIO_GCC_CFG_NOC_AH2PHY_XO_CBCR_ADDR
    &clk_reg_name="GCC_CFG_NOC_AH2PHY_XO_CBCR"
    &clk_name="gcc_cfg_noc_ah2phy_xo_clk"
    &clk_reg_cbcr_type="sm_cbc"
    &clk_vote_bit=-1.
    &clk_multiplier=4.
    &clk_access_mode="&GCC_access_mode"

    gosub Print_Clk_Info_Line
  )

  &match=0
  &wild_head=0
  &wild_tail=0
  &clk_input_length=STRING.LENGTH("&clk")
  &clk_itr_length=STRING.LENGTH("gcc_cfg_noc_dcd_xo_clk")

  if (STRING.SCAN("&clk", "*", 0)==0)
  (
    &wild_head=1
  )
  if (STRING.SCAN("&clk", "*", 1)==(STRING.LENGTH("&clk")-1))
  (
    &wild_tail=1
  )

  if ((&wild_head==1)&&(&wild_tail==1))
  (
    if (STRING.SCAN("gcc_cfg_noc_dcd_xo_clk", STRING.MID("&clk", 1, &clk_input_length-2), 0)!=-1)
    ( 
      &match=1
    )
  )
  else if (&wild_head==1)
  (
    if (STRING.MID("gcc_cfg_noc_dcd_xo_clk", &clk_itr_length-&clk_input_length+1, &clk_input_length-1)==STRING.CUT("&clk", 1))
    ( 
      &match=1
    )
  )
  else if (&wild_tail==1)
  (
    if (STRING.MID("gcc_cfg_noc_dcd_xo_clk", 0, &clk_input_length-1)==STRING.CUT("&clk", -1))
    ( 
      &match=1
    )
  )
  else if ("gcc_cfg_noc_dcd_xo_clk"=="&clk")
  (
    &match=1
  )
  
  if (&match==1)
  (
    &clk_test=&CLK_TEST_GCC_CFG_NOC_DCD_XO_CLK
    &clk_reg=&HWIO_GCC_CFG_NOC_DCD_XO_CBCR_ADDR
    &clk_reg_name="GCC_CFG_NOC_DCD_XO_CBCR"
    &clk_name="gcc_cfg_noc_dcd_xo_clk"
    &clk_reg_cbcr_type="sm_cbc"
    &clk_vote_bit=-1.
    &clk_multiplier=4.
    &clk_access_mode="&GCC_access_mode"

    gosub Print_Clk_Info_Line
  )

  &match=0
  &wild_head=0
  &wild_tail=0
  &clk_input_length=STRING.LENGTH("&clk")
  &clk_itr_length=STRING.LENGTH("gcc_cfg_noc_north_dcd_xo_clk")

  if (STRING.SCAN("&clk", "*", 0)==0)
  (
    &wild_head=1
  )
  if (STRING.SCAN("&clk", "*", 1)==(STRING.LENGTH("&clk")-1))
  (
    &wild_tail=1
  )

  if ((&wild_head==1)&&(&wild_tail==1))
  (
    if (STRING.SCAN("gcc_cfg_noc_north_dcd_xo_clk", STRING.MID("&clk", 1, &clk_input_length-2), 0)!=-1)
    ( 
      &match=1
    )
  )
  else if (&wild_head==1)
  (
    if (STRING.MID("gcc_cfg_noc_north_dcd_xo_clk", &clk_itr_length-&clk_input_length+1, &clk_input_length-1)==STRING.CUT("&clk", 1))
    ( 
      &match=1
    )
  )
  else if (&wild_tail==1)
  (
    if (STRING.MID("gcc_cfg_noc_north_dcd_xo_clk", 0, &clk_input_length-1)==STRING.CUT("&clk", -1))
    ( 
      &match=1
    )
  )
  else if ("gcc_cfg_noc_north_dcd_xo_clk"=="&clk")
  (
    &match=1
  )
  
  if (&match==1)
  (
    &clk_test=&CLK_TEST_GCC_CFG_NOC_NORTH_DCD_XO_CLK
    &clk_reg=&HWIO_GCC_CFG_NOC_NORTH_DCD_XO_CBCR_ADDR
    &clk_reg_name="GCC_CFG_NOC_NORTH_DCD_XO_CBCR"
    &clk_name="gcc_cfg_noc_north_dcd_xo_clk"
    &clk_reg_cbcr_type="sm_cbc"
    &clk_vote_bit=-1.
    &clk_multiplier=4.
    &clk_access_mode="&GCC_access_mode"

    gosub Print_Clk_Info_Line
  )

  &match=0
  &wild_head=0
  &wild_tail=0
  &clk_input_length=STRING.LENGTH("&clk")
  &clk_itr_length=STRING.LENGTH("gcc_cfg_noc_south_dcd_xo_clk")

  if (STRING.SCAN("&clk", "*", 0)==0)
  (
    &wild_head=1
  )
  if (STRING.SCAN("&clk", "*", 1)==(STRING.LENGTH("&clk")-1))
  (
    &wild_tail=1
  )

  if ((&wild_head==1)&&(&wild_tail==1))
  (
    if (STRING.SCAN("gcc_cfg_noc_south_dcd_xo_clk", STRING.MID("&clk", 1, &clk_input_length-2), 0)!=-1)
    ( 
      &match=1
    )
  )
  else if (&wild_head==1)
  (
    if (STRING.MID("gcc_cfg_noc_south_dcd_xo_clk", &clk_itr_length-&clk_input_length+1, &clk_input_length-1)==STRING.CUT("&clk", 1))
    ( 
      &match=1
    )
  )
  else if (&wild_tail==1)
  (
    if (STRING.MID("gcc_cfg_noc_south_dcd_xo_clk", 0, &clk_input_length-1)==STRING.CUT("&clk", -1))
    ( 
      &match=1
    )
  )
  else if ("gcc_cfg_noc_south_dcd_xo_clk"=="&clk")
  (
    &match=1
  )
  
  if (&match==1)
  (
    &clk_test=&CLK_TEST_GCC_CFG_NOC_SOUTH_DCD_XO_CLK
    &clk_reg=&HWIO_GCC_CFG_NOC_SOUTH_DCD_XO_CBCR_ADDR
    &clk_reg_name="GCC_CFG_NOC_SOUTH_DCD_XO_CBCR"
    &clk_name="gcc_cfg_noc_south_dcd_xo_clk"
    &clk_reg_cbcr_type="sm_cbc"
    &clk_vote_bit=-1.
    &clk_multiplier=4.
    &clk_access_mode="&GCC_access_mode"

    gosub Print_Clk_Info_Line
  )

  &match=0
  &wild_head=0
  &wild_tail=0
  &clk_input_length=STRING.LENGTH("&clk")
  &clk_itr_length=STRING.LENGTH("gcc_cm_phy_refgen1_clk")

  if (STRING.SCAN("&clk", "*", 0)==0)
  (
    &wild_head=1
  )
  if (STRING.SCAN("&clk", "*", 1)==(STRING.LENGTH("&clk")-1))
  (
    &wild_tail=1
  )

  if ((&wild_head==1)&&(&wild_tail==1))
  (
    if (STRING.SCAN("gcc_cm_phy_refgen1_clk", STRING.MID("&clk", 1, &clk_input_length-2), 0)!=-1)
    ( 
      &match=1
    )
  )
  else if (&wild_head==1)
  (
    if (STRING.MID("gcc_cm_phy_refgen1_clk", &clk_itr_length-&clk_input_length+1, &clk_input_length-1)==STRING.CUT("&clk", 1))
    ( 
      &match=1
    )
  )
  else if (&wild_tail==1)
  (
    if (STRING.MID("gcc_cm_phy_refgen1_clk", 0, &clk_input_length-1)==STRING.CUT("&clk", -1))
    ( 
      &match=1
    )
  )
  else if ("gcc_cm_phy_refgen1_clk"=="&clk")
  (
    &match=1
  )
  
  if (&match==1)
  (
    &clk_test=&CLK_TEST_GCC_CM_PHY_REFGEN1_CLK
    &clk_reg=&HWIO_GCC_CM_PHY_REFGEN1_CBCR_ADDR
    &clk_reg_name="GCC_CM_PHY_REFGEN1_CBCR"
    &clk_name="gcc_cm_phy_refgen1_clk"
    &clk_reg_cbcr_type="sm_cbc"
    &clk_vote_bit=-1.
    &clk_multiplier=4.
    &clk_access_mode="&GCC_access_mode"

    gosub Print_Clk_Info_Line
  )

  &match=0
  &wild_head=0
  &wild_tail=0
  &clk_input_length=STRING.LENGTH("&clk")
  &clk_itr_length=STRING.LENGTH("gcc_cm_phy_refgen2_clk")

  if (STRING.SCAN("&clk", "*", 0)==0)
  (
    &wild_head=1
  )
  if (STRING.SCAN("&clk", "*", 1)==(STRING.LENGTH("&clk")-1))
  (
    &wild_tail=1
  )

  if ((&wild_head==1)&&(&wild_tail==1))
  (
    if (STRING.SCAN("gcc_cm_phy_refgen2_clk", STRING.MID("&clk", 1, &clk_input_length-2), 0)!=-1)
    ( 
      &match=1
    )
  )
  else if (&wild_head==1)
  (
    if (STRING.MID("gcc_cm_phy_refgen2_clk", &clk_itr_length-&clk_input_length+1, &clk_input_length-1)==STRING.CUT("&clk", 1))
    ( 
      &match=1
    )
  )
  else if (&wild_tail==1)
  (
    if (STRING.MID("gcc_cm_phy_refgen2_clk", 0, &clk_input_length-1)==STRING.CUT("&clk", -1))
    ( 
      &match=1
    )
  )
  else if ("gcc_cm_phy_refgen2_clk"=="&clk")
  (
    &match=1
  )
  
  if (&match==1)
  (
    &clk_test=&CLK_TEST_GCC_CM_PHY_REFGEN2_CLK
    &clk_reg=&HWIO_GCC_CM_PHY_REFGEN2_CBCR_ADDR
    &clk_reg_name="GCC_CM_PHY_REFGEN2_CBCR"
    &clk_name="gcc_cm_phy_refgen2_clk"
    &clk_reg_cbcr_type="sm_cbc"
    &clk_vote_bit=-1.
    &clk_multiplier=4.
    &clk_access_mode="&GCC_access_mode"

    gosub Print_Clk_Info_Line
  )

  &match=0
  &wild_head=0
  &wild_tail=0
  &clk_input_length=STRING.LENGTH("&clk")
  &clk_itr_length=STRING.LENGTH("gcc_cnoc_bus_timeout13_ahb_clk")

  if (STRING.SCAN("&clk", "*", 0)==0)
  (
    &wild_head=1
  )
  if (STRING.SCAN("&clk", "*", 1)==(STRING.LENGTH("&clk")-1))
  (
    &wild_tail=1
  )

  if ((&wild_head==1)&&(&wild_tail==1))
  (
    if (STRING.SCAN("gcc_cnoc_bus_timeout13_ahb_clk", STRING.MID("&clk", 1, &clk_input_length-2), 0)!=-1)
    ( 
      &match=1
    )
  )
  else if (&wild_head==1)
  (
    if (STRING.MID("gcc_cnoc_bus_timeout13_ahb_clk", &clk_itr_length-&clk_input_length+1, &clk_input_length-1)==STRING.CUT("&clk", 1))
    ( 
      &match=1
    )
  )
  else if (&wild_tail==1)
  (
    if (STRING.MID("gcc_cnoc_bus_timeout13_ahb_clk", 0, &clk_input_length-1)==STRING.CUT("&clk", -1))
    ( 
      &match=1
    )
  )
  else if ("gcc_cnoc_bus_timeout13_ahb_clk"=="&clk")
  (
    &match=1
  )
  
  if (&match==1)
  (
    &clk_test=&CLK_TEST_GCC_CNOC_BUS_TIMEOUT13_AHB_CLK
    &clk_reg=&HWIO_GCC_CNOC_BUS_TIMEOUT13_AHB_CBCR_ADDR
    &clk_reg_name="GCC_CNOC_BUS_TIMEOUT13_AHB_CBCR"
    &clk_name="gcc_cnoc_bus_timeout13_ahb_clk"
    &clk_reg_cbcr_type="sm_cbc"
    &clk_vote_bit=-1.
    &clk_multiplier=4.
    &clk_access_mode="&GCC_access_mode"

    gosub Print_Clk_Info_Line
  )

  &match=0
  &wild_head=0
  &wild_tail=0
  &clk_input_length=STRING.LENGTH("&clk")
  &clk_itr_length=STRING.LENGTH("gcc_glm_xo_clk")

  if (STRING.SCAN("&clk", "*", 0)==0)
  (
    &wild_head=1
  )
  if (STRING.SCAN("&clk", "*", 1)==(STRING.LENGTH("&clk")-1))
  (
    &wild_tail=1
  )

  if ((&wild_head==1)&&(&wild_tail==1))
  (
    if (STRING.SCAN("gcc_glm_xo_clk", STRING.MID("&clk", 1, &clk_input_length-2), 0)!=-1)
    ( 
      &match=1
    )
  )
  else if (&wild_head==1)
  (
    if (STRING.MID("gcc_glm_xo_clk", &clk_itr_length-&clk_input_length+1, &clk_input_length-1)==STRING.CUT("&clk", 1))
    ( 
      &match=1
    )
  )
  else if (&wild_tail==1)
  (
    if (STRING.MID("gcc_glm_xo_clk", 0, &clk_input_length-1)==STRING.CUT("&clk", -1))
    ( 
      &match=1
    )
  )
  else if ("gcc_glm_xo_clk"=="&clk")
  (
    &match=1
  )
  
  if (&match==1)
  (
    &clk_test=&CLK_TEST_GCC_GLM_XO_CLK
    &clk_reg=&HWIO_GCC_GLM_XO_CBCR_ADDR
    &clk_reg_name="GCC_GLM_XO_CBCR"
    &clk_name="gcc_glm_xo_clk"
    &clk_reg_cbcr_type="sm_cbc"
    &clk_vote_bit=-1.
    &clk_multiplier=4.
    &clk_access_mode="&GCC_access_mode"

    gosub Print_Clk_Info_Line
  )

  &match=0
  &wild_head=0
  &wild_tail=0
  &clk_input_length=STRING.LENGTH("&clk")
  &clk_itr_length=STRING.LENGTH("gcc_lpass_cxo_clk")

  if (STRING.SCAN("&clk", "*", 0)==0)
  (
    &wild_head=1
  )
  if (STRING.SCAN("&clk", "*", 1)==(STRING.LENGTH("&clk")-1))
  (
    &wild_tail=1
  )

  if ((&wild_head==1)&&(&wild_tail==1))
  (
    if (STRING.SCAN("gcc_lpass_cxo_clk", STRING.MID("&clk", 1, &clk_input_length-2), 0)!=-1)
    ( 
      &match=1
    )
  )
  else if (&wild_head==1)
  (
    if (STRING.MID("gcc_lpass_cxo_clk", &clk_itr_length-&clk_input_length+1, &clk_input_length-1)==STRING.CUT("&clk", 1))
    ( 
      &match=1
    )
  )
  else if (&wild_tail==1)
  (
    if (STRING.MID("gcc_lpass_cxo_clk", 0, &clk_input_length-1)==STRING.CUT("&clk", -1))
    ( 
      &match=1
    )
  )
  else if ("gcc_lpass_cxo_clk"=="&clk")
  (
    &match=1
  )
  
  if (&match==1)
  (
    &clk_test=&CLK_TEST_GCC_LPASS_CXO_CLK
    &clk_reg=&HWIO_GCC_LPASS_CXO_CBCR_ADDR
    &clk_reg_name="GCC_LPASS_CXO_CBCR"
    &clk_name="gcc_lpass_cxo_clk"
    &clk_reg_cbcr_type="sm_cbc"
    &clk_vote_bit=-1.
    &clk_multiplier=4.
    &clk_access_mode="&GCC_access_mode"

    gosub Print_Clk_Info_Line
  )

  &match=0
  &wild_head=0
  &wild_tail=0
  &clk_input_length=STRING.LENGTH("&clk")
  &clk_itr_length=STRING.LENGTH("gcc_pdm_xo4_clk")

  if (STRING.SCAN("&clk", "*", 0)==0)
  (
    &wild_head=1
  )
  if (STRING.SCAN("&clk", "*", 1)==(STRING.LENGTH("&clk")-1))
  (
    &wild_tail=1
  )

  if ((&wild_head==1)&&(&wild_tail==1))
  (
    if (STRING.SCAN("gcc_pdm_xo4_clk", STRING.MID("&clk", 1, &clk_input_length-2), 0)!=-1)
    ( 
      &match=1
    )
  )
  else if (&wild_head==1)
  (
    if (STRING.MID("gcc_pdm_xo4_clk", &clk_itr_length-&clk_input_length+1, &clk_input_length-1)==STRING.CUT("&clk", 1))
    ( 
      &match=1
    )
  )
  else if (&wild_tail==1)
  (
    if (STRING.MID("gcc_pdm_xo4_clk", 0, &clk_input_length-1)==STRING.CUT("&clk", -1))
    ( 
      &match=1
    )
  )
  else if ("gcc_pdm_xo4_clk"=="&clk")
  (
    &match=1
  )
  
  if (&match==1)
  (
    &clk_test=&CLK_TEST_GCC_PDM_XO4_CLK
    &clk_reg=&HWIO_GCC_PDM_XO4_CBCR_ADDR
    &clk_reg_name="GCC_PDM_XO4_CBCR"
    &clk_name="gcc_pdm_xo4_clk"
    &clk_reg_cbcr_type="sm_cbc"
    &clk_vote_bit=-1.
    &clk_multiplier=4.
    &clk_access_mode="&GCC_access_mode"

    gosub Print_Clk_Info_Line
  )

  &match=0
  &wild_head=0
  &wild_tail=0
  &clk_input_length=STRING.LENGTH("&clk")
  &clk_itr_length=STRING.LENGTH("gcc_qdss_xo_clk")

  if (STRING.SCAN("&clk", "*", 0)==0)
  (
    &wild_head=1
  )
  if (STRING.SCAN("&clk", "*", 1)==(STRING.LENGTH("&clk")-1))
  (
    &wild_tail=1
  )

  if ((&wild_head==1)&&(&wild_tail==1))
  (
    if (STRING.SCAN("gcc_qdss_xo_clk", STRING.MID("&clk", 1, &clk_input_length-2), 0)!=-1)
    ( 
      &match=1
    )
  )
  else if (&wild_head==1)
  (
    if (STRING.MID("gcc_qdss_xo_clk", &clk_itr_length-&clk_input_length+1, &clk_input_length-1)==STRING.CUT("&clk", 1))
    ( 
      &match=1
    )
  )
  else if (&wild_tail==1)
  (
    if (STRING.MID("gcc_qdss_xo_clk", 0, &clk_input_length-1)==STRING.CUT("&clk", -1))
    ( 
      &match=1
    )
  )
  else if ("gcc_qdss_xo_clk"=="&clk")
  (
    &match=1
  )
  
  if (&match==1)
  (
    &clk_test=&CLK_TEST_GCC_QDSS_XO_CLK
    &clk_reg=&HWIO_GCC_QDSS_XO_CBCR_ADDR
    &clk_reg_name="GCC_QDSS_XO_CBCR"
    &clk_name="gcc_qdss_xo_clk"
    &clk_reg_cbcr_type="sm_cbc"
    &clk_vote_bit=-1.
    &clk_multiplier=4.
    &clk_access_mode="&GCC_access_mode"

    gosub Print_Clk_Info_Line
  )

  &match=0
  &wild_head=0
  &wild_tail=0
  &clk_input_length=STRING.LENGTH("&clk")
  &clk_itr_length=STRING.LENGTH("gcc_qrefs_vbg_cal_clk")

  if (STRING.SCAN("&clk", "*", 0)==0)
  (
    &wild_head=1
  )
  if (STRING.SCAN("&clk", "*", 1)==(STRING.LENGTH("&clk")-1))
  (
    &wild_tail=1
  )

  if ((&wild_head==1)&&(&wild_tail==1))
  (
    if (STRING.SCAN("gcc_qrefs_vbg_cal_clk", STRING.MID("&clk", 1, &clk_input_length-2), 0)!=-1)
    ( 
      &match=1
    )
  )
  else if (&wild_head==1)
  (
    if (STRING.MID("gcc_qrefs_vbg_cal_clk", &clk_itr_length-&clk_input_length+1, &clk_input_length-1)==STRING.CUT("&clk", 1))
    ( 
      &match=1
    )
  )
  else if (&wild_tail==1)
  (
    if (STRING.MID("gcc_qrefs_vbg_cal_clk", 0, &clk_input_length-1)==STRING.CUT("&clk", -1))
    ( 
      &match=1
    )
  )
  else if ("gcc_qrefs_vbg_cal_clk"=="&clk")
  (
    &match=1
  )
  
  if (&match==1)
  (
    &clk_test=&CLK_TEST_GCC_QREFS_VBG_CAL_CLK
    &clk_reg=&HWIO_GCC_QREFS_VBG_CAL_CBCR_ADDR
    &clk_reg_name="GCC_QREFS_VBG_CAL_CBCR"
    &clk_name="gcc_qrefs_vbg_cal_clk"
    &clk_reg_cbcr_type="sm_cbc"
    &clk_vote_bit=-1.
    &clk_multiplier=4.
    &clk_access_mode="&GCC_access_mode"

    gosub Print_Clk_Info_Line
  )

  &match=0
  &wild_head=0
  &wild_tail=0
  &clk_input_length=STRING.LENGTH("&clk")
  &clk_itr_length=STRING.LENGTH("gcc_rpm_timer_clk")

  if (STRING.SCAN("&clk", "*", 0)==0)
  (
    &wild_head=1
  )
  if (STRING.SCAN("&clk", "*", 1)==(STRING.LENGTH("&clk")-1))
  (
    &wild_tail=1
  )

  if ((&wild_head==1)&&(&wild_tail==1))
  (
    if (STRING.SCAN("gcc_rpm_timer_clk", STRING.MID("&clk", 1, &clk_input_length-2), 0)!=-1)
    ( 
      &match=1
    )
  )
  else if (&wild_head==1)
  (
    if (STRING.MID("gcc_rpm_timer_clk", &clk_itr_length-&clk_input_length+1, &clk_input_length-1)==STRING.CUT("&clk", 1))
    ( 
      &match=1
    )
  )
  else if (&wild_tail==1)
  (
    if (STRING.MID("gcc_rpm_timer_clk", 0, &clk_input_length-1)==STRING.CUT("&clk", -1))
    ( 
      &match=1
    )
  )
  else if ("gcc_rpm_timer_clk"=="&clk")
  (
    &match=1
  )
  
  if (&match==1)
  (
    &clk_test=&CLK_TEST_GCC_RPM_TIMER_CLK
    &clk_reg=&HWIO_GCC_RPM_TIMER_CBCR_ADDR
    &clk_reg_name="GCC_RPM_TIMER_CBCR"
    &clk_name="gcc_rpm_timer_clk"
    &clk_reg_cbcr_type="sm_cbc"
    &clk_vote_bit=-1.
    &clk_multiplier=4.
    &clk_access_mode="&GCC_access_mode"

    gosub Print_Clk_Info_Line
  )

  &match=0
  &wild_head=0
  &wild_tail=0
  &clk_input_length=STRING.LENGTH("&clk")
  &clk_itr_length=STRING.LENGTH("gcc_spdm_ff_clk")

  if (STRING.SCAN("&clk", "*", 0)==0)
  (
    &wild_head=1
  )
  if (STRING.SCAN("&clk", "*", 1)==(STRING.LENGTH("&clk")-1))
  (
    &wild_tail=1
  )

  if ((&wild_head==1)&&(&wild_tail==1))
  (
    if (STRING.SCAN("gcc_spdm_ff_clk", STRING.MID("&clk", 1, &clk_input_length-2), 0)!=-1)
    ( 
      &match=1
    )
  )
  else if (&wild_head==1)
  (
    if (STRING.MID("gcc_spdm_ff_clk", &clk_itr_length-&clk_input_length+1, &clk_input_length-1)==STRING.CUT("&clk", 1))
    ( 
      &match=1
    )
  )
  else if (&wild_tail==1)
  (
    if (STRING.MID("gcc_spdm_ff_clk", 0, &clk_input_length-1)==STRING.CUT("&clk", -1))
    ( 
      &match=1
    )
  )
  else if ("gcc_spdm_ff_clk"=="&clk")
  (
    &match=1
  )
  
  if (&match==1)
  (
    &clk_test=&CLK_TEST_GCC_SPDM_FF_CLK
    &clk_reg=&HWIO_GCC_SPDM_FF_CBCR_ADDR
    &clk_reg_name="GCC_SPDM_FF_CBCR"
    &clk_name="gcc_spdm_ff_clk"
    &clk_reg_cbcr_type="sm_cbc"
    &clk_vote_bit=-1.
    &clk_multiplier=4.
    &clk_access_mode="&GCC_access_mode"

    gosub Print_Clk_Info_Line
  )

  &match=0
  &wild_head=0
  &wild_tail=0
  &clk_input_length=STRING.LENGTH("&clk")
  &clk_itr_length=STRING.LENGTH("gcc_sram_sensor_xo_clk")

  if (STRING.SCAN("&clk", "*", 0)==0)
  (
    &wild_head=1
  )
  if (STRING.SCAN("&clk", "*", 1)==(STRING.LENGTH("&clk")-1))
  (
    &wild_tail=1
  )

  if ((&wild_head==1)&&(&wild_tail==1))
  (
    if (STRING.SCAN("gcc_sram_sensor_xo_clk", STRING.MID("&clk", 1, &clk_input_length-2), 0)!=-1)
    ( 
      &match=1
    )
  )
  else if (&wild_head==1)
  (
    if (STRING.MID("gcc_sram_sensor_xo_clk", &clk_itr_length-&clk_input_length+1, &clk_input_length-1)==STRING.CUT("&clk", 1))
    ( 
      &match=1
    )
  )
  else if (&wild_tail==1)
  (
    if (STRING.MID("gcc_sram_sensor_xo_clk", 0, &clk_input_length-1)==STRING.CUT("&clk", -1))
    ( 
      &match=1
    )
  )
  else if ("gcc_sram_sensor_xo_clk"=="&clk")
  (
    &match=1
  )
  
  if (&match==1)
  (
    &clk_test=&CLK_TEST_GCC_SRAM_SENSOR_XO_CLK
    &clk_reg=&HWIO_GCC_SRAM_SENSOR_XO_CBCR_ADDR
    &clk_reg_name="GCC_SRAM_SENSOR_XO_CBCR"
    &clk_name="gcc_sram_sensor_xo_clk"
    &clk_reg_cbcr_type="sm_pscbc"
    &clk_vote_bit=-1.
    &clk_multiplier=4.
    &clk_access_mode="&GCC_access_mode"

    gosub Print_Clk_Info_Line
  )

  &match=0
  &wild_head=0
  &wild_tail=0
  &clk_input_length=STRING.LENGTH("&clk")
  &clk_itr_length=STRING.LENGTH("gcc_sys_noc_dcd_xo_clk")

  if (STRING.SCAN("&clk", "*", 0)==0)
  (
    &wild_head=1
  )
  if (STRING.SCAN("&clk", "*", 1)==(STRING.LENGTH("&clk")-1))
  (
    &wild_tail=1
  )

  if ((&wild_head==1)&&(&wild_tail==1))
  (
    if (STRING.SCAN("gcc_sys_noc_dcd_xo_clk", STRING.MID("&clk", 1, &clk_input_length-2), 0)!=-1)
    ( 
      &match=1
    )
  )
  else if (&wild_head==1)
  (
    if (STRING.MID("gcc_sys_noc_dcd_xo_clk", &clk_itr_length-&clk_input_length+1, &clk_input_length-1)==STRING.CUT("&clk", 1))
    ( 
      &match=1
    )
  )
  else if (&wild_tail==1)
  (
    if (STRING.MID("gcc_sys_noc_dcd_xo_clk", 0, &clk_input_length-1)==STRING.CUT("&clk", -1))
    ( 
      &match=1
    )
  )
  else if ("gcc_sys_noc_dcd_xo_clk"=="&clk")
  (
    &match=1
  )
  
  if (&match==1)
  (
    &clk_test=&CLK_TEST_GCC_SYS_NOC_DCD_XO_CLK
    &clk_reg=&HWIO_GCC_SYS_NOC_DCD_XO_CBCR_ADDR
    &clk_reg_name="GCC_SYS_NOC_DCD_XO_CBCR"
    &clk_name="gcc_sys_noc_dcd_xo_clk"
    &clk_reg_cbcr_type="sm_cbc"
    &clk_vote_bit=-1.
    &clk_multiplier=4.
    &clk_access_mode="&GCC_access_mode"

    gosub Print_Clk_Info_Line
  )

  &match=0
  &wild_head=0
  &wild_tail=0
  &clk_input_length=STRING.LENGTH("&clk")
  &clk_itr_length=STRING.LENGTH("gcc_xo_clk")

  if (STRING.SCAN("&clk", "*", 0)==0)
  (
    &wild_head=1
  )
  if (STRING.SCAN("&clk", "*", 1)==(STRING.LENGTH("&clk")-1))
  (
    &wild_tail=1
  )

  if ((&wild_head==1)&&(&wild_tail==1))
  (
    if (STRING.SCAN("gcc_xo_clk", STRING.MID("&clk", 1, &clk_input_length-2), 0)!=-1)
    ( 
      &match=1
    )
  )
  else if (&wild_head==1)
  (
    if (STRING.MID("gcc_xo_clk", &clk_itr_length-&clk_input_length+1, &clk_input_length-1)==STRING.CUT("&clk", 1))
    ( 
      &match=1
    )
  )
  else if (&wild_tail==1)
  (
    if (STRING.MID("gcc_xo_clk", 0, &clk_input_length-1)==STRING.CUT("&clk", -1))
    ( 
      &match=1
    )
  )
  else if ("gcc_xo_clk"=="&clk")
  (
    &match=1
  )
  
  if (&match==1)
  (
    &clk_test=&CLK_TEST_GCC_XO_CLK
    &clk_reg=&HWIO_GCC_GCC_XO_CBCR_ADDR
    &clk_reg_name="GCC_GCC_XO_CBCR"
    &clk_name="gcc_xo_clk"
    &clk_reg_cbcr_type="sm_cbc"
    &clk_vote_bit=-1.
    &clk_multiplier=4.
    &clk_access_mode="&GCC_access_mode"

    gosub Print_Clk_Info_Line
  )

  &match=0
  &wild_head=0
  &wild_tail=0
  &clk_input_length=STRING.LENGTH("&clk")
  &clk_itr_length=STRING.LENGTH("gcc_xo_div4_clk")

  if (STRING.SCAN("&clk", "*", 0)==0)
  (
    &wild_head=1
  )
  if (STRING.SCAN("&clk", "*", 1)==(STRING.LENGTH("&clk")-1))
  (
    &wild_tail=1
  )

  if ((&wild_head==1)&&(&wild_tail==1))
  (
    if (STRING.SCAN("gcc_xo_div4_clk", STRING.MID("&clk", 1, &clk_input_length-2), 0)!=-1)
    ( 
      &match=1
    )
  )
  else if (&wild_head==1)
  (
    if (STRING.MID("gcc_xo_div4_clk", &clk_itr_length-&clk_input_length+1, &clk_input_length-1)==STRING.CUT("&clk", 1))
    ( 
      &match=1
    )
  )
  else if (&wild_tail==1)
  (
    if (STRING.MID("gcc_xo_div4_clk", 0, &clk_input_length-1)==STRING.CUT("&clk", -1))
    ( 
      &match=1
    )
  )
  else if ("gcc_xo_div4_clk"=="&clk")
  (
    &match=1
  )
  
  if (&match==1)
  (
    &clk_test=&CLK_TEST_GCC_XO_DIV4_CLK
    &clk_reg=&HWIO_GCC_GCC_XO_DIV4_CBCR_ADDR
    &clk_reg_name="GCC_GCC_XO_DIV4_CBCR"
    &clk_name="gcc_xo_div4_clk"
    &clk_reg_cbcr_type="sm_cbc"
    &clk_vote_bit=-1.
    &clk_multiplier=4.
    &clk_access_mode="&GCC_access_mode"

    gosub Print_Clk_Info_Line
  )

  &match=0
  &wild_head=0
  &wild_tail=0
  &clk_input_length=STRING.LENGTH("&clk")
  &clk_itr_length=STRING.LENGTH("gcc_glm_clk")

  if (STRING.SCAN("&clk", "*", 0)==0)
  (
    &wild_head=1
  )
  if (STRING.SCAN("&clk", "*", 1)==(STRING.LENGTH("&clk")-1))
  (
    &wild_tail=1
  )

  if ((&wild_head==1)&&(&wild_tail==1))
  (
    if (STRING.SCAN("gcc_glm_clk", STRING.MID("&clk", 1, &clk_input_length-2), 0)!=-1)
    ( 
      &match=1
    )
  )
  else if (&wild_head==1)
  (
    if (STRING.MID("gcc_glm_clk", &clk_itr_length-&clk_input_length+1, &clk_input_length-1)==STRING.CUT("&clk", 1))
    ( 
      &match=1
    )
  )
  else if (&wild_tail==1)
  (
    if (STRING.MID("gcc_glm_clk", 0, &clk_input_length-1)==STRING.CUT("&clk", -1))
    ( 
      &match=1
    )
  )
  else if ("gcc_glm_clk"=="&clk")
  (
    &match=1
  )
  
  if (&match==1)
  (
    &clk_test=&CLK_TEST_GCC_GLM_CLK
    &clk_reg=&HWIO_GCC_GLM_CBCR_ADDR
    &clk_reg_name="GCC_GLM_CBCR"
    &clk_name="gcc_glm_clk"
    &clk_reg_cbcr_type="sm_cbc"
    &clk_vote_bit=-1.
    &clk_multiplier=4.
    &clk_access_mode="&GCC_access_mode"

    gosub Print_Clk_Info_Line
  )

  &match=0
  &wild_head=0
  &wild_tail=0
  &clk_input_length=STRING.LENGTH("&clk")
  &clk_itr_length=STRING.LENGTH("gcc_gp1_clk")

  if (STRING.SCAN("&clk", "*", 0)==0)
  (
    &wild_head=1
  )
  if (STRING.SCAN("&clk", "*", 1)==(STRING.LENGTH("&clk")-1))
  (
    &wild_tail=1
  )

  if ((&wild_head==1)&&(&wild_tail==1))
  (
    if (STRING.SCAN("gcc_gp1_clk", STRING.MID("&clk", 1, &clk_input_length-2), 0)!=-1)
    ( 
      &match=1
    )
  )
  else if (&wild_head==1)
  (
    if (STRING.MID("gcc_gp1_clk", &clk_itr_length-&clk_input_length+1, &clk_input_length-1)==STRING.CUT("&clk", 1))
    ( 
      &match=1
    )
  )
  else if (&wild_tail==1)
  (
    if (STRING.MID("gcc_gp1_clk", 0, &clk_input_length-1)==STRING.CUT("&clk", -1))
    ( 
      &match=1
    )
  )
  else if ("gcc_gp1_clk"=="&clk")
  (
    &match=1
  )
  
  if (&match==1)
  (
    &clk_test=&CLK_TEST_GCC_GP1_CLK
    &clk_reg=&HWIO_GCC_GP1_CBCR_ADDR
    &clk_reg_name="GCC_GP1_CBCR"
    &clk_name="gcc_gp1_clk"
    &clk_reg_cbcr_type="sm_cbc"
    &clk_vote_bit=-1.
    &clk_multiplier=4.
    &clk_access_mode="&GCC_access_mode"

    gosub Print_Clk_Info_Line
  )

  &match=0
  &wild_head=0
  &wild_tail=0
  &clk_input_length=STRING.LENGTH("&clk")
  &clk_itr_length=STRING.LENGTH("gcc_gp2_clk")

  if (STRING.SCAN("&clk", "*", 0)==0)
  (
    &wild_head=1
  )
  if (STRING.SCAN("&clk", "*", 1)==(STRING.LENGTH("&clk")-1))
  (
    &wild_tail=1
  )

  if ((&wild_head==1)&&(&wild_tail==1))
  (
    if (STRING.SCAN("gcc_gp2_clk", STRING.MID("&clk", 1, &clk_input_length-2), 0)!=-1)
    ( 
      &match=1
    )
  )
  else if (&wild_head==1)
  (
    if (STRING.MID("gcc_gp2_clk", &clk_itr_length-&clk_input_length+1, &clk_input_length-1)==STRING.CUT("&clk", 1))
    ( 
      &match=1
    )
  )
  else if (&wild_tail==1)
  (
    if (STRING.MID("gcc_gp2_clk", 0, &clk_input_length-1)==STRING.CUT("&clk", -1))
    ( 
      &match=1
    )
  )
  else if ("gcc_gp2_clk"=="&clk")
  (
    &match=1
  )
  
  if (&match==1)
  (
    &clk_test=&CLK_TEST_GCC_GP2_CLK
    &clk_reg=&HWIO_GCC_GP2_CBCR_ADDR
    &clk_reg_name="GCC_GP2_CBCR"
    &clk_name="gcc_gp2_clk"
    &clk_reg_cbcr_type="sm_cbc"
    &clk_vote_bit=-1.
    &clk_multiplier=4.
    &clk_access_mode="&GCC_access_mode"

    gosub Print_Clk_Info_Line
  )

  &match=0
  &wild_head=0
  &wild_tail=0
  &clk_input_length=STRING.LENGTH("&clk")
  &clk_itr_length=STRING.LENGTH("gcc_gp3_clk")

  if (STRING.SCAN("&clk", "*", 0)==0)
  (
    &wild_head=1
  )
  if (STRING.SCAN("&clk", "*", 1)==(STRING.LENGTH("&clk")-1))
  (
    &wild_tail=1
  )

  if ((&wild_head==1)&&(&wild_tail==1))
  (
    if (STRING.SCAN("gcc_gp3_clk", STRING.MID("&clk", 1, &clk_input_length-2), 0)!=-1)
    ( 
      &match=1
    )
  )
  else if (&wild_head==1)
  (
    if (STRING.MID("gcc_gp3_clk", &clk_itr_length-&clk_input_length+1, &clk_input_length-1)==STRING.CUT("&clk", 1))
    ( 
      &match=1
    )
  )
  else if (&wild_tail==1)
  (
    if (STRING.MID("gcc_gp3_clk", 0, &clk_input_length-1)==STRING.CUT("&clk", -1))
    ( 
      &match=1
    )
  )
  else if ("gcc_gp3_clk"=="&clk")
  (
    &match=1
  )
  
  if (&match==1)
  (
    &clk_test=&CLK_TEST_GCC_GP3_CLK
    &clk_reg=&HWIO_GCC_GP3_CBCR_ADDR
    &clk_reg_name="GCC_GP3_CBCR"
    &clk_name="gcc_gp3_clk"
    &clk_reg_cbcr_type="sm_cbc"
    &clk_vote_bit=-1.
    &clk_multiplier=4.
    &clk_access_mode="&GCC_access_mode"

    gosub Print_Clk_Info_Line
  )

  &match=0
  &wild_head=0
  &wild_tail=0
  &clk_input_length=STRING.LENGTH("&clk")
  &clk_itr_length=STRING.LENGTH("gcc_bimc_gfx_clk")

  if (STRING.SCAN("&clk", "*", 0)==0)
  (
    &wild_head=1
  )
  if (STRING.SCAN("&clk", "*", 1)==(STRING.LENGTH("&clk")-1))
  (
    &wild_tail=1
  )

  if ((&wild_head==1)&&(&wild_tail==1))
  (
    if (STRING.SCAN("gcc_bimc_gfx_clk", STRING.MID("&clk", 1, &clk_input_length-2), 0)!=-1)
    ( 
      &match=1
    )
  )
  else if (&wild_head==1)
  (
    if (STRING.MID("gcc_bimc_gfx_clk", &clk_itr_length-&clk_input_length+1, &clk_input_length-1)==STRING.CUT("&clk", 1))
    ( 
      &match=1
    )
  )
  else if (&wild_tail==1)
  (
    if (STRING.MID("gcc_bimc_gfx_clk", 0, &clk_input_length-1)==STRING.CUT("&clk", -1))
    ( 
      &match=1
    )
  )
  else if ("gcc_bimc_gfx_clk"=="&clk")
  (
    &match=1
  )
  
  if (&match==1)
  (
    &clk_test=&CLK_TEST_GCC_BIMC_GFX_CLK
    &clk_reg=&HWIO_GCC_BIMC_GFX_CBCR_ADDR
    &clk_reg_name="GCC_BIMC_GFX_CBCR"
    &clk_name="gcc_bimc_gfx_clk"
    &clk_reg_cbcr_type="sm_cbc"
    &clk_vote_bit=-1.
    &clk_multiplier=4.
    &clk_access_mode="&GCC_access_mode"

    gosub Print_Clk_Info_Line
  )

  &match=0
  &wild_head=0
  &wild_tail=0
  &clk_input_length=STRING.LENGTH("&clk")
  &clk_itr_length=STRING.LENGTH("gcc_gpu_bimc_gfx_clk")

  if (STRING.SCAN("&clk", "*", 0)==0)
  (
    &wild_head=1
  )
  if (STRING.SCAN("&clk", "*", 1)==(STRING.LENGTH("&clk")-1))
  (
    &wild_tail=1
  )

  if ((&wild_head==1)&&(&wild_tail==1))
  (
    if (STRING.SCAN("gcc_gpu_bimc_gfx_clk", STRING.MID("&clk", 1, &clk_input_length-2), 0)!=-1)
    ( 
      &match=1
    )
  )
  else if (&wild_head==1)
  (
    if (STRING.MID("gcc_gpu_bimc_gfx_clk", &clk_itr_length-&clk_input_length+1, &clk_input_length-1)==STRING.CUT("&clk", 1))
    ( 
      &match=1
    )
  )
  else if (&wild_tail==1)
  (
    if (STRING.MID("gcc_gpu_bimc_gfx_clk", 0, &clk_input_length-1)==STRING.CUT("&clk", -1))
    ( 
      &match=1
    )
  )
  else if ("gcc_gpu_bimc_gfx_clk"=="&clk")
  (
    &match=1
  )
  
  if (&match==1)
  (
    &clk_test=&CLK_TEST_GCC_GPU_BIMC_GFX_CLK
    &clk_reg=&HWIO_GCC_GPU_BIMC_GFX_CBCR_ADDR
    &clk_reg_name="GCC_GPU_BIMC_GFX_CBCR"
    &clk_name="gcc_gpu_bimc_gfx_clk"
    &clk_reg_cbcr_type="sm_cbc"
    &clk_vote_bit=-1.
    &clk_multiplier=4.
    &clk_access_mode="&GCC_access_mode"

    gosub Print_Clk_Info_Line
  )

  &match=0
  &wild_head=0
  &wild_tail=0
  &clk_input_length=STRING.LENGTH("&clk")
  &clk_itr_length=STRING.LENGTH("gcc_gpu_bimc_gfx_src_clk")

  if (STRING.SCAN("&clk", "*", 0)==0)
  (
    &wild_head=1
  )
  if (STRING.SCAN("&clk", "*", 1)==(STRING.LENGTH("&clk")-1))
  (
    &wild_tail=1
  )

  if ((&wild_head==1)&&(&wild_tail==1))
  (
    if (STRING.SCAN("gcc_gpu_bimc_gfx_src_clk", STRING.MID("&clk", 1, &clk_input_length-2), 0)!=-1)
    ( 
      &match=1
    )
  )
  else if (&wild_head==1)
  (
    if (STRING.MID("gcc_gpu_bimc_gfx_src_clk", &clk_itr_length-&clk_input_length+1, &clk_input_length-1)==STRING.CUT("&clk", 1))
    ( 
      &match=1
    )
  )
  else if (&wild_tail==1)
  (
    if (STRING.MID("gcc_gpu_bimc_gfx_src_clk", 0, &clk_input_length-1)==STRING.CUT("&clk", -1))
    ( 
      &match=1
    )
  )
  else if ("gcc_gpu_bimc_gfx_src_clk"=="&clk")
  (
    &match=1
  )
  
  if (&match==1)
  (
    &clk_test=&CLK_TEST_GCC_GPU_BIMC_GFX_SRC_CLK
    &clk_reg=&HWIO_GCC_GPU_BIMC_GFX_SRC_CBCR_ADDR
    &clk_reg_name="GCC_GPU_BIMC_GFX_SRC_CBCR"
    &clk_name="gcc_gpu_bimc_gfx_src_clk"
    &clk_reg_cbcr_type="sm_pscbc"
    &clk_vote_bit=-1.
    &clk_multiplier=4.
    &clk_access_mode="&GCC_access_mode"

    gosub Print_Clk_Info_Line
  )

  &match=0
  &wild_head=0
  &wild_tail=0
  &clk_input_length=STRING.LENGTH("&clk")
  &clk_itr_length=STRING.LENGTH("gcc_gpu_snoc_dvm_gfx_clk")

  if (STRING.SCAN("&clk", "*", 0)==0)
  (
    &wild_head=1
  )
  if (STRING.SCAN("&clk", "*", 1)==(STRING.LENGTH("&clk")-1))
  (
    &wild_tail=1
  )

  if ((&wild_head==1)&&(&wild_tail==1))
  (
    if (STRING.SCAN("gcc_gpu_snoc_dvm_gfx_clk", STRING.MID("&clk", 1, &clk_input_length-2), 0)!=-1)
    ( 
      &match=1
    )
  )
  else if (&wild_head==1)
  (
    if (STRING.MID("gcc_gpu_snoc_dvm_gfx_clk", &clk_itr_length-&clk_input_length+1, &clk_input_length-1)==STRING.CUT("&clk", 1))
    ( 
      &match=1
    )
  )
  else if (&wild_tail==1)
  (
    if (STRING.MID("gcc_gpu_snoc_dvm_gfx_clk", 0, &clk_input_length-1)==STRING.CUT("&clk", -1))
    ( 
      &match=1
    )
  )
  else if ("gcc_gpu_snoc_dvm_gfx_clk"=="&clk")
  (
    &match=1
  )
  
  if (&match==1)
  (
    &clk_test=&CLK_TEST_GCC_GPU_SNOC_DVM_GFX_CLK
    &clk_reg=&HWIO_GCC_GPU_SNOC_DVM_GFX_CBCR_ADDR
    &clk_reg_name="GCC_GPU_SNOC_DVM_GFX_CBCR"
    &clk_name="gcc_gpu_snoc_dvm_gfx_clk"
    &clk_reg_cbcr_type="sm_cbc"
    &clk_vote_bit=-1.
    &clk_multiplier=4.
    &clk_access_mode="&GCC_access_mode"

    gosub Print_Clk_Info_Line
  )

  &match=0
  &wild_head=0
  &wild_tail=0
  &clk_input_length=STRING.LENGTH("&clk")
  &clk_itr_length=STRING.LENGTH("gcc_hmss_ahb_clk")

  if (STRING.SCAN("&clk", "*", 0)==0)
  (
    &wild_head=1
  )
  if (STRING.SCAN("&clk", "*", 1)==(STRING.LENGTH("&clk")-1))
  (
    &wild_tail=1
  )

  if ((&wild_head==1)&&(&wild_tail==1))
  (
    if (STRING.SCAN("gcc_hmss_ahb_clk", STRING.MID("&clk", 1, &clk_input_length-2), 0)!=-1)
    ( 
      &match=1
    )
  )
  else if (&wild_head==1)
  (
    if (STRING.MID("gcc_hmss_ahb_clk", &clk_itr_length-&clk_input_length+1, &clk_input_length-1)==STRING.CUT("&clk", 1))
    ( 
      &match=1
    )
  )
  else if (&wild_tail==1)
  (
    if (STRING.MID("gcc_hmss_ahb_clk", 0, &clk_input_length-1)==STRING.CUT("&clk", -1))
    ( 
      &match=1
    )
  )
  else if ("gcc_hmss_ahb_clk"=="&clk")
  (
    &match=1
  )
  
  if (&match==1)
  (
    &clk_test=&CLK_TEST_GCC_HMSS_AHB_CLK
    &clk_reg=&HWIO_GCC_HMSS_AHB_CBCR_ADDR
    &clk_reg_name="GCC_HMSS_AHB_CBCR"
    &clk_name="gcc_hmss_ahb_clk"
    &clk_reg_cbcr_type="sm_cbc"
    &clk_vote_bit=21.
    &clk_multiplier=4.
    &clk_access_mode="&GCC_access_mode"

    gosub Print_Clk_Info_Line
  )

  &match=0
  &wild_head=0
  &wild_tail=0
  &clk_input_length=STRING.LENGTH("&clk")
  &clk_itr_length=STRING.LENGTH("gcc_sys_noc_hmss_ahb_clk")

  if (STRING.SCAN("&clk", "*", 0)==0)
  (
    &wild_head=1
  )
  if (STRING.SCAN("&clk", "*", 1)==(STRING.LENGTH("&clk")-1))
  (
    &wild_tail=1
  )

  if ((&wild_head==1)&&(&wild_tail==1))
  (
    if (STRING.SCAN("gcc_sys_noc_hmss_ahb_clk", STRING.MID("&clk", 1, &clk_input_length-2), 0)!=-1)
    ( 
      &match=1
    )
  )
  else if (&wild_head==1)
  (
    if (STRING.MID("gcc_sys_noc_hmss_ahb_clk", &clk_itr_length-&clk_input_length+1, &clk_input_length-1)==STRING.CUT("&clk", 1))
    ( 
      &match=1
    )
  )
  else if (&wild_tail==1)
  (
    if (STRING.MID("gcc_sys_noc_hmss_ahb_clk", 0, &clk_input_length-1)==STRING.CUT("&clk", -1))
    ( 
      &match=1
    )
  )
  else if ("gcc_sys_noc_hmss_ahb_clk"=="&clk")
  (
    &match=1
  )
  
  if (&match==1)
  (
    &clk_test=&CLK_TEST_GCC_SYS_NOC_HMSS_AHB_CLK
    &clk_reg=&HWIO_GCC_SYS_NOC_HMSS_AHB_CBCR_ADDR
    &clk_reg_name="GCC_SYS_NOC_HMSS_AHB_CBCR"
    &clk_name="gcc_sys_noc_hmss_ahb_clk"
    &clk_reg_cbcr_type="sm_cbc"
    &clk_vote_bit=23.
    &clk_multiplier=4.
    &clk_access_mode="&GCC_access_mode"

    gosub Print_Clk_Info_Line
  )

  &match=0
  &wild_head=0
  &wild_tail=0
  &clk_input_length=STRING.LENGTH("&clk")
  &clk_itr_length=STRING.LENGTH("gcc_hmss_rbcpr_clk")

  if (STRING.SCAN("&clk", "*", 0)==0)
  (
    &wild_head=1
  )
  if (STRING.SCAN("&clk", "*", 1)==(STRING.LENGTH("&clk")-1))
  (
    &wild_tail=1
  )

  if ((&wild_head==1)&&(&wild_tail==1))
  (
    if (STRING.SCAN("gcc_hmss_rbcpr_clk", STRING.MID("&clk", 1, &clk_input_length-2), 0)!=-1)
    ( 
      &match=1
    )
  )
  else if (&wild_head==1)
  (
    if (STRING.MID("gcc_hmss_rbcpr_clk", &clk_itr_length-&clk_input_length+1, &clk_input_length-1)==STRING.CUT("&clk", 1))
    ( 
      &match=1
    )
  )
  else if (&wild_tail==1)
  (
    if (STRING.MID("gcc_hmss_rbcpr_clk", 0, &clk_input_length-1)==STRING.CUT("&clk", -1))
    ( 
      &match=1
    )
  )
  else if ("gcc_hmss_rbcpr_clk"=="&clk")
  (
    &match=1
  )
  
  if (&match==1)
  (
    &clk_test=&CLK_TEST_GCC_HMSS_RBCPR_CLK
    &clk_reg=&HWIO_GCC_HMSS_RBCPR_CBCR_ADDR
    &clk_reg_name="GCC_HMSS_RBCPR_CBCR"
    &clk_name="gcc_hmss_rbcpr_clk"
    &clk_reg_cbcr_type="sm_cbc"
    &clk_vote_bit=-1.
    &clk_multiplier=4.
    &clk_access_mode="&GCC_access_mode"

    gosub Print_Clk_Info_Line
  )

  &match=0
  &wild_head=0
  &wild_tail=0
  &clk_input_length=STRING.LENGTH("&clk")
  &clk_itr_length=STRING.LENGTH("gcc_aggre2_noc_ipa_clk")

  if (STRING.SCAN("&clk", "*", 0)==0)
  (
    &wild_head=1
  )
  if (STRING.SCAN("&clk", "*", 1)==(STRING.LENGTH("&clk")-1))
  (
    &wild_tail=1
  )

  if ((&wild_head==1)&&(&wild_tail==1))
  (
    if (STRING.SCAN("gcc_aggre2_noc_ipa_clk", STRING.MID("&clk", 1, &clk_input_length-2), 0)!=-1)
    ( 
      &match=1
    )
  )
  else if (&wild_head==1)
  (
    if (STRING.MID("gcc_aggre2_noc_ipa_clk", &clk_itr_length-&clk_input_length+1, &clk_input_length-1)==STRING.CUT("&clk", 1))
    ( 
      &match=1
    )
  )
  else if (&wild_tail==1)
  (
    if (STRING.MID("gcc_aggre2_noc_ipa_clk", 0, &clk_input_length-1)==STRING.CUT("&clk", -1))
    ( 
      &match=1
    )
  )
  else if ("gcc_aggre2_noc_ipa_clk"=="&clk")
  (
    &match=1
  )
  
  if (&match==1)
  (
    &clk_test=&CLK_TEST_GCC_AGGRE2_NOC_IPA_CLK
    &clk_reg=&HWIO_GCC_AGGRE2_NOC_IPA_CBCR_ADDR
    &clk_reg_name="GCC_AGGRE2_NOC_IPA_CBCR"
    &clk_name="gcc_aggre2_noc_ipa_clk"
    &clk_reg_cbcr_type="sm_cbc"
    &clk_vote_bit=-1.
    &clk_multiplier=4.
    &clk_access_mode="&GCC_access_mode"

    gosub Print_Clk_Info_Line
  )

  &match=0
  &wild_head=0
  &wild_tail=0
  &clk_input_length=STRING.LENGTH("&clk")
  &clk_itr_length=STRING.LENGTH("gcc_ipa_2x_clk")

  if (STRING.SCAN("&clk", "*", 0)==0)
  (
    &wild_head=1
  )
  if (STRING.SCAN("&clk", "*", 1)==(STRING.LENGTH("&clk")-1))
  (
    &wild_tail=1
  )

  if ((&wild_head==1)&&(&wild_tail==1))
  (
    if (STRING.SCAN("gcc_ipa_2x_clk", STRING.MID("&clk", 1, &clk_input_length-2), 0)!=-1)
    ( 
      &match=1
    )
  )
  else if (&wild_head==1)
  (
    if (STRING.MID("gcc_ipa_2x_clk", &clk_itr_length-&clk_input_length+1, &clk_input_length-1)==STRING.CUT("&clk", 1))
    ( 
      &match=1
    )
  )
  else if (&wild_tail==1)
  (
    if (STRING.MID("gcc_ipa_2x_clk", 0, &clk_input_length-1)==STRING.CUT("&clk", -1))
    ( 
      &match=1
    )
  )
  else if ("gcc_ipa_2x_clk"=="&clk")
  (
    &match=1
  )
  
  if (&match==1)
  (
    &clk_test=&CLK_TEST_GCC_IPA_2X_CLK
    &clk_reg=&HWIO_GCC_IPA_2X_CBCR_ADDR
    &clk_reg_name="GCC_IPA_2X_CBCR"
    &clk_name="gcc_ipa_2x_clk"
    &clk_reg_cbcr_type="sm_pscbc"
    &clk_vote_bit=-1.
    &clk_multiplier=4.
    &clk_access_mode="&GCC_access_mode"

    gosub Print_Clk_Info_Line
  )

  &match=0
  &wild_head=0
  &wild_tail=0
  &clk_input_length=STRING.LENGTH("&clk")
  &clk_itr_length=STRING.LENGTH("gcc_ipa_clk")

  if (STRING.SCAN("&clk", "*", 0)==0)
  (
    &wild_head=1
  )
  if (STRING.SCAN("&clk", "*", 1)==(STRING.LENGTH("&clk")-1))
  (
    &wild_tail=1
  )

  if ((&wild_head==1)&&(&wild_tail==1))
  (
    if (STRING.SCAN("gcc_ipa_clk", STRING.MID("&clk", 1, &clk_input_length-2), 0)!=-1)
    ( 
      &match=1
    )
  )
  else if (&wild_head==1)
  (
    if (STRING.MID("gcc_ipa_clk", &clk_itr_length-&clk_input_length+1, &clk_input_length-1)==STRING.CUT("&clk", 1))
    ( 
      &match=1
    )
  )
  else if (&wild_tail==1)
  (
    if (STRING.MID("gcc_ipa_clk", 0, &clk_input_length-1)==STRING.CUT("&clk", -1))
    ( 
      &match=1
    )
  )
  else if ("gcc_ipa_clk"=="&clk")
  (
    &match=1
  )
  
  if (&match==1)
  (
    &clk_test=&CLK_TEST_GCC_IPA_CLK
    &clk_reg=&HWIO_GCC_IPA_CBCR_ADDR
    &clk_reg_name="GCC_IPA_CBCR"
    &clk_name="gcc_ipa_clk"
    &clk_reg_cbcr_type="sm_pscbc"
    &clk_vote_bit=-1.
    &clk_multiplier=4.
    &clk_access_mode="&GCC_access_mode"

    gosub Print_Clk_Info_Line
  )

  &match=0
  &wild_head=0
  &wild_tail=0
  &clk_input_length=STRING.LENGTH("&clk")
  &clk_itr_length=STRING.LENGTH("gcc_mmss_qm_core_clk")

  if (STRING.SCAN("&clk", "*", 0)==0)
  (
    &wild_head=1
  )
  if (STRING.SCAN("&clk", "*", 1)==(STRING.LENGTH("&clk")-1))
  (
    &wild_tail=1
  )

  if ((&wild_head==1)&&(&wild_tail==1))
  (
    if (STRING.SCAN("gcc_mmss_qm_core_clk", STRING.MID("&clk", 1, &clk_input_length-2), 0)!=-1)
    ( 
      &match=1
    )
  )
  else if (&wild_head==1)
  (
    if (STRING.MID("gcc_mmss_qm_core_clk", &clk_itr_length-&clk_input_length+1, &clk_input_length-1)==STRING.CUT("&clk", 1))
    ( 
      &match=1
    )
  )
  else if (&wild_tail==1)
  (
    if (STRING.MID("gcc_mmss_qm_core_clk", 0, &clk_input_length-1)==STRING.CUT("&clk", -1))
    ( 
      &match=1
    )
  )
  else if ("gcc_mmss_qm_core_clk"=="&clk")
  (
    &match=1
  )
  
  if (&match==1)
  (
    &clk_test=&CLK_TEST_GCC_MMSS_QM_CORE_CLK
    &clk_reg=&HWIO_GCC_MMSS_QM_CORE_CBCR_ADDR
    &clk_reg_name="GCC_MMSS_QM_CORE_CBCR"
    &clk_name="gcc_mmss_qm_core_clk"
    &clk_reg_cbcr_type="sm_cbc"
    &clk_vote_bit=-1.
    &clk_multiplier=4.
    &clk_access_mode="&GCC_access_mode"

    gosub Print_Clk_Info_Line
  )

  &match=0
  &wild_head=0
  &wild_tail=0
  &clk_input_length=STRING.LENGTH("&clk")
  &clk_itr_length=STRING.LENGTH("gcc_bimc_mss_q6_axi_clk")

  if (STRING.SCAN("&clk", "*", 0)==0)
  (
    &wild_head=1
  )
  if (STRING.SCAN("&clk", "*", 1)==(STRING.LENGTH("&clk")-1))
  (
    &wild_tail=1
  )

  if ((&wild_head==1)&&(&wild_tail==1))
  (
    if (STRING.SCAN("gcc_bimc_mss_q6_axi_clk", STRING.MID("&clk", 1, &clk_input_length-2), 0)!=-1)
    ( 
      &match=1
    )
  )
  else if (&wild_head==1)
  (
    if (STRING.MID("gcc_bimc_mss_q6_axi_clk", &clk_itr_length-&clk_input_length+1, &clk_input_length-1)==STRING.CUT("&clk", 1))
    ( 
      &match=1
    )
  )
  else if (&wild_tail==1)
  (
    if (STRING.MID("gcc_bimc_mss_q6_axi_clk", 0, &clk_input_length-1)==STRING.CUT("&clk", -1))
    ( 
      &match=1
    )
  )
  else if ("gcc_bimc_mss_q6_axi_clk"=="&clk")
  (
    &match=1
  )
  
  if (&match==1)
  (
    &clk_test=&CLK_TEST_GCC_BIMC_MSS_Q6_AXI_CLK
    &clk_reg=&HWIO_GCC_BIMC_MSS_Q6_AXI_CBCR_ADDR
    &clk_reg_name="GCC_BIMC_MSS_Q6_AXI_CBCR"
    &clk_name="gcc_bimc_mss_q6_axi_clk"
    &clk_reg_cbcr_type="sm_cbc"
    &clk_vote_bit=-1.
    &clk_multiplier=4.
    &clk_access_mode="&GCC_access_mode"

    gosub Print_Clk_Info_Line
  )

  &match=0
  &wild_head=0
  &wild_tail=0
  &clk_input_length=STRING.LENGTH("&clk")
  &clk_itr_length=STRING.LENGTH("gcc_mss_q6_bimc_axi_clk")

  if (STRING.SCAN("&clk", "*", 0)==0)
  (
    &wild_head=1
  )
  if (STRING.SCAN("&clk", "*", 1)==(STRING.LENGTH("&clk")-1))
  (
    &wild_tail=1
  )

  if ((&wild_head==1)&&(&wild_tail==1))
  (
    if (STRING.SCAN("gcc_mss_q6_bimc_axi_clk", STRING.MID("&clk", 1, &clk_input_length-2), 0)!=-1)
    ( 
      &match=1
    )
  )
  else if (&wild_head==1)
  (
    if (STRING.MID("gcc_mss_q6_bimc_axi_clk", &clk_itr_length-&clk_input_length+1, &clk_input_length-1)==STRING.CUT("&clk", 1))
    ( 
      &match=1
    )
  )
  else if (&wild_tail==1)
  (
    if (STRING.MID("gcc_mss_q6_bimc_axi_clk", 0, &clk_input_length-1)==STRING.CUT("&clk", -1))
    ( 
      &match=1
    )
  )
  else if ("gcc_mss_q6_bimc_axi_clk"=="&clk")
  (
    &match=1
  )
  
  if (&match==1)
  (
    &clk_test=&CLK_TEST_GCC_MSS_Q6_BIMC_AXI_CLK
    &clk_reg=&HWIO_GCC_MSS_Q6_BIMC_AXI_CBCR_ADDR
    &clk_reg_name="GCC_MSS_Q6_BIMC_AXI_CBCR"
    &clk_name="gcc_mss_q6_bimc_axi_clk"
    &clk_reg_cbcr_type="sm_cbc"
    &clk_vote_bit=-1.
    &clk_multiplier=4.
    &clk_access_mode="&GCC_access_mode"

    gosub Print_Clk_Info_Line
  )

  &match=0
  &wild_head=0
  &wild_tail=0
  &clk_input_length=STRING.LENGTH("&clk")
  &clk_itr_length=STRING.LENGTH("gcc_mss_q6_msmpu_client_axi_clk")

  if (STRING.SCAN("&clk", "*", 0)==0)
  (
    &wild_head=1
  )
  if (STRING.SCAN("&clk", "*", 1)==(STRING.LENGTH("&clk")-1))
  (
    &wild_tail=1
  )

  if ((&wild_head==1)&&(&wild_tail==1))
  (
    if (STRING.SCAN("gcc_mss_q6_msmpu_client_axi_clk", STRING.MID("&clk", 1, &clk_input_length-2), 0)!=-1)
    ( 
      &match=1
    )
  )
  else if (&wild_head==1)
  (
    if (STRING.MID("gcc_mss_q6_msmpu_client_axi_clk", &clk_itr_length-&clk_input_length+1, &clk_input_length-1)==STRING.CUT("&clk", 1))
    ( 
      &match=1
    )
  )
  else if (&wild_tail==1)
  (
    if (STRING.MID("gcc_mss_q6_msmpu_client_axi_clk", 0, &clk_input_length-1)==STRING.CUT("&clk", -1))
    ( 
      &match=1
    )
  )
  else if ("gcc_mss_q6_msmpu_client_axi_clk"=="&clk")
  (
    &match=1
  )
  
  if (&match==1)
  (
    &clk_test=&CLK_TEST_GCC_MSS_Q6_MSMPU_CLIENT_AXI_CLK
    &clk_reg=&HWIO_GCC_MSS_Q6_MSMPU_CLIENT_AXI_CBCR_ADDR
    &clk_reg_name="GCC_MSS_Q6_MSMPU_CLIENT_AXI_CBCR"
    &clk_name="gcc_mss_q6_msmpu_client_axi_clk"
    &clk_reg_cbcr_type="sm_cbc"
    &clk_vote_bit=-1.
    &clk_multiplier=4.
    &clk_access_mode="&GCC_access_mode"

    gosub Print_Clk_Info_Line
  )

  &match=0
  &wild_head=0
  &wild_tail=0
  &clk_input_length=STRING.LENGTH("&clk")
  &clk_itr_length=STRING.LENGTH("gcc_mss_vs_clk")

  if (STRING.SCAN("&clk", "*", 0)==0)
  (
    &wild_head=1
  )
  if (STRING.SCAN("&clk", "*", 1)==(STRING.LENGTH("&clk")-1))
  (
    &wild_tail=1
  )

  if ((&wild_head==1)&&(&wild_tail==1))
  (
    if (STRING.SCAN("gcc_mss_vs_clk", STRING.MID("&clk", 1, &clk_input_length-2), 0)!=-1)
    ( 
      &match=1
    )
  )
  else if (&wild_head==1)
  (
    if (STRING.MID("gcc_mss_vs_clk", &clk_itr_length-&clk_input_length+1, &clk_input_length-1)==STRING.CUT("&clk", 1))
    ( 
      &match=1
    )
  )
  else if (&wild_tail==1)
  (
    if (STRING.MID("gcc_mss_vs_clk", 0, &clk_input_length-1)==STRING.CUT("&clk", -1))
    ( 
      &match=1
    )
  )
  else if ("gcc_mss_vs_clk"=="&clk")
  (
    &match=1
  )
  
  if (&match==1)
  (
    &clk_test=&CLK_TEST_GCC_MSS_VS_CLK
    &clk_reg=&HWIO_GCC_MSS_VS_CBCR_ADDR
    &clk_reg_name="GCC_MSS_VS_CBCR"
    &clk_name="gcc_mss_vs_clk"
    &clk_reg_cbcr_type="sm_cbc"
    &clk_vote_bit=-1.
    &clk_multiplier=4.
    &clk_access_mode="&GCC_access_mode"

    gosub Print_Clk_Info_Line
  )

  &match=0
  &wild_head=0
  &wild_tail=0
  &clk_input_length=STRING.LENGTH("&clk")
  &clk_itr_length=STRING.LENGTH("gcc_obt_odt_clk")

  if (STRING.SCAN("&clk", "*", 0)==0)
  (
    &wild_head=1
  )
  if (STRING.SCAN("&clk", "*", 1)==(STRING.LENGTH("&clk")-1))
  (
    &wild_tail=1
  )

  if ((&wild_head==1)&&(&wild_tail==1))
  (
    if (STRING.SCAN("gcc_obt_odt_clk", STRING.MID("&clk", 1, &clk_input_length-2), 0)!=-1)
    ( 
      &match=1
    )
  )
  else if (&wild_head==1)
  (
    if (STRING.MID("gcc_obt_odt_clk", &clk_itr_length-&clk_input_length+1, &clk_input_length-1)==STRING.CUT("&clk", 1))
    ( 
      &match=1
    )
  )
  else if (&wild_tail==1)
  (
    if (STRING.MID("gcc_obt_odt_clk", 0, &clk_input_length-1)==STRING.CUT("&clk", -1))
    ( 
      &match=1
    )
  )
  else if ("gcc_obt_odt_clk"=="&clk")
  (
    &match=1
  )
  
  if (&match==1)
  (
    &clk_test=&CLK_TEST_GCC_OBT_ODT_CLK
    &clk_reg=&HWIO_GCC_OBT_ODT_CBCR_ADDR
    &clk_reg_name="GCC_OBT_ODT_CBCR"
    &clk_name="gcc_obt_odt_clk"
    &clk_reg_cbcr_type="sm_cbc"
    &clk_vote_bit=-1.
    &clk_multiplier=4.
    &clk_access_mode="&GCC_access_mode"

    gosub Print_Clk_Info_Line
  )

  &match=0
  &wild_head=0
  &wild_tail=0
  &clk_input_length=STRING.LENGTH("&clk")
  &clk_itr_length=STRING.LENGTH("gcc_pdm2_clk")

  if (STRING.SCAN("&clk", "*", 0)==0)
  (
    &wild_head=1
  )
  if (STRING.SCAN("&clk", "*", 1)==(STRING.LENGTH("&clk")-1))
  (
    &wild_tail=1
  )

  if ((&wild_head==1)&&(&wild_tail==1))
  (
    if (STRING.SCAN("gcc_pdm2_clk", STRING.MID("&clk", 1, &clk_input_length-2), 0)!=-1)
    ( 
      &match=1
    )
  )
  else if (&wild_head==1)
  (
    if (STRING.MID("gcc_pdm2_clk", &clk_itr_length-&clk_input_length+1, &clk_input_length-1)==STRING.CUT("&clk", 1))
    ( 
      &match=1
    )
  )
  else if (&wild_tail==1)
  (
    if (STRING.MID("gcc_pdm2_clk", 0, &clk_input_length-1)==STRING.CUT("&clk", -1))
    ( 
      &match=1
    )
  )
  else if ("gcc_pdm2_clk"=="&clk")
  (
    &match=1
  )
  
  if (&match==1)
  (
    &clk_test=&CLK_TEST_GCC_PDM2_CLK
    &clk_reg=&HWIO_GCC_PDM2_CBCR_ADDR
    &clk_reg_name="GCC_PDM2_CBCR"
    &clk_name="gcc_pdm2_clk"
    &clk_reg_cbcr_type="sm_cbc"
    &clk_vote_bit=-1.
    &clk_multiplier=4.
    &clk_access_mode="&GCC_access_mode"

    gosub Print_Clk_Info_Line
  )

  &match=0
  &wild_head=0
  &wild_tail=0
  &clk_input_length=STRING.LENGTH("&clk")
  &clk_itr_length=STRING.LENGTH("gcc_bimc_pimem_axi_clk")

  if (STRING.SCAN("&clk", "*", 0)==0)
  (
    &wild_head=1
  )
  if (STRING.SCAN("&clk", "*", 1)==(STRING.LENGTH("&clk")-1))
  (
    &wild_tail=1
  )

  if ((&wild_head==1)&&(&wild_tail==1))
  (
    if (STRING.SCAN("gcc_bimc_pimem_axi_clk", STRING.MID("&clk", 1, &clk_input_length-2), 0)!=-1)
    ( 
      &match=1
    )
  )
  else if (&wild_head==1)
  (
    if (STRING.MID("gcc_bimc_pimem_axi_clk", &clk_itr_length-&clk_input_length+1, &clk_input_length-1)==STRING.CUT("&clk", 1))
    ( 
      &match=1
    )
  )
  else if (&wild_tail==1)
  (
    if (STRING.MID("gcc_bimc_pimem_axi_clk", 0, &clk_input_length-1)==STRING.CUT("&clk", -1))
    ( 
      &match=1
    )
  )
  else if ("gcc_bimc_pimem_axi_clk"=="&clk")
  (
    &match=1
  )
  
  if (&match==1)
  (
    &clk_test=&CLK_TEST_GCC_BIMC_PIMEM_AXI_CLK
    &clk_reg=&HWIO_GCC_BIMC_PIMEM_AXI_CBCR_ADDR
    &clk_reg_name="GCC_BIMC_PIMEM_AXI_CBCR"
    &clk_name="gcc_bimc_pimem_axi_clk"
    &clk_reg_cbcr_type="sm_cbc"
    &clk_vote_bit=-1.
    &clk_multiplier=4.
    &clk_access_mode="&GCC_access_mode"

    gosub Print_Clk_Info_Line
  )

  &match=0
  &wild_head=0
  &wild_tail=0
  &clk_input_length=STRING.LENGTH("&clk")
  &clk_itr_length=STRING.LENGTH("gcc_pimem_axi_clk")

  if (STRING.SCAN("&clk", "*", 0)==0)
  (
    &wild_head=1
  )
  if (STRING.SCAN("&clk", "*", 1)==(STRING.LENGTH("&clk")-1))
  (
    &wild_tail=1
  )

  if ((&wild_head==1)&&(&wild_tail==1))
  (
    if (STRING.SCAN("gcc_pimem_axi_clk", STRING.MID("&clk", 1, &clk_input_length-2), 0)!=-1)
    ( 
      &match=1
    )
  )
  else if (&wild_head==1)
  (
    if (STRING.MID("gcc_pimem_axi_clk", &clk_itr_length-&clk_input_length+1, &clk_input_length-1)==STRING.CUT("&clk", 1))
    ( 
      &match=1
    )
  )
  else if (&wild_tail==1)
  (
    if (STRING.MID("gcc_pimem_axi_clk", 0, &clk_input_length-1)==STRING.CUT("&clk", -1))
    ( 
      &match=1
    )
  )
  else if ("gcc_pimem_axi_clk"=="&clk")
  (
    &match=1
  )
  
  if (&match==1)
  (
    &clk_test=&CLK_TEST_GCC_PIMEM_AXI_CLK
    &clk_reg=&HWIO_GCC_PIMEM_AXI_CBCR_ADDR
    &clk_reg_name="GCC_PIMEM_AXI_CBCR"
    &clk_name="gcc_pimem_axi_clk"
    &clk_reg_cbcr_type="sm_pscbc"
    &clk_vote_bit=-1.
    &clk_multiplier=4.
    &clk_access_mode="&GCC_access_mode"

    gosub Print_Clk_Info_Line
  )

  &match=0
  &wild_head=0
  &wild_tail=0
  &clk_input_length=STRING.LENGTH("&clk")
  &clk_itr_length=STRING.LENGTH("gcc_sys_noc_pimem_axi_clk")

  if (STRING.SCAN("&clk", "*", 0)==0)
  (
    &wild_head=1
  )
  if (STRING.SCAN("&clk", "*", 1)==(STRING.LENGTH("&clk")-1))
  (
    &wild_tail=1
  )

  if ((&wild_head==1)&&(&wild_tail==1))
  (
    if (STRING.SCAN("gcc_sys_noc_pimem_axi_clk", STRING.MID("&clk", 1, &clk_input_length-2), 0)!=-1)
    ( 
      &match=1
    )
  )
  else if (&wild_head==1)
  (
    if (STRING.MID("gcc_sys_noc_pimem_axi_clk", &clk_itr_length-&clk_input_length+1, &clk_input_length-1)==STRING.CUT("&clk", 1))
    ( 
      &match=1
    )
  )
  else if (&wild_tail==1)
  (
    if (STRING.MID("gcc_sys_noc_pimem_axi_clk", 0, &clk_input_length-1)==STRING.CUT("&clk", -1))
    ( 
      &match=1
    )
  )
  else if ("gcc_sys_noc_pimem_axi_clk"=="&clk")
  (
    &match=1
  )
  
  if (&match==1)
  (
    &clk_test=&CLK_TEST_GCC_SYS_NOC_PIMEM_AXI_CLK
    &clk_reg=&HWIO_GCC_SYS_NOC_PIMEM_AXI_CBCR_ADDR
    &clk_reg_name="GCC_SYS_NOC_PIMEM_AXI_CBCR"
    &clk_name="gcc_sys_noc_pimem_axi_clk"
    &clk_reg_cbcr_type="sm_cbc"
    &clk_vote_bit=-1.
    &clk_multiplier=4.
    &clk_access_mode="&GCC_access_mode"

    gosub Print_Clk_Info_Line
  )

  &match=0
  &wild_head=0
  &wild_tail=0
  &clk_input_length=STRING.LENGTH("&clk")
  &clk_itr_length=STRING.LENGTH("gcc_center_apb_clk")

  if (STRING.SCAN("&clk", "*", 0)==0)
  (
    &wild_head=1
  )
  if (STRING.SCAN("&clk", "*", 1)==(STRING.LENGTH("&clk")-1))
  (
    &wild_tail=1
  )

  if ((&wild_head==1)&&(&wild_tail==1))
  (
    if (STRING.SCAN("gcc_center_apb_clk", STRING.MID("&clk", 1, &clk_input_length-2), 0)!=-1)
    ( 
      &match=1
    )
  )
  else if (&wild_head==1)
  (
    if (STRING.MID("gcc_center_apb_clk", &clk_itr_length-&clk_input_length+1, &clk_input_length-1)==STRING.CUT("&clk", 1))
    ( 
      &match=1
    )
  )
  else if (&wild_tail==1)
  (
    if (STRING.MID("gcc_center_apb_clk", 0, &clk_input_length-1)==STRING.CUT("&clk", -1))
    ( 
      &match=1
    )
  )
  else if ("gcc_center_apb_clk"=="&clk")
  (
    &match=1
  )
  
  if (&match==1)
  (
    &clk_test=&CLK_TEST_GCC_CENTER_APB_CLK
    &clk_reg=&HWIO_GCC_CENTER_APB_CBCR_ADDR
    &clk_reg_name="GCC_CENTER_APB_CBCR"
    &clk_name="gcc_center_apb_clk"
    &clk_reg_cbcr_type="sm_cbc"
    &clk_vote_bit=-1.
    &clk_multiplier=4.
    &clk_access_mode="&GCC_access_mode"

    gosub Print_Clk_Info_Line
  )

  &match=0
  &wild_head=0
  &wild_tail=0
  &clk_input_length=STRING.LENGTH("&clk")
  &clk_itr_length=STRING.LENGTH("gcc_gpu_trig_clk")

  if (STRING.SCAN("&clk", "*", 0)==0)
  (
    &wild_head=1
  )
  if (STRING.SCAN("&clk", "*", 1)==(STRING.LENGTH("&clk")-1))
  (
    &wild_tail=1
  )

  if ((&wild_head==1)&&(&wild_tail==1))
  (
    if (STRING.SCAN("gcc_gpu_trig_clk", STRING.MID("&clk", 1, &clk_input_length-2), 0)!=-1)
    ( 
      &match=1
    )
  )
  else if (&wild_head==1)
  (
    if (STRING.MID("gcc_gpu_trig_clk", &clk_itr_length-&clk_input_length+1, &clk_input_length-1)==STRING.CUT("&clk", 1))
    ( 
      &match=1
    )
  )
  else if (&wild_tail==1)
  (
    if (STRING.MID("gcc_gpu_trig_clk", 0, &clk_input_length-1)==STRING.CUT("&clk", -1))
    ( 
      &match=1
    )
  )
  else if ("gcc_gpu_trig_clk"=="&clk")
  (
    &match=1
  )
  
  if (&match==1)
  (
    &clk_test=&CLK_TEST_GCC_GPU_TRIG_CLK
    &clk_reg=&HWIO_GCC_GPU_TRIG_CBCR_ADDR
    &clk_reg_name="GCC_GPU_TRIG_CBCR"
    &clk_name="gcc_gpu_trig_clk"
    &clk_reg_cbcr_type="sm_cbc"
    &clk_vote_bit=-1.
    &clk_multiplier=4.
    &clk_access_mode="&GCC_access_mode"

    gosub Print_Clk_Info_Line
  )

  &match=0
  &wild_head=0
  &wild_tail=0
  &clk_input_length=STRING.LENGTH("&clk")
  &clk_itr_length=STRING.LENGTH("gcc_hmss_trig_clk")

  if (STRING.SCAN("&clk", "*", 0)==0)
  (
    &wild_head=1
  )
  if (STRING.SCAN("&clk", "*", 1)==(STRING.LENGTH("&clk")-1))
  (
    &wild_tail=1
  )

  if ((&wild_head==1)&&(&wild_tail==1))
  (
    if (STRING.SCAN("gcc_hmss_trig_clk", STRING.MID("&clk", 1, &clk_input_length-2), 0)!=-1)
    ( 
      &match=1
    )
  )
  else if (&wild_head==1)
  (
    if (STRING.MID("gcc_hmss_trig_clk", &clk_itr_length-&clk_input_length+1, &clk_input_length-1)==STRING.CUT("&clk", 1))
    ( 
      &match=1
    )
  )
  else if (&wild_tail==1)
  (
    if (STRING.MID("gcc_hmss_trig_clk", 0, &clk_input_length-1)==STRING.CUT("&clk", -1))
    ( 
      &match=1
    )
  )
  else if ("gcc_hmss_trig_clk"=="&clk")
  (
    &match=1
  )
  
  if (&match==1)
  (
    &clk_test=&CLK_TEST_GCC_HMSS_TRIG_CLK
    &clk_reg=&HWIO_GCC_HMSS_TRIG_CBCR_ADDR
    &clk_reg_name="GCC_HMSS_TRIG_CBCR"
    &clk_name="gcc_hmss_trig_clk"
    &clk_reg_cbcr_type="sm_cbc"
    &clk_vote_bit=-1.
    &clk_multiplier=4.
    &clk_access_mode="&GCC_access_mode"

    gosub Print_Clk_Info_Line
  )

  &match=0
  &wild_head=0
  &wild_tail=0
  &clk_input_length=STRING.LENGTH("&clk")
  &clk_itr_length=STRING.LENGTH("gcc_lpass_trig_clk")

  if (STRING.SCAN("&clk", "*", 0)==0)
  (
    &wild_head=1
  )
  if (STRING.SCAN("&clk", "*", 1)==(STRING.LENGTH("&clk")-1))
  (
    &wild_tail=1
  )

  if ((&wild_head==1)&&(&wild_tail==1))
  (
    if (STRING.SCAN("gcc_lpass_trig_clk", STRING.MID("&clk", 1, &clk_input_length-2), 0)!=-1)
    ( 
      &match=1
    )
  )
  else if (&wild_head==1)
  (
    if (STRING.MID("gcc_lpass_trig_clk", &clk_itr_length-&clk_input_length+1, &clk_input_length-1)==STRING.CUT("&clk", 1))
    ( 
      &match=1
    )
  )
  else if (&wild_tail==1)
  (
    if (STRING.MID("gcc_lpass_trig_clk", 0, &clk_input_length-1)==STRING.CUT("&clk", -1))
    ( 
      &match=1
    )
  )
  else if ("gcc_lpass_trig_clk"=="&clk")
  (
    &match=1
  )
  
  if (&match==1)
  (
    &clk_test=&CLK_TEST_GCC_LPASS_TRIG_CLK
    &clk_reg=&HWIO_GCC_LPASS_TRIG_CBCR_ADDR
    &clk_reg_name="GCC_LPASS_TRIG_CBCR"
    &clk_name="gcc_lpass_trig_clk"
    &clk_reg_cbcr_type="sm_cbc"
    &clk_vote_bit=-1.
    &clk_multiplier=4.
    &clk_access_mode="&GCC_access_mode"

    gosub Print_Clk_Info_Line
  )

  &match=0
  &wild_head=0
  &wild_tail=0
  &clk_input_length=STRING.LENGTH("&clk")
  &clk_itr_length=STRING.LENGTH("gcc_mmss_trig_clk")

  if (STRING.SCAN("&clk", "*", 0)==0)
  (
    &wild_head=1
  )
  if (STRING.SCAN("&clk", "*", 1)==(STRING.LENGTH("&clk")-1))
  (
    &wild_tail=1
  )

  if ((&wild_head==1)&&(&wild_tail==1))
  (
    if (STRING.SCAN("gcc_mmss_trig_clk", STRING.MID("&clk", 1, &clk_input_length-2), 0)!=-1)
    ( 
      &match=1
    )
  )
  else if (&wild_head==1)
  (
    if (STRING.MID("gcc_mmss_trig_clk", &clk_itr_length-&clk_input_length+1, &clk_input_length-1)==STRING.CUT("&clk", 1))
    ( 
      &match=1
    )
  )
  else if (&wild_tail==1)
  (
    if (STRING.MID("gcc_mmss_trig_clk", 0, &clk_input_length-1)==STRING.CUT("&clk", -1))
    ( 
      &match=1
    )
  )
  else if ("gcc_mmss_trig_clk"=="&clk")
  (
    &match=1
  )
  
  if (&match==1)
  (
    &clk_test=&CLK_TEST_GCC_MMSS_TRIG_CLK
    &clk_reg=&HWIO_GCC_MMSS_TRIG_CBCR_ADDR
    &clk_reg_name="GCC_MMSS_TRIG_CBCR"
    &clk_name="gcc_mmss_trig_clk"
    &clk_reg_cbcr_type="sm_cbc"
    &clk_vote_bit=-1.
    &clk_multiplier=4.
    &clk_access_mode="&GCC_access_mode"

    gosub Print_Clk_Info_Line
  )

  &match=0
  &wild_head=0
  &wild_tail=0
  &clk_input_length=STRING.LENGTH("&clk")
  &clk_itr_length=STRING.LENGTH("gcc_mss_trig_clk")

  if (STRING.SCAN("&clk", "*", 0)==0)
  (
    &wild_head=1
  )
  if (STRING.SCAN("&clk", "*", 1)==(STRING.LENGTH("&clk")-1))
  (
    &wild_tail=1
  )

  if ((&wild_head==1)&&(&wild_tail==1))
  (
    if (STRING.SCAN("gcc_mss_trig_clk", STRING.MID("&clk", 1, &clk_input_length-2), 0)!=-1)
    ( 
      &match=1
    )
  )
  else if (&wild_head==1)
  (
    if (STRING.MID("gcc_mss_trig_clk", &clk_itr_length-&clk_input_length+1, &clk_input_length-1)==STRING.CUT("&clk", 1))
    ( 
      &match=1
    )
  )
  else if (&wild_tail==1)
  (
    if (STRING.MID("gcc_mss_trig_clk", 0, &clk_input_length-1)==STRING.CUT("&clk", -1))
    ( 
      &match=1
    )
  )
  else if ("gcc_mss_trig_clk"=="&clk")
  (
    &match=1
  )
  
  if (&match==1)
  (
    &clk_test=&CLK_TEST_GCC_MSS_TRIG_CLK
    &clk_reg=&HWIO_GCC_MSS_TRIG_CBCR_ADDR
    &clk_reg_name="GCC_MSS_TRIG_CBCR"
    &clk_name="gcc_mss_trig_clk"
    &clk_reg_cbcr_type="sm_cbc"
    &clk_vote_bit=-1.
    &clk_multiplier=4.
    &clk_access_mode="&GCC_access_mode"

    gosub Print_Clk_Info_Line
  )

  &match=0
  &wild_head=0
  &wild_tail=0
  &clk_input_length=STRING.LENGTH("&clk")
  &clk_itr_length=STRING.LENGTH("gcc_north_apb_clk")

  if (STRING.SCAN("&clk", "*", 0)==0)
  (
    &wild_head=1
  )
  if (STRING.SCAN("&clk", "*", 1)==(STRING.LENGTH("&clk")-1))
  (
    &wild_tail=1
  )

  if ((&wild_head==1)&&(&wild_tail==1))
  (
    if (STRING.SCAN("gcc_north_apb_clk", STRING.MID("&clk", 1, &clk_input_length-2), 0)!=-1)
    ( 
      &match=1
    )
  )
  else if (&wild_head==1)
  (
    if (STRING.MID("gcc_north_apb_clk", &clk_itr_length-&clk_input_length+1, &clk_input_length-1)==STRING.CUT("&clk", 1))
    ( 
      &match=1
    )
  )
  else if (&wild_tail==1)
  (
    if (STRING.MID("gcc_north_apb_clk", 0, &clk_input_length-1)==STRING.CUT("&clk", -1))
    ( 
      &match=1
    )
  )
  else if ("gcc_north_apb_clk"=="&clk")
  (
    &match=1
  )
  
  if (&match==1)
  (
    &clk_test=&CLK_TEST_GCC_NORTH_APB_CLK
    &clk_reg=&HWIO_GCC_NORTH_APB_CBCR_ADDR
    &clk_reg_name="GCC_NORTH_APB_CBCR"
    &clk_name="gcc_north_apb_clk"
    &clk_reg_cbcr_type="sm_cbc"
    &clk_vote_bit=-1.
    &clk_multiplier=4.
    &clk_access_mode="&GCC_access_mode"

    gosub Print_Clk_Info_Line
  )

  &match=0
  &wild_head=0
  &wild_tail=0
  &clk_input_length=STRING.LENGTH("&clk")
  &clk_itr_length=STRING.LENGTH("gcc_qdss_apb2jtag_clk")

  if (STRING.SCAN("&clk", "*", 0)==0)
  (
    &wild_head=1
  )
  if (STRING.SCAN("&clk", "*", 1)==(STRING.LENGTH("&clk")-1))
  (
    &wild_tail=1
  )

  if ((&wild_head==1)&&(&wild_tail==1))
  (
    if (STRING.SCAN("gcc_qdss_apb2jtag_clk", STRING.MID("&clk", 1, &clk_input_length-2), 0)!=-1)
    ( 
      &match=1
    )
  )
  else if (&wild_head==1)
  (
    if (STRING.MID("gcc_qdss_apb2jtag_clk", &clk_itr_length-&clk_input_length+1, &clk_input_length-1)==STRING.CUT("&clk", 1))
    ( 
      &match=1
    )
  )
  else if (&wild_tail==1)
  (
    if (STRING.MID("gcc_qdss_apb2jtag_clk", 0, &clk_input_length-1)==STRING.CUT("&clk", -1))
    ( 
      &match=1
    )
  )
  else if ("gcc_qdss_apb2jtag_clk"=="&clk")
  (
    &match=1
  )
  
  if (&match==1)
  (
    &clk_test=&CLK_TEST_GCC_QDSS_APB2JTAG_CLK
    &clk_reg=&HWIO_GCC_QDSS_APB2JTAG_CBCR_ADDR
    &clk_reg_name="GCC_QDSS_APB2JTAG_CBCR"
    &clk_name="gcc_qdss_apb2jtag_clk"
    &clk_reg_cbcr_type="sm_cbc"
    &clk_vote_bit=-1.
    &clk_multiplier=4.
    &clk_access_mode="&GCC_access_mode"

    gosub Print_Clk_Info_Line
  )

  &match=0
  &wild_head=0
  &wild_tail=0
  &clk_input_length=STRING.LENGTH("&clk")
  &clk_itr_length=STRING.LENGTH("gcc_qdss_dap_clk")

  if (STRING.SCAN("&clk", "*", 0)==0)
  (
    &wild_head=1
  )
  if (STRING.SCAN("&clk", "*", 1)==(STRING.LENGTH("&clk")-1))
  (
    &wild_tail=1
  )

  if ((&wild_head==1)&&(&wild_tail==1))
  (
    if (STRING.SCAN("gcc_qdss_dap_clk", STRING.MID("&clk", 1, &clk_input_length-2), 0)!=-1)
    ( 
      &match=1
    )
  )
  else if (&wild_head==1)
  (
    if (STRING.MID("gcc_qdss_dap_clk", &clk_itr_length-&clk_input_length+1, &clk_input_length-1)==STRING.CUT("&clk", 1))
    ( 
      &match=1
    )
  )
  else if (&wild_tail==1)
  (
    if (STRING.MID("gcc_qdss_dap_clk", 0, &clk_input_length-1)==STRING.CUT("&clk", -1))
    ( 
      &match=1
    )
  )
  else if ("gcc_qdss_dap_clk"=="&clk")
  (
    &match=1
  )
  
  if (&match==1)
  (
    &clk_test=&CLK_TEST_GCC_QDSS_DAP_CLK
    &clk_reg=&HWIO_GCC_QDSS_DAP_CBCR_ADDR
    &clk_reg_name="GCC_QDSS_DAP_CBCR"
    &clk_name="gcc_qdss_dap_clk"
    &clk_reg_cbcr_type="sm_cbc"
    &clk_vote_bit=-1.
    &clk_multiplier=4.
    &clk_access_mode="&GCC_access_mode"

    gosub Print_Clk_Info_Line
  )

  &match=0
  &wild_head=0
  &wild_tail=0
  &clk_input_length=STRING.LENGTH("&clk")
  &clk_itr_length=STRING.LENGTH("gcc_qdss_trig_clk")

  if (STRING.SCAN("&clk", "*", 0)==0)
  (
    &wild_head=1
  )
  if (STRING.SCAN("&clk", "*", 1)==(STRING.LENGTH("&clk")-1))
  (
    &wild_tail=1
  )

  if ((&wild_head==1)&&(&wild_tail==1))
  (
    if (STRING.SCAN("gcc_qdss_trig_clk", STRING.MID("&clk", 1, &clk_input_length-2), 0)!=-1)
    ( 
      &match=1
    )
  )
  else if (&wild_head==1)
  (
    if (STRING.MID("gcc_qdss_trig_clk", &clk_itr_length-&clk_input_length+1, &clk_input_length-1)==STRING.CUT("&clk", 1))
    ( 
      &match=1
    )
  )
  else if (&wild_tail==1)
  (
    if (STRING.MID("gcc_qdss_trig_clk", 0, &clk_input_length-1)==STRING.CUT("&clk", -1))
    ( 
      &match=1
    )
  )
  else if ("gcc_qdss_trig_clk"=="&clk")
  (
    &match=1
  )
  
  if (&match==1)
  (
    &clk_test=&CLK_TEST_GCC_QDSS_TRIG_CLK
    &clk_reg=&HWIO_GCC_QDSS_TRIG_CBCR_ADDR
    &clk_reg_name="GCC_QDSS_TRIG_CBCR"
    &clk_name="gcc_qdss_trig_clk"
    &clk_reg_cbcr_type="sm_cbc"
    &clk_vote_bit=-1.
    &clk_multiplier=4.
    &clk_access_mode="&GCC_access_mode"

    gosub Print_Clk_Info_Line
  )

  &match=0
  &wild_head=0
  &wild_tail=0
  &clk_input_length=STRING.LENGTH("&clk")
  &clk_itr_length=STRING.LENGTH("gcc_south_apb_clk")

  if (STRING.SCAN("&clk", "*", 0)==0)
  (
    &wild_head=1
  )
  if (STRING.SCAN("&clk", "*", 1)==(STRING.LENGTH("&clk")-1))
  (
    &wild_tail=1
  )

  if ((&wild_head==1)&&(&wild_tail==1))
  (
    if (STRING.SCAN("gcc_south_apb_clk", STRING.MID("&clk", 1, &clk_input_length-2), 0)!=-1)
    ( 
      &match=1
    )
  )
  else if (&wild_head==1)
  (
    if (STRING.MID("gcc_south_apb_clk", &clk_itr_length-&clk_input_length+1, &clk_input_length-1)==STRING.CUT("&clk", 1))
    ( 
      &match=1
    )
  )
  else if (&wild_tail==1)
  (
    if (STRING.MID("gcc_south_apb_clk", 0, &clk_input_length-1)==STRING.CUT("&clk", -1))
    ( 
      &match=1
    )
  )
  else if ("gcc_south_apb_clk"=="&clk")
  (
    &match=1
  )
  
  if (&match==1)
  (
    &clk_test=&CLK_TEST_GCC_SOUTH_APB_CLK
    &clk_reg=&HWIO_GCC_SOUTH_APB_CBCR_ADDR
    &clk_reg_name="GCC_SOUTH_APB_CBCR"
    &clk_name="gcc_south_apb_clk"
    &clk_reg_cbcr_type="sm_cbc"
    &clk_vote_bit=-1.
    &clk_multiplier=4.
    &clk_access_mode="&GCC_access_mode"

    gosub Print_Clk_Info_Line
  )

  &match=0
  &wild_head=0
  &wild_tail=0
  &clk_input_length=STRING.LENGTH("&clk")
  &clk_itr_length=STRING.LENGTH("gcc_turing_trig_clk")

  if (STRING.SCAN("&clk", "*", 0)==0)
  (
    &wild_head=1
  )
  if (STRING.SCAN("&clk", "*", 1)==(STRING.LENGTH("&clk")-1))
  (
    &wild_tail=1
  )

  if ((&wild_head==1)&&(&wild_tail==1))
  (
    if (STRING.SCAN("gcc_turing_trig_clk", STRING.MID("&clk", 1, &clk_input_length-2), 0)!=-1)
    ( 
      &match=1
    )
  )
  else if (&wild_head==1)
  (
    if (STRING.MID("gcc_turing_trig_clk", &clk_itr_length-&clk_input_length+1, &clk_input_length-1)==STRING.CUT("&clk", 1))
    ( 
      &match=1
    )
  )
  else if (&wild_tail==1)
  (
    if (STRING.MID("gcc_turing_trig_clk", 0, &clk_input_length-1)==STRING.CUT("&clk", -1))
    ( 
      &match=1
    )
  )
  else if ("gcc_turing_trig_clk"=="&clk")
  (
    &match=1
  )
  
  if (&match==1)
  (
    &clk_test=&CLK_TEST_GCC_TURING_TRIG_CLK
    &clk_reg=&HWIO_GCC_TURING_TRIG_CBCR_ADDR
    &clk_reg_name="GCC_TURING_TRIG_CBCR"
    &clk_name="gcc_turing_trig_clk"
    &clk_reg_cbcr_type="sm_cbc"
    &clk_vote_bit=-1.
    &clk_multiplier=4.
    &clk_access_mode="&GCC_access_mode"

    gosub Print_Clk_Info_Line
  )

  &match=0
  &wild_head=0
  &wild_tail=0
  &clk_input_length=STRING.LENGTH("&clk")
  &clk_itr_length=STRING.LENGTH("gcc_wcss_apb_clk")

  if (STRING.SCAN("&clk", "*", 0)==0)
  (
    &wild_head=1
  )
  if (STRING.SCAN("&clk", "*", 1)==(STRING.LENGTH("&clk")-1))
  (
    &wild_tail=1
  )

  if ((&wild_head==1)&&(&wild_tail==1))
  (
    if (STRING.SCAN("gcc_wcss_apb_clk", STRING.MID("&clk", 1, &clk_input_length-2), 0)!=-1)
    ( 
      &match=1
    )
  )
  else if (&wild_head==1)
  (
    if (STRING.MID("gcc_wcss_apb_clk", &clk_itr_length-&clk_input_length+1, &clk_input_length-1)==STRING.CUT("&clk", 1))
    ( 
      &match=1
    )
  )
  else if (&wild_tail==1)
  (
    if (STRING.MID("gcc_wcss_apb_clk", 0, &clk_input_length-1)==STRING.CUT("&clk", -1))
    ( 
      &match=1
    )
  )
  else if ("gcc_wcss_apb_clk"=="&clk")
  (
    &match=1
  )
  
  if (&match==1)
  (
    &clk_test=&CLK_TEST_GCC_WCSS_APB_CLK
    &clk_reg=&HWIO_GCC_WCSS_APB_CBCR_ADDR
    &clk_reg_name="GCC_WCSS_APB_CBCR"
    &clk_name="gcc_wcss_apb_clk"
    &clk_reg_cbcr_type="sm_cbc"
    &clk_vote_bit=-1.
    &clk_multiplier=4.
    &clk_access_mode="&GCC_access_mode"

    gosub Print_Clk_Info_Line
  )

  &match=0
  &wild_head=0
  &wild_tail=0
  &clk_input_length=STRING.LENGTH("&clk")
  &clk_itr_length=STRING.LENGTH("gcc_aggre2_noc_at_clk")

  if (STRING.SCAN("&clk", "*", 0)==0)
  (
    &wild_head=1
  )
  if (STRING.SCAN("&clk", "*", 1)==(STRING.LENGTH("&clk")-1))
  (
    &wild_tail=1
  )

  if ((&wild_head==1)&&(&wild_tail==1))
  (
    if (STRING.SCAN("gcc_aggre2_noc_at_clk", STRING.MID("&clk", 1, &clk_input_length-2), 0)!=-1)
    ( 
      &match=1
    )
  )
  else if (&wild_head==1)
  (
    if (STRING.MID("gcc_aggre2_noc_at_clk", &clk_itr_length-&clk_input_length+1, &clk_input_length-1)==STRING.CUT("&clk", 1))
    ( 
      &match=1
    )
  )
  else if (&wild_tail==1)
  (
    if (STRING.MID("gcc_aggre2_noc_at_clk", 0, &clk_input_length-1)==STRING.CUT("&clk", -1))
    ( 
      &match=1
    )
  )
  else if ("gcc_aggre2_noc_at_clk"=="&clk")
  (
    &match=1
  )
  
  if (&match==1)
  (
    &clk_test=&CLK_TEST_GCC_AGGRE2_NOC_AT_CLK
    &clk_reg=&HWIO_GCC_AGGRE2_NOC_AT_CBCR_ADDR
    &clk_reg_name="GCC_AGGRE2_NOC_AT_CBCR"
    &clk_name="gcc_aggre2_noc_at_clk"
    &clk_reg_cbcr_type="sm_cbc"
    &clk_vote_bit=-1.
    &clk_multiplier=4.
    &clk_access_mode="&GCC_access_mode"

    gosub Print_Clk_Info_Line
  )

  &match=0
  &wild_head=0
  &wild_tail=0
  &clk_input_length=STRING.LENGTH("&clk")
  &clk_itr_length=STRING.LENGTH("gcc_gpu_at_clk")

  if (STRING.SCAN("&clk", "*", 0)==0)
  (
    &wild_head=1
  )
  if (STRING.SCAN("&clk", "*", 1)==(STRING.LENGTH("&clk")-1))
  (
    &wild_tail=1
  )

  if ((&wild_head==1)&&(&wild_tail==1))
  (
    if (STRING.SCAN("gcc_gpu_at_clk", STRING.MID("&clk", 1, &clk_input_length-2), 0)!=-1)
    ( 
      &match=1
    )
  )
  else if (&wild_head==1)
  (
    if (STRING.MID("gcc_gpu_at_clk", &clk_itr_length-&clk_input_length+1, &clk_input_length-1)==STRING.CUT("&clk", 1))
    ( 
      &match=1
    )
  )
  else if (&wild_tail==1)
  (
    if (STRING.MID("gcc_gpu_at_clk", 0, &clk_input_length-1)==STRING.CUT("&clk", -1))
    ( 
      &match=1
    )
  )
  else if ("gcc_gpu_at_clk"=="&clk")
  (
    &match=1
  )
  
  if (&match==1)
  (
    &clk_test=&CLK_TEST_GCC_GPU_AT_CLK
    &clk_reg=&HWIO_GCC_GPU_AT_CBCR_ADDR
    &clk_reg_name="GCC_GPU_AT_CBCR"
    &clk_name="gcc_gpu_at_clk"
    &clk_reg_cbcr_type="sm_cbc"
    &clk_vote_bit=-1.
    &clk_multiplier=4.
    &clk_access_mode="&GCC_access_mode"

    gosub Print_Clk_Info_Line
  )

  &match=0
  &wild_head=0
  &wild_tail=0
  &clk_input_length=STRING.LENGTH("&clk")
  &clk_itr_length=STRING.LENGTH("gcc_hmss_at_clk")

  if (STRING.SCAN("&clk", "*", 0)==0)
  (
    &wild_head=1
  )
  if (STRING.SCAN("&clk", "*", 1)==(STRING.LENGTH("&clk")-1))
  (
    &wild_tail=1
  )

  if ((&wild_head==1)&&(&wild_tail==1))
  (
    if (STRING.SCAN("gcc_hmss_at_clk", STRING.MID("&clk", 1, &clk_input_length-2), 0)!=-1)
    ( 
      &match=1
    )
  )
  else if (&wild_head==1)
  (
    if (STRING.MID("gcc_hmss_at_clk", &clk_itr_length-&clk_input_length+1, &clk_input_length-1)==STRING.CUT("&clk", 1))
    ( 
      &match=1
    )
  )
  else if (&wild_tail==1)
  (
    if (STRING.MID("gcc_hmss_at_clk", 0, &clk_input_length-1)==STRING.CUT("&clk", -1))
    ( 
      &match=1
    )
  )
  else if ("gcc_hmss_at_clk"=="&clk")
  (
    &match=1
  )
  
  if (&match==1)
  (
    &clk_test=&CLK_TEST_GCC_HMSS_AT_CLK
    &clk_reg=&HWIO_GCC_HMSS_AT_CBCR_ADDR
    &clk_reg_name="GCC_HMSS_AT_CBCR"
    &clk_name="gcc_hmss_at_clk"
    &clk_reg_cbcr_type="sm_cbc"
    &clk_vote_bit=-1.
    &clk_multiplier=4.
    &clk_access_mode="&GCC_access_mode"

    gosub Print_Clk_Info_Line
  )

  &match=0
  &wild_head=0
  &wild_tail=0
  &clk_input_length=STRING.LENGTH("&clk")
  &clk_itr_length=STRING.LENGTH("gcc_mmss_at_clk")

  if (STRING.SCAN("&clk", "*", 0)==0)
  (
    &wild_head=1
  )
  if (STRING.SCAN("&clk", "*", 1)==(STRING.LENGTH("&clk")-1))
  (
    &wild_tail=1
  )

  if ((&wild_head==1)&&(&wild_tail==1))
  (
    if (STRING.SCAN("gcc_mmss_at_clk", STRING.MID("&clk", 1, &clk_input_length-2), 0)!=-1)
    ( 
      &match=1
    )
  )
  else if (&wild_head==1)
  (
    if (STRING.MID("gcc_mmss_at_clk", &clk_itr_length-&clk_input_length+1, &clk_input_length-1)==STRING.CUT("&clk", 1))
    ( 
      &match=1
    )
  )
  else if (&wild_tail==1)
  (
    if (STRING.MID("gcc_mmss_at_clk", 0, &clk_input_length-1)==STRING.CUT("&clk", -1))
    ( 
      &match=1
    )
  )
  else if ("gcc_mmss_at_clk"=="&clk")
  (
    &match=1
  )
  
  if (&match==1)
  (
    &clk_test=&CLK_TEST_GCC_MMSS_AT_CLK
    &clk_reg=&HWIO_GCC_MMSS_AT_CBCR_ADDR
    &clk_reg_name="GCC_MMSS_AT_CBCR"
    &clk_name="gcc_mmss_at_clk"
    &clk_reg_cbcr_type="sm_cbc"
    &clk_vote_bit=-1.
    &clk_multiplier=4.
    &clk_access_mode="&GCC_access_mode"

    gosub Print_Clk_Info_Line
  )

  &match=0
  &wild_head=0
  &wild_tail=0
  &clk_input_length=STRING.LENGTH("&clk")
  &clk_itr_length=STRING.LENGTH("gcc_mmss_noc_at_clk")

  if (STRING.SCAN("&clk", "*", 0)==0)
  (
    &wild_head=1
  )
  if (STRING.SCAN("&clk", "*", 1)==(STRING.LENGTH("&clk")-1))
  (
    &wild_tail=1
  )

  if ((&wild_head==1)&&(&wild_tail==1))
  (
    if (STRING.SCAN("gcc_mmss_noc_at_clk", STRING.MID("&clk", 1, &clk_input_length-2), 0)!=-1)
    ( 
      &match=1
    )
  )
  else if (&wild_head==1)
  (
    if (STRING.MID("gcc_mmss_noc_at_clk", &clk_itr_length-&clk_input_length+1, &clk_input_length-1)==STRING.CUT("&clk", 1))
    ( 
      &match=1
    )
  )
  else if (&wild_tail==1)
  (
    if (STRING.MID("gcc_mmss_noc_at_clk", 0, &clk_input_length-1)==STRING.CUT("&clk", -1))
    ( 
      &match=1
    )
  )
  else if ("gcc_mmss_noc_at_clk"=="&clk")
  (
    &match=1
  )
  
  if (&match==1)
  (
    &clk_test=&CLK_TEST_GCC_MMSS_NOC_AT_CLK
    &clk_reg=&HWIO_GCC_MMSS_NOC_AT_CBCR_ADDR
    &clk_reg_name="GCC_MMSS_NOC_AT_CBCR"
    &clk_name="gcc_mmss_noc_at_clk"
    &clk_reg_cbcr_type="sm_cbc"
    &clk_vote_bit=-1.
    &clk_multiplier=4.
    &clk_access_mode="&GCC_access_mode"

    gosub Print_Clk_Info_Line
  )

  &match=0
  &wild_head=0
  &wild_tail=0
  &clk_input_length=STRING.LENGTH("&clk")
  &clk_itr_length=STRING.LENGTH("gcc_north_at_clk")

  if (STRING.SCAN("&clk", "*", 0)==0)
  (
    &wild_head=1
  )
  if (STRING.SCAN("&clk", "*", 1)==(STRING.LENGTH("&clk")-1))
  (
    &wild_tail=1
  )

  if ((&wild_head==1)&&(&wild_tail==1))
  (
    if (STRING.SCAN("gcc_north_at_clk", STRING.MID("&clk", 1, &clk_input_length-2), 0)!=-1)
    ( 
      &match=1
    )
  )
  else if (&wild_head==1)
  (
    if (STRING.MID("gcc_north_at_clk", &clk_itr_length-&clk_input_length+1, &clk_input_length-1)==STRING.CUT("&clk", 1))
    ( 
      &match=1
    )
  )
  else if (&wild_tail==1)
  (
    if (STRING.MID("gcc_north_at_clk", 0, &clk_input_length-1)==STRING.CUT("&clk", -1))
    ( 
      &match=1
    )
  )
  else if ("gcc_north_at_clk"=="&clk")
  (
    &match=1
  )
  
  if (&match==1)
  (
    &clk_test=&CLK_TEST_GCC_NORTH_AT_CLK
    &clk_reg=&HWIO_GCC_NORTH_AT_CBCR_ADDR
    &clk_reg_name="GCC_NORTH_AT_CBCR"
    &clk_name="gcc_north_at_clk"
    &clk_reg_cbcr_type="sm_cbc"
    &clk_vote_bit=-1.
    &clk_multiplier=4.
    &clk_access_mode="&GCC_access_mode"

    gosub Print_Clk_Info_Line
  )

  &match=0
  &wild_head=0
  &wild_tail=0
  &clk_input_length=STRING.LENGTH("&clk")
  &clk_itr_length=STRING.LENGTH("gcc_qdss_center_at_clk")

  if (STRING.SCAN("&clk", "*", 0)==0)
  (
    &wild_head=1
  )
  if (STRING.SCAN("&clk", "*", 1)==(STRING.LENGTH("&clk")-1))
  (
    &wild_tail=1
  )

  if ((&wild_head==1)&&(&wild_tail==1))
  (
    if (STRING.SCAN("gcc_qdss_center_at_clk", STRING.MID("&clk", 1, &clk_input_length-2), 0)!=-1)
    ( 
      &match=1
    )
  )
  else if (&wild_head==1)
  (
    if (STRING.MID("gcc_qdss_center_at_clk", &clk_itr_length-&clk_input_length+1, &clk_input_length-1)==STRING.CUT("&clk", 1))
    ( 
      &match=1
    )
  )
  else if (&wild_tail==1)
  (
    if (STRING.MID("gcc_qdss_center_at_clk", 0, &clk_input_length-1)==STRING.CUT("&clk", -1))
    ( 
      &match=1
    )
  )
  else if ("gcc_qdss_center_at_clk"=="&clk")
  (
    &match=1
  )
  
  if (&match==1)
  (
    &clk_test=&CLK_TEST_GCC_QDSS_CENTER_AT_CLK
    &clk_reg=&HWIO_GCC_QDSS_CENTER_AT_CBCR_ADDR
    &clk_reg_name="GCC_QDSS_CENTER_AT_CBCR"
    &clk_name="gcc_qdss_center_at_clk"
    &clk_reg_cbcr_type="sm_pscbc"
    &clk_vote_bit=-1.
    &clk_multiplier=4.
    &clk_access_mode="&GCC_access_mode"

    gosub Print_Clk_Info_Line
  )

  &match=0
  &wild_head=0
  &wild_tail=0
  &clk_input_length=STRING.LENGTH("&clk")
  &clk_itr_length=STRING.LENGTH("gcc_south_at_clk")

  if (STRING.SCAN("&clk", "*", 0)==0)
  (
    &wild_head=1
  )
  if (STRING.SCAN("&clk", "*", 1)==(STRING.LENGTH("&clk")-1))
  (
    &wild_tail=1
  )

  if ((&wild_head==1)&&(&wild_tail==1))
  (
    if (STRING.SCAN("gcc_south_at_clk", STRING.MID("&clk", 1, &clk_input_length-2), 0)!=-1)
    ( 
      &match=1
    )
  )
  else if (&wild_head==1)
  (
    if (STRING.MID("gcc_south_at_clk", &clk_itr_length-&clk_input_length+1, &clk_input_length-1)==STRING.CUT("&clk", 1))
    ( 
      &match=1
    )
  )
  else if (&wild_tail==1)
  (
    if (STRING.MID("gcc_south_at_clk", 0, &clk_input_length-1)==STRING.CUT("&clk", -1))
    ( 
      &match=1
    )
  )
  else if ("gcc_south_at_clk"=="&clk")
  (
    &match=1
  )
  
  if (&match==1)
  (
    &clk_test=&CLK_TEST_GCC_SOUTH_AT_CLK
    &clk_reg=&HWIO_GCC_SOUTH_AT_CBCR_ADDR
    &clk_reg_name="GCC_SOUTH_AT_CBCR"
    &clk_name="gcc_south_at_clk"
    &clk_reg_cbcr_type="sm_cbc"
    &clk_vote_bit=-1.
    &clk_multiplier=4.
    &clk_access_mode="&GCC_access_mode"

    gosub Print_Clk_Info_Line
  )

  &match=0
  &wild_head=0
  &wild_tail=0
  &clk_input_length=STRING.LENGTH("&clk")
  &clk_itr_length=STRING.LENGTH("gcc_sys_noc_at_clk")

  if (STRING.SCAN("&clk", "*", 0)==0)
  (
    &wild_head=1
  )
  if (STRING.SCAN("&clk", "*", 1)==(STRING.LENGTH("&clk")-1))
  (
    &wild_tail=1
  )

  if ((&wild_head==1)&&(&wild_tail==1))
  (
    if (STRING.SCAN("gcc_sys_noc_at_clk", STRING.MID("&clk", 1, &clk_input_length-2), 0)!=-1)
    ( 
      &match=1
    )
  )
  else if (&wild_head==1)
  (
    if (STRING.MID("gcc_sys_noc_at_clk", &clk_itr_length-&clk_input_length+1, &clk_input_length-1)==STRING.CUT("&clk", 1))
    ( 
      &match=1
    )
  )
  else if (&wild_tail==1)
  (
    if (STRING.MID("gcc_sys_noc_at_clk", 0, &clk_input_length-1)==STRING.CUT("&clk", -1))
    ( 
      &match=1
    )
  )
  else if ("gcc_sys_noc_at_clk"=="&clk")
  (
    &match=1
  )
  
  if (&match==1)
  (
    &clk_test=&CLK_TEST_GCC_SYS_NOC_AT_CLK
    &clk_reg=&HWIO_GCC_SYS_NOC_AT_CBCR_ADDR
    &clk_reg_name="GCC_SYS_NOC_AT_CBCR"
    &clk_name="gcc_sys_noc_at_clk"
    &clk_reg_cbcr_type="sm_cbc"
    &clk_vote_bit=-1.
    &clk_multiplier=4.
    &clk_access_mode="&GCC_access_mode"

    gosub Print_Clk_Info_Line
  )

  &match=0
  &wild_head=0
  &wild_tail=0
  &clk_input_length=STRING.LENGTH("&clk")
  &clk_itr_length=STRING.LENGTH("gcc_wcss_at_clk")

  if (STRING.SCAN("&clk", "*", 0)==0)
  (
    &wild_head=1
  )
  if (STRING.SCAN("&clk", "*", 1)==(STRING.LENGTH("&clk")-1))
  (
    &wild_tail=1
  )

  if ((&wild_head==1)&&(&wild_tail==1))
  (
    if (STRING.SCAN("gcc_wcss_at_clk", STRING.MID("&clk", 1, &clk_input_length-2), 0)!=-1)
    ( 
      &match=1
    )
  )
  else if (&wild_head==1)
  (
    if (STRING.MID("gcc_wcss_at_clk", &clk_itr_length-&clk_input_length+1, &clk_input_length-1)==STRING.CUT("&clk", 1))
    ( 
      &match=1
    )
  )
  else if (&wild_tail==1)
  (
    if (STRING.MID("gcc_wcss_at_clk", 0, &clk_input_length-1)==STRING.CUT("&clk", -1))
    ( 
      &match=1
    )
  )
  else if ("gcc_wcss_at_clk"=="&clk")
  (
    &match=1
  )
  
  if (&match==1)
  (
    &clk_test=&CLK_TEST_GCC_WCSS_AT_CLK
    &clk_reg=&HWIO_GCC_WCSS_AT_CBCR_ADDR
    &clk_reg_name="GCC_WCSS_AT_CBCR"
    &clk_name="gcc_wcss_at_clk"
    &clk_reg_cbcr_type="sm_cbc"
    &clk_vote_bit=-1.
    &clk_multiplier=4.
    &clk_access_mode="&GCC_access_mode"

    gosub Print_Clk_Info_Line
  )

  &match=0
  &wild_head=0
  &wild_tail=0
  &clk_input_length=STRING.LENGTH("&clk")
  &clk_itr_length=STRING.LENGTH("gcc_bimc_at_clk")

  if (STRING.SCAN("&clk", "*", 0)==0)
  (
    &wild_head=1
  )
  if (STRING.SCAN("&clk", "*", 1)==(STRING.LENGTH("&clk")-1))
  (
    &wild_tail=1
  )

  if ((&wild_head==1)&&(&wild_tail==1))
  (
    if (STRING.SCAN("gcc_bimc_at_clk", STRING.MID("&clk", 1, &clk_input_length-2), 0)!=-1)
    ( 
      &match=1
    )
  )
  else if (&wild_head==1)
  (
    if (STRING.MID("gcc_bimc_at_clk", &clk_itr_length-&clk_input_length+1, &clk_input_length-1)==STRING.CUT("&clk", 1))
    ( 
      &match=1
    )
  )
  else if (&wild_tail==1)
  (
    if (STRING.MID("gcc_bimc_at_clk", 0, &clk_input_length-1)==STRING.CUT("&clk", -1))
    ( 
      &match=1
    )
  )
  else if ("gcc_bimc_at_clk"=="&clk")
  (
    &match=1
  )
  
  if (&match==1)
  (
    &clk_test=&CLK_TEST_GCC_BIMC_AT_CLK
    &clk_reg=&HWIO_GCC_BIMC_AT_CBCR_ADDR
    &clk_reg_name="GCC_BIMC_AT_CBCR"
    &clk_name="gcc_bimc_at_clk"
    &clk_reg_cbcr_type="sm_cbc"
    &clk_vote_bit=-1.
    &clk_multiplier=4.
    &clk_access_mode="&GCC_access_mode"

    gosub Print_Clk_Info_Line
  )

  &match=0
  &wild_head=0
  &wild_tail=0
  &clk_input_length=STRING.LENGTH("&clk")
  &clk_itr_length=STRING.LENGTH("gcc_mss_at_clk")

  if (STRING.SCAN("&clk", "*", 0)==0)
  (
    &wild_head=1
  )
  if (STRING.SCAN("&clk", "*", 1)==(STRING.LENGTH("&clk")-1))
  (
    &wild_tail=1
  )

  if ((&wild_head==1)&&(&wild_tail==1))
  (
    if (STRING.SCAN("gcc_mss_at_clk", STRING.MID("&clk", 1, &clk_input_length-2), 0)!=-1)
    ( 
      &match=1
    )
  )
  else if (&wild_head==1)
  (
    if (STRING.MID("gcc_mss_at_clk", &clk_itr_length-&clk_input_length+1, &clk_input_length-1)==STRING.CUT("&clk", 1))
    ( 
      &match=1
    )
  )
  else if (&wild_tail==1)
  (
    if (STRING.MID("gcc_mss_at_clk", 0, &clk_input_length-1)==STRING.CUT("&clk", -1))
    ( 
      &match=1
    )
  )
  else if ("gcc_mss_at_clk"=="&clk")
  (
    &match=1
  )
  
  if (&match==1)
  (
    &clk_test=&CLK_TEST_GCC_MSS_AT_CLK
    &clk_reg=&HWIO_GCC_MSS_AT_CBCR_ADDR
    &clk_reg_name="GCC_MSS_AT_CBCR"
    &clk_name="gcc_mss_at_clk"
    &clk_reg_cbcr_type="sm_cbc"
    &clk_vote_bit=-1.
    &clk_multiplier=4.
    &clk_access_mode="&GCC_access_mode"

    gosub Print_Clk_Info_Line
  )

  &match=0
  &wild_head=0
  &wild_tail=0
  &clk_input_length=STRING.LENGTH("&clk")
  &clk_itr_length=STRING.LENGTH("gcc_lpass_at_clk")

  if (STRING.SCAN("&clk", "*", 0)==0)
  (
    &wild_head=1
  )
  if (STRING.SCAN("&clk", "*", 1)==(STRING.LENGTH("&clk")-1))
  (
    &wild_tail=1
  )

  if ((&wild_head==1)&&(&wild_tail==1))
  (
    if (STRING.SCAN("gcc_lpass_at_clk", STRING.MID("&clk", 1, &clk_input_length-2), 0)!=-1)
    ( 
      &match=1
    )
  )
  else if (&wild_head==1)
  (
    if (STRING.MID("gcc_lpass_at_clk", &clk_itr_length-&clk_input_length+1, &clk_input_length-1)==STRING.CUT("&clk", 1))
    ( 
      &match=1
    )
  )
  else if (&wild_tail==1)
  (
    if (STRING.MID("gcc_lpass_at_clk", 0, &clk_input_length-1)==STRING.CUT("&clk", -1))
    ( 
      &match=1
    )
  )
  else if ("gcc_lpass_at_clk"=="&clk")
  (
    &match=1
  )
  
  if (&match==1)
  (
    &clk_test=&CLK_TEST_GCC_LPASS_AT_CLK
    &clk_reg=&HWIO_GCC_LPASS_AT_CBCR_ADDR
    &clk_reg_name="GCC_LPASS_AT_CBCR"
    &clk_name="gcc_lpass_at_clk"
    &clk_reg_cbcr_type="sm_cbc"
    &clk_vote_bit=-1.
    &clk_multiplier=4.
    &clk_access_mode="&GCC_access_mode"

    gosub Print_Clk_Info_Line
  )

  &match=0
  &wild_head=0
  &wild_tail=0
  &clk_input_length=STRING.LENGTH("&clk")
  &clk_itr_length=STRING.LENGTH("gcc_turing_at_clk")

  if (STRING.SCAN("&clk", "*", 0)==0)
  (
    &wild_head=1
  )
  if (STRING.SCAN("&clk", "*", 1)==(STRING.LENGTH("&clk")-1))
  (
    &wild_tail=1
  )

  if ((&wild_head==1)&&(&wild_tail==1))
  (
    if (STRING.SCAN("gcc_turing_at_clk", STRING.MID("&clk", 1, &clk_input_length-2), 0)!=-1)
    ( 
      &match=1
    )
  )
  else if (&wild_head==1)
  (
    if (STRING.MID("gcc_turing_at_clk", &clk_itr_length-&clk_input_length+1, &clk_input_length-1)==STRING.CUT("&clk", 1))
    ( 
      &match=1
    )
  )
  else if (&wild_tail==1)
  (
    if (STRING.MID("gcc_turing_at_clk", 0, &clk_input_length-1)==STRING.CUT("&clk", -1))
    ( 
      &match=1
    )
  )
  else if ("gcc_turing_at_clk"=="&clk")
  (
    &match=1
  )
  
  if (&match==1)
  (
    &clk_test=&CLK_TEST_GCC_TURING_AT_CLK
    &clk_reg=&HWIO_GCC_TURING_AT_CBCR_ADDR
    &clk_reg_name="GCC_TURING_AT_CBCR"
    &clk_name="gcc_turing_at_clk"
    &clk_reg_cbcr_type="sm_cbc"
    &clk_vote_bit=-1.
    &clk_multiplier=4.
    &clk_access_mode="&GCC_access_mode"

    gosub Print_Clk_Info_Line
  )

  &match=0
  &wild_head=0
  &wild_tail=0
  &clk_input_length=STRING.LENGTH("&clk")
  &clk_itr_length=STRING.LENGTH("gcc_qdss_stm_clk")

  if (STRING.SCAN("&clk", "*", 0)==0)
  (
    &wild_head=1
  )
  if (STRING.SCAN("&clk", "*", 1)==(STRING.LENGTH("&clk")-1))
  (
    &wild_tail=1
  )

  if ((&wild_head==1)&&(&wild_tail==1))
  (
    if (STRING.SCAN("gcc_qdss_stm_clk", STRING.MID("&clk", 1, &clk_input_length-2), 0)!=-1)
    ( 
      &match=1
    )
  )
  else if (&wild_head==1)
  (
    if (STRING.MID("gcc_qdss_stm_clk", &clk_itr_length-&clk_input_length+1, &clk_input_length-1)==STRING.CUT("&clk", 1))
    ( 
      &match=1
    )
  )
  else if (&wild_tail==1)
  (
    if (STRING.MID("gcc_qdss_stm_clk", 0, &clk_input_length-1)==STRING.CUT("&clk", -1))
    ( 
      &match=1
    )
  )
  else if ("gcc_qdss_stm_clk"=="&clk")
  (
    &match=1
  )
  
  if (&match==1)
  (
    &clk_test=&CLK_TEST_GCC_QDSS_STM_CLK
    &clk_reg=&HWIO_GCC_QDSS_STM_CBCR_ADDR
    &clk_reg_name="GCC_QDSS_STM_CBCR"
    &clk_name="gcc_qdss_stm_clk"
    &clk_reg_cbcr_type="sm_cbc"
    &clk_vote_bit=-1.
    &clk_multiplier=4.
    &clk_access_mode="&GCC_access_mode"

    gosub Print_Clk_Info_Line
  )

  &match=0
  &wild_head=0
  &wild_tail=0
  &clk_input_length=STRING.LENGTH("&clk")
  &clk_itr_length=STRING.LENGTH("gcc_sys_noc_qdss_stm_axi_clk")

  if (STRING.SCAN("&clk", "*", 0)==0)
  (
    &wild_head=1
  )
  if (STRING.SCAN("&clk", "*", 1)==(STRING.LENGTH("&clk")-1))
  (
    &wild_tail=1
  )

  if ((&wild_head==1)&&(&wild_tail==1))
  (
    if (STRING.SCAN("gcc_sys_noc_qdss_stm_axi_clk", STRING.MID("&clk", 1, &clk_input_length-2), 0)!=-1)
    ( 
      &match=1
    )
  )
  else if (&wild_head==1)
  (
    if (STRING.MID("gcc_sys_noc_qdss_stm_axi_clk", &clk_itr_length-&clk_input_length+1, &clk_input_length-1)==STRING.CUT("&clk", 1))
    ( 
      &match=1
    )
  )
  else if (&wild_tail==1)
  (
    if (STRING.MID("gcc_sys_noc_qdss_stm_axi_clk", 0, &clk_input_length-1)==STRING.CUT("&clk", -1))
    ( 
      &match=1
    )
  )
  else if ("gcc_sys_noc_qdss_stm_axi_clk"=="&clk")
  (
    &match=1
  )
  
  if (&match==1)
  (
    &clk_test=&CLK_TEST_GCC_SYS_NOC_QDSS_STM_AXI_CLK
    &clk_reg=&HWIO_GCC_SYS_NOC_QDSS_STM_AXI_CBCR_ADDR
    &clk_reg_name="GCC_SYS_NOC_QDSS_STM_AXI_CBCR"
    &clk_name="gcc_sys_noc_qdss_stm_axi_clk"
    &clk_reg_cbcr_type="sm_cbc"
    &clk_vote_bit=-1.
    &clk_multiplier=4.
    &clk_access_mode="&GCC_access_mode"

    gosub Print_Clk_Info_Line
  )

  &match=0
  &wild_head=0
  &wild_tail=0
  &clk_input_length=STRING.LENGTH("&clk")
  &clk_itr_length=STRING.LENGTH("gcc_qdss_traceclkin_clk")

  if (STRING.SCAN("&clk", "*", 0)==0)
  (
    &wild_head=1
  )
  if (STRING.SCAN("&clk", "*", 1)==(STRING.LENGTH("&clk")-1))
  (
    &wild_tail=1
  )

  if ((&wild_head==1)&&(&wild_tail==1))
  (
    if (STRING.SCAN("gcc_qdss_traceclkin_clk", STRING.MID("&clk", 1, &clk_input_length-2), 0)!=-1)
    ( 
      &match=1
    )
  )
  else if (&wild_head==1)
  (
    if (STRING.MID("gcc_qdss_traceclkin_clk", &clk_itr_length-&clk_input_length+1, &clk_input_length-1)==STRING.CUT("&clk", 1))
    ( 
      &match=1
    )
  )
  else if (&wild_tail==1)
  (
    if (STRING.MID("gcc_qdss_traceclkin_clk", 0, &clk_input_length-1)==STRING.CUT("&clk", -1))
    ( 
      &match=1
    )
  )
  else if ("gcc_qdss_traceclkin_clk"=="&clk")
  (
    &match=1
  )
  
  if (&match==1)
  (
    &clk_test=&CLK_TEST_GCC_QDSS_TRACECLKIN_CLK
    &clk_reg=&HWIO_GCC_QDSS_TRACECLKIN_CBCR_ADDR
    &clk_reg_name="GCC_QDSS_TRACECLKIN_CBCR"
    &clk_name="gcc_qdss_traceclkin_clk"
    &clk_reg_cbcr_type="sm_cbc"
    &clk_vote_bit=-1.
    &clk_multiplier=4.
    &clk_access_mode="&GCC_access_mode"

    gosub Print_Clk_Info_Line
  )

  &match=0
  &wild_head=0
  &wild_tail=0
  &clk_input_length=STRING.LENGTH("&clk")
  &clk_itr_length=STRING.LENGTH("gcc_apss_qdss_tsctr_div2_clk")

  if (STRING.SCAN("&clk", "*", 0)==0)
  (
    &wild_head=1
  )
  if (STRING.SCAN("&clk", "*", 1)==(STRING.LENGTH("&clk")-1))
  (
    &wild_tail=1
  )

  if ((&wild_head==1)&&(&wild_tail==1))
  (
    if (STRING.SCAN("gcc_apss_qdss_tsctr_div2_clk", STRING.MID("&clk", 1, &clk_input_length-2), 0)!=-1)
    ( 
      &match=1
    )
  )
  else if (&wild_head==1)
  (
    if (STRING.MID("gcc_apss_qdss_tsctr_div2_clk", &clk_itr_length-&clk_input_length+1, &clk_input_length-1)==STRING.CUT("&clk", 1))
    ( 
      &match=1
    )
  )
  else if (&wild_tail==1)
  (
    if (STRING.MID("gcc_apss_qdss_tsctr_div2_clk", 0, &clk_input_length-1)==STRING.CUT("&clk", -1))
    ( 
      &match=1
    )
  )
  else if ("gcc_apss_qdss_tsctr_div2_clk"=="&clk")
  (
    &match=1
  )
  
  if (&match==1)
  (
    &clk_test=&CLK_TEST_GCC_APSS_QDSS_TSCTR_DIV2_CLK
    &clk_reg=&HWIO_GCC_APSS_QDSS_TSCTR_DIV2_CBCR_ADDR
    &clk_reg_name="GCC_APSS_QDSS_TSCTR_DIV2_CBCR"
    &clk_name="gcc_apss_qdss_tsctr_div2_clk"
    &clk_reg_cbcr_type="sm_cbc"
    &clk_vote_bit=-1.
    &clk_multiplier=4.
    &clk_access_mode="&GCC_access_mode"

    gosub Print_Clk_Info_Line
  )

  &match=0
  &wild_head=0
  &wild_tail=0
  &clk_input_length=STRING.LENGTH("&clk")
  &clk_itr_length=STRING.LENGTH("gcc_apss_qdss_tsctr_div8_clk")

  if (STRING.SCAN("&clk", "*", 0)==0)
  (
    &wild_head=1
  )
  if (STRING.SCAN("&clk", "*", 1)==(STRING.LENGTH("&clk")-1))
  (
    &wild_tail=1
  )

  if ((&wild_head==1)&&(&wild_tail==1))
  (
    if (STRING.SCAN("gcc_apss_qdss_tsctr_div8_clk", STRING.MID("&clk", 1, &clk_input_length-2), 0)!=-1)
    ( 
      &match=1
    )
  )
  else if (&wild_head==1)
  (
    if (STRING.MID("gcc_apss_qdss_tsctr_div8_clk", &clk_itr_length-&clk_input_length+1, &clk_input_length-1)==STRING.CUT("&clk", 1))
    ( 
      &match=1
    )
  )
  else if (&wild_tail==1)
  (
    if (STRING.MID("gcc_apss_qdss_tsctr_div8_clk", 0, &clk_input_length-1)==STRING.CUT("&clk", -1))
    ( 
      &match=1
    )
  )
  else if ("gcc_apss_qdss_tsctr_div8_clk"=="&clk")
  (
    &match=1
  )
  
  if (&match==1)
  (
    &clk_test=&CLK_TEST_GCC_APSS_QDSS_TSCTR_DIV8_CLK
    &clk_reg=&HWIO_GCC_APSS_QDSS_TSCTR_DIV8_CBCR_ADDR
    &clk_reg_name="GCC_APSS_QDSS_TSCTR_DIV8_CBCR"
    &clk_name="gcc_apss_qdss_tsctr_div8_clk"
    &clk_reg_cbcr_type="sm_cbc"
    &clk_vote_bit=-1.
    &clk_multiplier=4.
    &clk_access_mode="&GCC_access_mode"

    gosub Print_Clk_Info_Line
  )

  &match=0
  &wild_head=0
  &wild_tail=0
  &clk_input_length=STRING.LENGTH("&clk")
  &clk_itr_length=STRING.LENGTH("gcc_qdss_tsctr_div16_clk")

  if (STRING.SCAN("&clk", "*", 0)==0)
  (
    &wild_head=1
  )
  if (STRING.SCAN("&clk", "*", 1)==(STRING.LENGTH("&clk")-1))
  (
    &wild_tail=1
  )

  if ((&wild_head==1)&&(&wild_tail==1))
  (
    if (STRING.SCAN("gcc_qdss_tsctr_div16_clk", STRING.MID("&clk", 1, &clk_input_length-2), 0)!=-1)
    ( 
      &match=1
    )
  )
  else if (&wild_head==1)
  (
    if (STRING.MID("gcc_qdss_tsctr_div16_clk", &clk_itr_length-&clk_input_length+1, &clk_input_length-1)==STRING.CUT("&clk", 1))
    ( 
      &match=1
    )
  )
  else if (&wild_tail==1)
  (
    if (STRING.MID("gcc_qdss_tsctr_div16_clk", 0, &clk_input_length-1)==STRING.CUT("&clk", -1))
    ( 
      &match=1
    )
  )
  else if ("gcc_qdss_tsctr_div16_clk"=="&clk")
  (
    &match=1
  )
  
  if (&match==1)
  (
    &clk_test=&CLK_TEST_GCC_QDSS_TSCTR_DIV16_CLK
    &clk_reg=&HWIO_GCC_QDSS_TSCTR_DIV16_CBCR_ADDR
    &clk_reg_name="GCC_QDSS_TSCTR_DIV16_CBCR"
    &clk_name="gcc_qdss_tsctr_div16_clk"
    &clk_reg_cbcr_type="sm_cbc"
    &clk_vote_bit=-1.
    &clk_multiplier=4.
    &clk_access_mode="&GCC_access_mode"

    gosub Print_Clk_Info_Line
  )

  &match=0
  &wild_head=0
  &wild_tail=0
  &clk_input_length=STRING.LENGTH("&clk")
  &clk_itr_length=STRING.LENGTH("gcc_qdss_tsctr_div2_clk")

  if (STRING.SCAN("&clk", "*", 0)==0)
  (
    &wild_head=1
  )
  if (STRING.SCAN("&clk", "*", 1)==(STRING.LENGTH("&clk")-1))
  (
    &wild_tail=1
  )

  if ((&wild_head==1)&&(&wild_tail==1))
  (
    if (STRING.SCAN("gcc_qdss_tsctr_div2_clk", STRING.MID("&clk", 1, &clk_input_length-2), 0)!=-1)
    ( 
      &match=1
    )
  )
  else if (&wild_head==1)
  (
    if (STRING.MID("gcc_qdss_tsctr_div2_clk", &clk_itr_length-&clk_input_length+1, &clk_input_length-1)==STRING.CUT("&clk", 1))
    ( 
      &match=1
    )
  )
  else if (&wild_tail==1)
  (
    if (STRING.MID("gcc_qdss_tsctr_div2_clk", 0, &clk_input_length-1)==STRING.CUT("&clk", -1))
    ( 
      &match=1
    )
  )
  else if ("gcc_qdss_tsctr_div2_clk"=="&clk")
  (
    &match=1
  )
  
  if (&match==1)
  (
    &clk_test=&CLK_TEST_GCC_QDSS_TSCTR_DIV2_CLK
    &clk_reg=&HWIO_GCC_QDSS_TSCTR_DIV2_CBCR_ADDR
    &clk_reg_name="GCC_QDSS_TSCTR_DIV2_CBCR"
    &clk_name="gcc_qdss_tsctr_div2_clk"
    &clk_reg_cbcr_type="sm_cbc"
    &clk_vote_bit=-1.
    &clk_multiplier=4.
    &clk_access_mode="&GCC_access_mode"

    gosub Print_Clk_Info_Line
  )

  &match=0
  &wild_head=0
  &wild_tail=0
  &clk_input_length=STRING.LENGTH("&clk")
  &clk_itr_length=STRING.LENGTH("gcc_qdss_tsctr_div3_clk")

  if (STRING.SCAN("&clk", "*", 0)==0)
  (
    &wild_head=1
  )
  if (STRING.SCAN("&clk", "*", 1)==(STRING.LENGTH("&clk")-1))
  (
    &wild_tail=1
  )

  if ((&wild_head==1)&&(&wild_tail==1))
  (
    if (STRING.SCAN("gcc_qdss_tsctr_div3_clk", STRING.MID("&clk", 1, &clk_input_length-2), 0)!=-1)
    ( 
      &match=1
    )
  )
  else if (&wild_head==1)
  (
    if (STRING.MID("gcc_qdss_tsctr_div3_clk", &clk_itr_length-&clk_input_length+1, &clk_input_length-1)==STRING.CUT("&clk", 1))
    ( 
      &match=1
    )
  )
  else if (&wild_tail==1)
  (
    if (STRING.MID("gcc_qdss_tsctr_div3_clk", 0, &clk_input_length-1)==STRING.CUT("&clk", -1))
    ( 
      &match=1
    )
  )
  else if ("gcc_qdss_tsctr_div3_clk"=="&clk")
  (
    &match=1
  )
  
  if (&match==1)
  (
    &clk_test=&CLK_TEST_GCC_QDSS_TSCTR_DIV3_CLK
    &clk_reg=&HWIO_GCC_QDSS_TSCTR_DIV3_CBCR_ADDR
    &clk_reg_name="GCC_QDSS_TSCTR_DIV3_CBCR"
    &clk_name="gcc_qdss_tsctr_div3_clk"
    &clk_reg_cbcr_type="sm_cbc"
    &clk_vote_bit=-1.
    &clk_multiplier=4.
    &clk_access_mode="&GCC_access_mode"

    gosub Print_Clk_Info_Line
  )

  &match=0
  &wild_head=0
  &wild_tail=0
  &clk_input_length=STRING.LENGTH("&clk")
  &clk_itr_length=STRING.LENGTH("gcc_qdss_tsctr_div4_clk")

  if (STRING.SCAN("&clk", "*", 0)==0)
  (
    &wild_head=1
  )
  if (STRING.SCAN("&clk", "*", 1)==(STRING.LENGTH("&clk")-1))
  (
    &wild_tail=1
  )

  if ((&wild_head==1)&&(&wild_tail==1))
  (
    if (STRING.SCAN("gcc_qdss_tsctr_div4_clk", STRING.MID("&clk", 1, &clk_input_length-2), 0)!=-1)
    ( 
      &match=1
    )
  )
  else if (&wild_head==1)
  (
    if (STRING.MID("gcc_qdss_tsctr_div4_clk", &clk_itr_length-&clk_input_length+1, &clk_input_length-1)==STRING.CUT("&clk", 1))
    ( 
      &match=1
    )
  )
  else if (&wild_tail==1)
  (
    if (STRING.MID("gcc_qdss_tsctr_div4_clk", 0, &clk_input_length-1)==STRING.CUT("&clk", -1))
    ( 
      &match=1
    )
  )
  else if ("gcc_qdss_tsctr_div4_clk"=="&clk")
  (
    &match=1
  )
  
  if (&match==1)
  (
    &clk_test=&CLK_TEST_GCC_QDSS_TSCTR_DIV4_CLK
    &clk_reg=&HWIO_GCC_QDSS_TSCTR_DIV4_CBCR_ADDR
    &clk_reg_name="GCC_QDSS_TSCTR_DIV4_CBCR"
    &clk_name="gcc_qdss_tsctr_div4_clk"
    &clk_reg_cbcr_type="sm_cbc"
    &clk_vote_bit=-1.
    &clk_multiplier=4.
    &clk_access_mode="&GCC_access_mode"

    gosub Print_Clk_Info_Line
  )

  &match=0
  &wild_head=0
  &wild_tail=0
  &clk_input_length=STRING.LENGTH("&clk")
  &clk_itr_length=STRING.LENGTH("gcc_qdss_tsctr_div8_clk")

  if (STRING.SCAN("&clk", "*", 0)==0)
  (
    &wild_head=1
  )
  if (STRING.SCAN("&clk", "*", 1)==(STRING.LENGTH("&clk")-1))
  (
    &wild_tail=1
  )

  if ((&wild_head==1)&&(&wild_tail==1))
  (
    if (STRING.SCAN("gcc_qdss_tsctr_div8_clk", STRING.MID("&clk", 1, &clk_input_length-2), 0)!=-1)
    ( 
      &match=1
    )
  )
  else if (&wild_head==1)
  (
    if (STRING.MID("gcc_qdss_tsctr_div8_clk", &clk_itr_length-&clk_input_length+1, &clk_input_length-1)==STRING.CUT("&clk", 1))
    ( 
      &match=1
    )
  )
  else if (&wild_tail==1)
  (
    if (STRING.MID("gcc_qdss_tsctr_div8_clk", 0, &clk_input_length-1)==STRING.CUT("&clk", -1))
    ( 
      &match=1
    )
  )
  else if ("gcc_qdss_tsctr_div8_clk"=="&clk")
  (
    &match=1
  )
  
  if (&match==1)
  (
    &clk_test=&CLK_TEST_GCC_QDSS_TSCTR_DIV8_CLK
    &clk_reg=&HWIO_GCC_QDSS_TSCTR_DIV8_CBCR_ADDR
    &clk_reg_name="GCC_QDSS_TSCTR_DIV8_CBCR"
    &clk_name="gcc_qdss_tsctr_div8_clk"
    &clk_reg_cbcr_type="sm_cbc"
    &clk_vote_bit=-1.
    &clk_multiplier=4.
    &clk_access_mode="&GCC_access_mode"

    gosub Print_Clk_Info_Line
  )

  &match=0
  &wild_head=0
  &wild_tail=0
  &clk_input_length=STRING.LENGTH("&clk")
  &clk_itr_length=STRING.LENGTH("gcc_wcss_tsctr_div2_clk")

  if (STRING.SCAN("&clk", "*", 0)==0)
  (
    &wild_head=1
  )
  if (STRING.SCAN("&clk", "*", 1)==(STRING.LENGTH("&clk")-1))
  (
    &wild_tail=1
  )

  if ((&wild_head==1)&&(&wild_tail==1))
  (
    if (STRING.SCAN("gcc_wcss_tsctr_div2_clk", STRING.MID("&clk", 1, &clk_input_length-2), 0)!=-1)
    ( 
      &match=1
    )
  )
  else if (&wild_head==1)
  (
    if (STRING.MID("gcc_wcss_tsctr_div2_clk", &clk_itr_length-&clk_input_length+1, &clk_input_length-1)==STRING.CUT("&clk", 1))
    ( 
      &match=1
    )
  )
  else if (&wild_tail==1)
  (
    if (STRING.MID("gcc_wcss_tsctr_div2_clk", 0, &clk_input_length-1)==STRING.CUT("&clk", -1))
    ( 
      &match=1
    )
  )
  else if ("gcc_wcss_tsctr_div2_clk"=="&clk")
  (
    &match=1
  )
  
  if (&match==1)
  (
    &clk_test=&CLK_TEST_GCC_WCSS_TSCTR_DIV2_CLK
    &clk_reg=&HWIO_GCC_WCSS_TSCTR_DIV2_CBCR_ADDR
    &clk_reg_name="GCC_WCSS_TSCTR_DIV2_CBCR"
    &clk_name="gcc_wcss_tsctr_div2_clk"
    &clk_reg_cbcr_type="sm_cbc"
    &clk_vote_bit=-1.
    &clk_multiplier=4.
    &clk_access_mode="&GCC_access_mode"

    gosub Print_Clk_Info_Line
  )

  &match=0
  &wild_head=0
  &wild_tail=0
  &clk_input_length=STRING.LENGTH("&clk")
  &clk_itr_length=STRING.LENGTH("gcc_qspi_ser_clk")

  if (STRING.SCAN("&clk", "*", 0)==0)
  (
    &wild_head=1
  )
  if (STRING.SCAN("&clk", "*", 1)==(STRING.LENGTH("&clk")-1))
  (
    &wild_tail=1
  )

  if ((&wild_head==1)&&(&wild_tail==1))
  (
    if (STRING.SCAN("gcc_qspi_ser_clk", STRING.MID("&clk", 1, &clk_input_length-2), 0)!=-1)
    ( 
      &match=1
    )
  )
  else if (&wild_head==1)
  (
    if (STRING.MID("gcc_qspi_ser_clk", &clk_itr_length-&clk_input_length+1, &clk_input_length-1)==STRING.CUT("&clk", 1))
    ( 
      &match=1
    )
  )
  else if (&wild_tail==1)
  (
    if (STRING.MID("gcc_qspi_ser_clk", 0, &clk_input_length-1)==STRING.CUT("&clk", -1))
    ( 
      &match=1
    )
  )
  else if ("gcc_qspi_ser_clk"=="&clk")
  (
    &match=1
  )
  
  if (&match==1)
  (
    &clk_test=&CLK_TEST_GCC_QSPI_SER_CLK
    &clk_reg=&HWIO_GCC_QSPI_SER_CBCR_ADDR
    &clk_reg_name="GCC_QSPI_SER_CBCR"
    &clk_name="gcc_qspi_ser_clk"
    &clk_reg_cbcr_type="sm_cbc"
    &clk_vote_bit=-1.
    &clk_multiplier=4.
    &clk_access_mode="&GCC_access_mode"

    gosub Print_Clk_Info_Line
  )

  &match=0
  &wild_head=0
  &wild_tail=0
  &clk_input_length=STRING.LENGTH("&clk")
  &clk_itr_length=STRING.LENGTH("gcc_rbcpr_cx_clk")

  if (STRING.SCAN("&clk", "*", 0)==0)
  (
    &wild_head=1
  )
  if (STRING.SCAN("&clk", "*", 1)==(STRING.LENGTH("&clk")-1))
  (
    &wild_tail=1
  )

  if ((&wild_head==1)&&(&wild_tail==1))
  (
    if (STRING.SCAN("gcc_rbcpr_cx_clk", STRING.MID("&clk", 1, &clk_input_length-2), 0)!=-1)
    ( 
      &match=1
    )
  )
  else if (&wild_head==1)
  (
    if (STRING.MID("gcc_rbcpr_cx_clk", &clk_itr_length-&clk_input_length+1, &clk_input_length-1)==STRING.CUT("&clk", 1))
    ( 
      &match=1
    )
  )
  else if (&wild_tail==1)
  (
    if (STRING.MID("gcc_rbcpr_cx_clk", 0, &clk_input_length-1)==STRING.CUT("&clk", -1))
    ( 
      &match=1
    )
  )
  else if ("gcc_rbcpr_cx_clk"=="&clk")
  (
    &match=1
  )
  
  if (&match==1)
  (
    &clk_test=&CLK_TEST_GCC_RBCPR_CX_CLK
    &clk_reg=&HWIO_GCC_RBCPR_CX_CBCR_ADDR
    &clk_reg_name="GCC_RBCPR_CX_CBCR"
    &clk_name="gcc_rbcpr_cx_clk"
    &clk_reg_cbcr_type="sm_cbc"
    &clk_vote_bit=-1.
    &clk_multiplier=4.
    &clk_access_mode="&GCC_access_mode"

    gosub Print_Clk_Info_Line
  )

  &match=0
  &wild_head=0
  &wild_tail=0
  &clk_input_length=STRING.LENGTH("&clk")
  &clk_itr_length=STRING.LENGTH("gcc_rbcpr_mx_clk")

  if (STRING.SCAN("&clk", "*", 0)==0)
  (
    &wild_head=1
  )
  if (STRING.SCAN("&clk", "*", 1)==(STRING.LENGTH("&clk")-1))
  (
    &wild_tail=1
  )

  if ((&wild_head==1)&&(&wild_tail==1))
  (
    if (STRING.SCAN("gcc_rbcpr_mx_clk", STRING.MID("&clk", 1, &clk_input_length-2), 0)!=-1)
    ( 
      &match=1
    )
  )
  else if (&wild_head==1)
  (
    if (STRING.MID("gcc_rbcpr_mx_clk", &clk_itr_length-&clk_input_length+1, &clk_input_length-1)==STRING.CUT("&clk", 1))
    ( 
      &match=1
    )
  )
  else if (&wild_tail==1)
  (
    if (STRING.MID("gcc_rbcpr_mx_clk", 0, &clk_input_length-1)==STRING.CUT("&clk", -1))
    ( 
      &match=1
    )
  )
  else if ("gcc_rbcpr_mx_clk"=="&clk")
  (
    &match=1
  )
  
  if (&match==1)
  (
    &clk_test=&CLK_TEST_GCC_RBCPR_MX_CLK
    &clk_reg=&HWIO_GCC_RBCPR_MX_CBCR_ADDR
    &clk_reg_name="GCC_RBCPR_MX_CBCR"
    &clk_name="gcc_rbcpr_mx_clk"
    &clk_reg_cbcr_type="sm_cbc"
    &clk_vote_bit=-1.
    &clk_multiplier=4.
    &clk_access_mode="&GCC_access_mode"

    gosub Print_Clk_Info_Line
  )

  &match=0
  &wild_head=0
  &wild_tail=0
  &clk_input_length=STRING.LENGTH("&clk")
  &clk_itr_length=STRING.LENGTH("gcc_rpm_bus_ahb_clk")

  if (STRING.SCAN("&clk", "*", 0)==0)
  (
    &wild_head=1
  )
  if (STRING.SCAN("&clk", "*", 1)==(STRING.LENGTH("&clk")-1))
  (
    &wild_tail=1
  )

  if ((&wild_head==1)&&(&wild_tail==1))
  (
    if (STRING.SCAN("gcc_rpm_bus_ahb_clk", STRING.MID("&clk", 1, &clk_input_length-2), 0)!=-1)
    ( 
      &match=1
    )
  )
  else if (&wild_head==1)
  (
    if (STRING.MID("gcc_rpm_bus_ahb_clk", &clk_itr_length-&clk_input_length+1, &clk_input_length-1)==STRING.CUT("&clk", 1))
    ( 
      &match=1
    )
  )
  else if (&wild_tail==1)
  (
    if (STRING.MID("gcc_rpm_bus_ahb_clk", 0, &clk_input_length-1)==STRING.CUT("&clk", -1))
    ( 
      &match=1
    )
  )
  else if ("gcc_rpm_bus_ahb_clk"=="&clk")
  (
    &match=1
  )
  
  if (&match==1)
  (
    &clk_test=&CLK_TEST_GCC_RPM_BUS_AHB_CLK
    &clk_reg=&HWIO_GCC_RPM_BUS_AHB_CBCR_ADDR
    &clk_reg_name="GCC_RPM_BUS_AHB_CBCR"
    &clk_name="gcc_rpm_bus_ahb_clk"
    &clk_reg_cbcr_type="sm_pscbc"
    &clk_vote_bit=-1.
    &clk_multiplier=4.
    &clk_access_mode="&GCC_access_mode"

    gosub Print_Clk_Info_Line
  )

  &match=0
  &wild_head=0
  &wild_tail=0
  &clk_input_length=STRING.LENGTH("&clk")
  &clk_itr_length=STRING.LENGTH("gcc_rpm_proc_fclk")

  if (STRING.SCAN("&clk", "*", 0)==0)
  (
    &wild_head=1
  )
  if (STRING.SCAN("&clk", "*", 1)==(STRING.LENGTH("&clk")-1))
  (
    &wild_tail=1
  )

  if ((&wild_head==1)&&(&wild_tail==1))
  (
    if (STRING.SCAN("gcc_rpm_proc_fclk", STRING.MID("&clk", 1, &clk_input_length-2), 0)!=-1)
    ( 
      &match=1
    )
  )
  else if (&wild_head==1)
  (
    if (STRING.MID("gcc_rpm_proc_fclk", &clk_itr_length-&clk_input_length+1, &clk_input_length-1)==STRING.CUT("&clk", 1))
    ( 
      &match=1
    )
  )
  else if (&wild_tail==1)
  (
    if (STRING.MID("gcc_rpm_proc_fclk", 0, &clk_input_length-1)==STRING.CUT("&clk", -1))
    ( 
      &match=1
    )
  )
  else if ("gcc_rpm_proc_fclk"=="&clk")||("cpus"=="&clk")
  (
    &match=1
  )
  
  if (&match==1)
  (
    &clk_test=&CLK_TEST_GCC_RPM_PROC_FCLK
    &clk_reg=0
    &clk_reg_name="No CBCR"
    &clk_name="gcc_rpm_proc_fclk"
    &clk_reg_cbcr_type=""
    &clk_vote_bit=-1.
    &clk_multiplier=4.
    &clk_access_mode="&GCC_access_mode"

    gosub Print_Clk_Info_Line
  )

  &match=0
  &wild_head=0
  &wild_tail=0
  &clk_input_length=STRING.LENGTH("&clk")
  &clk_itr_length=STRING.LENGTH("gcc_rpm_proc_hclk")

  if (STRING.SCAN("&clk", "*", 0)==0)
  (
    &wild_head=1
  )
  if (STRING.SCAN("&clk", "*", 1)==(STRING.LENGTH("&clk")-1))
  (
    &wild_tail=1
  )

  if ((&wild_head==1)&&(&wild_tail==1))
  (
    if (STRING.SCAN("gcc_rpm_proc_hclk", STRING.MID("&clk", 1, &clk_input_length-2), 0)!=-1)
    ( 
      &match=1
    )
  )
  else if (&wild_head==1)
  (
    if (STRING.MID("gcc_rpm_proc_hclk", &clk_itr_length-&clk_input_length+1, &clk_input_length-1)==STRING.CUT("&clk", 1))
    ( 
      &match=1
    )
  )
  else if (&wild_tail==1)
  (
    if (STRING.MID("gcc_rpm_proc_hclk", 0, &clk_input_length-1)==STRING.CUT("&clk", -1))
    ( 
      &match=1
    )
  )
  else if ("gcc_rpm_proc_hclk"=="&clk")
  (
    &match=1
  )
  
  if (&match==1)
  (
    &clk_test=&CLK_TEST_GCC_RPM_PROC_HCLK
    &clk_reg=&HWIO_GCC_RPM_PROC_HCLK_CBCR_ADDR
    &clk_reg_name="GCC_RPM_PROC_HCLK_CBCR"
    &clk_name="gcc_rpm_proc_hclk"
    &clk_reg_cbcr_type="sm_cbc"
    &clk_vote_bit=-1.
    &clk_multiplier=4.
    &clk_access_mode="&GCC_access_mode"

    gosub Print_Clk_Info_Line
  )

  &match=0
  &wild_head=0
  &wild_tail=0
  &clk_input_length=STRING.LENGTH("&clk")
  &clk_itr_length=STRING.LENGTH("gcc_spdm_rpm_cy_clk")

  if (STRING.SCAN("&clk", "*", 0)==0)
  (
    &wild_head=1
  )
  if (STRING.SCAN("&clk", "*", 1)==(STRING.LENGTH("&clk")-1))
  (
    &wild_tail=1
  )

  if ((&wild_head==1)&&(&wild_tail==1))
  (
    if (STRING.SCAN("gcc_spdm_rpm_cy_clk", STRING.MID("&clk", 1, &clk_input_length-2), 0)!=-1)
    ( 
      &match=1
    )
  )
  else if (&wild_head==1)
  (
    if (STRING.MID("gcc_spdm_rpm_cy_clk", &clk_itr_length-&clk_input_length+1, &clk_input_length-1)==STRING.CUT("&clk", 1))
    ( 
      &match=1
    )
  )
  else if (&wild_tail==1)
  (
    if (STRING.MID("gcc_spdm_rpm_cy_clk", 0, &clk_input_length-1)==STRING.CUT("&clk", -1))
    ( 
      &match=1
    )
  )
  else if ("gcc_spdm_rpm_cy_clk"=="&clk")
  (
    &match=1
  )
  
  if (&match==1)
  (
    &clk_test=&CLK_TEST_GCC_SPDM_RPM_CY_CLK
    &clk_reg=&HWIO_GCC_SPDM_RPM_CY_CBCR_ADDR
    &clk_reg_name="GCC_SPDM_RPM_CY_CBCR"
    &clk_name="gcc_spdm_rpm_cy_clk"
    &clk_reg_cbcr_type="sm_cbc"
    &clk_vote_bit=-1.
    &clk_multiplier=4.
    &clk_access_mode="&GCC_access_mode"

    gosub Print_Clk_Info_Line
  )

  &match=0
  &wild_head=0
  &wild_tail=0
  &clk_input_length=STRING.LENGTH("&clk")
  &clk_itr_length=STRING.LENGTH("gcc_sdcc1_apps_clk")

  if (STRING.SCAN("&clk", "*", 0)==0)
  (
    &wild_head=1
  )
  if (STRING.SCAN("&clk", "*", 1)==(STRING.LENGTH("&clk")-1))
  (
    &wild_tail=1
  )

  if ((&wild_head==1)&&(&wild_tail==1))
  (
    if (STRING.SCAN("gcc_sdcc1_apps_clk", STRING.MID("&clk", 1, &clk_input_length-2), 0)!=-1)
    ( 
      &match=1
    )
  )
  else if (&wild_head==1)
  (
    if (STRING.MID("gcc_sdcc1_apps_clk", &clk_itr_length-&clk_input_length+1, &clk_input_length-1)==STRING.CUT("&clk", 1))
    ( 
      &match=1
    )
  )
  else if (&wild_tail==1)
  (
    if (STRING.MID("gcc_sdcc1_apps_clk", 0, &clk_input_length-1)==STRING.CUT("&clk", -1))
    ( 
      &match=1
    )
  )
  else if ("gcc_sdcc1_apps_clk"=="&clk")
  (
    &match=1
  )
  
  if (&match==1)
  (
    &clk_test=&CLK_TEST_GCC_SDCC1_APPS_CLK
    &clk_reg=&HWIO_GCC_SDCC1_APPS_CBCR_ADDR
    &clk_reg_name="GCC_SDCC1_APPS_CBCR"
    &clk_name="gcc_sdcc1_apps_clk"
    &clk_reg_cbcr_type="sm_pscbc"
    &clk_vote_bit=-1.
    &clk_multiplier=4.
    &clk_access_mode="&GCC_access_mode"

    gosub Print_Clk_Info_Line
  )

  &match=0
  &wild_head=0
  &wild_tail=0
  &clk_input_length=STRING.LENGTH("&clk")
  &clk_itr_length=STRING.LENGTH("gcc_sdcc1_ice_core_clk")

  if (STRING.SCAN("&clk", "*", 0)==0)
  (
    &wild_head=1
  )
  if (STRING.SCAN("&clk", "*", 1)==(STRING.LENGTH("&clk")-1))
  (
    &wild_tail=1
  )

  if ((&wild_head==1)&&(&wild_tail==1))
  (
    if (STRING.SCAN("gcc_sdcc1_ice_core_clk", STRING.MID("&clk", 1, &clk_input_length-2), 0)!=-1)
    ( 
      &match=1
    )
  )
  else if (&wild_head==1)
  (
    if (STRING.MID("gcc_sdcc1_ice_core_clk", &clk_itr_length-&clk_input_length+1, &clk_input_length-1)==STRING.CUT("&clk", 1))
    ( 
      &match=1
    )
  )
  else if (&wild_tail==1)
  (
    if (STRING.MID("gcc_sdcc1_ice_core_clk", 0, &clk_input_length-1)==STRING.CUT("&clk", -1))
    ( 
      &match=1
    )
  )
  else if ("gcc_sdcc1_ice_core_clk"=="&clk")
  (
    &match=1
  )
  
  if (&match==1)
  (
    &clk_test=&CLK_TEST_GCC_SDCC1_ICE_CORE_CLK
    &clk_reg=&HWIO_GCC_SDCC1_ICE_CORE_CBCR_ADDR
    &clk_reg_name="GCC_SDCC1_ICE_CORE_CBCR"
    &clk_name="gcc_sdcc1_ice_core_clk"
    &clk_reg_cbcr_type="sm_pscbc"
    &clk_vote_bit=-1.
    &clk_multiplier=4.
    &clk_access_mode="&GCC_access_mode"

    gosub Print_Clk_Info_Line
  )

  &match=0
  &wild_head=0
  &wild_tail=0
  &clk_input_length=STRING.LENGTH("&clk")
  &clk_itr_length=STRING.LENGTH("gcc_sdcc2_apps_clk")

  if (STRING.SCAN("&clk", "*", 0)==0)
  (
    &wild_head=1
  )
  if (STRING.SCAN("&clk", "*", 1)==(STRING.LENGTH("&clk")-1))
  (
    &wild_tail=1
  )

  if ((&wild_head==1)&&(&wild_tail==1))
  (
    if (STRING.SCAN("gcc_sdcc2_apps_clk", STRING.MID("&clk", 1, &clk_input_length-2), 0)!=-1)
    ( 
      &match=1
    )
  )
  else if (&wild_head==1)
  (
    if (STRING.MID("gcc_sdcc2_apps_clk", &clk_itr_length-&clk_input_length+1, &clk_input_length-1)==STRING.CUT("&clk", 1))
    ( 
      &match=1
    )
  )
  else if (&wild_tail==1)
  (
    if (STRING.MID("gcc_sdcc2_apps_clk", 0, &clk_input_length-1)==STRING.CUT("&clk", -1))
    ( 
      &match=1
    )
  )
  else if ("gcc_sdcc2_apps_clk"=="&clk")
  (
    &match=1
  )
  
  if (&match==1)
  (
    &clk_test=&CLK_TEST_GCC_SDCC2_APPS_CLK
    &clk_reg=&HWIO_GCC_SDCC2_APPS_CBCR_ADDR
    &clk_reg_name="GCC_SDCC2_APPS_CBCR"
    &clk_name="gcc_sdcc2_apps_clk"
    &clk_reg_cbcr_type="sm_pscbc"
    &clk_vote_bit=-1.
    &clk_multiplier=4.
    &clk_access_mode="&GCC_access_mode"

    gosub Print_Clk_Info_Line
  )

  &match=0
  &wild_head=0
  &wild_tail=0
  &clk_input_length=STRING.LENGTH("&clk")
  &clk_itr_length=STRING.LENGTH("gcc_sec_ctrl_clk")

  if (STRING.SCAN("&clk", "*", 0)==0)
  (
    &wild_head=1
  )
  if (STRING.SCAN("&clk", "*", 1)==(STRING.LENGTH("&clk")-1))
  (
    &wild_tail=1
  )

  if ((&wild_head==1)&&(&wild_tail==1))
  (
    if (STRING.SCAN("gcc_sec_ctrl_clk", STRING.MID("&clk", 1, &clk_input_length-2), 0)!=-1)
    ( 
      &match=1
    )
  )
  else if (&wild_head==1)
  (
    if (STRING.MID("gcc_sec_ctrl_clk", &clk_itr_length-&clk_input_length+1, &clk_input_length-1)==STRING.CUT("&clk", 1))
    ( 
      &match=1
    )
  )
  else if (&wild_tail==1)
  (
    if (STRING.MID("gcc_sec_ctrl_clk", 0, &clk_input_length-1)==STRING.CUT("&clk", -1))
    ( 
      &match=1
    )
  )
  else if ("gcc_sec_ctrl_clk"=="&clk")
  (
    &match=1
  )
  
  if (&match==1)
  (
    &clk_test=&CLK_TEST_GCC_SEC_CTRL_CLK
    &clk_reg=&HWIO_GCC_SEC_CTRL_CBCR_ADDR
    &clk_reg_name="GCC_SEC_CTRL_CBCR"
    &clk_name="gcc_sec_ctrl_clk"
    &clk_reg_cbcr_type="sm_pscbc"
    &clk_vote_bit=-1.
    &clk_multiplier=4.
    &clk_access_mode="&GCC_access_mode"

    gosub Print_Clk_Info_Line
  )

  &match=0
  &wild_head=0
  &wild_tail=0
  &clk_input_length=STRING.LENGTH("&clk")
  &clk_itr_length=STRING.LENGTH("gcc_sec_ctrl_sense_clk")

  if (STRING.SCAN("&clk", "*", 0)==0)
  (
    &wild_head=1
  )
  if (STRING.SCAN("&clk", "*", 1)==(STRING.LENGTH("&clk")-1))
  (
    &wild_tail=1
  )

  if ((&wild_head==1)&&(&wild_tail==1))
  (
    if (STRING.SCAN("gcc_sec_ctrl_sense_clk", STRING.MID("&clk", 1, &clk_input_length-2), 0)!=-1)
    ( 
      &match=1
    )
  )
  else if (&wild_head==1)
  (
    if (STRING.MID("gcc_sec_ctrl_sense_clk", &clk_itr_length-&clk_input_length+1, &clk_input_length-1)==STRING.CUT("&clk", 1))
    ( 
      &match=1
    )
  )
  else if (&wild_tail==1)
  (
    if (STRING.MID("gcc_sec_ctrl_sense_clk", 0, &clk_input_length-1)==STRING.CUT("&clk", -1))
    ( 
      &match=1
    )
  )
  else if ("gcc_sec_ctrl_sense_clk"=="&clk")
  (
    &match=1
  )
  
  if (&match==1)
  (
    &clk_test=&CLK_TEST_GCC_SEC_CTRL_SENSE_CLK
    &clk_reg=&HWIO_GCC_SEC_CTRL_SENSE_CBCR_ADDR
    &clk_reg_name="GCC_SEC_CTRL_SENSE_CBCR"
    &clk_name="gcc_sec_ctrl_sense_clk"
    &clk_reg_cbcr_type="sm_cbc"
    &clk_vote_bit=-1.
    &clk_multiplier=4.
    &clk_access_mode="&GCC_access_mode"

    gosub Print_Clk_Info_Line
  )

  &match=0
  &wild_head=0
  &wild_tail=0
  &clk_input_length=STRING.LENGTH("&clk")
  &clk_itr_length=STRING.LENGTH("gcc_spmi_ahb_clk")

  if (STRING.SCAN("&clk", "*", 0)==0)
  (
    &wild_head=1
  )
  if (STRING.SCAN("&clk", "*", 1)==(STRING.LENGTH("&clk")-1))
  (
    &wild_tail=1
  )

  if ((&wild_head==1)&&(&wild_tail==1))
  (
    if (STRING.SCAN("gcc_spmi_ahb_clk", STRING.MID("&clk", 1, &clk_input_length-2), 0)!=-1)
    ( 
      &match=1
    )
  )
  else if (&wild_head==1)
  (
    if (STRING.MID("gcc_spmi_ahb_clk", &clk_itr_length-&clk_input_length+1, &clk_input_length-1)==STRING.CUT("&clk", 1))
    ( 
      &match=1
    )
  )
  else if (&wild_tail==1)
  (
    if (STRING.MID("gcc_spmi_ahb_clk", 0, &clk_input_length-1)==STRING.CUT("&clk", -1))
    ( 
      &match=1
    )
  )
  else if ("gcc_spmi_ahb_clk"=="&clk")
  (
    &match=1
  )
  
  if (&match==1)
  (
    &clk_test=&CLK_TEST_GCC_SPMI_AHB_CLK
    &clk_reg=&HWIO_GCC_SPMI_AHB_CBCR_ADDR
    &clk_reg_name="GCC_SPMI_AHB_CBCR"
    &clk_name="gcc_spmi_ahb_clk"
    &clk_reg_cbcr_type="sm_pscbc"
    &clk_vote_bit=-1.
    &clk_multiplier=4.
    &clk_access_mode="&GCC_access_mode"

    gosub Print_Clk_Info_Line
  )

  &match=0
  &wild_head=0
  &wild_tail=0
  &clk_input_length=STRING.LENGTH("&clk")
  &clk_itr_length=STRING.LENGTH("gcc_spmi_ser_clk")

  if (STRING.SCAN("&clk", "*", 0)==0)
  (
    &wild_head=1
  )
  if (STRING.SCAN("&clk", "*", 1)==(STRING.LENGTH("&clk")-1))
  (
    &wild_tail=1
  )

  if ((&wild_head==1)&&(&wild_tail==1))
  (
    if (STRING.SCAN("gcc_spmi_ser_clk", STRING.MID("&clk", 1, &clk_input_length-2), 0)!=-1)
    ( 
      &match=1
    )
  )
  else if (&wild_head==1)
  (
    if (STRING.MID("gcc_spmi_ser_clk", &clk_itr_length-&clk_input_length+1, &clk_input_length-1)==STRING.CUT("&clk", 1))
    ( 
      &match=1
    )
  )
  else if (&wild_tail==1)
  (
    if (STRING.MID("gcc_spmi_ser_clk", 0, &clk_input_length-1)==STRING.CUT("&clk", -1))
    ( 
      &match=1
    )
  )
  else if ("gcc_spmi_ser_clk"=="&clk")
  (
    &match=1
  )
  
  if (&match==1)
  (
    &clk_test=&CLK_TEST_GCC_SPMI_SER_CLK
    &clk_reg=&HWIO_GCC_SPMI_SER_CBCR_ADDR
    &clk_reg_name="GCC_SPMI_SER_CBCR"
    &clk_name="gcc_spmi_ser_clk"
    &clk_reg_cbcr_type="sm_pscbc"
    &clk_vote_bit=-1.
    &clk_multiplier=4.
    &clk_access_mode="&GCC_access_mode"

    gosub Print_Clk_Info_Line
  )

  &match=0
  &wild_head=0
  &wild_tail=0
  &clk_input_length=STRING.LENGTH("&clk")
  &clk_itr_length=STRING.LENGTH("gcc_bimc_nius_hs_axi_clk")

  if (STRING.SCAN("&clk", "*", 0)==0)
  (
    &wild_head=1
  )
  if (STRING.SCAN("&clk", "*", 1)==(STRING.LENGTH("&clk")-1))
  (
    &wild_tail=1
  )

  if ((&wild_head==1)&&(&wild_tail==1))
  (
    if (STRING.SCAN("gcc_bimc_nius_hs_axi_clk", STRING.MID("&clk", 1, &clk_input_length-2), 0)!=-1)
    ( 
      &match=1
    )
  )
  else if (&wild_head==1)
  (
    if (STRING.MID("gcc_bimc_nius_hs_axi_clk", &clk_itr_length-&clk_input_length+1, &clk_input_length-1)==STRING.CUT("&clk", 1))
    ( 
      &match=1
    )
  )
  else if (&wild_tail==1)
  (
    if (STRING.MID("gcc_bimc_nius_hs_axi_clk", 0, &clk_input_length-1)==STRING.CUT("&clk", -1))
    ( 
      &match=1
    )
  )
  else if ("gcc_bimc_nius_hs_axi_clk"=="&clk")
  (
    &match=1
  )
  
  if (&match==1)
  (
    &clk_test=&CLK_TEST_GCC_BIMC_NIUS_HS_AXI_CLK
    &clk_reg=&HWIO_GCC_BIMC_NIUS_HS_AXI_CBCR_ADDR
    &clk_reg_name="GCC_BIMC_NIUS_HS_AXI_CBCR"
    &clk_name="gcc_bimc_nius_hs_axi_clk"
    &clk_reg_cbcr_type="sm_cbc"
    &clk_vote_bit=-1.
    &clk_multiplier=4.
    &clk_access_mode="&GCC_access_mode"

    gosub Print_Clk_Info_Line
  )

  &match=0
  &wild_head=0
  &wild_tail=0
  &clk_input_length=STRING.LENGTH("&clk")
  &clk_itr_length=STRING.LENGTH("gcc_bimc_sysnoc_hs_axi_clk")

  if (STRING.SCAN("&clk", "*", 0)==0)
  (
    &wild_head=1
  )
  if (STRING.SCAN("&clk", "*", 1)==(STRING.LENGTH("&clk")-1))
  (
    &wild_tail=1
  )

  if ((&wild_head==1)&&(&wild_tail==1))
  (
    if (STRING.SCAN("gcc_bimc_sysnoc_hs_axi_clk", STRING.MID("&clk", 1, &clk_input_length-2), 0)!=-1)
    ( 
      &match=1
    )
  )
  else if (&wild_head==1)
  (
    if (STRING.MID("gcc_bimc_sysnoc_hs_axi_clk", &clk_itr_length-&clk_input_length+1, &clk_input_length-1)==STRING.CUT("&clk", 1))
    ( 
      &match=1
    )
  )
  else if (&wild_tail==1)
  (
    if (STRING.MID("gcc_bimc_sysnoc_hs_axi_clk", 0, &clk_input_length-1)==STRING.CUT("&clk", -1))
    ( 
      &match=1
    )
  )
  else if ("gcc_bimc_sysnoc_hs_axi_clk"=="&clk")
  (
    &match=1
  )
  
  if (&match==1)
  (
    &clk_test=&CLK_TEST_GCC_BIMC_SYSNOC_HS_AXI_CLK
    &clk_reg=&HWIO_GCC_BIMC_SYSNOC_HS_AXI_CBCR_ADDR
    &clk_reg_name="GCC_BIMC_SYSNOC_HS_AXI_CBCR"
    &clk_name="gcc_bimc_sysnoc_hs_axi_clk"
    &clk_reg_cbcr_type="sm_cbc"
    &clk_vote_bit=-1.
    &clk_multiplier=4.
    &clk_access_mode="&GCC_access_mode"

    gosub Print_Clk_Info_Line
  )

  &match=0
  &wild_head=0
  &wild_tail=0
  &clk_input_length=STRING.LENGTH("&clk")
  &clk_itr_length=STRING.LENGTH("gcc_lpass_q6_axi_clk")

  if (STRING.SCAN("&clk", "*", 0)==0)
  (
    &wild_head=1
  )
  if (STRING.SCAN("&clk", "*", 1)==(STRING.LENGTH("&clk")-1))
  (
    &wild_tail=1
  )

  if ((&wild_head==1)&&(&wild_tail==1))
  (
    if (STRING.SCAN("gcc_lpass_q6_axi_clk", STRING.MID("&clk", 1, &clk_input_length-2), 0)!=-1)
    ( 
      &match=1
    )
  )
  else if (&wild_head==1)
  (
    if (STRING.MID("gcc_lpass_q6_axi_clk", &clk_itr_length-&clk_input_length+1, &clk_input_length-1)==STRING.CUT("&clk", 1))
    ( 
      &match=1
    )
  )
  else if (&wild_tail==1)
  (
    if (STRING.MID("gcc_lpass_q6_axi_clk", 0, &clk_input_length-1)==STRING.CUT("&clk", -1))
    ( 
      &match=1
    )
  )
  else if ("gcc_lpass_q6_axi_clk"=="&clk")
  (
    &match=1
  )
  
  if (&match==1)
  (
    &clk_test=&CLK_TEST_GCC_LPASS_Q6_AXI_CLK
    &clk_reg=&HWIO_GCC_LPASS_Q6_AXI_CBCR_ADDR
    &clk_reg_name="GCC_LPASS_Q6_AXI_CBCR"
    &clk_name="gcc_lpass_q6_axi_clk"
    &clk_reg_cbcr_type="sm_cbc"
    &clk_vote_bit=-1.
    &clk_multiplier=4.
    &clk_access_mode="&GCC_access_mode"

    gosub Print_Clk_Info_Line
  )

  &match=0
  &wild_head=0
  &wild_tail=0
  &clk_input_length=STRING.LENGTH("&clk")
  &clk_itr_length=STRING.LENGTH("gcc_lpass_q6_smmu_axi_clk")

  if (STRING.SCAN("&clk", "*", 0)==0)
  (
    &wild_head=1
  )
  if (STRING.SCAN("&clk", "*", 1)==(STRING.LENGTH("&clk")-1))
  (
    &wild_tail=1
  )

  if ((&wild_head==1)&&(&wild_tail==1))
  (
    if (STRING.SCAN("gcc_lpass_q6_smmu_axi_clk", STRING.MID("&clk", 1, &clk_input_length-2), 0)!=-1)
    ( 
      &match=1
    )
  )
  else if (&wild_head==1)
  (
    if (STRING.MID("gcc_lpass_q6_smmu_axi_clk", &clk_itr_length-&clk_input_length+1, &clk_input_length-1)==STRING.CUT("&clk", 1))
    ( 
      &match=1
    )
  )
  else if (&wild_tail==1)
  (
    if (STRING.MID("gcc_lpass_q6_smmu_axi_clk", 0, &clk_input_length-1)==STRING.CUT("&clk", -1))
    ( 
      &match=1
    )
  )
  else if ("gcc_lpass_q6_smmu_axi_clk"=="&clk")
  (
    &match=1
  )
  
  if (&match==1)
  (
    &clk_test=&CLK_TEST_GCC_LPASS_Q6_SMMU_AXI_CLK
    &clk_reg=&HWIO_GCC_LPASS_Q6_SMMU_AXI_CBCR_ADDR
    &clk_reg_name="GCC_LPASS_Q6_SMMU_AXI_CBCR"
    &clk_name="gcc_lpass_q6_smmu_axi_clk"
    &clk_reg_cbcr_type="sm_cbc"
    &clk_vote_bit=-1.
    &clk_multiplier=4.
    &clk_access_mode="&GCC_access_mode"

    gosub Print_Clk_Info_Line
  )

  &match=0
  &wild_head=0
  &wild_tail=0
  &clk_input_length=STRING.LENGTH("&clk")
  &clk_itr_length=STRING.LENGTH("gcc_lpass_q6_smmu_axi_src_clk")

  if (STRING.SCAN("&clk", "*", 0)==0)
  (
    &wild_head=1
  )
  if (STRING.SCAN("&clk", "*", 1)==(STRING.LENGTH("&clk")-1))
  (
    &wild_tail=1
  )

  if ((&wild_head==1)&&(&wild_tail==1))
  (
    if (STRING.SCAN("gcc_lpass_q6_smmu_axi_src_clk", STRING.MID("&clk", 1, &clk_input_length-2), 0)!=-1)
    ( 
      &match=1
    )
  )
  else if (&wild_head==1)
  (
    if (STRING.MID("gcc_lpass_q6_smmu_axi_src_clk", &clk_itr_length-&clk_input_length+1, &clk_input_length-1)==STRING.CUT("&clk", 1))
    ( 
      &match=1
    )
  )
  else if (&wild_tail==1)
  (
    if (STRING.MID("gcc_lpass_q6_smmu_axi_src_clk", 0, &clk_input_length-1)==STRING.CUT("&clk", -1))
    ( 
      &match=1
    )
  )
  else if ("gcc_lpass_q6_smmu_axi_src_clk"=="&clk")
  (
    &match=1
  )
  
  if (&match==1)
  (
    &clk_test=&CLK_TEST_GCC_LPASS_Q6_SMMU_AXI_SRC_CLK
    &clk_reg=&HWIO_GCC_LPASS_Q6_SMMU_AXI_SRC_CBCR_ADDR
    &clk_reg_name="GCC_LPASS_Q6_SMMU_AXI_SRC_CBCR"
    &clk_name="gcc_lpass_q6_smmu_axi_src_clk"
    &clk_reg_cbcr_type="sm_pscbc"
    &clk_vote_bit=-1.
    &clk_multiplier=4.
    &clk_access_mode="&GCC_access_mode"

    gosub Print_Clk_Info_Line
  )

  &match=0
  &wild_head=0
  &wild_tail=0
  &clk_input_length=STRING.LENGTH("&clk")
  &clk_itr_length=STRING.LENGTH("gcc_mss_mnoc_bimc_axi_clk")

  if (STRING.SCAN("&clk", "*", 0)==0)
  (
    &wild_head=1
  )
  if (STRING.SCAN("&clk", "*", 1)==(STRING.LENGTH("&clk")-1))
  (
    &wild_tail=1
  )

  if ((&wild_head==1)&&(&wild_tail==1))
  (
    if (STRING.SCAN("gcc_mss_mnoc_bimc_axi_clk", STRING.MID("&clk", 1, &clk_input_length-2), 0)!=-1)
    ( 
      &match=1
    )
  )
  else if (&wild_head==1)
  (
    if (STRING.MID("gcc_mss_mnoc_bimc_axi_clk", &clk_itr_length-&clk_input_length+1, &clk_input_length-1)==STRING.CUT("&clk", 1))
    ( 
      &match=1
    )
  )
  else if (&wild_tail==1)
  (
    if (STRING.MID("gcc_mss_mnoc_bimc_axi_clk", 0, &clk_input_length-1)==STRING.CUT("&clk", -1))
    ( 
      &match=1
    )
  )
  else if ("gcc_mss_mnoc_bimc_axi_clk"=="&clk")
  (
    &match=1
  )
  
  if (&match==1)
  (
    &clk_test=&CLK_TEST_GCC_MSS_MNOC_BIMC_AXI_CLK
    &clk_reg=&HWIO_GCC_MSS_MNOC_BIMC_AXI_CBCR_ADDR
    &clk_reg_name="GCC_MSS_MNOC_BIMC_AXI_CBCR"
    &clk_name="gcc_mss_mnoc_bimc_axi_clk"
    &clk_reg_cbcr_type="sm_cbc"
    &clk_vote_bit=-1.
    &clk_multiplier=4.
    &clk_access_mode="&GCC_access_mode"

    gosub Print_Clk_Info_Line
  )

  &match=0
  &wild_head=0
  &wild_tail=0
  &clk_input_length=STRING.LENGTH("&clk")
  &clk_itr_length=STRING.LENGTH("gcc_mss_msmpu_client_axi_clk")

  if (STRING.SCAN("&clk", "*", 0)==0)
  (
    &wild_head=1
  )
  if (STRING.SCAN("&clk", "*", 1)==(STRING.LENGTH("&clk")-1))
  (
    &wild_tail=1
  )

  if ((&wild_head==1)&&(&wild_tail==1))
  (
    if (STRING.SCAN("gcc_mss_msmpu_client_axi_clk", STRING.MID("&clk", 1, &clk_input_length-2), 0)!=-1)
    ( 
      &match=1
    )
  )
  else if (&wild_head==1)
  (
    if (STRING.MID("gcc_mss_msmpu_client_axi_clk", &clk_itr_length-&clk_input_length+1, &clk_input_length-1)==STRING.CUT("&clk", 1))
    ( 
      &match=1
    )
  )
  else if (&wild_tail==1)
  (
    if (STRING.MID("gcc_mss_msmpu_client_axi_clk", 0, &clk_input_length-1)==STRING.CUT("&clk", -1))
    ( 
      &match=1
    )
  )
  else if ("gcc_mss_msmpu_client_axi_clk"=="&clk")
  (
    &match=1
  )
  
  if (&match==1)
  (
    &clk_test=&CLK_TEST_GCC_MSS_MSMPU_CLIENT_AXI_CLK
    &clk_reg=&HWIO_GCC_MSS_MSMPU_CLIENT_AXI_CBCR_ADDR
    &clk_reg_name="GCC_MSS_MSMPU_CLIENT_AXI_CBCR"
    &clk_name="gcc_mss_msmpu_client_axi_clk"
    &clk_reg_cbcr_type="sm_cbc"
    &clk_vote_bit=-1.
    &clk_multiplier=4.
    &clk_access_mode="&GCC_access_mode"

    gosub Print_Clk_Info_Line
  )

  &match=0
  &wild_head=0
  &wild_tail=0
  &clk_input_length=STRING.LENGTH("&clk")
  &clk_itr_length=STRING.LENGTH("gcc_sys_noc_hs_axi_clk")

  if (STRING.SCAN("&clk", "*", 0)==0)
  (
    &wild_head=1
  )
  if (STRING.SCAN("&clk", "*", 1)==(STRING.LENGTH("&clk")-1))
  (
    &wild_tail=1
  )

  if ((&wild_head==1)&&(&wild_tail==1))
  (
    if (STRING.SCAN("gcc_sys_noc_hs_axi_clk", STRING.MID("&clk", 1, &clk_input_length-2), 0)!=-1)
    ( 
      &match=1
    )
  )
  else if (&wild_head==1)
  (
    if (STRING.MID("gcc_sys_noc_hs_axi_clk", &clk_itr_length-&clk_input_length+1, &clk_input_length-1)==STRING.CUT("&clk", 1))
    ( 
      &match=1
    )
  )
  else if (&wild_tail==1)
  (
    if (STRING.MID("gcc_sys_noc_hs_axi_clk", 0, &clk_input_length-1)==STRING.CUT("&clk", -1))
    ( 
      &match=1
    )
  )
  else if ("gcc_sys_noc_hs_axi_clk"=="&clk")
  (
    &match=1
  )
  
  if (&match==1)
  (
    &clk_test=&CLK_TEST_GCC_SYS_NOC_HS_AXI_CLK
    &clk_reg=&HWIO_GCC_SYS_NOC_HS_AXI_CBCR_ADDR
    &clk_reg_name="GCC_SYS_NOC_HS_AXI_CBCR"
    &clk_name="gcc_sys_noc_hs_axi_clk"
    &clk_reg_cbcr_type="sm_cbc"
    &clk_vote_bit=-1.
    &clk_multiplier=4.
    &clk_access_mode="&GCC_access_mode"

    gosub Print_Clk_Info_Line
  )

  &match=0
  &wild_head=0
  &wild_tail=0
  &clk_input_length=STRING.LENGTH("&clk")
  &clk_itr_length=STRING.LENGTH("gcc_a2noc_throttle_core_axi_clk")

  if (STRING.SCAN("&clk", "*", 0)==0)
  (
    &wild_head=1
  )
  if (STRING.SCAN("&clk", "*", 1)==(STRING.LENGTH("&clk")-1))
  (
    &wild_tail=1
  )

  if ((&wild_head==1)&&(&wild_tail==1))
  (
    if (STRING.SCAN("gcc_a2noc_throttle_core_axi_clk", STRING.MID("&clk", 1, &clk_input_length-2), 0)!=-1)
    ( 
      &match=1
    )
  )
  else if (&wild_head==1)
  (
    if (STRING.MID("gcc_a2noc_throttle_core_axi_clk", &clk_itr_length-&clk_input_length+1, &clk_input_length-1)==STRING.CUT("&clk", 1))
    ( 
      &match=1
    )
  )
  else if (&wild_tail==1)
  (
    if (STRING.MID("gcc_a2noc_throttle_core_axi_clk", 0, &clk_input_length-1)==STRING.CUT("&clk", -1))
    ( 
      &match=1
    )
  )
  else if ("gcc_a2noc_throttle_core_axi_clk"=="&clk")
  (
    &match=1
  )
  
  if (&match==1)
  (
    &clk_test=&CLK_TEST_GCC_A2NOC_THROTTLE_CORE_AXI_CLK
    &clk_reg=&HWIO_GCC_A2NOC_THROTTLE_CORE_AXI_CBCR_ADDR
    &clk_reg_name="GCC_A2NOC_THROTTLE_CORE_AXI_CBCR"
    &clk_name="gcc_a2noc_throttle_core_axi_clk"
    &clk_reg_cbcr_type="sm_cbc"
    &clk_vote_bit=-1.
    &clk_multiplier=4.
    &clk_access_mode="&GCC_access_mode"

    gosub Print_Clk_Info_Line
  )

  &match=0
  &wild_head=0
  &wild_tail=0
  &clk_input_length=STRING.LENGTH("&clk")
  &clk_itr_length=STRING.LENGTH("gcc_aggre2_snoc_axi_clk")

  if (STRING.SCAN("&clk", "*", 0)==0)
  (
    &wild_head=1
  )
  if (STRING.SCAN("&clk", "*", 1)==(STRING.LENGTH("&clk")-1))
  (
    &wild_tail=1
  )

  if ((&wild_head==1)&&(&wild_tail==1))
  (
    if (STRING.SCAN("gcc_aggre2_snoc_axi_clk", STRING.MID("&clk", 1, &clk_input_length-2), 0)!=-1)
    ( 
      &match=1
    )
  )
  else if (&wild_head==1)
  (
    if (STRING.MID("gcc_aggre2_snoc_axi_clk", &clk_itr_length-&clk_input_length+1, &clk_input_length-1)==STRING.CUT("&clk", 1))
    ( 
      &match=1
    )
  )
  else if (&wild_tail==1)
  (
    if (STRING.MID("gcc_aggre2_snoc_axi_clk", 0, &clk_input_length-1)==STRING.CUT("&clk", -1))
    ( 
      &match=1
    )
  )
  else if ("gcc_aggre2_snoc_axi_clk"=="&clk")
  (
    &match=1
  )
  
  if (&match==1)
  (
    &clk_test=&CLK_TEST_GCC_AGGRE2_SNOC_AXI_CLK
    &clk_reg=&HWIO_GCC_AGGRE2_SNOC_AXI_CBCR_ADDR
    &clk_reg_name="GCC_AGGRE2_SNOC_AXI_CBCR"
    &clk_name="gcc_aggre2_snoc_axi_clk"
    &clk_reg_cbcr_type="sm_cbc"
    &clk_vote_bit=-1.
    &clk_multiplier=4.
    &clk_access_mode="&GCC_access_mode"

    gosub Print_Clk_Info_Line
  )

  &match=0
  &wild_head=0
  &wild_tail=0
  &clk_input_length=STRING.LENGTH("&clk")
  &clk_itr_length=STRING.LENGTH("gcc_aggre2_snoc_msmpu_client_axi_clk")

  if (STRING.SCAN("&clk", "*", 0)==0)
  (
    &wild_head=1
  )
  if (STRING.SCAN("&clk", "*", 1)==(STRING.LENGTH("&clk")-1))
  (
    &wild_tail=1
  )

  if ((&wild_head==1)&&(&wild_tail==1))
  (
    if (STRING.SCAN("gcc_aggre2_snoc_msmpu_client_axi_clk", STRING.MID("&clk", 1, &clk_input_length-2), 0)!=-1)
    ( 
      &match=1
    )
  )
  else if (&wild_head==1)
  (
    if (STRING.MID("gcc_aggre2_snoc_msmpu_client_axi_clk", &clk_itr_length-&clk_input_length+1, &clk_input_length-1)==STRING.CUT("&clk", 1))
    ( 
      &match=1
    )
  )
  else if (&wild_tail==1)
  (
    if (STRING.MID("gcc_aggre2_snoc_msmpu_client_axi_clk", 0, &clk_input_length-1)==STRING.CUT("&clk", -1))
    ( 
      &match=1
    )
  )
  else if ("gcc_aggre2_snoc_msmpu_client_axi_clk"=="&clk")
  (
    &match=1
  )
  
  if (&match==1)
  (
    &clk_test=&CLK_TEST_GCC_AGGRE2_SNOC_MSMPU_CLIENT_AXI_CLK
    &clk_reg=&HWIO_GCC_AGGRE2_SNOC_MSMPU_CLIENT_AXI_CBCR_ADDR
    &clk_reg_name="GCC_AGGRE2_SNOC_MSMPU_CLIENT_AXI_CBCR"
    &clk_name="gcc_aggre2_snoc_msmpu_client_axi_clk"
    &clk_reg_cbcr_type="sm_cbc"
    &clk_vote_bit=-1.
    &clk_multiplier=4.
    &clk_access_mode="&GCC_access_mode"

    gosub Print_Clk_Info_Line
  )

  &match=0
  &wild_head=0
  &wild_tail=0
  &clk_input_length=STRING.LENGTH("&clk")
  &clk_itr_length=STRING.LENGTH("gcc_aggre2_snoc_north_axi_clk")

  if (STRING.SCAN("&clk", "*", 0)==0)
  (
    &wild_head=1
  )
  if (STRING.SCAN("&clk", "*", 1)==(STRING.LENGTH("&clk")-1))
  (
    &wild_tail=1
  )

  if ((&wild_head==1)&&(&wild_tail==1))
  (
    if (STRING.SCAN("gcc_aggre2_snoc_north_axi_clk", STRING.MID("&clk", 1, &clk_input_length-2), 0)!=-1)
    ( 
      &match=1
    )
  )
  else if (&wild_head==1)
  (
    if (STRING.MID("gcc_aggre2_snoc_north_axi_clk", &clk_itr_length-&clk_input_length+1, &clk_input_length-1)==STRING.CUT("&clk", 1))
    ( 
      &match=1
    )
  )
  else if (&wild_tail==1)
  (
    if (STRING.MID("gcc_aggre2_snoc_north_axi_clk", 0, &clk_input_length-1)==STRING.CUT("&clk", -1))
    ( 
      &match=1
    )
  )
  else if ("gcc_aggre2_snoc_north_axi_clk"=="&clk")
  (
    &match=1
  )
  
  if (&match==1)
  (
    &clk_test=&CLK_TEST_GCC_AGGRE2_SNOC_NORTH_AXI_CLK
    &clk_reg=&HWIO_GCC_AGGRE2_SNOC_NORTH_AXI_CBCR_ADDR
    &clk_reg_name="GCC_AGGRE2_SNOC_NORTH_AXI_CBCR"
    &clk_name="gcc_aggre2_snoc_north_axi_clk"
    &clk_reg_cbcr_type="sm_cbc"
    &clk_vote_bit=-1.
    &clk_multiplier=4.
    &clk_access_mode="&GCC_access_mode"

    gosub Print_Clk_Info_Line
  )

  &match=0
  &wild_head=0
  &wild_tail=0
  &clk_input_length=STRING.LENGTH("&clk")
  &clk_itr_length=STRING.LENGTH("gcc_aggre2_snoc_south_axi_clk")

  if (STRING.SCAN("&clk", "*", 0)==0)
  (
    &wild_head=1
  )
  if (STRING.SCAN("&clk", "*", 1)==(STRING.LENGTH("&clk")-1))
  (
    &wild_tail=1
  )

  if ((&wild_head==1)&&(&wild_tail==1))
  (
    if (STRING.SCAN("gcc_aggre2_snoc_south_axi_clk", STRING.MID("&clk", 1, &clk_input_length-2), 0)!=-1)
    ( 
      &match=1
    )
  )
  else if (&wild_head==1)
  (
    if (STRING.MID("gcc_aggre2_snoc_south_axi_clk", &clk_itr_length-&clk_input_length+1, &clk_input_length-1)==STRING.CUT("&clk", 1))
    ( 
      &match=1
    )
  )
  else if (&wild_tail==1)
  (
    if (STRING.MID("gcc_aggre2_snoc_south_axi_clk", 0, &clk_input_length-1)==STRING.CUT("&clk", -1))
    ( 
      &match=1
    )
  )
  else if ("gcc_aggre2_snoc_south_axi_clk"=="&clk")
  (
    &match=1
  )
  
  if (&match==1)
  (
    &clk_test=&CLK_TEST_GCC_AGGRE2_SNOC_SOUTH_AXI_CLK
    &clk_reg=&HWIO_GCC_AGGRE2_SNOC_SOUTH_AXI_CBCR_ADDR
    &clk_reg_name="GCC_AGGRE2_SNOC_SOUTH_AXI_CBCR"
    &clk_name="gcc_aggre2_snoc_south_axi_clk"
    &clk_reg_cbcr_type="sm_cbc"
    &clk_vote_bit=-1.
    &clk_multiplier=4.
    &clk_access_mode="&GCC_access_mode"

    gosub Print_Clk_Info_Line
  )

  &match=0
  &wild_head=0
  &wild_tail=0
  &clk_input_length=STRING.LENGTH("&clk")
  &clk_itr_length=STRING.LENGTH("gcc_bimc_nius_axi_clk")

  if (STRING.SCAN("&clk", "*", 0)==0)
  (
    &wild_head=1
  )
  if (STRING.SCAN("&clk", "*", 1)==(STRING.LENGTH("&clk")-1))
  (
    &wild_tail=1
  )

  if ((&wild_head==1)&&(&wild_tail==1))
  (
    if (STRING.SCAN("gcc_bimc_nius_axi_clk", STRING.MID("&clk", 1, &clk_input_length-2), 0)!=-1)
    ( 
      &match=1
    )
  )
  else if (&wild_head==1)
  (
    if (STRING.MID("gcc_bimc_nius_axi_clk", &clk_itr_length-&clk_input_length+1, &clk_input_length-1)==STRING.CUT("&clk", 1))
    ( 
      &match=1
    )
  )
  else if (&wild_tail==1)
  (
    if (STRING.MID("gcc_bimc_nius_axi_clk", 0, &clk_input_length-1)==STRING.CUT("&clk", -1))
    ( 
      &match=1
    )
  )
  else if ("gcc_bimc_nius_axi_clk"=="&clk")
  (
    &match=1
  )
  
  if (&match==1)
  (
    &clk_test=&CLK_TEST_GCC_BIMC_NIUS_AXI_CLK
    &clk_reg=&HWIO_GCC_BIMC_NIUS_AXI_CBCR_ADDR
    &clk_reg_name="GCC_BIMC_NIUS_AXI_CBCR"
    &clk_name="gcc_bimc_nius_axi_clk"
    &clk_reg_cbcr_type="sm_cbc"
    &clk_vote_bit=-1.
    &clk_multiplier=4.
    &clk_access_mode="&GCC_access_mode"

    gosub Print_Clk_Info_Line
  )

  &match=0
  &wild_head=0
  &wild_tail=0
  &clk_input_length=STRING.LENGTH("&clk")
  &clk_itr_length=STRING.LENGTH("gcc_bimc_sysnoc_axi_clk")

  if (STRING.SCAN("&clk", "*", 0)==0)
  (
    &wild_head=1
  )
  if (STRING.SCAN("&clk", "*", 1)==(STRING.LENGTH("&clk")-1))
  (
    &wild_tail=1
  )

  if ((&wild_head==1)&&(&wild_tail==1))
  (
    if (STRING.SCAN("gcc_bimc_sysnoc_axi_clk", STRING.MID("&clk", 1, &clk_input_length-2), 0)!=-1)
    ( 
      &match=1
    )
  )
  else if (&wild_head==1)
  (
    if (STRING.MID("gcc_bimc_sysnoc_axi_clk", &clk_itr_length-&clk_input_length+1, &clk_input_length-1)==STRING.CUT("&clk", 1))
    ( 
      &match=1
    )
  )
  else if (&wild_tail==1)
  (
    if (STRING.MID("gcc_bimc_sysnoc_axi_clk", 0, &clk_input_length-1)==STRING.CUT("&clk", -1))
    ( 
      &match=1
    )
  )
  else if ("gcc_bimc_sysnoc_axi_clk"=="&clk")
  (
    &match=1
  )
  
  if (&match==1)
  (
    &clk_test=&CLK_TEST_GCC_BIMC_SYSNOC_AXI_CLK
    &clk_reg=&HWIO_GCC_BIMC_SYSNOC_AXI_CBCR_ADDR
    &clk_reg_name="GCC_BIMC_SYSNOC_AXI_CBCR"
    &clk_name="gcc_bimc_sysnoc_axi_clk"
    &clk_reg_cbcr_type="sm_cbc"
    &clk_vote_bit=-1.
    &clk_multiplier=4.
    &clk_access_mode="&GCC_access_mode"

    gosub Print_Clk_Info_Line
  )

  &match=0
  &wild_head=0
  &wild_tail=0
  &clk_input_length=STRING.LENGTH("&clk")
  &clk_itr_length=STRING.LENGTH("gcc_ce1_axi_clk")

  if (STRING.SCAN("&clk", "*", 0)==0)
  (
    &wild_head=1
  )
  if (STRING.SCAN("&clk", "*", 1)==(STRING.LENGTH("&clk")-1))
  (
    &wild_tail=1
  )

  if ((&wild_head==1)&&(&wild_tail==1))
  (
    if (STRING.SCAN("gcc_ce1_axi_clk", STRING.MID("&clk", 1, &clk_input_length-2), 0)!=-1)
    ( 
      &match=1
    )
  )
  else if (&wild_head==1)
  (
    if (STRING.MID("gcc_ce1_axi_clk", &clk_itr_length-&clk_input_length+1, &clk_input_length-1)==STRING.CUT("&clk", 1))
    ( 
      &match=1
    )
  )
  else if (&wild_tail==1)
  (
    if (STRING.MID("gcc_ce1_axi_clk", 0, &clk_input_length-1)==STRING.CUT("&clk", -1))
    ( 
      &match=1
    )
  )
  else if ("gcc_ce1_axi_clk"=="&clk")
  (
    &match=1
  )
  
  if (&match==1)
  (
    &clk_test=&CLK_TEST_GCC_CE1_AXI_CLK
    &clk_reg=&HWIO_GCC_CE1_AXI_CBCR_ADDR
    &clk_reg_name="GCC_CE1_AXI_CBCR"
    &clk_name="gcc_ce1_axi_clk"
    &clk_reg_cbcr_type="sm_cbc"
    &clk_vote_bit=4.
    &clk_multiplier=4.
    &clk_access_mode="&GCC_access_mode"

    gosub Print_Clk_Info_Line
  )

  &match=0
  &wild_head=0
  &wild_tail=0
  &clk_input_length=STRING.LENGTH("&clk")
  &clk_itr_length=STRING.LENGTH("gcc_hmss_dvm_bus_clk")

  if (STRING.SCAN("&clk", "*", 0)==0)
  (
    &wild_head=1
  )
  if (STRING.SCAN("&clk", "*", 1)==(STRING.LENGTH("&clk")-1))
  (
    &wild_tail=1
  )

  if ((&wild_head==1)&&(&wild_tail==1))
  (
    if (STRING.SCAN("gcc_hmss_dvm_bus_clk", STRING.MID("&clk", 1, &clk_input_length-2), 0)!=-1)
    ( 
      &match=1
    )
  )
  else if (&wild_head==1)
  (
    if (STRING.MID("gcc_hmss_dvm_bus_clk", &clk_itr_length-&clk_input_length+1, &clk_input_length-1)==STRING.CUT("&clk", 1))
    ( 
      &match=1
    )
  )
  else if (&wild_tail==1)
  (
    if (STRING.MID("gcc_hmss_dvm_bus_clk", 0, &clk_input_length-1)==STRING.CUT("&clk", -1))
    ( 
      &match=1
    )
  )
  else if ("gcc_hmss_dvm_bus_clk"=="&clk")
  (
    &match=1
  )
  
  if (&match==1)
  (
    &clk_test=&CLK_TEST_GCC_HMSS_DVM_BUS_CLK
    &clk_reg=&HWIO_GCC_HMSS_DVM_BUS_CBCR_ADDR
    &clk_reg_name="GCC_HMSS_DVM_BUS_CBCR"
    &clk_name="gcc_hmss_dvm_bus_clk"
    &clk_reg_cbcr_type="sm_cbc"
    &clk_vote_bit=-1.
    &clk_multiplier=4.
    &clk_access_mode="&GCC_access_mode"

    gosub Print_Clk_Info_Line
  )

  &match=0
  &wild_head=0
  &wild_tail=0
  &clk_input_length=STRING.LENGTH("&clk")
  &clk_itr_length=STRING.LENGTH("gcc_imem_axi_clk")

  if (STRING.SCAN("&clk", "*", 0)==0)
  (
    &wild_head=1
  )
  if (STRING.SCAN("&clk", "*", 1)==(STRING.LENGTH("&clk")-1))
  (
    &wild_tail=1
  )

  if ((&wild_head==1)&&(&wild_tail==1))
  (
    if (STRING.SCAN("gcc_imem_axi_clk", STRING.MID("&clk", 1, &clk_input_length-2), 0)!=-1)
    ( 
      &match=1
    )
  )
  else if (&wild_head==1)
  (
    if (STRING.MID("gcc_imem_axi_clk", &clk_itr_length-&clk_input_length+1, &clk_input_length-1)==STRING.CUT("&clk", 1))
    ( 
      &match=1
    )
  )
  else if (&wild_tail==1)
  (
    if (STRING.MID("gcc_imem_axi_clk", 0, &clk_input_length-1)==STRING.CUT("&clk", -1))
    ( 
      &match=1
    )
  )
  else if ("gcc_imem_axi_clk"=="&clk")
  (
    &match=1
  )
  
  if (&match==1)
  (
    &clk_test=&CLK_TEST_GCC_IMEM_AXI_CLK
    &clk_reg=&HWIO_GCC_IMEM_AXI_CBCR_ADDR
    &clk_reg_name="GCC_IMEM_AXI_CBCR"
    &clk_name="gcc_imem_axi_clk"
    &clk_reg_cbcr_type="sm_pscbc"
    &clk_vote_bit=24.
    &clk_multiplier=4.
    &clk_access_mode="&GCC_access_mode"

    gosub Print_Clk_Info_Line
  )

  &match=0
  &wild_head=0
  &wild_tail=0
  &clk_input_length=STRING.LENGTH("&clk")
  &clk_itr_length=STRING.LENGTH("gcc_lpass_mport_clk")

  if (STRING.SCAN("&clk", "*", 0)==0)
  (
    &wild_head=1
  )
  if (STRING.SCAN("&clk", "*", 1)==(STRING.LENGTH("&clk")-1))
  (
    &wild_tail=1
  )

  if ((&wild_head==1)&&(&wild_tail==1))
  (
    if (STRING.SCAN("gcc_lpass_mport_clk", STRING.MID("&clk", 1, &clk_input_length-2), 0)!=-1)
    ( 
      &match=1
    )
  )
  else if (&wild_head==1)
  (
    if (STRING.MID("gcc_lpass_mport_clk", &clk_itr_length-&clk_input_length+1, &clk_input_length-1)==STRING.CUT("&clk", 1))
    ( 
      &match=1
    )
  )
  else if (&wild_tail==1)
  (
    if (STRING.MID("gcc_lpass_mport_clk", 0, &clk_input_length-1)==STRING.CUT("&clk", -1))
    ( 
      &match=1
    )
  )
  else if ("gcc_lpass_mport_clk"=="&clk")
  (
    &match=1
  )
  
  if (&match==1)
  (
    &clk_test=&CLK_TEST_GCC_LPASS_MPORT_CLK
    &clk_reg=&HWIO_GCC_LPASS_MPORT_CBCR_ADDR
    &clk_reg_name="GCC_LPASS_MPORT_CBCR"
    &clk_name="gcc_lpass_mport_clk"
    &clk_reg_cbcr_type="sm_cbc"
    &clk_vote_bit=-1.
    &clk_multiplier=4.
    &clk_access_mode="&GCC_access_mode"

    gosub Print_Clk_Info_Line
  )

  &match=0
  &wild_head=0
  &wild_tail=0
  &clk_input_length=STRING.LENGTH("&clk")
  &clk_itr_length=STRING.LENGTH("gcc_lpass_sway_clk")

  if (STRING.SCAN("&clk", "*", 0)==0)
  (
    &wild_head=1
  )
  if (STRING.SCAN("&clk", "*", 1)==(STRING.LENGTH("&clk")-1))
  (
    &wild_tail=1
  )

  if ((&wild_head==1)&&(&wild_tail==1))
  (
    if (STRING.SCAN("gcc_lpass_sway_clk", STRING.MID("&clk", 1, &clk_input_length-2), 0)!=-1)
    ( 
      &match=1
    )
  )
  else if (&wild_head==1)
  (
    if (STRING.MID("gcc_lpass_sway_clk", &clk_itr_length-&clk_input_length+1, &clk_input_length-1)==STRING.CUT("&clk", 1))
    ( 
      &match=1
    )
  )
  else if (&wild_tail==1)
  (
    if (STRING.MID("gcc_lpass_sway_clk", 0, &clk_input_length-1)==STRING.CUT("&clk", -1))
    ( 
      &match=1
    )
  )
  else if ("gcc_lpass_sway_clk"=="&clk")
  (
    &match=1
  )
  
  if (&match==1)
  (
    &clk_test=&CLK_TEST_GCC_LPASS_SWAY_CLK
    &clk_reg=&HWIO_GCC_LPASS_SWAY_CBCR_ADDR
    &clk_reg_name="GCC_LPASS_SWAY_CBCR"
    &clk_name="gcc_lpass_sway_clk"
    &clk_reg_cbcr_type="sm_cbc"
    &clk_vote_bit=-1.
    &clk_multiplier=4.
    &clk_access_mode="&GCC_access_mode"

    gosub Print_Clk_Info_Line
  )

  &match=0
  &wild_head=0
  &wild_tail=0
  &clk_input_length=STRING.LENGTH("&clk")
  &clk_itr_length=STRING.LENGTH("gcc_lpass_sway_mpu_clk")

  if (STRING.SCAN("&clk", "*", 0)==0)
  (
    &wild_head=1
  )
  if (STRING.SCAN("&clk", "*", 1)==(STRING.LENGTH("&clk")-1))
  (
    &wild_tail=1
  )

  if ((&wild_head==1)&&(&wild_tail==1))
  (
    if (STRING.SCAN("gcc_lpass_sway_mpu_clk", STRING.MID("&clk", 1, &clk_input_length-2), 0)!=-1)
    ( 
      &match=1
    )
  )
  else if (&wild_head==1)
  (
    if (STRING.MID("gcc_lpass_sway_mpu_clk", &clk_itr_length-&clk_input_length+1, &clk_input_length-1)==STRING.CUT("&clk", 1))
    ( 
      &match=1
    )
  )
  else if (&wild_tail==1)
  (
    if (STRING.MID("gcc_lpass_sway_mpu_clk", 0, &clk_input_length-1)==STRING.CUT("&clk", -1))
    ( 
      &match=1
    )
  )
  else if ("gcc_lpass_sway_mpu_clk"=="&clk")
  (
    &match=1
  )
  
  if (&match==1)
  (
    &clk_test=&CLK_TEST_GCC_LPASS_SWAY_MPU_CLK
    &clk_reg=&HWIO_GCC_LPASS_SWAY_MPU_CBCR_ADDR
    &clk_reg_name="GCC_LPASS_SWAY_MPU_CBCR"
    &clk_name="gcc_lpass_sway_mpu_clk"
    &clk_reg_cbcr_type="sm_cbc"
    &clk_vote_bit=-1.
    &clk_multiplier=4.
    &clk_access_mode="&GCC_access_mode"

    gosub Print_Clk_Info_Line
  )

  &match=0
  &wild_head=0
  &wild_tail=0
  &clk_input_length=STRING.LENGTH("&clk")
  &clk_itr_length=STRING.LENGTH("gcc_mmss_sys_noc_axi_clk")

  if (STRING.SCAN("&clk", "*", 0)==0)
  (
    &wild_head=1
  )
  if (STRING.SCAN("&clk", "*", 1)==(STRING.LENGTH("&clk")-1))
  (
    &wild_tail=1
  )

  if ((&wild_head==1)&&(&wild_tail==1))
  (
    if (STRING.SCAN("gcc_mmss_sys_noc_axi_clk", STRING.MID("&clk", 1, &clk_input_length-2), 0)!=-1)
    ( 
      &match=1
    )
  )
  else if (&wild_head==1)
  (
    if (STRING.MID("gcc_mmss_sys_noc_axi_clk", &clk_itr_length-&clk_input_length+1, &clk_input_length-1)==STRING.CUT("&clk", 1))
    ( 
      &match=1
    )
  )
  else if (&wild_tail==1)
  (
    if (STRING.MID("gcc_mmss_sys_noc_axi_clk", 0, &clk_input_length-1)==STRING.CUT("&clk", -1))
    ( 
      &match=1
    )
  )
  else if ("gcc_mmss_sys_noc_axi_clk"=="&clk")
  (
    &match=1
  )
  
  if (&match==1)
  (
    &clk_test=&CLK_TEST_GCC_MMSS_SYS_NOC_AXI_CLK
    &clk_reg=&HWIO_GCC_MMSS_SYS_NOC_AXI_CBCR_ADDR
    &clk_reg_name="GCC_MMSS_SYS_NOC_AXI_CBCR"
    &clk_name="gcc_mmss_sys_noc_axi_clk"
    &clk_reg_cbcr_type="sm_cbc"
    &clk_vote_bit=-1.
    &clk_multiplier=4.
    &clk_access_mode="&GCC_access_mode"

    gosub Print_Clk_Info_Line
  )

  &match=0
  &wild_head=0
  &wild_tail=0
  &clk_input_length=STRING.LENGTH("&clk")
  &clk_itr_length=STRING.LENGTH("gcc_mss_snoc_axi_clk")

  if (STRING.SCAN("&clk", "*", 0)==0)
  (
    &wild_head=1
  )
  if (STRING.SCAN("&clk", "*", 1)==(STRING.LENGTH("&clk")-1))
  (
    &wild_tail=1
  )

  if ((&wild_head==1)&&(&wild_tail==1))
  (
    if (STRING.SCAN("gcc_mss_snoc_axi_clk", STRING.MID("&clk", 1, &clk_input_length-2), 0)!=-1)
    ( 
      &match=1
    )
  )
  else if (&wild_head==1)
  (
    if (STRING.MID("gcc_mss_snoc_axi_clk", &clk_itr_length-&clk_input_length+1, &clk_input_length-1)==STRING.CUT("&clk", 1))
    ( 
      &match=1
    )
  )
  else if (&wild_tail==1)
  (
    if (STRING.MID("gcc_mss_snoc_axi_clk", 0, &clk_input_length-1)==STRING.CUT("&clk", -1))
    ( 
      &match=1
    )
  )
  else if ("gcc_mss_snoc_axi_clk"=="&clk")
  (
    &match=1
  )
  
  if (&match==1)
  (
    &clk_test=&CLK_TEST_GCC_MSS_SNOC_AXI_CLK
    &clk_reg=&HWIO_GCC_MSS_SNOC_AXI_CBCR_ADDR
    &clk_reg_name="GCC_MSS_SNOC_AXI_CBCR"
    &clk_name="gcc_mss_snoc_axi_clk"
    &clk_reg_cbcr_type="sm_cbc"
    &clk_vote_bit=-1.
    &clk_multiplier=4.
    &clk_access_mode="&GCC_access_mode"

    gosub Print_Clk_Info_Line
  )

  &match=0
  &wild_head=0
  &wild_tail=0
  &clk_input_length=STRING.LENGTH("&clk")
  &clk_itr_length=STRING.LENGTH("gcc_qdss_etr_usb_clk")

  if (STRING.SCAN("&clk", "*", 0)==0)
  (
    &wild_head=1
  )
  if (STRING.SCAN("&clk", "*", 1)==(STRING.LENGTH("&clk")-1))
  (
    &wild_tail=1
  )

  if ((&wild_head==1)&&(&wild_tail==1))
  (
    if (STRING.SCAN("gcc_qdss_etr_usb_clk", STRING.MID("&clk", 1, &clk_input_length-2), 0)!=-1)
    ( 
      &match=1
    )
  )
  else if (&wild_head==1)
  (
    if (STRING.MID("gcc_qdss_etr_usb_clk", &clk_itr_length-&clk_input_length+1, &clk_input_length-1)==STRING.CUT("&clk", 1))
    ( 
      &match=1
    )
  )
  else if (&wild_tail==1)
  (
    if (STRING.MID("gcc_qdss_etr_usb_clk", 0, &clk_input_length-1)==STRING.CUT("&clk", -1))
    ( 
      &match=1
    )
  )
  else if ("gcc_qdss_etr_usb_clk"=="&clk")
  (
    &match=1
  )
  
  if (&match==1)
  (
    &clk_test=&CLK_TEST_GCC_QDSS_ETR_USB_CLK
    &clk_reg=&HWIO_GCC_QDSS_ETR_USB_CBCR_ADDR
    &clk_reg_name="GCC_QDSS_ETR_USB_CBCR"
    &clk_name="gcc_qdss_etr_usb_clk"
    &clk_reg_cbcr_type="sm_cbc"
    &clk_vote_bit=-1.
    &clk_multiplier=4.
    &clk_access_mode="&GCC_access_mode"

    gosub Print_Clk_Info_Line
  )

  &match=0
  &wild_head=0
  &wild_tail=0
  &clk_input_length=STRING.LENGTH("&clk")
  &clk_itr_length=STRING.LENGTH("gcc_smmu_aggre2_axi_clk")

  if (STRING.SCAN("&clk", "*", 0)==0)
  (
    &wild_head=1
  )
  if (STRING.SCAN("&clk", "*", 1)==(STRING.LENGTH("&clk")-1))
  (
    &wild_tail=1
  )

  if ((&wild_head==1)&&(&wild_tail==1))
  (
    if (STRING.SCAN("gcc_smmu_aggre2_axi_clk", STRING.MID("&clk", 1, &clk_input_length-2), 0)!=-1)
    ( 
      &match=1
    )
  )
  else if (&wild_head==1)
  (
    if (STRING.MID("gcc_smmu_aggre2_axi_clk", &clk_itr_length-&clk_input_length+1, &clk_input_length-1)==STRING.CUT("&clk", 1))
    ( 
      &match=1
    )
  )
  else if (&wild_tail==1)
  (
    if (STRING.MID("gcc_smmu_aggre2_axi_clk", 0, &clk_input_length-1)==STRING.CUT("&clk", -1))
    ( 
      &match=1
    )
  )
  else if ("gcc_smmu_aggre2_axi_clk"=="&clk")
  (
    &match=1
  )
  
  if (&match==1)
  (
    &clk_test=&CLK_TEST_GCC_SMMU_AGGRE2_AXI_CLK
    &clk_reg=&HWIO_GCC_SMMU_AGGRE2_AXI_CBCR_ADDR
    &clk_reg_name="GCC_SMMU_AGGRE2_AXI_CBCR"
    &clk_name="gcc_smmu_aggre2_axi_clk"
    &clk_reg_cbcr_type="sm_cbc"
    &clk_vote_bit=-1.
    &clk_multiplier=4.
    &clk_access_mode="&GCC_access_mode"

    gosub Print_Clk_Info_Line
  )

  &match=0
  &wild_head=0
  &wild_tail=0
  &clk_input_length=STRING.LENGTH("&clk")
  &clk_itr_length=STRING.LENGTH("gcc_smmu_aggre2_axi_src_clk")

  if (STRING.SCAN("&clk", "*", 0)==0)
  (
    &wild_head=1
  )
  if (STRING.SCAN("&clk", "*", 1)==(STRING.LENGTH("&clk")-1))
  (
    &wild_tail=1
  )

  if ((&wild_head==1)&&(&wild_tail==1))
  (
    if (STRING.SCAN("gcc_smmu_aggre2_axi_src_clk", STRING.MID("&clk", 1, &clk_input_length-2), 0)!=-1)
    ( 
      &match=1
    )
  )
  else if (&wild_head==1)
  (
    if (STRING.MID("gcc_smmu_aggre2_axi_src_clk", &clk_itr_length-&clk_input_length+1, &clk_input_length-1)==STRING.CUT("&clk", 1))
    ( 
      &match=1
    )
  )
  else if (&wild_tail==1)
  (
    if (STRING.MID("gcc_smmu_aggre2_axi_src_clk", 0, &clk_input_length-1)==STRING.CUT("&clk", -1))
    ( 
      &match=1
    )
  )
  else if ("gcc_smmu_aggre2_axi_src_clk"=="&clk")
  (
    &match=1
  )
  
  if (&match==1)
  (
    &clk_test=&CLK_TEST_GCC_SMMU_AGGRE2_AXI_SRC_CLK
    &clk_reg=&HWIO_GCC_SMMU_AGGRE2_AXI_SRC_CBCR_ADDR
    &clk_reg_name="GCC_SMMU_AGGRE2_AXI_SRC_CBCR"
    &clk_name="gcc_smmu_aggre2_axi_src_clk"
    &clk_reg_cbcr_type="sm_pscbc"
    &clk_vote_bit=-1.
    &clk_multiplier=4.
    &clk_access_mode="&GCC_access_mode"

    gosub Print_Clk_Info_Line
  )

  &match=0
  &wild_head=0
  &wild_tail=0
  &clk_input_length=STRING.LENGTH("&clk")
  &clk_itr_length=STRING.LENGTH("gcc_snoc_bus_timeout0_ahb_clk")

  if (STRING.SCAN("&clk", "*", 0)==0)
  (
    &wild_head=1
  )
  if (STRING.SCAN("&clk", "*", 1)==(STRING.LENGTH("&clk")-1))
  (
    &wild_tail=1
  )

  if ((&wild_head==1)&&(&wild_tail==1))
  (
    if (STRING.SCAN("gcc_snoc_bus_timeout0_ahb_clk", STRING.MID("&clk", 1, &clk_input_length-2), 0)!=-1)
    ( 
      &match=1
    )
  )
  else if (&wild_head==1)
  (
    if (STRING.MID("gcc_snoc_bus_timeout0_ahb_clk", &clk_itr_length-&clk_input_length+1, &clk_input_length-1)==STRING.CUT("&clk", 1))
    ( 
      &match=1
    )
  )
  else if (&wild_tail==1)
  (
    if (STRING.MID("gcc_snoc_bus_timeout0_ahb_clk", 0, &clk_input_length-1)==STRING.CUT("&clk", -1))
    ( 
      &match=1
    )
  )
  else if ("gcc_snoc_bus_timeout0_ahb_clk"=="&clk")
  (
    &match=1
  )
  
  if (&match==1)
  (
    &clk_test=&CLK_TEST_GCC_SNOC_BUS_TIMEOUT0_AHB_CLK
    &clk_reg=&HWIO_GCC_SNOC_BUS_TIMEOUT0_AHB_CBCR_ADDR
    &clk_reg_name="GCC_SNOC_BUS_TIMEOUT0_AHB_CBCR"
    &clk_name="gcc_snoc_bus_timeout0_ahb_clk"
    &clk_reg_cbcr_type="sm_cbc"
    &clk_vote_bit=-1.
    &clk_multiplier=4.
    &clk_access_mode="&GCC_access_mode"

    gosub Print_Clk_Info_Line
  )

  &match=0
  &wild_head=0
  &wild_tail=0
  &clk_input_length=STRING.LENGTH("&clk")
  &clk_itr_length=STRING.LENGTH("gcc_snoc_bus_timeout1_ahb_clk")

  if (STRING.SCAN("&clk", "*", 0)==0)
  (
    &wild_head=1
  )
  if (STRING.SCAN("&clk", "*", 1)==(STRING.LENGTH("&clk")-1))
  (
    &wild_tail=1
  )

  if ((&wild_head==1)&&(&wild_tail==1))
  (
    if (STRING.SCAN("gcc_snoc_bus_timeout1_ahb_clk", STRING.MID("&clk", 1, &clk_input_length-2), 0)!=-1)
    ( 
      &match=1
    )
  )
  else if (&wild_head==1)
  (
    if (STRING.MID("gcc_snoc_bus_timeout1_ahb_clk", &clk_itr_length-&clk_input_length+1, &clk_input_length-1)==STRING.CUT("&clk", 1))
    ( 
      &match=1
    )
  )
  else if (&wild_tail==1)
  (
    if (STRING.MID("gcc_snoc_bus_timeout1_ahb_clk", 0, &clk_input_length-1)==STRING.CUT("&clk", -1))
    ( 
      &match=1
    )
  )
  else if ("gcc_snoc_bus_timeout1_ahb_clk"=="&clk")
  (
    &match=1
  )
  
  if (&match==1)
  (
    &clk_test=&CLK_TEST_GCC_SNOC_BUS_TIMEOUT1_AHB_CLK
    &clk_reg=&HWIO_GCC_SNOC_BUS_TIMEOUT1_AHB_CBCR_ADDR
    &clk_reg_name="GCC_SNOC_BUS_TIMEOUT1_AHB_CBCR"
    &clk_name="gcc_snoc_bus_timeout1_ahb_clk"
    &clk_reg_cbcr_type="sm_cbc"
    &clk_vote_bit=-1.
    &clk_multiplier=4.
    &clk_access_mode="&GCC_access_mode"

    gosub Print_Clk_Info_Line
  )

  &match=0
  &wild_head=0
  &wild_tail=0
  &clk_input_length=STRING.LENGTH("&clk")
  &clk_itr_length=STRING.LENGTH("gcc_snoc_bus_timeout3_ahb_clk")

  if (STRING.SCAN("&clk", "*", 0)==0)
  (
    &wild_head=1
  )
  if (STRING.SCAN("&clk", "*", 1)==(STRING.LENGTH("&clk")-1))
  (
    &wild_tail=1
  )

  if ((&wild_head==1)&&(&wild_tail==1))
  (
    if (STRING.SCAN("gcc_snoc_bus_timeout3_ahb_clk", STRING.MID("&clk", 1, &clk_input_length-2), 0)!=-1)
    ( 
      &match=1
    )
  )
  else if (&wild_head==1)
  (
    if (STRING.MID("gcc_snoc_bus_timeout3_ahb_clk", &clk_itr_length-&clk_input_length+1, &clk_input_length-1)==STRING.CUT("&clk", 1))
    ( 
      &match=1
    )
  )
  else if (&wild_tail==1)
  (
    if (STRING.MID("gcc_snoc_bus_timeout3_ahb_clk", 0, &clk_input_length-1)==STRING.CUT("&clk", -1))
    ( 
      &match=1
    )
  )
  else if ("gcc_snoc_bus_timeout3_ahb_clk"=="&clk")
  (
    &match=1
  )
  
  if (&match==1)
  (
    &clk_test=&CLK_TEST_GCC_SNOC_BUS_TIMEOUT3_AHB_CLK
    &clk_reg=&HWIO_GCC_SNOC_BUS_TIMEOUT3_AHB_CBCR_ADDR
    &clk_reg_name="GCC_SNOC_BUS_TIMEOUT3_AHB_CBCR"
    &clk_name="gcc_snoc_bus_timeout3_ahb_clk"
    &clk_reg_cbcr_type="sm_cbc"
    &clk_vote_bit=-1.
    &clk_multiplier=4.
    &clk_access_mode="&GCC_access_mode"

    gosub Print_Clk_Info_Line
  )

  &match=0
  &wild_head=0
  &wild_tail=0
  &clk_input_length=STRING.LENGTH("&clk")
  &clk_itr_length=STRING.LENGTH("gcc_snoc_lpass_q6_axis_clk")

  if (STRING.SCAN("&clk", "*", 0)==0)
  (
    &wild_head=1
  )
  if (STRING.SCAN("&clk", "*", 1)==(STRING.LENGTH("&clk")-1))
  (
    &wild_tail=1
  )

  if ((&wild_head==1)&&(&wild_tail==1))
  (
    if (STRING.SCAN("gcc_snoc_lpass_q6_axis_clk", STRING.MID("&clk", 1, &clk_input_length-2), 0)!=-1)
    ( 
      &match=1
    )
  )
  else if (&wild_head==1)
  (
    if (STRING.MID("gcc_snoc_lpass_q6_axis_clk", &clk_itr_length-&clk_input_length+1, &clk_input_length-1)==STRING.CUT("&clk", 1))
    ( 
      &match=1
    )
  )
  else if (&wild_tail==1)
  (
    if (STRING.MID("gcc_snoc_lpass_q6_axis_clk", 0, &clk_input_length-1)==STRING.CUT("&clk", -1))
    ( 
      &match=1
    )
  )
  else if ("gcc_snoc_lpass_q6_axis_clk"=="&clk")
  (
    &match=1
  )
  
  if (&match==1)
  (
    &clk_test=&CLK_TEST_GCC_SNOC_LPASS_Q6_AXIS_CLK
    &clk_reg=&HWIO_GCC_SNOC_LPASS_Q6_AXIS_CBCR_ADDR
    &clk_reg_name="GCC_SNOC_LPASS_Q6_AXIS_CBCR"
    &clk_name="gcc_snoc_lpass_q6_axis_clk"
    &clk_reg_cbcr_type="sm_cbc"
    &clk_vote_bit=-1.
    &clk_multiplier=4.
    &clk_access_mode="&GCC_access_mode"

    gosub Print_Clk_Info_Line
  )

  &match=0
  &wild_head=0
  &wild_tail=0
  &clk_input_length=STRING.LENGTH("&clk")
  &clk_itr_length=STRING.LENGTH("gcc_spdm_snoc_cy_clk")

  if (STRING.SCAN("&clk", "*", 0)==0)
  (
    &wild_head=1
  )
  if (STRING.SCAN("&clk", "*", 1)==(STRING.LENGTH("&clk")-1))
  (
    &wild_tail=1
  )

  if ((&wild_head==1)&&(&wild_tail==1))
  (
    if (STRING.SCAN("gcc_spdm_snoc_cy_clk", STRING.MID("&clk", 1, &clk_input_length-2), 0)!=-1)
    ( 
      &match=1
    )
  )
  else if (&wild_head==1)
  (
    if (STRING.MID("gcc_spdm_snoc_cy_clk", &clk_itr_length-&clk_input_length+1, &clk_input_length-1)==STRING.CUT("&clk", 1))
    ( 
      &match=1
    )
  )
  else if (&wild_tail==1)
  (
    if (STRING.MID("gcc_spdm_snoc_cy_clk", 0, &clk_input_length-1)==STRING.CUT("&clk", -1))
    ( 
      &match=1
    )
  )
  else if ("gcc_spdm_snoc_cy_clk"=="&clk")
  (
    &match=1
  )
  
  if (&match==1)
  (
    &clk_test=&CLK_TEST_GCC_SPDM_SNOC_CY_CLK
    &clk_reg=&HWIO_GCC_SPDM_SNOC_CY_CBCR_ADDR
    &clk_reg_name="GCC_SPDM_SNOC_CY_CBCR"
    &clk_name="gcc_spdm_snoc_cy_clk"
    &clk_reg_cbcr_type="sm_cbc"
    &clk_vote_bit=-1.
    &clk_multiplier=4.
    &clk_access_mode="&GCC_access_mode"

    gosub Print_Clk_Info_Line
  )

  &match=0
  &wild_head=0
  &wild_tail=0
  &clk_input_length=STRING.LENGTH("&clk")
  &clk_itr_length=STRING.LENGTH("gcc_sys_noc_axi_clk")

  if (STRING.SCAN("&clk", "*", 0)==0)
  (
    &wild_head=1
  )
  if (STRING.SCAN("&clk", "*", 1)==(STRING.LENGTH("&clk")-1))
  (
    &wild_tail=1
  )

  if ((&wild_head==1)&&(&wild_tail==1))
  (
    if (STRING.SCAN("gcc_sys_noc_axi_clk", STRING.MID("&clk", 1, &clk_input_length-2), 0)!=-1)
    ( 
      &match=1
    )
  )
  else if (&wild_head==1)
  (
    if (STRING.MID("gcc_sys_noc_axi_clk", &clk_itr_length-&clk_input_length+1, &clk_input_length-1)==STRING.CUT("&clk", 1))
    ( 
      &match=1
    )
  )
  else if (&wild_tail==1)
  (
    if (STRING.MID("gcc_sys_noc_axi_clk", 0, &clk_input_length-1)==STRING.CUT("&clk", -1))
    ( 
      &match=1
    )
  )
  else if ("gcc_sys_noc_axi_clk"=="&clk")
  (
    &match=1
  )
  
  if (&match==1)
  (
    &clk_test=&CLK_TEST_GCC_SYS_NOC_AXI_CLK
    &clk_reg=&HWIO_GCC_SYS_NOC_AXI_CBCR_ADDR
    &clk_reg_name="GCC_SYS_NOC_AXI_CBCR"
    &clk_name="gcc_sys_noc_axi_clk"
    &clk_reg_cbcr_type="sm_cbc"
    &clk_vote_bit=-1.
    &clk_multiplier=4.
    &clk_access_mode="&GCC_access_mode"

    gosub Print_Clk_Info_Line
  )

  &match=0
  &wild_head=0
  &wild_tail=0
  &clk_input_length=STRING.LENGTH("&clk")
  &clk_itr_length=STRING.LENGTH("gcc_sys_noc_north_axi_clk")

  if (STRING.SCAN("&clk", "*", 0)==0)
  (
    &wild_head=1
  )
  if (STRING.SCAN("&clk", "*", 1)==(STRING.LENGTH("&clk")-1))
  (
    &wild_tail=1
  )

  if ((&wild_head==1)&&(&wild_tail==1))
  (
    if (STRING.SCAN("gcc_sys_noc_north_axi_clk", STRING.MID("&clk", 1, &clk_input_length-2), 0)!=-1)
    ( 
      &match=1
    )
  )
  else if (&wild_head==1)
  (
    if (STRING.MID("gcc_sys_noc_north_axi_clk", &clk_itr_length-&clk_input_length+1, &clk_input_length-1)==STRING.CUT("&clk", 1))
    ( 
      &match=1
    )
  )
  else if (&wild_tail==1)
  (
    if (STRING.MID("gcc_sys_noc_north_axi_clk", 0, &clk_input_length-1)==STRING.CUT("&clk", -1))
    ( 
      &match=1
    )
  )
  else if ("gcc_sys_noc_north_axi_clk"=="&clk")
  (
    &match=1
  )
  
  if (&match==1)
  (
    &clk_test=&CLK_TEST_GCC_SYS_NOC_NORTH_AXI_CLK
    &clk_reg=&HWIO_GCC_SYS_NOC_NORTH_AXI_CBCR_ADDR
    &clk_reg_name="GCC_SYS_NOC_NORTH_AXI_CBCR"
    &clk_name="gcc_sys_noc_north_axi_clk"
    &clk_reg_cbcr_type="sm_cbc"
    &clk_vote_bit=-1.
    &clk_multiplier=4.
    &clk_access_mode="&GCC_access_mode"

    gosub Print_Clk_Info_Line
  )

  &match=0
  &wild_head=0
  &wild_tail=0
  &clk_input_length=STRING.LENGTH("&clk")
  &clk_itr_length=STRING.LENGTH("gcc_sys_noc_south_axi_clk")

  if (STRING.SCAN("&clk", "*", 0)==0)
  (
    &wild_head=1
  )
  if (STRING.SCAN("&clk", "*", 1)==(STRING.LENGTH("&clk")-1))
  (
    &wild_tail=1
  )

  if ((&wild_head==1)&&(&wild_tail==1))
  (
    if (STRING.SCAN("gcc_sys_noc_south_axi_clk", STRING.MID("&clk", 1, &clk_input_length-2), 0)!=-1)
    ( 
      &match=1
    )
  )
  else if (&wild_head==1)
  (
    if (STRING.MID("gcc_sys_noc_south_axi_clk", &clk_itr_length-&clk_input_length+1, &clk_input_length-1)==STRING.CUT("&clk", 1))
    ( 
      &match=1
    )
  )
  else if (&wild_tail==1)
  (
    if (STRING.MID("gcc_sys_noc_south_axi_clk", 0, &clk_input_length-1)==STRING.CUT("&clk", -1))
    ( 
      &match=1
    )
  )
  else if ("gcc_sys_noc_south_axi_clk"=="&clk")
  (
    &match=1
  )
  
  if (&match==1)
  (
    &clk_test=&CLK_TEST_GCC_SYS_NOC_SOUTH_AXI_CLK
    &clk_reg=&HWIO_GCC_SYS_NOC_SOUTH_AXI_CBCR_ADDR
    &clk_reg_name="GCC_SYS_NOC_SOUTH_AXI_CBCR"
    &clk_name="gcc_sys_noc_south_axi_clk"
    &clk_reg_cbcr_type="sm_cbc"
    &clk_vote_bit=-1.
    &clk_multiplier=4.
    &clk_access_mode="&GCC_access_mode"

    gosub Print_Clk_Info_Line
  )

  &match=0
  &wild_head=0
  &wild_tail=0
  &clk_input_length=STRING.LENGTH("&clk")
  &clk_itr_length=STRING.LENGTH("gcc_turing_sway_clk")

  if (STRING.SCAN("&clk", "*", 0)==0)
  (
    &wild_head=1
  )
  if (STRING.SCAN("&clk", "*", 1)==(STRING.LENGTH("&clk")-1))
  (
    &wild_tail=1
  )

  if ((&wild_head==1)&&(&wild_tail==1))
  (
    if (STRING.SCAN("gcc_turing_sway_clk", STRING.MID("&clk", 1, &clk_input_length-2), 0)!=-1)
    ( 
      &match=1
    )
  )
  else if (&wild_head==1)
  (
    if (STRING.MID("gcc_turing_sway_clk", &clk_itr_length-&clk_input_length+1, &clk_input_length-1)==STRING.CUT("&clk", 1))
    ( 
      &match=1
    )
  )
  else if (&wild_tail==1)
  (
    if (STRING.MID("gcc_turing_sway_clk", 0, &clk_input_length-1)==STRING.CUT("&clk", -1))
    ( 
      &match=1
    )
  )
  else if ("gcc_turing_sway_clk"=="&clk")
  (
    &match=1
  )
  
  if (&match==1)
  (
    &clk_test=&CLK_TEST_GCC_TURING_SWAY_CLK
    &clk_reg=&HWIO_GCC_TURING_SWAY_CBCR_ADDR
    &clk_reg_name="GCC_TURING_SWAY_CBCR"
    &clk_name="gcc_turing_sway_clk"
    &clk_reg_cbcr_type="sm_cbc"
    &clk_vote_bit=-1.
    &clk_multiplier=4.
    &clk_access_mode="&GCC_access_mode"

    gosub Print_Clk_Info_Line
  )

  &match=0
  &wild_head=0
  &wild_tail=0
  &clk_input_length=STRING.LENGTH("&clk")
  &clk_itr_length=STRING.LENGTH("gcc_wcss_ahb_s0_clk")

  if (STRING.SCAN("&clk", "*", 0)==0)
  (
    &wild_head=1
  )
  if (STRING.SCAN("&clk", "*", 1)==(STRING.LENGTH("&clk")-1))
  (
    &wild_tail=1
  )

  if ((&wild_head==1)&&(&wild_tail==1))
  (
    if (STRING.SCAN("gcc_wcss_ahb_s0_clk", STRING.MID("&clk", 1, &clk_input_length-2), 0)!=-1)
    ( 
      &match=1
    )
  )
  else if (&wild_head==1)
  (
    if (STRING.MID("gcc_wcss_ahb_s0_clk", &clk_itr_length-&clk_input_length+1, &clk_input_length-1)==STRING.CUT("&clk", 1))
    ( 
      &match=1
    )
  )
  else if (&wild_tail==1)
  (
    if (STRING.MID("gcc_wcss_ahb_s0_clk", 0, &clk_input_length-1)==STRING.CUT("&clk", -1))
    ( 
      &match=1
    )
  )
  else if ("gcc_wcss_ahb_s0_clk"=="&clk")
  (
    &match=1
  )
  
  if (&match==1)
  (
    &clk_test=&CLK_TEST_GCC_WCSS_AHB_S0_CLK
    &clk_reg=&HWIO_GCC_WCSS_AHB_S0_CBCR_ADDR
    &clk_reg_name="GCC_WCSS_AHB_S0_CBCR"
    &clk_name="gcc_wcss_ahb_s0_clk"
    &clk_reg_cbcr_type="sm_cbc"
    &clk_vote_bit=-1.
    &clk_multiplier=4.
    &clk_access_mode="&GCC_access_mode"

    gosub Print_Clk_Info_Line
  )

  &match=0
  &wild_head=0
  &wild_tail=0
  &clk_input_length=STRING.LENGTH("&clk")
  &clk_itr_length=STRING.LENGTH("gcc_wcss_axi_m_clk")

  if (STRING.SCAN("&clk", "*", 0)==0)
  (
    &wild_head=1
  )
  if (STRING.SCAN("&clk", "*", 1)==(STRING.LENGTH("&clk")-1))
  (
    &wild_tail=1
  )

  if ((&wild_head==1)&&(&wild_tail==1))
  (
    if (STRING.SCAN("gcc_wcss_axi_m_clk", STRING.MID("&clk", 1, &clk_input_length-2), 0)!=-1)
    ( 
      &match=1
    )
  )
  else if (&wild_head==1)
  (
    if (STRING.MID("gcc_wcss_axi_m_clk", &clk_itr_length-&clk_input_length+1, &clk_input_length-1)==STRING.CUT("&clk", 1))
    ( 
      &match=1
    )
  )
  else if (&wild_tail==1)
  (
    if (STRING.MID("gcc_wcss_axi_m_clk", 0, &clk_input_length-1)==STRING.CUT("&clk", -1))
    ( 
      &match=1
    )
  )
  else if ("gcc_wcss_axi_m_clk"=="&clk")
  (
    &match=1
  )
  
  if (&match==1)
  (
    &clk_test=&CLK_TEST_GCC_WCSS_AXI_M_CLK
    &clk_reg=&HWIO_GCC_WCSS_AXI_M_CBCR_ADDR
    &clk_reg_name="GCC_WCSS_AXI_M_CBCR"
    &clk_name="gcc_wcss_axi_m_clk"
    &clk_reg_cbcr_type="sm_cbc"
    &clk_vote_bit=-1.
    &clk_multiplier=4.
    &clk_access_mode="&GCC_access_mode"

    gosub Print_Clk_Info_Line
  )

  &match=0
  &wild_head=0
  &wild_tail=0
  &clk_input_length=STRING.LENGTH("&clk")
  &clk_itr_length=STRING.LENGTH("gcc_wcss_ecahb_clk")

  if (STRING.SCAN("&clk", "*", 0)==0)
  (
    &wild_head=1
  )
  if (STRING.SCAN("&clk", "*", 1)==(STRING.LENGTH("&clk")-1))
  (
    &wild_tail=1
  )

  if ((&wild_head==1)&&(&wild_tail==1))
  (
    if (STRING.SCAN("gcc_wcss_ecahb_clk", STRING.MID("&clk", 1, &clk_input_length-2), 0)!=-1)
    ( 
      &match=1
    )
  )
  else if (&wild_head==1)
  (
    if (STRING.MID("gcc_wcss_ecahb_clk", &clk_itr_length-&clk_input_length+1, &clk_input_length-1)==STRING.CUT("&clk", 1))
    ( 
      &match=1
    )
  )
  else if (&wild_tail==1)
  (
    if (STRING.MID("gcc_wcss_ecahb_clk", 0, &clk_input_length-1)==STRING.CUT("&clk", -1))
    ( 
      &match=1
    )
  )
  else if ("gcc_wcss_ecahb_clk"=="&clk")
  (
    &match=1
  )
  
  if (&match==1)
  (
    &clk_test=&CLK_TEST_GCC_WCSS_ECAHB_CLK
    &clk_reg=&HWIO_GCC_WCSS_ECAHB_CBCR_ADDR
    &clk_reg_name="GCC_WCSS_ECAHB_CBCR"
    &clk_name="gcc_wcss_ecahb_clk"
    &clk_reg_cbcr_type="sm_cbc"
    &clk_vote_bit=-1.
    &clk_multiplier=4.
    &clk_access_mode="&GCC_access_mode"

    gosub Print_Clk_Info_Line
  )

  &match=0
  &wild_head=0
  &wild_tail=0
  &clk_input_length=STRING.LENGTH("&clk")
  &clk_itr_length=STRING.LENGTH("gcc_wcss_shdreg_ahb_clk")

  if (STRING.SCAN("&clk", "*", 0)==0)
  (
    &wild_head=1
  )
  if (STRING.SCAN("&clk", "*", 1)==(STRING.LENGTH("&clk")-1))
  (
    &wild_tail=1
  )

  if ((&wild_head==1)&&(&wild_tail==1))
  (
    if (STRING.SCAN("gcc_wcss_shdreg_ahb_clk", STRING.MID("&clk", 1, &clk_input_length-2), 0)!=-1)
    ( 
      &match=1
    )
  )
  else if (&wild_head==1)
  (
    if (STRING.MID("gcc_wcss_shdreg_ahb_clk", &clk_itr_length-&clk_input_length+1, &clk_input_length-1)==STRING.CUT("&clk", 1))
    ( 
      &match=1
    )
  )
  else if (&wild_tail==1)
  (
    if (STRING.MID("gcc_wcss_shdreg_ahb_clk", 0, &clk_input_length-1)==STRING.CUT("&clk", -1))
    ( 
      &match=1
    )
  )
  else if ("gcc_wcss_shdreg_ahb_clk"=="&clk")
  (
    &match=1
  )
  
  if (&match==1)
  (
    &clk_test=&CLK_TEST_GCC_WCSS_SHDREG_AHB_CLK
    &clk_reg=&HWIO_GCC_WCSS_SHDREG_AHB_CBCR_ADDR
    &clk_reg_name="GCC_WCSS_SHDREG_AHB_CBCR"
    &clk_name="gcc_wcss_shdreg_ahb_clk"
    &clk_reg_cbcr_type="sm_cbc"
    &clk_vote_bit=-1.
    &clk_multiplier=4.
    &clk_access_mode="&GCC_access_mode"

    gosub Print_Clk_Info_Line
  )

  &match=0
  &wild_head=0
  &wild_tail=0
  &clk_input_length=STRING.LENGTH("&clk")
  &clk_itr_length=STRING.LENGTH("gcc_cfg_noc_tic_clk")

  if (STRING.SCAN("&clk", "*", 0)==0)
  (
    &wild_head=1
  )
  if (STRING.SCAN("&clk", "*", 1)==(STRING.LENGTH("&clk")-1))
  (
    &wild_tail=1
  )

  if ((&wild_head==1)&&(&wild_tail==1))
  (
    if (STRING.SCAN("gcc_cfg_noc_tic_clk", STRING.MID("&clk", 1, &clk_input_length-2), 0)!=-1)
    ( 
      &match=1
    )
  )
  else if (&wild_head==1)
  (
    if (STRING.MID("gcc_cfg_noc_tic_clk", &clk_itr_length-&clk_input_length+1, &clk_input_length-1)==STRING.CUT("&clk", 1))
    ( 
      &match=1
    )
  )
  else if (&wild_tail==1)
  (
    if (STRING.MID("gcc_cfg_noc_tic_clk", 0, &clk_input_length-1)==STRING.CUT("&clk", -1))
    ( 
      &match=1
    )
  )
  else if ("gcc_cfg_noc_tic_clk"=="&clk")
  (
    &match=1
  )
  
  if (&match==1)
  (
    &clk_test=&CLK_TEST_GCC_CFG_NOC_TIC_CLK
    &clk_reg=0
    &clk_reg_name="No CBCR"
    &clk_name="gcc_cfg_noc_tic_clk"
    &clk_reg_cbcr_type=""
    &clk_vote_bit=-1.
    &clk_multiplier=4.
    &clk_access_mode="&GCC_access_mode"

    gosub Print_Clk_Info_Line
  )

  &match=0
  &wild_head=0
  &wild_tail=0
  &clk_input_length=STRING.LENGTH("&clk")
  &clk_itr_length=STRING.LENGTH("gcc_tic_clk")

  if (STRING.SCAN("&clk", "*", 0)==0)
  (
    &wild_head=1
  )
  if (STRING.SCAN("&clk", "*", 1)==(STRING.LENGTH("&clk")-1))
  (
    &wild_tail=1
  )

  if ((&wild_head==1)&&(&wild_tail==1))
  (
    if (STRING.SCAN("gcc_tic_clk", STRING.MID("&clk", 1, &clk_input_length-2), 0)!=-1)
    ( 
      &match=1
    )
  )
  else if (&wild_head==1)
  (
    if (STRING.MID("gcc_tic_clk", &clk_itr_length-&clk_input_length+1, &clk_input_length-1)==STRING.CUT("&clk", 1))
    ( 
      &match=1
    )
  )
  else if (&wild_tail==1)
  (
    if (STRING.MID("gcc_tic_clk", 0, &clk_input_length-1)==STRING.CUT("&clk", -1))
    ( 
      &match=1
    )
  )
  else if ("gcc_tic_clk"=="&clk")
  (
    &match=1
  )
  
  if (&match==1)
  (
    &clk_test=0
    &clk_reg=0
    &clk_reg_name="No CBCR"
    &clk_name="gcc_tic_clk"
    &clk_reg_cbcr_type=""
    &clk_vote_bit=-1.
    &clk_multiplier=4.
    &clk_access_mode="&GCC_access_mode"

    gosub Print_Clk_Info_Line
  )

  &match=0
  &wild_head=0
  &wild_tail=0
  &clk_input_length=STRING.LENGTH("&clk")
  &clk_itr_length=STRING.LENGTH("gcc_aggre2_ufs_axi_clk")

  if (STRING.SCAN("&clk", "*", 0)==0)
  (
    &wild_head=1
  )
  if (STRING.SCAN("&clk", "*", 1)==(STRING.LENGTH("&clk")-1))
  (
    &wild_tail=1
  )

  if ((&wild_head==1)&&(&wild_tail==1))
  (
    if (STRING.SCAN("gcc_aggre2_ufs_axi_clk", STRING.MID("&clk", 1, &clk_input_length-2), 0)!=-1)
    ( 
      &match=1
    )
  )
  else if (&wild_head==1)
  (
    if (STRING.MID("gcc_aggre2_ufs_axi_clk", &clk_itr_length-&clk_input_length+1, &clk_input_length-1)==STRING.CUT("&clk", 1))
    ( 
      &match=1
    )
  )
  else if (&wild_tail==1)
  (
    if (STRING.MID("gcc_aggre2_ufs_axi_clk", 0, &clk_input_length-1)==STRING.CUT("&clk", -1))
    ( 
      &match=1
    )
  )
  else if ("gcc_aggre2_ufs_axi_clk"=="&clk")
  (
    &match=1
  )
  
  if (&match==1)
  (
    &clk_test=&CLK_TEST_GCC_AGGRE2_UFS_AXI_CLK
    &clk_reg=&HWIO_GCC_AGGRE2_UFS_AXI_CBCR_ADDR
    &clk_reg_name="GCC_AGGRE2_UFS_AXI_CBCR"
    &clk_name="gcc_aggre2_ufs_axi_clk"
    &clk_reg_cbcr_type="sm_cbc"
    &clk_vote_bit=-1.
    &clk_multiplier=4.
    &clk_access_mode="&GCC_access_mode"

    gosub Print_Clk_Info_Line
  )

  &match=0
  &wild_head=0
  &wild_tail=0
  &clk_input_length=STRING.LENGTH("&clk")
  &clk_itr_length=STRING.LENGTH("gcc_ufs_axi_clk")

  if (STRING.SCAN("&clk", "*", 0)==0)
  (
    &wild_head=1
  )
  if (STRING.SCAN("&clk", "*", 1)==(STRING.LENGTH("&clk")-1))
  (
    &wild_tail=1
  )

  if ((&wild_head==1)&&(&wild_tail==1))
  (
    if (STRING.SCAN("gcc_ufs_axi_clk", STRING.MID("&clk", 1, &clk_input_length-2), 0)!=-1)
    ( 
      &match=1
    )
  )
  else if (&wild_head==1)
  (
    if (STRING.MID("gcc_ufs_axi_clk", &clk_itr_length-&clk_input_length+1, &clk_input_length-1)==STRING.CUT("&clk", 1))
    ( 
      &match=1
    )
  )
  else if (&wild_tail==1)
  (
    if (STRING.MID("gcc_ufs_axi_clk", 0, &clk_input_length-1)==STRING.CUT("&clk", -1))
    ( 
      &match=1
    )
  )
  else if ("gcc_ufs_axi_clk"=="&clk")
  (
    &match=1
  )
  
  if (&match==1)
  (
    &clk_test=&CLK_TEST_GCC_UFS_AXI_CLK
    &clk_reg=&HWIO_GCC_UFS_AXI_CBCR_ADDR
    &clk_reg_name="GCC_UFS_AXI_CBCR"
    &clk_name="gcc_ufs_axi_clk"
    &clk_reg_cbcr_type="sm_pscbc"
    &clk_vote_bit=-1.
    &clk_multiplier=4.
    &clk_access_mode="&GCC_access_mode"

    gosub Print_Clk_Info_Line
  )

  &match=0
  &wild_head=0
  &wild_tail=0
  &clk_input_length=STRING.LENGTH("&clk")
  &clk_itr_length=STRING.LENGTH("gcc_ufs_ice_core_clk")

  if (STRING.SCAN("&clk", "*", 0)==0)
  (
    &wild_head=1
  )
  if (STRING.SCAN("&clk", "*", 1)==(STRING.LENGTH("&clk")-1))
  (
    &wild_tail=1
  )

  if ((&wild_head==1)&&(&wild_tail==1))
  (
    if (STRING.SCAN("gcc_ufs_ice_core_clk", STRING.MID("&clk", 1, &clk_input_length-2), 0)!=-1)
    ( 
      &match=1
    )
  )
  else if (&wild_head==1)
  (
    if (STRING.MID("gcc_ufs_ice_core_clk", &clk_itr_length-&clk_input_length+1, &clk_input_length-1)==STRING.CUT("&clk", 1))
    ( 
      &match=1
    )
  )
  else if (&wild_tail==1)
  (
    if (STRING.MID("gcc_ufs_ice_core_clk", 0, &clk_input_length-1)==STRING.CUT("&clk", -1))
    ( 
      &match=1
    )
  )
  else if ("gcc_ufs_ice_core_clk"=="&clk")
  (
    &match=1
  )
  
  if (&match==1)
  (
    &clk_test=&CLK_TEST_GCC_UFS_ICE_CORE_CLK
    &clk_reg=&HWIO_GCC_UFS_ICE_CORE_CBCR_ADDR
    &clk_reg_name="GCC_UFS_ICE_CORE_CBCR"
    &clk_name="gcc_ufs_ice_core_clk"
    &clk_reg_cbcr_type="sm_pscbc"
    &clk_vote_bit=-1.
    &clk_multiplier=4.
    &clk_access_mode="&GCC_access_mode"

    gosub Print_Clk_Info_Line
  )

  &match=0
  &wild_head=0
  &wild_tail=0
  &clk_input_length=STRING.LENGTH("&clk")
  &clk_itr_length=STRING.LENGTH("gcc_ufs_phy_aux_clk")

  if (STRING.SCAN("&clk", "*", 0)==0)
  (
    &wild_head=1
  )
  if (STRING.SCAN("&clk", "*", 1)==(STRING.LENGTH("&clk")-1))
  (
    &wild_tail=1
  )

  if ((&wild_head==1)&&(&wild_tail==1))
  (
    if (STRING.SCAN("gcc_ufs_phy_aux_clk", STRING.MID("&clk", 1, &clk_input_length-2), 0)!=-1)
    ( 
      &match=1
    )
  )
  else if (&wild_head==1)
  (
    if (STRING.MID("gcc_ufs_phy_aux_clk", &clk_itr_length-&clk_input_length+1, &clk_input_length-1)==STRING.CUT("&clk", 1))
    ( 
      &match=1
    )
  )
  else if (&wild_tail==1)
  (
    if (STRING.MID("gcc_ufs_phy_aux_clk", 0, &clk_input_length-1)==STRING.CUT("&clk", -1))
    ( 
      &match=1
    )
  )
  else if ("gcc_ufs_phy_aux_clk"=="&clk")
  (
    &match=1
  )
  
  if (&match==1)
  (
    &clk_test=&CLK_TEST_GCC_UFS_PHY_AUX_CLK
    &clk_reg=&HWIO_GCC_UFS_PHY_AUX_CBCR_ADDR
    &clk_reg_name="GCC_UFS_PHY_AUX_CBCR"
    &clk_name="gcc_ufs_phy_aux_clk"
    &clk_reg_cbcr_type="sm_cbc"
    &clk_vote_bit=-1.
    &clk_multiplier=4.
    &clk_access_mode="&GCC_access_mode"

    gosub Print_Clk_Info_Line
  )

  &match=0
  &wild_head=0
  &wild_tail=0
  &clk_input_length=STRING.LENGTH("&clk")
  &clk_itr_length=STRING.LENGTH("gcc_ufs_rx_symbol_0_clk")

  if (STRING.SCAN("&clk", "*", 0)==0)
  (
    &wild_head=1
  )
  if (STRING.SCAN("&clk", "*", 1)==(STRING.LENGTH("&clk")-1))
  (
    &wild_tail=1
  )

  if ((&wild_head==1)&&(&wild_tail==1))
  (
    if (STRING.SCAN("gcc_ufs_rx_symbol_0_clk", STRING.MID("&clk", 1, &clk_input_length-2), 0)!=-1)
    ( 
      &match=1
    )
  )
  else if (&wild_head==1)
  (
    if (STRING.MID("gcc_ufs_rx_symbol_0_clk", &clk_itr_length-&clk_input_length+1, &clk_input_length-1)==STRING.CUT("&clk", 1))
    ( 
      &match=1
    )
  )
  else if (&wild_tail==1)
  (
    if (STRING.MID("gcc_ufs_rx_symbol_0_clk", 0, &clk_input_length-1)==STRING.CUT("&clk", -1))
    ( 
      &match=1
    )
  )
  else if ("gcc_ufs_rx_symbol_0_clk"=="&clk")
  (
    &match=1
  )
  
  if (&match==1)
  (
    &clk_test=&CLK_TEST_GCC_UFS_RX_SYMBOL_0_CLK
    &clk_reg=&HWIO_GCC_UFS_RX_SYMBOL_0_CBCR_ADDR
    &clk_reg_name="GCC_UFS_RX_SYMBOL_0_CBCR"
    &clk_name="gcc_ufs_rx_symbol_0_clk"
    &clk_reg_cbcr_type="sm_cbc"
    &clk_vote_bit=-1.
    &clk_multiplier=4.
    &clk_access_mode="&GCC_access_mode"

    gosub Print_Clk_Info_Line
  )

  &match=0
  &wild_head=0
  &wild_tail=0
  &clk_input_length=STRING.LENGTH("&clk")
  &clk_itr_length=STRING.LENGTH("gcc_ufs_rx_symbol_1_clk")

  if (STRING.SCAN("&clk", "*", 0)==0)
  (
    &wild_head=1
  )
  if (STRING.SCAN("&clk", "*", 1)==(STRING.LENGTH("&clk")-1))
  (
    &wild_tail=1
  )

  if ((&wild_head==1)&&(&wild_tail==1))
  (
    if (STRING.SCAN("gcc_ufs_rx_symbol_1_clk", STRING.MID("&clk", 1, &clk_input_length-2), 0)!=-1)
    ( 
      &match=1
    )
  )
  else if (&wild_head==1)
  (
    if (STRING.MID("gcc_ufs_rx_symbol_1_clk", &clk_itr_length-&clk_input_length+1, &clk_input_length-1)==STRING.CUT("&clk", 1))
    ( 
      &match=1
    )
  )
  else if (&wild_tail==1)
  (
    if (STRING.MID("gcc_ufs_rx_symbol_1_clk", 0, &clk_input_length-1)==STRING.CUT("&clk", -1))
    ( 
      &match=1
    )
  )
  else if ("gcc_ufs_rx_symbol_1_clk"=="&clk")
  (
    &match=1
  )
  
  if (&match==1)
  (
    &clk_test=&CLK_TEST_GCC_UFS_RX_SYMBOL_1_CLK
    &clk_reg=&HWIO_GCC_UFS_RX_SYMBOL_1_CBCR_ADDR
    &clk_reg_name="GCC_UFS_RX_SYMBOL_1_CBCR"
    &clk_name="gcc_ufs_rx_symbol_1_clk"
    &clk_reg_cbcr_type="sm_cbc"
    &clk_vote_bit=-1.
    &clk_multiplier=4.
    &clk_access_mode="&GCC_access_mode"

    gosub Print_Clk_Info_Line
  )

  &match=0
  &wild_head=0
  &wild_tail=0
  &clk_input_length=STRING.LENGTH("&clk")
  &clk_itr_length=STRING.LENGTH("gcc_ufs_tx_symbol_0_clk")

  if (STRING.SCAN("&clk", "*", 0)==0)
  (
    &wild_head=1
  )
  if (STRING.SCAN("&clk", "*", 1)==(STRING.LENGTH("&clk")-1))
  (
    &wild_tail=1
  )

  if ((&wild_head==1)&&(&wild_tail==1))
  (
    if (STRING.SCAN("gcc_ufs_tx_symbol_0_clk", STRING.MID("&clk", 1, &clk_input_length-2), 0)!=-1)
    ( 
      &match=1
    )
  )
  else if (&wild_head==1)
  (
    if (STRING.MID("gcc_ufs_tx_symbol_0_clk", &clk_itr_length-&clk_input_length+1, &clk_input_length-1)==STRING.CUT("&clk", 1))
    ( 
      &match=1
    )
  )
  else if (&wild_tail==1)
  (
    if (STRING.MID("gcc_ufs_tx_symbol_0_clk", 0, &clk_input_length-1)==STRING.CUT("&clk", -1))
    ( 
      &match=1
    )
  )
  else if ("gcc_ufs_tx_symbol_0_clk"=="&clk")
  (
    &match=1
  )
  
  if (&match==1)
  (
    &clk_test=&CLK_TEST_GCC_UFS_TX_SYMBOL_0_CLK
    &clk_reg=&HWIO_GCC_UFS_TX_SYMBOL_0_CBCR_ADDR
    &clk_reg_name="GCC_UFS_TX_SYMBOL_0_CBCR"
    &clk_name="gcc_ufs_tx_symbol_0_clk"
    &clk_reg_cbcr_type="sm_cbc"
    &clk_vote_bit=-1.
    &clk_multiplier=4.
    &clk_access_mode="&GCC_access_mode"

    gosub Print_Clk_Info_Line
  )

  &match=0
  &wild_head=0
  &wild_tail=0
  &clk_input_length=STRING.LENGTH("&clk")
  &clk_itr_length=STRING.LENGTH("gcc_ufs_unipro_core_clk")

  if (STRING.SCAN("&clk", "*", 0)==0)
  (
    &wild_head=1
  )
  if (STRING.SCAN("&clk", "*", 1)==(STRING.LENGTH("&clk")-1))
  (
    &wild_tail=1
  )

  if ((&wild_head==1)&&(&wild_tail==1))
  (
    if (STRING.SCAN("gcc_ufs_unipro_core_clk", STRING.MID("&clk", 1, &clk_input_length-2), 0)!=-1)
    ( 
      &match=1
    )
  )
  else if (&wild_head==1)
  (
    if (STRING.MID("gcc_ufs_unipro_core_clk", &clk_itr_length-&clk_input_length+1, &clk_input_length-1)==STRING.CUT("&clk", 1))
    ( 
      &match=1
    )
  )
  else if (&wild_tail==1)
  (
    if (STRING.MID("gcc_ufs_unipro_core_clk", 0, &clk_input_length-1)==STRING.CUT("&clk", -1))
    ( 
      &match=1
    )
  )
  else if ("gcc_ufs_unipro_core_clk"=="&clk")
  (
    &match=1
  )
  
  if (&match==1)
  (
    &clk_test=&CLK_TEST_GCC_UFS_UNIPRO_CORE_CLK
    &clk_reg=&HWIO_GCC_UFS_UNIPRO_CORE_CBCR_ADDR
    &clk_reg_name="GCC_UFS_UNIPRO_CORE_CBCR"
    &clk_name="gcc_ufs_unipro_core_clk"
    &clk_reg_cbcr_type="sm_pscbc"
    &clk_vote_bit=-1.
    &clk_multiplier=4.
    &clk_access_mode="&GCC_access_mode"

    gosub Print_Clk_Info_Line
  )

  &match=0
  &wild_head=0
  &wild_tail=0
  &clk_input_length=STRING.LENGTH("&clk")
  &clk_itr_length=STRING.LENGTH("gcc_cfg_noc_usb2_axi_clk")

  if (STRING.SCAN("&clk", "*", 0)==0)
  (
    &wild_head=1
  )
  if (STRING.SCAN("&clk", "*", 1)==(STRING.LENGTH("&clk")-1))
  (
    &wild_tail=1
  )

  if ((&wild_head==1)&&(&wild_tail==1))
  (
    if (STRING.SCAN("gcc_cfg_noc_usb2_axi_clk", STRING.MID("&clk", 1, &clk_input_length-2), 0)!=-1)
    ( 
      &match=1
    )
  )
  else if (&wild_head==1)
  (
    if (STRING.MID("gcc_cfg_noc_usb2_axi_clk", &clk_itr_length-&clk_input_length+1, &clk_input_length-1)==STRING.CUT("&clk", 1))
    ( 
      &match=1
    )
  )
  else if (&wild_tail==1)
  (
    if (STRING.MID("gcc_cfg_noc_usb2_axi_clk", 0, &clk_input_length-1)==STRING.CUT("&clk", -1))
    ( 
      &match=1
    )
  )
  else if ("gcc_cfg_noc_usb2_axi_clk"=="&clk")
  (
    &match=1
  )
  
  if (&match==1)
  (
    &clk_test=&CLK_TEST_GCC_CFG_NOC_USB2_AXI_CLK
    &clk_reg=&HWIO_GCC_CFG_NOC_USB2_AXI_CBCR_ADDR
    &clk_reg_name="GCC_CFG_NOC_USB2_AXI_CBCR"
    &clk_name="gcc_cfg_noc_usb2_axi_clk"
    &clk_reg_cbcr_type="sm_cbc"
    &clk_vote_bit=-1.
    &clk_multiplier=4.
    &clk_access_mode="&GCC_access_mode"

    gosub Print_Clk_Info_Line
  )

  &match=0
  &wild_head=0
  &wild_tail=0
  &clk_input_length=STRING.LENGTH("&clk")
  &clk_itr_length=STRING.LENGTH("gcc_cnoc_bus_timeout12_ahb_clk")

  if (STRING.SCAN("&clk", "*", 0)==0)
  (
    &wild_head=1
  )
  if (STRING.SCAN("&clk", "*", 1)==(STRING.LENGTH("&clk")-1))
  (
    &wild_tail=1
  )

  if ((&wild_head==1)&&(&wild_tail==1))
  (
    if (STRING.SCAN("gcc_cnoc_bus_timeout12_ahb_clk", STRING.MID("&clk", 1, &clk_input_length-2), 0)!=-1)
    ( 
      &match=1
    )
  )
  else if (&wild_head==1)
  (
    if (STRING.MID("gcc_cnoc_bus_timeout12_ahb_clk", &clk_itr_length-&clk_input_length+1, &clk_input_length-1)==STRING.CUT("&clk", 1))
    ( 
      &match=1
    )
  )
  else if (&wild_tail==1)
  (
    if (STRING.MID("gcc_cnoc_bus_timeout12_ahb_clk", 0, &clk_input_length-1)==STRING.CUT("&clk", -1))
    ( 
      &match=1
    )
  )
  else if ("gcc_cnoc_bus_timeout12_ahb_clk"=="&clk")
  (
    &match=1
  )
  
  if (&match==1)
  (
    &clk_test=&CLK_TEST_GCC_CNOC_BUS_TIMEOUT12_AHB_CLK
    &clk_reg=&HWIO_GCC_CNOC_BUS_TIMEOUT12_AHB_CBCR_ADDR
    &clk_reg_name="GCC_CNOC_BUS_TIMEOUT12_AHB_CBCR"
    &clk_name="gcc_cnoc_bus_timeout12_ahb_clk"
    &clk_reg_cbcr_type="sm_cbc"
    &clk_vote_bit=-1.
    &clk_multiplier=4.
    &clk_access_mode="&GCC_access_mode"

    gosub Print_Clk_Info_Line
  )

  &match=0
  &wild_head=0
  &wild_tail=0
  &clk_input_length=STRING.LENGTH("&clk")
  &clk_itr_length=STRING.LENGTH("gcc_usb20_master_clk")

  if (STRING.SCAN("&clk", "*", 0)==0)
  (
    &wild_head=1
  )
  if (STRING.SCAN("&clk", "*", 1)==(STRING.LENGTH("&clk")-1))
  (
    &wild_tail=1
  )

  if ((&wild_head==1)&&(&wild_tail==1))
  (
    if (STRING.SCAN("gcc_usb20_master_clk", STRING.MID("&clk", 1, &clk_input_length-2), 0)!=-1)
    ( 
      &match=1
    )
  )
  else if (&wild_head==1)
  (
    if (STRING.MID("gcc_usb20_master_clk", &clk_itr_length-&clk_input_length+1, &clk_input_length-1)==STRING.CUT("&clk", 1))
    ( 
      &match=1
    )
  )
  else if (&wild_tail==1)
  (
    if (STRING.MID("gcc_usb20_master_clk", 0, &clk_input_length-1)==STRING.CUT("&clk", -1))
    ( 
      &match=1
    )
  )
  else if ("gcc_usb20_master_clk"=="&clk")
  (
    &match=1
  )
  
  if (&match==1)
  (
    &clk_test=&CLK_TEST_GCC_USB20_MASTER_CLK
    &clk_reg=&HWIO_GCC_USB20_MASTER_CBCR_ADDR
    &clk_reg_name="GCC_USB20_MASTER_CBCR"
    &clk_name="gcc_usb20_master_clk"
    &clk_reg_cbcr_type="sm_pscbc"
    &clk_vote_bit=-1.
    &clk_multiplier=4.
    &clk_access_mode="&GCC_access_mode"

    gosub Print_Clk_Info_Line
  )

  &match=0
  &wild_head=0
  &wild_tail=0
  &clk_input_length=STRING.LENGTH("&clk")
  &clk_itr_length=STRING.LENGTH("gcc_usb20_mock_utmi_clk")

  if (STRING.SCAN("&clk", "*", 0)==0)
  (
    &wild_head=1
  )
  if (STRING.SCAN("&clk", "*", 1)==(STRING.LENGTH("&clk")-1))
  (
    &wild_tail=1
  )

  if ((&wild_head==1)&&(&wild_tail==1))
  (
    if (STRING.SCAN("gcc_usb20_mock_utmi_clk", STRING.MID("&clk", 1, &clk_input_length-2), 0)!=-1)
    ( 
      &match=1
    )
  )
  else if (&wild_head==1)
  (
    if (STRING.MID("gcc_usb20_mock_utmi_clk", &clk_itr_length-&clk_input_length+1, &clk_input_length-1)==STRING.CUT("&clk", 1))
    ( 
      &match=1
    )
  )
  else if (&wild_tail==1)
  (
    if (STRING.MID("gcc_usb20_mock_utmi_clk", 0, &clk_input_length-1)==STRING.CUT("&clk", -1))
    ( 
      &match=1
    )
  )
  else if ("gcc_usb20_mock_utmi_clk"=="&clk")
  (
    &match=1
  )
  
  if (&match==1)
  (
    &clk_test=&CLK_TEST_GCC_USB20_MOCK_UTMI_CLK
    &clk_reg=&HWIO_GCC_USB20_MOCK_UTMI_CBCR_ADDR
    &clk_reg_name="GCC_USB20_MOCK_UTMI_CBCR"
    &clk_name="gcc_usb20_mock_utmi_clk"
    &clk_reg_cbcr_type="sm_cbc"
    &clk_vote_bit=-1.
    &clk_multiplier=4.
    &clk_access_mode="&GCC_access_mode"

    gosub Print_Clk_Info_Line
  )

  &match=0
  &wild_head=0
  &wild_tail=0
  &clk_input_length=STRING.LENGTH("&clk")
  &clk_itr_length=STRING.LENGTH("gcc_aggre2_usb3_axi_clk")

  if (STRING.SCAN("&clk", "*", 0)==0)
  (
    &wild_head=1
  )
  if (STRING.SCAN("&clk", "*", 1)==(STRING.LENGTH("&clk")-1))
  (
    &wild_tail=1
  )

  if ((&wild_head==1)&&(&wild_tail==1))
  (
    if (STRING.SCAN("gcc_aggre2_usb3_axi_clk", STRING.MID("&clk", 1, &clk_input_length-2), 0)!=-1)
    ( 
      &match=1
    )
  )
  else if (&wild_head==1)
  (
    if (STRING.MID("gcc_aggre2_usb3_axi_clk", &clk_itr_length-&clk_input_length+1, &clk_input_length-1)==STRING.CUT("&clk", 1))
    ( 
      &match=1
    )
  )
  else if (&wild_tail==1)
  (
    if (STRING.MID("gcc_aggre2_usb3_axi_clk", 0, &clk_input_length-1)==STRING.CUT("&clk", -1))
    ( 
      &match=1
    )
  )
  else if ("gcc_aggre2_usb3_axi_clk"=="&clk")
  (
    &match=1
  )
  
  if (&match==1)
  (
    &clk_test=&CLK_TEST_GCC_AGGRE2_USB3_AXI_CLK
    &clk_reg=&HWIO_GCC_AGGRE2_USB3_AXI_CBCR_ADDR
    &clk_reg_name="GCC_AGGRE2_USB3_AXI_CBCR"
    &clk_name="gcc_aggre2_usb3_axi_clk"
    &clk_reg_cbcr_type="sm_cbc"
    &clk_vote_bit=-1.
    &clk_multiplier=4.
    &clk_access_mode="&GCC_access_mode"

    gosub Print_Clk_Info_Line
  )

  &match=0
  &wild_head=0
  &wild_tail=0
  &clk_input_length=STRING.LENGTH("&clk")
  &clk_itr_length=STRING.LENGTH("gcc_cfg_noc_usb3_axi_clk")

  if (STRING.SCAN("&clk", "*", 0)==0)
  (
    &wild_head=1
  )
  if (STRING.SCAN("&clk", "*", 1)==(STRING.LENGTH("&clk")-1))
  (
    &wild_tail=1
  )

  if ((&wild_head==1)&&(&wild_tail==1))
  (
    if (STRING.SCAN("gcc_cfg_noc_usb3_axi_clk", STRING.MID("&clk", 1, &clk_input_length-2), 0)!=-1)
    ( 
      &match=1
    )
  )
  else if (&wild_head==1)
  (
    if (STRING.MID("gcc_cfg_noc_usb3_axi_clk", &clk_itr_length-&clk_input_length+1, &clk_input_length-1)==STRING.CUT("&clk", 1))
    ( 
      &match=1
    )
  )
  else if (&wild_tail==1)
  (
    if (STRING.MID("gcc_cfg_noc_usb3_axi_clk", 0, &clk_input_length-1)==STRING.CUT("&clk", -1))
    ( 
      &match=1
    )
  )
  else if ("gcc_cfg_noc_usb3_axi_clk"=="&clk")
  (
    &match=1
  )
  
  if (&match==1)
  (
    &clk_test=&CLK_TEST_GCC_CFG_NOC_USB3_AXI_CLK
    &clk_reg=&HWIO_GCC_CFG_NOC_USB3_AXI_CBCR_ADDR
    &clk_reg_name="GCC_CFG_NOC_USB3_AXI_CBCR"
    &clk_name="gcc_cfg_noc_usb3_axi_clk"
    &clk_reg_cbcr_type="sm_cbc"
    &clk_vote_bit=-1.
    &clk_multiplier=4.
    &clk_access_mode="&GCC_access_mode"

    gosub Print_Clk_Info_Line
  )

  &match=0
  &wild_head=0
  &wild_tail=0
  &clk_input_length=STRING.LENGTH("&clk")
  &clk_itr_length=STRING.LENGTH("gcc_cnoc_bus_timeout14_ahb_clk")

  if (STRING.SCAN("&clk", "*", 0)==0)
  (
    &wild_head=1
  )
  if (STRING.SCAN("&clk", "*", 1)==(STRING.LENGTH("&clk")-1))
  (
    &wild_tail=1
  )

  if ((&wild_head==1)&&(&wild_tail==1))
  (
    if (STRING.SCAN("gcc_cnoc_bus_timeout14_ahb_clk", STRING.MID("&clk", 1, &clk_input_length-2), 0)!=-1)
    ( 
      &match=1
    )
  )
  else if (&wild_head==1)
  (
    if (STRING.MID("gcc_cnoc_bus_timeout14_ahb_clk", &clk_itr_length-&clk_input_length+1, &clk_input_length-1)==STRING.CUT("&clk", 1))
    ( 
      &match=1
    )
  )
  else if (&wild_tail==1)
  (
    if (STRING.MID("gcc_cnoc_bus_timeout14_ahb_clk", 0, &clk_input_length-1)==STRING.CUT("&clk", -1))
    ( 
      &match=1
    )
  )
  else if ("gcc_cnoc_bus_timeout14_ahb_clk"=="&clk")
  (
    &match=1
  )
  
  if (&match==1)
  (
    &clk_test=&CLK_TEST_GCC_CNOC_BUS_TIMEOUT14_AHB_CLK
    &clk_reg=&HWIO_GCC_CNOC_BUS_TIMEOUT14_AHB_CBCR_ADDR
    &clk_reg_name="GCC_CNOC_BUS_TIMEOUT14_AHB_CBCR"
    &clk_name="gcc_cnoc_bus_timeout14_ahb_clk"
    &clk_reg_cbcr_type="sm_cbc"
    &clk_vote_bit=-1.
    &clk_multiplier=4.
    &clk_access_mode="&GCC_access_mode"

    gosub Print_Clk_Info_Line
  )

  &match=0
  &wild_head=0
  &wild_tail=0
  &clk_input_length=STRING.LENGTH("&clk")
  &clk_itr_length=STRING.LENGTH("gcc_usb30_master_clk")

  if (STRING.SCAN("&clk", "*", 0)==0)
  (
    &wild_head=1
  )
  if (STRING.SCAN("&clk", "*", 1)==(STRING.LENGTH("&clk")-1))
  (
    &wild_tail=1
  )

  if ((&wild_head==1)&&(&wild_tail==1))
  (
    if (STRING.SCAN("gcc_usb30_master_clk", STRING.MID("&clk", 1, &clk_input_length-2), 0)!=-1)
    ( 
      &match=1
    )
  )
  else if (&wild_head==1)
  (
    if (STRING.MID("gcc_usb30_master_clk", &clk_itr_length-&clk_input_length+1, &clk_input_length-1)==STRING.CUT("&clk", 1))
    ( 
      &match=1
    )
  )
  else if (&wild_tail==1)
  (
    if (STRING.MID("gcc_usb30_master_clk", 0, &clk_input_length-1)==STRING.CUT("&clk", -1))
    ( 
      &match=1
    )
  )
  else if ("gcc_usb30_master_clk"=="&clk")
  (
    &match=1
  )
  
  if (&match==1)
  (
    &clk_test=&CLK_TEST_GCC_USB30_MASTER_CLK
    &clk_reg=&HWIO_GCC_USB30_MASTER_CBCR_ADDR
    &clk_reg_name="GCC_USB30_MASTER_CBCR"
    &clk_name="gcc_usb30_master_clk"
    &clk_reg_cbcr_type="sm_pscbc"
    &clk_vote_bit=-1.
    &clk_multiplier=4.
    &clk_access_mode="&GCC_access_mode"

    gosub Print_Clk_Info_Line
  )

  &match=0
  &wild_head=0
  &wild_tail=0
  &clk_input_length=STRING.LENGTH("&clk")
  &clk_itr_length=STRING.LENGTH("gcc_usb30_mock_utmi_clk")

  if (STRING.SCAN("&clk", "*", 0)==0)
  (
    &wild_head=1
  )
  if (STRING.SCAN("&clk", "*", 1)==(STRING.LENGTH("&clk")-1))
  (
    &wild_tail=1
  )

  if ((&wild_head==1)&&(&wild_tail==1))
  (
    if (STRING.SCAN("gcc_usb30_mock_utmi_clk", STRING.MID("&clk", 1, &clk_input_length-2), 0)!=-1)
    ( 
      &match=1
    )
  )
  else if (&wild_head==1)
  (
    if (STRING.MID("gcc_usb30_mock_utmi_clk", &clk_itr_length-&clk_input_length+1, &clk_input_length-1)==STRING.CUT("&clk", 1))
    ( 
      &match=1
    )
  )
  else if (&wild_tail==1)
  (
    if (STRING.MID("gcc_usb30_mock_utmi_clk", 0, &clk_input_length-1)==STRING.CUT("&clk", -1))
    ( 
      &match=1
    )
  )
  else if ("gcc_usb30_mock_utmi_clk"=="&clk")
  (
    &match=1
  )
  
  if (&match==1)
  (
    &clk_test=&CLK_TEST_GCC_USB30_MOCK_UTMI_CLK
    &clk_reg=&HWIO_GCC_USB30_MOCK_UTMI_CBCR_ADDR
    &clk_reg_name="GCC_USB30_MOCK_UTMI_CBCR"
    &clk_name="gcc_usb30_mock_utmi_clk"
    &clk_reg_cbcr_type="sm_cbc"
    &clk_vote_bit=-1.
    &clk_multiplier=4.
    &clk_access_mode="&GCC_access_mode"

    gosub Print_Clk_Info_Line
  )

  &match=0
  &wild_head=0
  &wild_tail=0
  &clk_input_length=STRING.LENGTH("&clk")
  &clk_itr_length=STRING.LENGTH("gcc_usb3_phy_aux_clk")

  if (STRING.SCAN("&clk", "*", 0)==0)
  (
    &wild_head=1
  )
  if (STRING.SCAN("&clk", "*", 1)==(STRING.LENGTH("&clk")-1))
  (
    &wild_tail=1
  )

  if ((&wild_head==1)&&(&wild_tail==1))
  (
    if (STRING.SCAN("gcc_usb3_phy_aux_clk", STRING.MID("&clk", 1, &clk_input_length-2), 0)!=-1)
    ( 
      &match=1
    )
  )
  else if (&wild_head==1)
  (
    if (STRING.MID("gcc_usb3_phy_aux_clk", &clk_itr_length-&clk_input_length+1, &clk_input_length-1)==STRING.CUT("&clk", 1))
    ( 
      &match=1
    )
  )
  else if (&wild_tail==1)
  (
    if (STRING.MID("gcc_usb3_phy_aux_clk", 0, &clk_input_length-1)==STRING.CUT("&clk", -1))
    ( 
      &match=1
    )
  )
  else if ("gcc_usb3_phy_aux_clk"=="&clk")
  (
    &match=1
  )
  
  if (&match==1)
  (
    &clk_test=&CLK_TEST_GCC_USB3_PHY_AUX_CLK
    &clk_reg=&HWIO_GCC_USB3_PHY_AUX_CBCR_ADDR
    &clk_reg_name="GCC_USB3_PHY_AUX_CBCR"
    &clk_name="gcc_usb3_phy_aux_clk"
    &clk_reg_cbcr_type="sm_cbc"
    &clk_vote_bit=-1.
    &clk_multiplier=4.
    &clk_access_mode="&GCC_access_mode"

    gosub Print_Clk_Info_Line
  )

  &match=0
  &wild_head=0
  &wild_tail=0
  &clk_input_length=STRING.LENGTH("&clk")
  &clk_itr_length=STRING.LENGTH("gcc_usb3_phy_pipe_clk")

  if (STRING.SCAN("&clk", "*", 0)==0)
  (
    &wild_head=1
  )
  if (STRING.SCAN("&clk", "*", 1)==(STRING.LENGTH("&clk")-1))
  (
    &wild_tail=1
  )

  if ((&wild_head==1)&&(&wild_tail==1))
  (
    if (STRING.SCAN("gcc_usb3_phy_pipe_clk", STRING.MID("&clk", 1, &clk_input_length-2), 0)!=-1)
    ( 
      &match=1
    )
  )
  else if (&wild_head==1)
  (
    if (STRING.MID("gcc_usb3_phy_pipe_clk", &clk_itr_length-&clk_input_length+1, &clk_input_length-1)==STRING.CUT("&clk", 1))
    ( 
      &match=1
    )
  )
  else if (&wild_tail==1)
  (
    if (STRING.MID("gcc_usb3_phy_pipe_clk", 0, &clk_input_length-1)==STRING.CUT("&clk", -1))
    ( 
      &match=1
    )
  )
  else if ("gcc_usb3_phy_pipe_clk"=="&clk")
  (
    &match=1
  )
  
  if (&match==1)
  (
    &clk_test=&CLK_TEST_GCC_USB3_PHY_PIPE_CLK
    &clk_reg=&HWIO_GCC_USB3_PHY_PIPE_CBCR_ADDR
    &clk_reg_name="GCC_USB3_PHY_PIPE_CBCR"
    &clk_name="gcc_usb3_phy_pipe_clk"
    &clk_reg_cbcr_type="sm_cbc"
    &clk_vote_bit=-1.
    &clk_multiplier=4.
    &clk_access_mode="&GCC_access_mode"

    gosub Print_Clk_Info_Line
  )

  &match=0
  &wild_head=0
  &wild_tail=0
  &clk_input_length=STRING.LENGTH("&clk")
  &clk_itr_length=STRING.LENGTH("gcc_vdda_vs_clk")

  if (STRING.SCAN("&clk", "*", 0)==0)
  (
    &wild_head=1
  )
  if (STRING.SCAN("&clk", "*", 1)==(STRING.LENGTH("&clk")-1))
  (
    &wild_tail=1
  )

  if ((&wild_head==1)&&(&wild_tail==1))
  (
    if (STRING.SCAN("gcc_vdda_vs_clk", STRING.MID("&clk", 1, &clk_input_length-2), 0)!=-1)
    ( 
      &match=1
    )
  )
  else if (&wild_head==1)
  (
    if (STRING.MID("gcc_vdda_vs_clk", &clk_itr_length-&clk_input_length+1, &clk_input_length-1)==STRING.CUT("&clk", 1))
    ( 
      &match=1
    )
  )
  else if (&wild_tail==1)
  (
    if (STRING.MID("gcc_vdda_vs_clk", 0, &clk_input_length-1)==STRING.CUT("&clk", -1))
    ( 
      &match=1
    )
  )
  else if ("gcc_vdda_vs_clk"=="&clk")
  (
    &match=1
  )
  
  if (&match==1)
  (
    &clk_test=&CLK_TEST_GCC_VDDA_VS_CLK
    &clk_reg=&HWIO_GCC_VDDA_VS_CBCR_ADDR
    &clk_reg_name="GCC_VDDA_VS_CBCR"
    &clk_name="gcc_vdda_vs_clk"
    &clk_reg_cbcr_type="sm_cbc"
    &clk_vote_bit=-1.
    &clk_multiplier=4.
    &clk_access_mode="&GCC_access_mode"

    gosub Print_Clk_Info_Line
  )

  &match=0
  &wild_head=0
  &wild_tail=0
  &clk_input_length=STRING.LENGTH("&clk")
  &clk_itr_length=STRING.LENGTH("gcc_vddcx_vs_clk")

  if (STRING.SCAN("&clk", "*", 0)==0)
  (
    &wild_head=1
  )
  if (STRING.SCAN("&clk", "*", 1)==(STRING.LENGTH("&clk")-1))
  (
    &wild_tail=1
  )

  if ((&wild_head==1)&&(&wild_tail==1))
  (
    if (STRING.SCAN("gcc_vddcx_vs_clk", STRING.MID("&clk", 1, &clk_input_length-2), 0)!=-1)
    ( 
      &match=1
    )
  )
  else if (&wild_head==1)
  (
    if (STRING.MID("gcc_vddcx_vs_clk", &clk_itr_length-&clk_input_length+1, &clk_input_length-1)==STRING.CUT("&clk", 1))
    ( 
      &match=1
    )
  )
  else if (&wild_tail==1)
  (
    if (STRING.MID("gcc_vddcx_vs_clk", 0, &clk_input_length-1)==STRING.CUT("&clk", -1))
    ( 
      &match=1
    )
  )
  else if ("gcc_vddcx_vs_clk"=="&clk")
  (
    &match=1
  )
  
  if (&match==1)
  (
    &clk_test=&CLK_TEST_GCC_VDDCX_VS_CLK
    &clk_reg=&HWIO_GCC_VDDCX_VS_CBCR_ADDR
    &clk_reg_name="GCC_VDDCX_VS_CBCR"
    &clk_name="gcc_vddcx_vs_clk"
    &clk_reg_cbcr_type="sm_cbc"
    &clk_vote_bit=-1.
    &clk_multiplier=4.
    &clk_access_mode="&GCC_access_mode"

    gosub Print_Clk_Info_Line
  )

  &match=0
  &wild_head=0
  &wild_tail=0
  &clk_input_length=STRING.LENGTH("&clk")
  &clk_itr_length=STRING.LENGTH("gcc_vddmx_vs_clk")

  if (STRING.SCAN("&clk", "*", 0)==0)
  (
    &wild_head=1
  )
  if (STRING.SCAN("&clk", "*", 1)==(STRING.LENGTH("&clk")-1))
  (
    &wild_tail=1
  )

  if ((&wild_head==1)&&(&wild_tail==1))
  (
    if (STRING.SCAN("gcc_vddmx_vs_clk", STRING.MID("&clk", 1, &clk_input_length-2), 0)!=-1)
    ( 
      &match=1
    )
  )
  else if (&wild_head==1)
  (
    if (STRING.MID("gcc_vddmx_vs_clk", &clk_itr_length-&clk_input_length+1, &clk_input_length-1)==STRING.CUT("&clk", 1))
    ( 
      &match=1
    )
  )
  else if (&wild_tail==1)
  (
    if (STRING.MID("gcc_vddmx_vs_clk", 0, &clk_input_length-1)==STRING.CUT("&clk", -1))
    ( 
      &match=1
    )
  )
  else if ("gcc_vddmx_vs_clk"=="&clk")
  (
    &match=1
  )
  
  if (&match==1)
  (
    &clk_test=&CLK_TEST_GCC_VDDMX_VS_CLK
    &clk_reg=&HWIO_GCC_VDDMX_VS_CBCR_ADDR
    &clk_reg_name="GCC_VDDMX_VS_CBCR"
    &clk_name="gcc_vddmx_vs_clk"
    &clk_reg_cbcr_type="sm_cbc"
    &clk_vote_bit=-1.
    &clk_multiplier=4.
    &clk_access_mode="&GCC_access_mode"

    gosub Print_Clk_Info_Line
  )

  &match=0
  &wild_head=0
  &wild_tail=0
  &clk_input_length=STRING.LENGTH("&clk")
  &clk_itr_length=STRING.LENGTH("gcc_vs_ctrl_clk")

  if (STRING.SCAN("&clk", "*", 0)==0)
  (
    &wild_head=1
  )
  if (STRING.SCAN("&clk", "*", 1)==(STRING.LENGTH("&clk")-1))
  (
    &wild_tail=1
  )

  if ((&wild_head==1)&&(&wild_tail==1))
  (
    if (STRING.SCAN("gcc_vs_ctrl_clk", STRING.MID("&clk", 1, &clk_input_length-2), 0)!=-1)
    ( 
      &match=1
    )
  )
  else if (&wild_head==1)
  (
    if (STRING.MID("gcc_vs_ctrl_clk", &clk_itr_length-&clk_input_length+1, &clk_input_length-1)==STRING.CUT("&clk", 1))
    ( 
      &match=1
    )
  )
  else if (&wild_tail==1)
  (
    if (STRING.MID("gcc_vs_ctrl_clk", 0, &clk_input_length-1)==STRING.CUT("&clk", -1))
    ( 
      &match=1
    )
  )
  else if ("gcc_vs_ctrl_clk"=="&clk")
  (
    &match=1
  )
  
  if (&match==1)
  (
    &clk_test=&CLK_TEST_GCC_VS_CTRL_CLK
    &clk_reg=&HWIO_GCC_VS_CTRL_CBCR_ADDR
    &clk_reg_name="GCC_VS_CTRL_CBCR"
    &clk_name="gcc_vs_ctrl_clk"
    &clk_reg_cbcr_type="sm_cbc"
    &clk_vote_bit=-1.
    &clk_multiplier=4.
    &clk_access_mode="&GCC_access_mode"

    gosub Print_Clk_Info_Line
  )

  &match=0
  &wild_head=0
  &wild_tail=0
  &clk_input_length=STRING.LENGTH("&clk")
  &clk_itr_length=STRING.LENGTH("gcc_wcss_vs_clk")

  if (STRING.SCAN("&clk", "*", 0)==0)
  (
    &wild_head=1
  )
  if (STRING.SCAN("&clk", "*", 1)==(STRING.LENGTH("&clk")-1))
  (
    &wild_tail=1
  )

  if ((&wild_head==1)&&(&wild_tail==1))
  (
    if (STRING.SCAN("gcc_wcss_vs_clk", STRING.MID("&clk", 1, &clk_input_length-2), 0)!=-1)
    ( 
      &match=1
    )
  )
  else if (&wild_head==1)
  (
    if (STRING.MID("gcc_wcss_vs_clk", &clk_itr_length-&clk_input_length+1, &clk_input_length-1)==STRING.CUT("&clk", 1))
    ( 
      &match=1
    )
  )
  else if (&wild_tail==1)
  (
    if (STRING.MID("gcc_wcss_vs_clk", 0, &clk_input_length-1)==STRING.CUT("&clk", -1))
    ( 
      &match=1
    )
  )
  else if ("gcc_wcss_vs_clk"=="&clk")
  (
    &match=1
  )
  
  if (&match==1)
  (
    &clk_test=&CLK_TEST_GCC_WCSS_VS_CLK
    &clk_reg=&HWIO_GCC_WCSS_VS_CBCR_ADDR
    &clk_reg_name="GCC_WCSS_VS_CBCR"
    &clk_name="gcc_wcss_vs_clk"
    &clk_reg_cbcr_type="sm_cbc"
    &clk_vote_bit=-1.
    &clk_multiplier=4.
    &clk_access_mode="&GCC_access_mode"

    gosub Print_Clk_Info_Line
  )

  &match=0
  &wild_head=0
  &wild_tail=0
  &clk_input_length=STRING.LENGTH("&clk")
  &clk_itr_length=STRING.LENGTH("gcc_aggre2_noc_qosgen_extref")

  if (STRING.SCAN("&clk", "*", 0)==0)
  (
    &wild_head=1
  )
  if (STRING.SCAN("&clk", "*", 1)==(STRING.LENGTH("&clk")-1))
  (
    &wild_tail=1
  )

  if ((&wild_head==1)&&(&wild_tail==1))
  (
    if (STRING.SCAN("gcc_aggre2_noc_qosgen_extref", STRING.MID("&clk", 1, &clk_input_length-2), 0)!=-1)
    ( 
      &match=1
    )
  )
  else if (&wild_head==1)
  (
    if (STRING.MID("gcc_aggre2_noc_qosgen_extref", &clk_itr_length-&clk_input_length+1, &clk_input_length-1)==STRING.CUT("&clk", 1))
    ( 
      &match=1
    )
  )
  else if (&wild_tail==1)
  (
    if (STRING.MID("gcc_aggre2_noc_qosgen_extref", 0, &clk_input_length-1)==STRING.CUT("&clk", -1))
    ( 
      &match=1
    )
  )
  else if ("gcc_aggre2_noc_qosgen_extref"=="&clk")
  (
    &match=1
  )
  
  if (&match==1)
  (
    &clk_test=&CLK_TEST_GCC_AGGRE2_NOC_QOSGEN_EXTREF
    &clk_reg=0
    &clk_reg_name="No CBCR"
    &clk_name="gcc_aggre2_noc_qosgen_extref"
    &clk_reg_cbcr_type=""
    &clk_vote_bit=-1.
    &clk_multiplier=4.
    &clk_access_mode="&GCC_access_mode"

    gosub Print_Clk_Info_Line
  )

  &match=0
  &wild_head=0
  &wild_tail=0
  &clk_input_length=STRING.LENGTH("&clk")
  &clk_itr_length=STRING.LENGTH("gcc_cnoc_bus_timeout_extref")

  if (STRING.SCAN("&clk", "*", 0)==0)
  (
    &wild_head=1
  )
  if (STRING.SCAN("&clk", "*", 1)==(STRING.LENGTH("&clk")-1))
  (
    &wild_tail=1
  )

  if ((&wild_head==1)&&(&wild_tail==1))
  (
    if (STRING.SCAN("gcc_cnoc_bus_timeout_extref", STRING.MID("&clk", 1, &clk_input_length-2), 0)!=-1)
    ( 
      &match=1
    )
  )
  else if (&wild_head==1)
  (
    if (STRING.MID("gcc_cnoc_bus_timeout_extref", &clk_itr_length-&clk_input_length+1, &clk_input_length-1)==STRING.CUT("&clk", 1))
    ( 
      &match=1
    )
  )
  else if (&wild_tail==1)
  (
    if (STRING.MID("gcc_cnoc_bus_timeout_extref", 0, &clk_input_length-1)==STRING.CUT("&clk", -1))
    ( 
      &match=1
    )
  )
  else if ("gcc_cnoc_bus_timeout_extref"=="&clk")
  (
    &match=1
  )
  
  if (&match==1)
  (
    &clk_test=&CLK_TEST_GCC_CNOC_BUS_TIMEOUT_EXTREF
    &clk_reg=0
    &clk_reg_name="No CBCR"
    &clk_name="gcc_cnoc_bus_timeout_extref"
    &clk_reg_cbcr_type=""
    &clk_vote_bit=-1.
    &clk_multiplier=4.
    &clk_access_mode="&GCC_access_mode"

    gosub Print_Clk_Info_Line
  )

  &match=0
  &wild_head=0
  &wild_tail=0
  &clk_input_length=STRING.LENGTH("&clk")
  &clk_itr_length=STRING.LENGTH("gcc_snoc_bus_timeout_extref")

  if (STRING.SCAN("&clk", "*", 0)==0)
  (
    &wild_head=1
  )
  if (STRING.SCAN("&clk", "*", 1)==(STRING.LENGTH("&clk")-1))
  (
    &wild_tail=1
  )

  if ((&wild_head==1)&&(&wild_tail==1))
  (
    if (STRING.SCAN("gcc_snoc_bus_timeout_extref", STRING.MID("&clk", 1, &clk_input_length-2), 0)!=-1)
    ( 
      &match=1
    )
  )
  else if (&wild_head==1)
  (
    if (STRING.MID("gcc_snoc_bus_timeout_extref", &clk_itr_length-&clk_input_length+1, &clk_input_length-1)==STRING.CUT("&clk", 1))
    ( 
      &match=1
    )
  )
  else if (&wild_tail==1)
  (
    if (STRING.MID("gcc_snoc_bus_timeout_extref", 0, &clk_input_length-1)==STRING.CUT("&clk", -1))
    ( 
      &match=1
    )
  )
  else if ("gcc_snoc_bus_timeout_extref"=="&clk")
  (
    &match=1
  )
  
  if (&match==1)
  (
    &clk_test=&CLK_TEST_GCC_SNOC_BUS_TIMEOUT_EXTREF
    &clk_reg=0
    &clk_reg_name="No CBCR"
    &clk_name="gcc_snoc_bus_timeout_extref"
    &clk_reg_cbcr_type=""
    &clk_vote_bit=-1.
    &clk_multiplier=4.
    &clk_access_mode="&GCC_access_mode"

    gosub Print_Clk_Info_Line
  )

  &match=0
  &wild_head=0
  &wild_tail=0
  &clk_input_length=STRING.LENGTH("&clk")
  &clk_itr_length=STRING.LENGTH("gcc_snoc_qosgen_extref")

  if (STRING.SCAN("&clk", "*", 0)==0)
  (
    &wild_head=1
  )
  if (STRING.SCAN("&clk", "*", 1)==(STRING.LENGTH("&clk")-1))
  (
    &wild_tail=1
  )

  if ((&wild_head==1)&&(&wild_tail==1))
  (
    if (STRING.SCAN("gcc_snoc_qosgen_extref", STRING.MID("&clk", 1, &clk_input_length-2), 0)!=-1)
    ( 
      &match=1
    )
  )
  else if (&wild_head==1)
  (
    if (STRING.MID("gcc_snoc_qosgen_extref", &clk_itr_length-&clk_input_length+1, &clk_input_length-1)==STRING.CUT("&clk", 1))
    ( 
      &match=1
    )
  )
  else if (&wild_tail==1)
  (
    if (STRING.MID("gcc_snoc_qosgen_extref", 0, &clk_input_length-1)==STRING.CUT("&clk", -1))
    ( 
      &match=1
    )
  )
  else if ("gcc_snoc_qosgen_extref"=="&clk")
  (
    &match=1
  )
  
  if (&match==1)
  (
    &clk_test=&CLK_TEST_GCC_SNOC_QOSGEN_EXTREF
    &clk_reg=0
    &clk_reg_name="No CBCR"
    &clk_name="gcc_snoc_qosgen_extref"
    &clk_reg_cbcr_type=""
    &clk_vote_bit=-1.
    &clk_multiplier=4.
    &clk_access_mode="&GCC_access_mode"

    gosub Print_Clk_Info_Line
  )

  &match=0
  &wild_head=0
  &wild_tail=0
  &clk_input_length=STRING.LENGTH("&clk")
  &clk_itr_length=STRING.LENGTH("gpll0_dtest")

  if (STRING.SCAN("&clk", "*", 0)==0)
  (
    &wild_head=1
  )
  if (STRING.SCAN("&clk", "*", 1)==(STRING.LENGTH("&clk")-1))
  (
    &wild_tail=1
  )

  if ((&wild_head==1)&&(&wild_tail==1))
  (
    if (STRING.SCAN("gpll0_dtest", STRING.MID("&clk", 1, &clk_input_length-2), 0)!=-1)
    ( 
      &match=1
    )
  )
  else if (&wild_head==1)
  (
    if (STRING.MID("gpll0_dtest", &clk_itr_length-&clk_input_length+1, &clk_input_length-1)==STRING.CUT("&clk", 1))
    ( 
      &match=1
    )
  )
  else if (&wild_tail==1)
  (
    if (STRING.MID("gpll0_dtest", 0, &clk_input_length-1)==STRING.CUT("&clk", -1))
    ( 
      &match=1
    )
  )
  else if ("gpll0_dtest"=="&clk")
  (
    &match=1
  )
  
  if (&match==1)
  (
    &clk_test=&CLK_TEST_GPLL0_DTEST
    &clk_reg=0
    &clk_reg_name="No CBCR"
    &clk_name="gpll0_dtest"
    &clk_reg_cbcr_type=""
    &clk_vote_bit=-1.
    &clk_multiplier=4.
    &clk_access_mode="&GCC_access_mode"

    gosub Print_Clk_Info_Line
  )

  &match=0
  &wild_head=0
  &wild_tail=0
  &clk_input_length=STRING.LENGTH("&clk")
  &clk_itr_length=STRING.LENGTH("gpll1_dtest")

  if (STRING.SCAN("&clk", "*", 0)==0)
  (
    &wild_head=1
  )
  if (STRING.SCAN("&clk", "*", 1)==(STRING.LENGTH("&clk")-1))
  (
    &wild_tail=1
  )

  if ((&wild_head==1)&&(&wild_tail==1))
  (
    if (STRING.SCAN("gpll1_dtest", STRING.MID("&clk", 1, &clk_input_length-2), 0)!=-1)
    ( 
      &match=1
    )
  )
  else if (&wild_head==1)
  (
    if (STRING.MID("gpll1_dtest", &clk_itr_length-&clk_input_length+1, &clk_input_length-1)==STRING.CUT("&clk", 1))
    ( 
      &match=1
    )
  )
  else if (&wild_tail==1)
  (
    if (STRING.MID("gpll1_dtest", 0, &clk_input_length-1)==STRING.CUT("&clk", -1))
    ( 
      &match=1
    )
  )
  else if ("gpll1_dtest"=="&clk")
  (
    &match=1
  )
  
  if (&match==1)
  (
    &clk_test=&CLK_TEST_GPLL1_DTEST
    &clk_reg=0
    &clk_reg_name="No CBCR"
    &clk_name="gpll1_dtest"
    &clk_reg_cbcr_type=""
    &clk_vote_bit=-1.
    &clk_multiplier=4.
    &clk_access_mode="&GCC_access_mode"

    gosub Print_Clk_Info_Line
  )

  &match=0
  &wild_head=0
  &wild_tail=0
  &clk_input_length=STRING.LENGTH("&clk")
  &clk_itr_length=STRING.LENGTH("gpll2_dtest")

  if (STRING.SCAN("&clk", "*", 0)==0)
  (
    &wild_head=1
  )
  if (STRING.SCAN("&clk", "*", 1)==(STRING.LENGTH("&clk")-1))
  (
    &wild_tail=1
  )

  if ((&wild_head==1)&&(&wild_tail==1))
  (
    if (STRING.SCAN("gpll2_dtest", STRING.MID("&clk", 1, &clk_input_length-2), 0)!=-1)
    ( 
      &match=1
    )
  )
  else if (&wild_head==1)
  (
    if (STRING.MID("gpll2_dtest", &clk_itr_length-&clk_input_length+1, &clk_input_length-1)==STRING.CUT("&clk", 1))
    ( 
      &match=1
    )
  )
  else if (&wild_tail==1)
  (
    if (STRING.MID("gpll2_dtest", 0, &clk_input_length-1)==STRING.CUT("&clk", -1))
    ( 
      &match=1
    )
  )
  else if ("gpll2_dtest"=="&clk")
  (
    &match=1
  )
  
  if (&match==1)
  (
    &clk_test=&CLK_TEST_GPLL2_DTEST
    &clk_reg=0
    &clk_reg_name="No CBCR"
    &clk_name="gpll2_dtest"
    &clk_reg_cbcr_type=""
    &clk_vote_bit=-1.
    &clk_multiplier=4.
    &clk_access_mode="&GCC_access_mode"

    gosub Print_Clk_Info_Line
  )

  &match=0
  &wild_head=0
  &wild_tail=0
  &clk_input_length=STRING.LENGTH("&clk")
  &clk_itr_length=STRING.LENGTH("gpll3_dtest")

  if (STRING.SCAN("&clk", "*", 0)==0)
  (
    &wild_head=1
  )
  if (STRING.SCAN("&clk", "*", 1)==(STRING.LENGTH("&clk")-1))
  (
    &wild_tail=1
  )

  if ((&wild_head==1)&&(&wild_tail==1))
  (
    if (STRING.SCAN("gpll3_dtest", STRING.MID("&clk", 1, &clk_input_length-2), 0)!=-1)
    ( 
      &match=1
    )
  )
  else if (&wild_head==1)
  (
    if (STRING.MID("gpll3_dtest", &clk_itr_length-&clk_input_length+1, &clk_input_length-1)==STRING.CUT("&clk", 1))
    ( 
      &match=1
    )
  )
  else if (&wild_tail==1)
  (
    if (STRING.MID("gpll3_dtest", 0, &clk_input_length-1)==STRING.CUT("&clk", -1))
    ( 
      &match=1
    )
  )
  else if ("gpll3_dtest"=="&clk")
  (
    &match=1
  )
  
  if (&match==1)
  (
    &clk_test=&CLK_TEST_GPLL3_DTEST
    &clk_reg=0
    &clk_reg_name="No CBCR"
    &clk_name="gpll3_dtest"
    &clk_reg_cbcr_type=""
    &clk_vote_bit=-1.
    &clk_multiplier=4.
    &clk_access_mode="&GCC_access_mode"

    gosub Print_Clk_Info_Line
  )

  &match=0
  &wild_head=0
  &wild_tail=0
  &clk_input_length=STRING.LENGTH("&clk")
  &clk_itr_length=STRING.LENGTH("gpll4_dtest")

  if (STRING.SCAN("&clk", "*", 0)==0)
  (
    &wild_head=1
  )
  if (STRING.SCAN("&clk", "*", 1)==(STRING.LENGTH("&clk")-1))
  (
    &wild_tail=1
  )

  if ((&wild_head==1)&&(&wild_tail==1))
  (
    if (STRING.SCAN("gpll4_dtest", STRING.MID("&clk", 1, &clk_input_length-2), 0)!=-1)
    ( 
      &match=1
    )
  )
  else if (&wild_head==1)
  (
    if (STRING.MID("gpll4_dtest", &clk_itr_length-&clk_input_length+1, &clk_input_length-1)==STRING.CUT("&clk", 1))
    ( 
      &match=1
    )
  )
  else if (&wild_tail==1)
  (
    if (STRING.MID("gpll4_dtest", 0, &clk_input_length-1)==STRING.CUT("&clk", -1))
    ( 
      &match=1
    )
  )
  else if ("gpll4_dtest"=="&clk")
  (
    &match=1
  )
  
  if (&match==1)
  (
    &clk_test=&CLK_TEST_GPLL4_DTEST
    &clk_reg=0
    &clk_reg_name="No CBCR"
    &clk_name="gpll4_dtest"
    &clk_reg_cbcr_type=""
    &clk_vote_bit=-1.
    &clk_multiplier=4.
    &clk_access_mode="&GCC_access_mode"

    gosub Print_Clk_Info_Line
  )

  &match=0
  &wild_head=0
  &wild_tail=0
  &clk_input_length=STRING.LENGTH("&clk")
  &clk_itr_length=STRING.LENGTH("gpll5_dtest")

  if (STRING.SCAN("&clk", "*", 0)==0)
  (
    &wild_head=1
  )
  if (STRING.SCAN("&clk", "*", 1)==(STRING.LENGTH("&clk")-1))
  (
    &wild_tail=1
  )

  if ((&wild_head==1)&&(&wild_tail==1))
  (
    if (STRING.SCAN("gpll5_dtest", STRING.MID("&clk", 1, &clk_input_length-2), 0)!=-1)
    ( 
      &match=1
    )
  )
  else if (&wild_head==1)
  (
    if (STRING.MID("gpll5_dtest", &clk_itr_length-&clk_input_length+1, &clk_input_length-1)==STRING.CUT("&clk", 1))
    ( 
      &match=1
    )
  )
  else if (&wild_tail==1)
  (
    if (STRING.MID("gpll5_dtest", 0, &clk_input_length-1)==STRING.CUT("&clk", -1))
    ( 
      &match=1
    )
  )
  else if ("gpll5_dtest"=="&clk")
  (
    &match=1
  )
  
  if (&match==1)
  (
    &clk_test=&CLK_TEST_GPLL5_DTEST
    &clk_reg=0
    &clk_reg_name="No CBCR"
    &clk_name="gpll5_dtest"
    &clk_reg_cbcr_type=""
    &clk_vote_bit=-1.
    &clk_multiplier=4.
    &clk_access_mode="&GCC_access_mode"

    gosub Print_Clk_Info_Line
  )

  &match=0
  &wild_head=0
  &wild_tail=0
  &clk_input_length=STRING.LENGTH("&clk")
  &clk_itr_length=STRING.LENGTH("gpll6_dtest")

  if (STRING.SCAN("&clk", "*", 0)==0)
  (
    &wild_head=1
  )
  if (STRING.SCAN("&clk", "*", 1)==(STRING.LENGTH("&clk")-1))
  (
    &wild_tail=1
  )

  if ((&wild_head==1)&&(&wild_tail==1))
  (
    if (STRING.SCAN("gpll6_dtest", STRING.MID("&clk", 1, &clk_input_length-2), 0)!=-1)
    ( 
      &match=1
    )
  )
  else if (&wild_head==1)
  (
    if (STRING.MID("gpll6_dtest", &clk_itr_length-&clk_input_length+1, &clk_input_length-1)==STRING.CUT("&clk", 1))
    ( 
      &match=1
    )
  )
  else if (&wild_tail==1)
  (
    if (STRING.MID("gpll6_dtest", 0, &clk_input_length-1)==STRING.CUT("&clk", -1))
    ( 
      &match=1
    )
  )
  else if ("gpll6_dtest"=="&clk")
  (
    &match=1
  )
  
  if (&match==1)
  (
    &clk_test=&CLK_TEST_GPLL6_DTEST
    &clk_reg=0
    &clk_reg_name="No CBCR"
    &clk_name="gpll6_dtest"
    &clk_reg_cbcr_type=""
    &clk_vote_bit=-1.
    &clk_multiplier=4.
    &clk_access_mode="&GCC_access_mode"

    gosub Print_Clk_Info_Line
  )

  &match=0
  &wild_head=0
  &wild_tail=0
  &clk_input_length=STRING.LENGTH("&clk")
  &clk_itr_length=STRING.LENGTH("gpu_gcc_dbg_clk")

  if (STRING.SCAN("&clk", "*", 0)==0)
  (
    &wild_head=1
  )
  if (STRING.SCAN("&clk", "*", 1)==(STRING.LENGTH("&clk")-1))
  (
    &wild_tail=1
  )

  if ((&wild_head==1)&&(&wild_tail==1))
  (
    if (STRING.SCAN("gpu_gcc_dbg_clk", STRING.MID("&clk", 1, &clk_input_length-2), 0)!=-1)
    ( 
      &match=1
    )
  )
  else if (&wild_head==1)
  (
    if (STRING.MID("gpu_gcc_dbg_clk", &clk_itr_length-&clk_input_length+1, &clk_input_length-1)==STRING.CUT("&clk", 1))
    ( 
      &match=1
    )
  )
  else if (&wild_tail==1)
  (
    if (STRING.MID("gpu_gcc_dbg_clk", 0, &clk_input_length-1)==STRING.CUT("&clk", -1))
    ( 
      &match=1
    )
  )
  else if ("gpu_gcc_dbg_clk"=="&clk")
  (
    &match=1
  )
  
  if (&match==1)
  (
    &clk_test=&CLK_TEST_GPU_GCC_DBG_CLK
    &clk_reg=0
    &clk_reg_name="No CBCR"
    &clk_name="gpu_gcc_dbg_clk"
    &clk_reg_cbcr_type=""
    &clk_vote_bit=-1.
    &clk_multiplier=4.
    &clk_access_mode="&GCC_access_mode"

    gosub Print_Clk_Info_Line
  )

  &match=0
  &wild_head=0
  &wild_tail=0
  &clk_input_length=STRING.LENGTH("&clk")
  &clk_itr_length=STRING.LENGTH("hmss_gcc_dbg_clk")

  if (STRING.SCAN("&clk", "*", 0)==0)
  (
    &wild_head=1
  )
  if (STRING.SCAN("&clk", "*", 1)==(STRING.LENGTH("&clk")-1))
  (
    &wild_tail=1
  )

  if ((&wild_head==1)&&(&wild_tail==1))
  (
    if (STRING.SCAN("hmss_gcc_dbg_clk", STRING.MID("&clk", 1, &clk_input_length-2), 0)!=-1)
    ( 
      &match=1
    )
  )
  else if (&wild_head==1)
  (
    if (STRING.MID("hmss_gcc_dbg_clk", &clk_itr_length-&clk_input_length+1, &clk_input_length-1)==STRING.CUT("&clk", 1))
    ( 
      &match=1
    )
  )
  else if (&wild_tail==1)
  (
    if (STRING.MID("hmss_gcc_dbg_clk", 0, &clk_input_length-1)==STRING.CUT("&clk", -1))
    ( 
      &match=1
    )
  )
  else if ("hmss_gcc_dbg_clk"=="&clk")
  (
    &match=1
  )
  
  if (&match==1)
  (
    &clk_test=&CLK_TEST_HMSS_GCC_DBG_CLK
    &clk_reg=0
    &clk_reg_name="No CBCR"
    &clk_name="hmss_gcc_dbg_clk"
    &clk_reg_cbcr_type=""
    &clk_vote_bit=-1.
    &clk_multiplier=4.
    &clk_access_mode="&GCC_access_mode"

    gosub Print_Clk_Info_Line
  )

  &match=0
  &wild_head=0
  &wild_tail=0
  &clk_input_length=STRING.LENGTH("&clk")
  &clk_itr_length=STRING.LENGTH("lpass_gcc_dbg_clk")

  if (STRING.SCAN("&clk", "*", 0)==0)
  (
    &wild_head=1
  )
  if (STRING.SCAN("&clk", "*", 1)==(STRING.LENGTH("&clk")-1))
  (
    &wild_tail=1
  )

  if ((&wild_head==1)&&(&wild_tail==1))
  (
    if (STRING.SCAN("lpass_gcc_dbg_clk", STRING.MID("&clk", 1, &clk_input_length-2), 0)!=-1)
    ( 
      &match=1
    )
  )
  else if (&wild_head==1)
  (
    if (STRING.MID("lpass_gcc_dbg_clk", &clk_itr_length-&clk_input_length+1, &clk_input_length-1)==STRING.CUT("&clk", 1))
    ( 
      &match=1
    )
  )
  else if (&wild_tail==1)
  (
    if (STRING.MID("lpass_gcc_dbg_clk", 0, &clk_input_length-1)==STRING.CUT("&clk", -1))
    ( 
      &match=1
    )
  )
  else if ("lpass_gcc_dbg_clk"=="&clk")
  (
    &match=1
  )
  
  if (&match==1)
  (
    &clk_test=&CLK_TEST_LPASS_GCC_DBG_CLK
    &clk_reg=0
    &clk_reg_name="No CBCR"
    &clk_name="lpass_gcc_dbg_clk"
    &clk_reg_cbcr_type=""
    &clk_vote_bit=-1.
    &clk_multiplier=4.
    &clk_access_mode="&GCC_access_mode"

    gosub Print_Clk_Info_Line
  )

  &match=0
  &wild_head=0
  &wild_tail=0
  &clk_input_length=STRING.LENGTH("&clk")
  &clk_itr_length=STRING.LENGTH("mccc_ddrss_gcc_ch_clk")

  if (STRING.SCAN("&clk", "*", 0)==0)
  (
    &wild_head=1
  )
  if (STRING.SCAN("&clk", "*", 1)==(STRING.LENGTH("&clk")-1))
  (
    &wild_tail=1
  )

  if ((&wild_head==1)&&(&wild_tail==1))
  (
    if (STRING.SCAN("mccc_ddrss_gcc_ch_clk", STRING.MID("&clk", 1, &clk_input_length-2), 0)!=-1)
    ( 
      &match=1
    )
  )
  else if (&wild_head==1)
  (
    if (STRING.MID("mccc_ddrss_gcc_ch_clk", &clk_itr_length-&clk_input_length+1, &clk_input_length-1)==STRING.CUT("&clk", 1))
    ( 
      &match=1
    )
  )
  else if (&wild_tail==1)
  (
    if (STRING.MID("mccc_ddrss_gcc_ch_clk", 0, &clk_input_length-1)==STRING.CUT("&clk", -1))
    ( 
      &match=1
    )
  )
  else if ("mccc_ddrss_gcc_ch_clk"=="&clk")
  (
    &match=1
  )
  
  if (&match==1)
  (
    &clk_test=&CLK_TEST_MCCC_DDRSS_GCC_CH_CLK
    &clk_reg=0
    &clk_reg_name="No CBCR"
    &clk_name="mccc_ddrss_gcc_ch_clk"
    &clk_reg_cbcr_type=""
    &clk_vote_bit=-1.
    &clk_multiplier=4.
    &clk_access_mode="&GCC_access_mode"

    gosub Print_Clk_Info_Line
  )

  &match=0
  &wild_head=0
  &wild_tail=0
  &clk_input_length=STRING.LENGTH("&clk")
  &clk_itr_length=STRING.LENGTH("mmss_gcc_dbg_clk")

  if (STRING.SCAN("&clk", "*", 0)==0)
  (
    &wild_head=1
  )
  if (STRING.SCAN("&clk", "*", 1)==(STRING.LENGTH("&clk")-1))
  (
    &wild_tail=1
  )

  if ((&wild_head==1)&&(&wild_tail==1))
  (
    if (STRING.SCAN("mmss_gcc_dbg_clk", STRING.MID("&clk", 1, &clk_input_length-2), 0)!=-1)
    ( 
      &match=1
    )
  )
  else if (&wild_head==1)
  (
    if (STRING.MID("mmss_gcc_dbg_clk", &clk_itr_length-&clk_input_length+1, &clk_input_length-1)==STRING.CUT("&clk", 1))
    ( 
      &match=1
    )
  )
  else if (&wild_tail==1)
  (
    if (STRING.MID("mmss_gcc_dbg_clk", 0, &clk_input_length-1)==STRING.CUT("&clk", -1))
    ( 
      &match=1
    )
  )
  else if ("mmss_gcc_dbg_clk"=="&clk")
  (
    &match=1
  )
  
  if (&match==1)
  (
    &clk_test=&CLK_TEST_MMSS_GCC_DBG_CLK
    &clk_reg=0
    &clk_reg_name="No CBCR"
    &clk_name="mmss_gcc_dbg_clk"
    &clk_reg_cbcr_type=""
    &clk_vote_bit=-1.
    &clk_multiplier=4.
    &clk_access_mode="&GCC_access_mode"

    gosub Print_Clk_Info_Line
  )

  &match=0
  &wild_head=0
  &wild_tail=0
  &clk_input_length=STRING.LENGTH("&clk")
  &clk_itr_length=STRING.LENGTH("mpm_gcc_temp0_sensor_ringosc_clk")

  if (STRING.SCAN("&clk", "*", 0)==0)
  (
    &wild_head=1
  )
  if (STRING.SCAN("&clk", "*", 1)==(STRING.LENGTH("&clk")-1))
  (
    &wild_tail=1
  )

  if ((&wild_head==1)&&(&wild_tail==1))
  (
    if (STRING.SCAN("mpm_gcc_temp0_sensor_ringosc_clk", STRING.MID("&clk", 1, &clk_input_length-2), 0)!=-1)
    ( 
      &match=1
    )
  )
  else if (&wild_head==1)
  (
    if (STRING.MID("mpm_gcc_temp0_sensor_ringosc_clk", &clk_itr_length-&clk_input_length+1, &clk_input_length-1)==STRING.CUT("&clk", 1))
    ( 
      &match=1
    )
  )
  else if (&wild_tail==1)
  (
    if (STRING.MID("mpm_gcc_temp0_sensor_ringosc_clk", 0, &clk_input_length-1)==STRING.CUT("&clk", -1))
    ( 
      &match=1
    )
  )
  else if ("mpm_gcc_temp0_sensor_ringosc_clk"=="&clk")
  (
    &match=1
  )
  
  if (&match==1)
  (
    &clk_test=&CLK_TEST_MPM_GCC_TEMP0_SENSOR_RINGOSC_CLK
    &clk_reg=0
    &clk_reg_name="No CBCR"
    &clk_name="mpm_gcc_temp0_sensor_ringosc_clk"
    &clk_reg_cbcr_type=""
    &clk_vote_bit=-1.
    &clk_multiplier=4.
    &clk_access_mode="&GCC_access_mode"

    gosub Print_Clk_Info_Line
  )

  &match=0
  &wild_head=0
  &wild_tail=0
  &clk_input_length=STRING.LENGTH("&clk")
  &clk_itr_length=STRING.LENGTH("mpm_gcc_temp1_sensor_ringosc_clk")

  if (STRING.SCAN("&clk", "*", 0)==0)
  (
    &wild_head=1
  )
  if (STRING.SCAN("&clk", "*", 1)==(STRING.LENGTH("&clk")-1))
  (
    &wild_tail=1
  )

  if ((&wild_head==1)&&(&wild_tail==1))
  (
    if (STRING.SCAN("mpm_gcc_temp1_sensor_ringosc_clk", STRING.MID("&clk", 1, &clk_input_length-2), 0)!=-1)
    ( 
      &match=1
    )
  )
  else if (&wild_head==1)
  (
    if (STRING.MID("mpm_gcc_temp1_sensor_ringosc_clk", &clk_itr_length-&clk_input_length+1, &clk_input_length-1)==STRING.CUT("&clk", 1))
    ( 
      &match=1
    )
  )
  else if (&wild_tail==1)
  (
    if (STRING.MID("mpm_gcc_temp1_sensor_ringosc_clk", 0, &clk_input_length-1)==STRING.CUT("&clk", -1))
    ( 
      &match=1
    )
  )
  else if ("mpm_gcc_temp1_sensor_ringosc_clk"=="&clk")
  (
    &match=1
  )
  
  if (&match==1)
  (
    &clk_test=&CLK_TEST_MPM_GCC_TEMP1_SENSOR_RINGOSC_CLK
    &clk_reg=0
    &clk_reg_name="No CBCR"
    &clk_name="mpm_gcc_temp1_sensor_ringosc_clk"
    &clk_reg_cbcr_type=""
    &clk_vote_bit=-1.
    &clk_multiplier=4.
    &clk_access_mode="&GCC_access_mode"

    gosub Print_Clk_Info_Line
  )

  &match=0
  &wild_head=0
  &wild_tail=0
  &clk_input_length=STRING.LENGTH("&clk")
  &clk_itr_length=STRING.LENGTH("mss_gcc_dbg_clk")

  if (STRING.SCAN("&clk", "*", 0)==0)
  (
    &wild_head=1
  )
  if (STRING.SCAN("&clk", "*", 1)==(STRING.LENGTH("&clk")-1))
  (
    &wild_tail=1
  )

  if ((&wild_head==1)&&(&wild_tail==1))
  (
    if (STRING.SCAN("mss_gcc_dbg_clk", STRING.MID("&clk", 1, &clk_input_length-2), 0)!=-1)
    ( 
      &match=1
    )
  )
  else if (&wild_head==1)
  (
    if (STRING.MID("mss_gcc_dbg_clk", &clk_itr_length-&clk_input_length+1, &clk_input_length-1)==STRING.CUT("&clk", 1))
    ( 
      &match=1
    )
  )
  else if (&wild_tail==1)
  (
    if (STRING.MID("mss_gcc_dbg_clk", 0, &clk_input_length-1)==STRING.CUT("&clk", -1))
    ( 
      &match=1
    )
  )
  else if ("mss_gcc_dbg_clk"=="&clk")
  (
    &match=1
  )
  
  if (&match==1)
  (
    &clk_test=&CLK_TEST_MSS_GCC_DBG_CLK
    &clk_reg=0
    &clk_reg_name="No CBCR"
    &clk_name="mss_gcc_dbg_clk"
    &clk_reg_cbcr_type=""
    &clk_vote_bit=-1.
    &clk_multiplier=4.
    &clk_access_mode="&GCC_access_mode"

    gosub Print_Clk_Info_Line
  )

  &match=0
  &wild_head=0
  &wild_tail=0
  &clk_input_length=STRING.LENGTH("&clk")
  &clk_itr_length=STRING.LENGTH("nav_gcc_dbg_clk")

  if (STRING.SCAN("&clk", "*", 0)==0)
  (
    &wild_head=1
  )
  if (STRING.SCAN("&clk", "*", 1)==(STRING.LENGTH("&clk")-1))
  (
    &wild_tail=1
  )

  if ((&wild_head==1)&&(&wild_tail==1))
  (
    if (STRING.SCAN("nav_gcc_dbg_clk", STRING.MID("&clk", 1, &clk_input_length-2), 0)!=-1)
    ( 
      &match=1
    )
  )
  else if (&wild_head==1)
  (
    if (STRING.MID("nav_gcc_dbg_clk", &clk_itr_length-&clk_input_length+1, &clk_input_length-1)==STRING.CUT("&clk", 1))
    ( 
      &match=1
    )
  )
  else if (&wild_tail==1)
  (
    if (STRING.MID("nav_gcc_dbg_clk", 0, &clk_input_length-1)==STRING.CUT("&clk", -1))
    ( 
      &match=1
    )
  )
  else if ("nav_gcc_dbg_clk"=="&clk")
  (
    &match=1
  )
  
  if (&match==1)
  (
    &clk_test=&CLK_TEST_NAV_GCC_DBG_CLK
    &clk_reg=0
    &clk_reg_name="No CBCR"
    &clk_name="nav_gcc_dbg_clk"
    &clk_reg_cbcr_type=""
    &clk_vote_bit=-1.
    &clk_multiplier=4.
    &clk_access_mode="&GCC_access_mode"

    gosub Print_Clk_Info_Line
  )

  &match=0
  &wild_head=0
  &wild_tail=0
  &clk_input_length=STRING.LENGTH("&clk")
  &clk_itr_length=STRING.LENGTH("nav_pll_dtest")

  if (STRING.SCAN("&clk", "*", 0)==0)
  (
    &wild_head=1
  )
  if (STRING.SCAN("&clk", "*", 1)==(STRING.LENGTH("&clk")-1))
  (
    &wild_tail=1
  )

  if ((&wild_head==1)&&(&wild_tail==1))
  (
    if (STRING.SCAN("nav_pll_dtest", STRING.MID("&clk", 1, &clk_input_length-2), 0)!=-1)
    ( 
      &match=1
    )
  )
  else if (&wild_head==1)
  (
    if (STRING.MID("nav_pll_dtest", &clk_itr_length-&clk_input_length+1, &clk_input_length-1)==STRING.CUT("&clk", 1))
    ( 
      &match=1
    )
  )
  else if (&wild_tail==1)
  (
    if (STRING.MID("nav_pll_dtest", 0, &clk_input_length-1)==STRING.CUT("&clk", -1))
    ( 
      &match=1
    )
  )
  else if ("nav_pll_dtest"=="&clk")
  (
    &match=1
  )
  
  if (&match==1)
  (
    &clk_test=&CLK_TEST_NAV_PLL_DTEST
    &clk_reg=0
    &clk_reg_name="No CBCR"
    &clk_name="nav_pll_dtest"
    &clk_reg_cbcr_type=""
    &clk_vote_bit=-1.
    &clk_multiplier=4.
    &clk_access_mode="&GCC_access_mode"

    gosub Print_Clk_Info_Line
  )

  &match=0
  &wild_head=0
  &wild_tail=0
  &clk_input_length=STRING.LENGTH("&clk")
  &clk_itr_length=STRING.LENGTH("qusb2phy_gcc_clk_test_prim")

  if (STRING.SCAN("&clk", "*", 0)==0)
  (
    &wild_head=1
  )
  if (STRING.SCAN("&clk", "*", 1)==(STRING.LENGTH("&clk")-1))
  (
    &wild_tail=1
  )

  if ((&wild_head==1)&&(&wild_tail==1))
  (
    if (STRING.SCAN("qusb2phy_gcc_clk_test_prim", STRING.MID("&clk", 1, &clk_input_length-2), 0)!=-1)
    ( 
      &match=1
    )
  )
  else if (&wild_head==1)
  (
    if (STRING.MID("qusb2phy_gcc_clk_test_prim", &clk_itr_length-&clk_input_length+1, &clk_input_length-1)==STRING.CUT("&clk", 1))
    ( 
      &match=1
    )
  )
  else if (&wild_tail==1)
  (
    if (STRING.MID("qusb2phy_gcc_clk_test_prim", 0, &clk_input_length-1)==STRING.CUT("&clk", -1))
    ( 
      &match=1
    )
  )
  else if ("qusb2phy_gcc_clk_test_prim"=="&clk")
  (
    &match=1
  )
  
  if (&match==1)
  (
    &clk_test=&CLK_TEST_QUSB2PHY_GCC_CLK_TEST_PRIM
    &clk_reg=0
    &clk_reg_name="No CBCR"
    &clk_name="qusb2phy_gcc_clk_test_prim"
    &clk_reg_cbcr_type=""
    &clk_vote_bit=-1.
    &clk_multiplier=4.
    &clk_access_mode="&GCC_access_mode"

    gosub Print_Clk_Info_Line
  )

  &match=0
  &wild_head=0
  &wild_tail=0
  &clk_input_length=STRING.LENGTH("&clk")
  &clk_itr_length=STRING.LENGTH("qusb2phy_gcc_clk_test_sec")

  if (STRING.SCAN("&clk", "*", 0)==0)
  (
    &wild_head=1
  )
  if (STRING.SCAN("&clk", "*", 1)==(STRING.LENGTH("&clk")-1))
  (
    &wild_tail=1
  )

  if ((&wild_head==1)&&(&wild_tail==1))
  (
    if (STRING.SCAN("qusb2phy_gcc_clk_test_sec", STRING.MID("&clk", 1, &clk_input_length-2), 0)!=-1)
    ( 
      &match=1
    )
  )
  else if (&wild_head==1)
  (
    if (STRING.MID("qusb2phy_gcc_clk_test_sec", &clk_itr_length-&clk_input_length+1, &clk_input_length-1)==STRING.CUT("&clk", 1))
    ( 
      &match=1
    )
  )
  else if (&wild_tail==1)
  (
    if (STRING.MID("qusb2phy_gcc_clk_test_sec", 0, &clk_input_length-1)==STRING.CUT("&clk", -1))
    ( 
      &match=1
    )
  )
  else if ("qusb2phy_gcc_clk_test_sec"=="&clk")
  (
    &match=1
  )
  
  if (&match==1)
  (
    &clk_test=&CLK_TEST_QUSB2PHY_GCC_CLK_TEST_SEC
    &clk_reg=0
    &clk_reg_name="No CBCR"
    &clk_name="qusb2phy_gcc_clk_test_sec"
    &clk_reg_cbcr_type=""
    &clk_vote_bit=-1.
    &clk_multiplier=4.
    &clk_access_mode="&GCC_access_mode"

    gosub Print_Clk_Info_Line
  )

  &match=0
  &wild_head=0
  &wild_tail=0
  &clk_input_length=STRING.LENGTH("&clk")
  &clk_itr_length=STRING.LENGTH("qusb2phy_prim_gcc_usb30_utmi_clk")

  if (STRING.SCAN("&clk", "*", 0)==0)
  (
    &wild_head=1
  )
  if (STRING.SCAN("&clk", "*", 1)==(STRING.LENGTH("&clk")-1))
  (
    &wild_tail=1
  )

  if ((&wild_head==1)&&(&wild_tail==1))
  (
    if (STRING.SCAN("qusb2phy_prim_gcc_usb30_utmi_clk", STRING.MID("&clk", 1, &clk_input_length-2), 0)!=-1)
    ( 
      &match=1
    )
  )
  else if (&wild_head==1)
  (
    if (STRING.MID("qusb2phy_prim_gcc_usb30_utmi_clk", &clk_itr_length-&clk_input_length+1, &clk_input_length-1)==STRING.CUT("&clk", 1))
    ( 
      &match=1
    )
  )
  else if (&wild_tail==1)
  (
    if (STRING.MID("qusb2phy_prim_gcc_usb30_utmi_clk", 0, &clk_input_length-1)==STRING.CUT("&clk", -1))
    ( 
      &match=1
    )
  )
  else if ("qusb2phy_prim_gcc_usb30_utmi_clk"=="&clk")
  (
    &match=1
  )
  
  if (&match==1)
  (
    &clk_test=&CLK_TEST_QUSB2PHY_PRIM_GCC_USB30_UTMI_CLK
    &clk_reg=0
    &clk_reg_name="No CBCR"
    &clk_name="qusb2phy_prim_gcc_usb30_utmi_clk"
    &clk_reg_cbcr_type=""
    &clk_vote_bit=-1.
    &clk_multiplier=4.
    &clk_access_mode="&GCC_access_mode"

    gosub Print_Clk_Info_Line
  )

  &match=0
  &wild_head=0
  &wild_tail=0
  &clk_input_length=STRING.LENGTH("&clk")
  &clk_itr_length=STRING.LENGTH("qusb2phy_sec_gcc_usb20s_utmi_clk")

  if (STRING.SCAN("&clk", "*", 0)==0)
  (
    &wild_head=1
  )
  if (STRING.SCAN("&clk", "*", 1)==(STRING.LENGTH("&clk")-1))
  (
    &wild_tail=1
  )

  if ((&wild_head==1)&&(&wild_tail==1))
  (
    if (STRING.SCAN("qusb2phy_sec_gcc_usb20s_utmi_clk", STRING.MID("&clk", 1, &clk_input_length-2), 0)!=-1)
    ( 
      &match=1
    )
  )
  else if (&wild_head==1)
  (
    if (STRING.MID("qusb2phy_sec_gcc_usb20s_utmi_clk", &clk_itr_length-&clk_input_length+1, &clk_input_length-1)==STRING.CUT("&clk", 1))
    ( 
      &match=1
    )
  )
  else if (&wild_tail==1)
  (
    if (STRING.MID("qusb2phy_sec_gcc_usb20s_utmi_clk", 0, &clk_input_length-1)==STRING.CUT("&clk", -1))
    ( 
      &match=1
    )
  )
  else if ("qusb2phy_sec_gcc_usb20s_utmi_clk"=="&clk")
  (
    &match=1
  )
  
  if (&match==1)
  (
    &clk_test=&CLK_TEST_QUSB2PHY_SEC_GCC_USB20S_UTMI_CLK
    &clk_reg=0
    &clk_reg_name="No CBCR"
    &clk_name="qusb2phy_sec_gcc_usb20s_utmi_clk"
    &clk_reg_cbcr_type=""
    &clk_vote_bit=-1.
    &clk_multiplier=4.
    &clk_access_mode="&GCC_access_mode"

    gosub Print_Clk_Info_Line
  )

  &match=0
  &wild_head=0
  &wild_tail=0
  &clk_input_length=STRING.LENGTH("&clk")
  &clk_itr_length=STRING.LENGTH("turing_gcc_dbg_clk")

  if (STRING.SCAN("&clk", "*", 0)==0)
  (
    &wild_head=1
  )
  if (STRING.SCAN("&clk", "*", 1)==(STRING.LENGTH("&clk")-1))
  (
    &wild_tail=1
  )

  if ((&wild_head==1)&&(&wild_tail==1))
  (
    if (STRING.SCAN("turing_gcc_dbg_clk", STRING.MID("&clk", 1, &clk_input_length-2), 0)!=-1)
    ( 
      &match=1
    )
  )
  else if (&wild_head==1)
  (
    if (STRING.MID("turing_gcc_dbg_clk", &clk_itr_length-&clk_input_length+1, &clk_input_length-1)==STRING.CUT("&clk", 1))
    ( 
      &match=1
    )
  )
  else if (&wild_tail==1)
  (
    if (STRING.MID("turing_gcc_dbg_clk", 0, &clk_input_length-1)==STRING.CUT("&clk", -1))
    ( 
      &match=1
    )
  )
  else if ("turing_gcc_dbg_clk"=="&clk")
  (
    &match=1
  )
  
  if (&match==1)
  (
    &clk_test=&CLK_TEST_TURING_GCC_DBG_CLK
    &clk_reg=0
    &clk_reg_name="No CBCR"
    &clk_name="turing_gcc_dbg_clk"
    &clk_reg_cbcr_type=""
    &clk_vote_bit=-1.
    &clk_multiplier=4.
    &clk_access_mode="&GCC_access_mode"

    gosub Print_Clk_Info_Line
  )

  &match=0
  &wild_head=0
  &wild_tail=0
  &clk_input_length=STRING.LENGTH("&clk")
  &clk_itr_length=STRING.LENGTH("ufs_rx_symbol_0_clk")

  if (STRING.SCAN("&clk", "*", 0)==0)
  (
    &wild_head=1
  )
  if (STRING.SCAN("&clk", "*", 1)==(STRING.LENGTH("&clk")-1))
  (
    &wild_tail=1
  )

  if ((&wild_head==1)&&(&wild_tail==1))
  (
    if (STRING.SCAN("ufs_rx_symbol_0_clk", STRING.MID("&clk", 1, &clk_input_length-2), 0)!=-1)
    ( 
      &match=1
    )
  )
  else if (&wild_head==1)
  (
    if (STRING.MID("ufs_rx_symbol_0_clk", &clk_itr_length-&clk_input_length+1, &clk_input_length-1)==STRING.CUT("&clk", 1))
    ( 
      &match=1
    )
  )
  else if (&wild_tail==1)
  (
    if (STRING.MID("ufs_rx_symbol_0_clk", 0, &clk_input_length-1)==STRING.CUT("&clk", -1))
    ( 
      &match=1
    )
  )
  else if ("ufs_rx_symbol_0_clk"=="&clk")
  (
    &match=1
  )
  
  if (&match==1)
  (
    &clk_test=&CLK_TEST_UFS_RX_SYMBOL_0_CLK
    &clk_reg=0
    &clk_reg_name="No CBCR"
    &clk_name="ufs_rx_symbol_0_clk"
    &clk_reg_cbcr_type=""
    &clk_vote_bit=-1.
    &clk_multiplier=4.
    &clk_access_mode="&GCC_access_mode"

    gosub Print_Clk_Info_Line
  )

  &match=0
  &wild_head=0
  &wild_tail=0
  &clk_input_length=STRING.LENGTH("&clk")
  &clk_itr_length=STRING.LENGTH("ufs_rx_symbol_1_clk")

  if (STRING.SCAN("&clk", "*", 0)==0)
  (
    &wild_head=1
  )
  if (STRING.SCAN("&clk", "*", 1)==(STRING.LENGTH("&clk")-1))
  (
    &wild_tail=1
  )

  if ((&wild_head==1)&&(&wild_tail==1))
  (
    if (STRING.SCAN("ufs_rx_symbol_1_clk", STRING.MID("&clk", 1, &clk_input_length-2), 0)!=-1)
    ( 
      &match=1
    )
  )
  else if (&wild_head==1)
  (
    if (STRING.MID("ufs_rx_symbol_1_clk", &clk_itr_length-&clk_input_length+1, &clk_input_length-1)==STRING.CUT("&clk", 1))
    ( 
      &match=1
    )
  )
  else if (&wild_tail==1)
  (
    if (STRING.MID("ufs_rx_symbol_1_clk", 0, &clk_input_length-1)==STRING.CUT("&clk", -1))
    ( 
      &match=1
    )
  )
  else if ("ufs_rx_symbol_1_clk"=="&clk")
  (
    &match=1
  )
  
  if (&match==1)
  (
    &clk_test=&CLK_TEST_UFS_RX_SYMBOL_1_CLK
    &clk_reg=0
    &clk_reg_name="No CBCR"
    &clk_name="ufs_rx_symbol_1_clk"
    &clk_reg_cbcr_type=""
    &clk_vote_bit=-1.
    &clk_multiplier=4.
    &clk_access_mode="&GCC_access_mode"

    gosub Print_Clk_Info_Line
  )

  &match=0
  &wild_head=0
  &wild_tail=0
  &clk_input_length=STRING.LENGTH("&clk")
  &clk_itr_length=STRING.LENGTH("ufs_tx_symbol_0_clk")

  if (STRING.SCAN("&clk", "*", 0)==0)
  (
    &wild_head=1
  )
  if (STRING.SCAN("&clk", "*", 1)==(STRING.LENGTH("&clk")-1))
  (
    &wild_tail=1
  )

  if ((&wild_head==1)&&(&wild_tail==1))
  (
    if (STRING.SCAN("ufs_tx_symbol_0_clk", STRING.MID("&clk", 1, &clk_input_length-2), 0)!=-1)
    ( 
      &match=1
    )
  )
  else if (&wild_head==1)
  (
    if (STRING.MID("ufs_tx_symbol_0_clk", &clk_itr_length-&clk_input_length+1, &clk_input_length-1)==STRING.CUT("&clk", 1))
    ( 
      &match=1
    )
  )
  else if (&wild_tail==1)
  (
    if (STRING.MID("ufs_tx_symbol_0_clk", 0, &clk_input_length-1)==STRING.CUT("&clk", -1))
    ( 
      &match=1
    )
  )
  else if ("ufs_tx_symbol_0_clk"=="&clk")
  (
    &match=1
  )
  
  if (&match==1)
  (
    &clk_test=&CLK_TEST_UFS_TX_SYMBOL_0_CLK
    &clk_reg=0
    &clk_reg_name="No CBCR"
    &clk_name="ufs_tx_symbol_0_clk"
    &clk_reg_cbcr_type=""
    &clk_vote_bit=-1.
    &clk_multiplier=4.
    &clk_access_mode="&GCC_access_mode"

    gosub Print_Clk_Info_Line
  )

  &match=0
  &wild_head=0
  &wild_tail=0
  &clk_input_length=STRING.LENGTH("&clk")
  &clk_itr_length=STRING.LENGTH("usb3_phy_wrapper_gcc_usb3_pipe_clk")

  if (STRING.SCAN("&clk", "*", 0)==0)
  (
    &wild_head=1
  )
  if (STRING.SCAN("&clk", "*", 1)==(STRING.LENGTH("&clk")-1))
  (
    &wild_tail=1
  )

  if ((&wild_head==1)&&(&wild_tail==1))
  (
    if (STRING.SCAN("usb3_phy_wrapper_gcc_usb3_pipe_clk", STRING.MID("&clk", 1, &clk_input_length-2), 0)!=-1)
    ( 
      &match=1
    )
  )
  else if (&wild_head==1)
  (
    if (STRING.MID("usb3_phy_wrapper_gcc_usb3_pipe_clk", &clk_itr_length-&clk_input_length+1, &clk_input_length-1)==STRING.CUT("&clk", 1))
    ( 
      &match=1
    )
  )
  else if (&wild_tail==1)
  (
    if (STRING.MID("usb3_phy_wrapper_gcc_usb3_pipe_clk", 0, &clk_input_length-1)==STRING.CUT("&clk", -1))
    ( 
      &match=1
    )
  )
  else if ("usb3_phy_wrapper_gcc_usb3_pipe_clk"=="&clk")
  (
    &match=1
  )
  
  if (&match==1)
  (
    &clk_test=&CLK_TEST_USB3_PHY_WRAPPER_GCC_USB3_PIPE_CLK
    &clk_reg=0
    &clk_reg_name="No CBCR"
    &clk_name="usb3_phy_wrapper_gcc_usb3_pipe_clk"
    &clk_reg_cbcr_type=""
    &clk_vote_bit=-1.
    &clk_multiplier=4.
    &clk_access_mode="&GCC_access_mode"

    gosub Print_Clk_Info_Line
  )

  &match=0
  &wild_head=0
  &wild_tail=0
  &clk_input_length=STRING.LENGTH("&clk")
  &clk_itr_length=STRING.LENGTH("wcss_gcc_dbg_clk")

  if (STRING.SCAN("&clk", "*", 0)==0)
  (
    &wild_head=1
  )
  if (STRING.SCAN("&clk", "*", 1)==(STRING.LENGTH("&clk")-1))
  (
    &wild_tail=1
  )

  if ((&wild_head==1)&&(&wild_tail==1))
  (
    if (STRING.SCAN("wcss_gcc_dbg_clk", STRING.MID("&clk", 1, &clk_input_length-2), 0)!=-1)
    ( 
      &match=1
    )
  )
  else if (&wild_head==1)
  (
    if (STRING.MID("wcss_gcc_dbg_clk", &clk_itr_length-&clk_input_length+1, &clk_input_length-1)==STRING.CUT("&clk", 1))
    ( 
      &match=1
    )
  )
  else if (&wild_tail==1)
  (
    if (STRING.MID("wcss_gcc_dbg_clk", 0, &clk_input_length-1)==STRING.CUT("&clk", -1))
    ( 
      &match=1
    )
  )
  else if ("wcss_gcc_dbg_clk"=="&clk")
  (
    &match=1
  )
  
  if (&match==1)
  (
    &clk_test=&CLK_TEST_WCSS_GCC_DBG_CLK
    &clk_reg=0
    &clk_reg_name="No CBCR"
    &clk_name="wcss_gcc_dbg_clk"
    &clk_reg_cbcr_type=""
    &clk_vote_bit=-1.
    &clk_multiplier=4.
    &clk_access_mode="&GCC_access_mode"

    gosub Print_Clk_Info_Line
  )

  &match=0
  &wild_head=0
  &wild_tail=0
  &clk_input_length=STRING.LENGTH("&clk")
  &clk_itr_length=STRING.LENGTH("gpucc_gfx3d_clk")

  if (STRING.SCAN("&clk", "*", 0)==0)
  (
    &wild_head=1
  )
  if (STRING.SCAN("&clk", "*", 1)==(STRING.LENGTH("&clk")-1))
  (
    &wild_tail=1
  )

  if ((&wild_head==1)&&(&wild_tail==1))
  (
    if (STRING.SCAN("gpucc_gfx3d_clk", STRING.MID("&clk", 1, &clk_input_length-2), 0)!=-1)
    ( 
      &match=1
    )
  )
  else if (&wild_head==1)
  (
    if (STRING.MID("gpucc_gfx3d_clk", &clk_itr_length-&clk_input_length+1, &clk_input_length-1)==STRING.CUT("&clk", 1))
    ( 
      &match=1
    )
  )
  else if (&wild_tail==1)
  (
    if (STRING.MID("gpucc_gfx3d_clk", 0, &clk_input_length-1)==STRING.CUT("&clk", -1))
    ( 
      &match=1
    )
  )
  else if ("gpucc_gfx3d_clk"=="&clk")
  (
    &match=1
  )
  
  if (&match==1)
  (
    &clk_test=&CLK_TEST_GPUCC_GFX3D_CLK
    &clk_reg=&HWIO_GPUCC_GFX3D_CBCR_ADDR
    &clk_reg_name="GPUCC_GFX3D_CBCR"
    &clk_name="gpucc_gfx3d_clk"
    &clk_reg_cbcr_type="sm_pscbc"
    &clk_vote_bit=-1.
    &clk_multiplier=12.
    &clk_access_mode="&GPU_access_mode"

    gosub Print_Clk_Info_Line
  )

  &match=0
  &wild_head=0
  &wild_tail=0
  &clk_input_length=STRING.LENGTH("&clk")
  &clk_itr_length=STRING.LENGTH("gpucc_spdm_gfx3d_clk")

  if (STRING.SCAN("&clk", "*", 0)==0)
  (
    &wild_head=1
  )
  if (STRING.SCAN("&clk", "*", 1)==(STRING.LENGTH("&clk")-1))
  (
    &wild_tail=1
  )

  if ((&wild_head==1)&&(&wild_tail==1))
  (
    if (STRING.SCAN("gpucc_spdm_gfx3d_clk", STRING.MID("&clk", 1, &clk_input_length-2), 0)!=-1)
    ( 
      &match=1
    )
  )
  else if (&wild_head==1)
  (
    if (STRING.MID("gpucc_spdm_gfx3d_clk", &clk_itr_length-&clk_input_length+1, &clk_input_length-1)==STRING.CUT("&clk", 1))
    ( 
      &match=1
    )
  )
  else if (&wild_tail==1)
  (
    if (STRING.MID("gpucc_spdm_gfx3d_clk", 0, &clk_input_length-1)==STRING.CUT("&clk", -1))
    ( 
      &match=1
    )
  )
  else if ("gpucc_spdm_gfx3d_clk"=="&clk")
  (
    &match=1
  )
  
  if (&match==1)
  (
    &clk_test=&CLK_TEST_GPUCC_SPDM_GFX3D_CLK
    &clk_reg=&HWIO_GPUCC_SPDM_GFX3D_CBCR_ADDR
    &clk_reg_name="GPUCC_SPDM_GFX3D_CBCR"
    &clk_name="gpucc_spdm_gfx3d_clk"
    &clk_reg_cbcr_type="sm_cbc"
    &clk_vote_bit=-1.
    &clk_multiplier=12.
    &clk_access_mode="&GPU_access_mode"

    gosub Print_Clk_Info_Line
  )

  &match=0
  &wild_head=0
  &wild_tail=0
  &clk_input_length=STRING.LENGTH("&clk")
  &clk_itr_length=STRING.LENGTH("gpucc_rbbmtimer_clk")

  if (STRING.SCAN("&clk", "*", 0)==0)
  (
    &wild_head=1
  )
  if (STRING.SCAN("&clk", "*", 1)==(STRING.LENGTH("&clk")-1))
  (
    &wild_tail=1
  )

  if ((&wild_head==1)&&(&wild_tail==1))
  (
    if (STRING.SCAN("gpucc_rbbmtimer_clk", STRING.MID("&clk", 1, &clk_input_length-2), 0)!=-1)
    ( 
      &match=1
    )
  )
  else if (&wild_head==1)
  (
    if (STRING.MID("gpucc_rbbmtimer_clk", &clk_itr_length-&clk_input_length+1, &clk_input_length-1)==STRING.CUT("&clk", 1))
    ( 
      &match=1
    )
  )
  else if (&wild_tail==1)
  (
    if (STRING.MID("gpucc_rbbmtimer_clk", 0, &clk_input_length-1)==STRING.CUT("&clk", -1))
    ( 
      &match=1
    )
  )
  else if ("gpucc_rbbmtimer_clk"=="&clk")
  (
    &match=1
  )
  
  if (&match==1)
  (
    &clk_test=&CLK_TEST_GPUCC_RBBMTIMER_CLK
    &clk_reg=&HWIO_GPUCC_RBBMTIMER_CBCR_ADDR
    &clk_reg_name="GPUCC_RBBMTIMER_CBCR"
    &clk_name="gpucc_rbbmtimer_clk"
    &clk_reg_cbcr_type="sm_cbc"
    &clk_vote_bit=-1.
    &clk_multiplier=12.
    &clk_access_mode="&GPU_access_mode"

    gosub Print_Clk_Info_Line
  )

  &match=0
  &wild_head=0
  &wild_tail=0
  &clk_input_length=STRING.LENGTH("&clk")
  &clk_itr_length=STRING.LENGTH("gpucc_rbcpr_clk")

  if (STRING.SCAN("&clk", "*", 0)==0)
  (
    &wild_head=1
  )
  if (STRING.SCAN("&clk", "*", 1)==(STRING.LENGTH("&clk")-1))
  (
    &wild_tail=1
  )

  if ((&wild_head==1)&&(&wild_tail==1))
  (
    if (STRING.SCAN("gpucc_rbcpr_clk", STRING.MID("&clk", 1, &clk_input_length-2), 0)!=-1)
    ( 
      &match=1
    )
  )
  else if (&wild_head==1)
  (
    if (STRING.MID("gpucc_rbcpr_clk", &clk_itr_length-&clk_input_length+1, &clk_input_length-1)==STRING.CUT("&clk", 1))
    ( 
      &match=1
    )
  )
  else if (&wild_tail==1)
  (
    if (STRING.MID("gpucc_rbcpr_clk", 0, &clk_input_length-1)==STRING.CUT("&clk", -1))
    ( 
      &match=1
    )
  )
  else if ("gpucc_rbcpr_clk"=="&clk")
  (
    &match=1
  )
  
  if (&match==1)
  (
    &clk_test=&CLK_TEST_GPUCC_RBCPR_CLK
    &clk_reg=&HWIO_GPUCC_RBCPR_CBCR_ADDR
    &clk_reg_name="GPUCC_RBCPR_CBCR"
    &clk_name="gpucc_rbcpr_clk"
    &clk_reg_cbcr_type="sm_cbc"
    &clk_vote_bit=-1.
    &clk_multiplier=12.
    &clk_access_mode="&GPU_access_mode"

    gosub Print_Clk_Info_Line
  )

  &match=0
  &wild_head=0
  &wild_tail=0
  &clk_input_length=STRING.LENGTH("&clk")
  &clk_itr_length=STRING.LENGTH("gpucc_cxo_clk")

  if (STRING.SCAN("&clk", "*", 0)==0)
  (
    &wild_head=1
  )
  if (STRING.SCAN("&clk", "*", 1)==(STRING.LENGTH("&clk")-1))
  (
    &wild_tail=1
  )

  if ((&wild_head==1)&&(&wild_tail==1))
  (
    if (STRING.SCAN("gpucc_cxo_clk", STRING.MID("&clk", 1, &clk_input_length-2), 0)!=-1)
    ( 
      &match=1
    )
  )
  else if (&wild_head==1)
  (
    if (STRING.MID("gpucc_cxo_clk", &clk_itr_length-&clk_input_length+1, &clk_input_length-1)==STRING.CUT("&clk", 1))
    ( 
      &match=1
    )
  )
  else if (&wild_tail==1)
  (
    if (STRING.MID("gpucc_cxo_clk", 0, &clk_input_length-1)==STRING.CUT("&clk", -1))
    ( 
      &match=1
    )
  )
  else if ("gpucc_cxo_clk"=="&clk")
  (
    &match=1
  )
  
  if (&match==1)
  (
    &clk_test=0
    &clk_reg=&HWIO_GPUCC_CXO_CBCR_ADDR
    &clk_reg_name="GPUCC_CXO_CBCR"
    &clk_name="gpucc_cxo_clk"
    &clk_reg_cbcr_type="sm_cbc"
    &clk_vote_bit=-1.
    &clk_multiplier=12.
    &clk_access_mode="&GPU_access_mode"

    gosub Print_Clk_Info_Line
  )

  &match=0
  &wild_head=0
  &wild_tail=0
  &clk_input_length=STRING.LENGTH("&clk")
  &clk_itr_length=STRING.LENGTH("aon_clk_src")

  if (STRING.SCAN("&clk", "*", 0)==0)
  (
    &wild_head=1
  )
  if (STRING.SCAN("&clk", "*", 1)==(STRING.LENGTH("&clk")-1))
  (
    &wild_tail=1
  )

  if ((&wild_head==1)&&(&wild_tail==1))
  (
    if (STRING.SCAN("aon_clk_src", STRING.MID("&clk", 1, &clk_input_length-2), 0)!=-1)
    ( 
      &match=1
    )
  )
  else if (&wild_head==1)
  (
    if (STRING.MID("aon_clk_src", &clk_itr_length-&clk_input_length+1, &clk_input_length-1)==STRING.CUT("&clk", 1))
    ( 
      &match=1
    )
  )
  else if (&wild_tail==1)
  (
    if (STRING.MID("aon_clk_src", 0, &clk_input_length-1)==STRING.CUT("&clk", -1))
    ( 
      &match=1
    )
  )
  else if ("aon_clk_src"=="&clk")
  (
    &match=1
  )
  
  if (&match==1)
  (
    &clk_test=&CLK_TEST_AON_CLK_SRC
    &clk_reg=0
    &clk_reg_name="No CBCR"
    &clk_name="aon_clk_src"
    &clk_reg_cbcr_type=""
    &clk_vote_bit=-1.
    &clk_multiplier=4.
    &clk_access_mode="&LPASS_access_mode"

    gosub Print_Clk_Info_Line
  )

  &match=0
  &wild_head=0
  &wild_tail=0
  &clk_input_length=STRING.LENGTH("&clk")
  &clk_itr_length=STRING.LENGTH("audio_core_qdsp_sway_aon_clk")

  if (STRING.SCAN("&clk", "*", 0)==0)
  (
    &wild_head=1
  )
  if (STRING.SCAN("&clk", "*", 1)==(STRING.LENGTH("&clk")-1))
  (
    &wild_tail=1
  )

  if ((&wild_head==1)&&(&wild_tail==1))
  (
    if (STRING.SCAN("audio_core_qdsp_sway_aon_clk", STRING.MID("&clk", 1, &clk_input_length-2), 0)!=-1)
    ( 
      &match=1
    )
  )
  else if (&wild_head==1)
  (
    if (STRING.MID("audio_core_qdsp_sway_aon_clk", &clk_itr_length-&clk_input_length+1, &clk_input_length-1)==STRING.CUT("&clk", 1))
    ( 
      &match=1
    )
  )
  else if (&wild_tail==1)
  (
    if (STRING.MID("audio_core_qdsp_sway_aon_clk", 0, &clk_input_length-1)==STRING.CUT("&clk", -1))
    ( 
      &match=1
    )
  )
  else if ("audio_core_qdsp_sway_aon_clk"=="&clk")
  (
    &match=1
  )
  
  if (&match==1)
  (
    &clk_test=&CLK_TEST_AUDIO_CORE_QDSP_SWAY_AON_CLK
    &clk_reg=&HWIO_LPASS_AUDIO_CORE_QDSP_SWAY_AON_CBCR_ADDR
    &clk_reg_name="LPASS_AUDIO_CORE_QDSP_SWAY_AON_CBCR"
    &clk_name="audio_core_qdsp_sway_aon_clk"
    &clk_reg_cbcr_type="sm_cbc"
    &clk_vote_bit=-1.
    &clk_multiplier=4.
    &clk_access_mode="&LPASS_access_mode"

    gosub Print_Clk_Info_Line
  )

  &match=0
  &wild_head=0
  &wild_tail=0
  &clk_input_length=STRING.LENGTH("&clk")
  &clk_itr_length=STRING.LENGTH("audio_wrapper_aon_clk")

  if (STRING.SCAN("&clk", "*", 0)==0)
  (
    &wild_head=1
  )
  if (STRING.SCAN("&clk", "*", 1)==(STRING.LENGTH("&clk")-1))
  (
    &wild_tail=1
  )

  if ((&wild_head==1)&&(&wild_tail==1))
  (
    if (STRING.SCAN("audio_wrapper_aon_clk", STRING.MID("&clk", 1, &clk_input_length-2), 0)!=-1)
    ( 
      &match=1
    )
  )
  else if (&wild_head==1)
  (
    if (STRING.MID("audio_wrapper_aon_clk", &clk_itr_length-&clk_input_length+1, &clk_input_length-1)==STRING.CUT("&clk", 1))
    ( 
      &match=1
    )
  )
  else if (&wild_tail==1)
  (
    if (STRING.MID("audio_wrapper_aon_clk", 0, &clk_input_length-1)==STRING.CUT("&clk", -1))
    ( 
      &match=1
    )
  )
  else if ("audio_wrapper_aon_clk"=="&clk")
  (
    &match=1
  )
  
  if (&match==1)
  (
    &clk_test=&CLK_TEST_AUDIO_WRAPPER_AON_CLK
    &clk_reg=&HWIO_LPASS_AUDIO_WRAPPER_AON_CBCR_ADDR
    &clk_reg_name="LPASS_AUDIO_WRAPPER_AON_CBCR"
    &clk_name="audio_wrapper_aon_clk"
    &clk_reg_cbcr_type="sm_cbc"
    &clk_vote_bit=-1.
    &clk_multiplier=4.
    &clk_access_mode="&LPASS_access_mode"

    gosub Print_Clk_Info_Line
  )

  &match=0
  &wild_head=0
  &wild_tail=0
  &clk_input_length=STRING.LENGTH("&clk")
  &clk_itr_length=STRING.LENGTH("audio_wrapper_bus_timeout_aon_clk")

  if (STRING.SCAN("&clk", "*", 0)==0)
  (
    &wild_head=1
  )
  if (STRING.SCAN("&clk", "*", 1)==(STRING.LENGTH("&clk")-1))
  (
    &wild_tail=1
  )

  if ((&wild_head==1)&&(&wild_tail==1))
  (
    if (STRING.SCAN("audio_wrapper_bus_timeout_aon_clk", STRING.MID("&clk", 1, &clk_input_length-2), 0)!=-1)
    ( 
      &match=1
    )
  )
  else if (&wild_head==1)
  (
    if (STRING.MID("audio_wrapper_bus_timeout_aon_clk", &clk_itr_length-&clk_input_length+1, &clk_input_length-1)==STRING.CUT("&clk", 1))
    ( 
      &match=1
    )
  )
  else if (&wild_tail==1)
  (
    if (STRING.MID("audio_wrapper_bus_timeout_aon_clk", 0, &clk_input_length-1)==STRING.CUT("&clk", -1))
    ( 
      &match=1
    )
  )
  else if ("audio_wrapper_bus_timeout_aon_clk"=="&clk")
  (
    &match=1
  )
  
  if (&match==1)
  (
    &clk_test=&CLK_TEST_AUDIO_WRAPPER_BUS_TIMEOUT_AON_CLK
    &clk_reg=&HWIO_LPASS_AUDIO_WRAPPER_BUS_TIMEOUT_AON_CBCR_ADDR
    &clk_reg_name="LPASS_AUDIO_WRAPPER_BUS_TIMEOUT_AON_CBCR"
    &clk_name="audio_wrapper_bus_timeout_aon_clk"
    &clk_reg_cbcr_type="sm_cbc"
    &clk_vote_bit=-1.
    &clk_multiplier=4.
    &clk_access_mode="&LPASS_access_mode"

    gosub Print_Clk_Info_Line
  )

  &match=0
  &wild_head=0
  &wild_tail=0
  &clk_input_length=STRING.LENGTH("&clk")
  &clk_itr_length=STRING.LENGTH("audio_wrapper_mpu_cfg_aon_clk")

  if (STRING.SCAN("&clk", "*", 0)==0)
  (
    &wild_head=1
  )
  if (STRING.SCAN("&clk", "*", 1)==(STRING.LENGTH("&clk")-1))
  (
    &wild_tail=1
  )

  if ((&wild_head==1)&&(&wild_tail==1))
  (
    if (STRING.SCAN("audio_wrapper_mpu_cfg_aon_clk", STRING.MID("&clk", 1, &clk_input_length-2), 0)!=-1)
    ( 
      &match=1
    )
  )
  else if (&wild_head==1)
  (
    if (STRING.MID("audio_wrapper_mpu_cfg_aon_clk", &clk_itr_length-&clk_input_length+1, &clk_input_length-1)==STRING.CUT("&clk", 1))
    ( 
      &match=1
    )
  )
  else if (&wild_tail==1)
  (
    if (STRING.MID("audio_wrapper_mpu_cfg_aon_clk", 0, &clk_input_length-1)==STRING.CUT("&clk", -1))
    ( 
      &match=1
    )
  )
  else if ("audio_wrapper_mpu_cfg_aon_clk"=="&clk")
  (
    &match=1
  )
  
  if (&match==1)
  (
    &clk_test=&CLK_TEST_AUDIO_WRAPPER_MPU_CFG_AON_CLK
    &clk_reg=&HWIO_LPASS_AUDIO_WRAPPER_MPU_CFG_AON_CBCR_ADDR
    &clk_reg_name="LPASS_AUDIO_WRAPPER_MPU_CFG_AON_CBCR"
    &clk_name="audio_wrapper_mpu_cfg_aon_clk"
    &clk_reg_cbcr_type="sm_cbc"
    &clk_vote_bit=-1.
    &clk_multiplier=4.
    &clk_access_mode="&LPASS_access_mode"

    gosub Print_Clk_Info_Line
  )

  &match=0
  &wild_head=0
  &wild_tail=0
  &clk_input_length=STRING.LENGTH("&clk")
  &clk_itr_length=STRING.LENGTH("audio_wrapper_q6_ahbm_mpu_aon_clk")

  if (STRING.SCAN("&clk", "*", 0)==0)
  (
    &wild_head=1
  )
  if (STRING.SCAN("&clk", "*", 1)==(STRING.LENGTH("&clk")-1))
  (
    &wild_tail=1
  )

  if ((&wild_head==1)&&(&wild_tail==1))
  (
    if (STRING.SCAN("audio_wrapper_q6_ahbm_mpu_aon_clk", STRING.MID("&clk", 1, &clk_input_length-2), 0)!=-1)
    ( 
      &match=1
    )
  )
  else if (&wild_head==1)
  (
    if (STRING.MID("audio_wrapper_q6_ahbm_mpu_aon_clk", &clk_itr_length-&clk_input_length+1, &clk_input_length-1)==STRING.CUT("&clk", 1))
    ( 
      &match=1
    )
  )
  else if (&wild_tail==1)
  (
    if (STRING.MID("audio_wrapper_q6_ahbm_mpu_aon_clk", 0, &clk_input_length-1)==STRING.CUT("&clk", -1))
    ( 
      &match=1
    )
  )
  else if ("audio_wrapper_q6_ahbm_mpu_aon_clk"=="&clk")
  (
    &match=1
  )
  
  if (&match==1)
  (
    &clk_test=&CLK_TEST_AUDIO_WRAPPER_Q6_AHBM_MPU_AON_CLK
    &clk_reg=&HWIO_LPASS_AUDIO_WRAPPER_Q6_AHBM_MPU_AON_CBCR_ADDR
    &clk_reg_name="LPASS_AUDIO_WRAPPER_Q6_AHBM_MPU_AON_CBCR"
    &clk_name="audio_wrapper_q6_ahbm_mpu_aon_clk"
    &clk_reg_cbcr_type="sm_cbc"
    &clk_vote_bit=-1.
    &clk_multiplier=4.
    &clk_access_mode="&LPASS_access_mode"

    gosub Print_Clk_Info_Line
  )

  &match=0
  &wild_head=0
  &wild_tail=0
  &clk_input_length=STRING.LENGTH("&clk")
  &clk_itr_length=STRING.LENGTH("audio_wrapper_qos_ahbs_aon_clk")

  if (STRING.SCAN("&clk", "*", 0)==0)
  (
    &wild_head=1
  )
  if (STRING.SCAN("&clk", "*", 1)==(STRING.LENGTH("&clk")-1))
  (
    &wild_tail=1
  )

  if ((&wild_head==1)&&(&wild_tail==1))
  (
    if (STRING.SCAN("audio_wrapper_qos_ahbs_aon_clk", STRING.MID("&clk", 1, &clk_input_length-2), 0)!=-1)
    ( 
      &match=1
    )
  )
  else if (&wild_head==1)
  (
    if (STRING.MID("audio_wrapper_qos_ahbs_aon_clk", &clk_itr_length-&clk_input_length+1, &clk_input_length-1)==STRING.CUT("&clk", 1))
    ( 
      &match=1
    )
  )
  else if (&wild_tail==1)
  (
    if (STRING.MID("audio_wrapper_qos_ahbs_aon_clk", 0, &clk_input_length-1)==STRING.CUT("&clk", -1))
    ( 
      &match=1
    )
  )
  else if ("audio_wrapper_qos_ahbs_aon_clk"=="&clk")
  (
    &match=1
  )
  
  if (&match==1)
  (
    &clk_test=&CLK_TEST_AUDIO_WRAPPER_QOS_AHBS_AON_CLK
    &clk_reg=&HWIO_LPASS_AUDIO_WRAPPER_QOS_AHBS_AON_CBCR_ADDR
    &clk_reg_name="LPASS_AUDIO_WRAPPER_QOS_AHBS_AON_CBCR"
    &clk_name="audio_wrapper_qos_ahbs_aon_clk"
    &clk_reg_cbcr_type="sm_cbc"
    &clk_vote_bit=-1.
    &clk_multiplier=4.
    &clk_access_mode="&LPASS_access_mode"

    gosub Print_Clk_Info_Line
  )

  &match=0
  &wild_head=0
  &wild_tail=0
  &clk_input_length=STRING.LENGTH("&clk")
  &clk_itr_length=STRING.LENGTH("audio_wrapper_sysnoc_sway_aon_clk")

  if (STRING.SCAN("&clk", "*", 0)==0)
  (
    &wild_head=1
  )
  if (STRING.SCAN("&clk", "*", 1)==(STRING.LENGTH("&clk")-1))
  (
    &wild_tail=1
  )

  if ((&wild_head==1)&&(&wild_tail==1))
  (
    if (STRING.SCAN("audio_wrapper_sysnoc_sway_aon_clk", STRING.MID("&clk", 1, &clk_input_length-2), 0)!=-1)
    ( 
      &match=1
    )
  )
  else if (&wild_head==1)
  (
    if (STRING.MID("audio_wrapper_sysnoc_sway_aon_clk", &clk_itr_length-&clk_input_length+1, &clk_input_length-1)==STRING.CUT("&clk", 1))
    ( 
      &match=1
    )
  )
  else if (&wild_tail==1)
  (
    if (STRING.MID("audio_wrapper_sysnoc_sway_aon_clk", 0, &clk_input_length-1)==STRING.CUT("&clk", -1))
    ( 
      &match=1
    )
  )
  else if ("audio_wrapper_sysnoc_sway_aon_clk"=="&clk")
  (
    &match=1
  )
  
  if (&match==1)
  (
    &clk_test=&CLK_TEST_AUDIO_WRAPPER_SYSNOC_SWAY_AON_CLK
    &clk_reg=&HWIO_LPASS_AUDIO_WRAPPER_SYSNOC_SWAY_AON_CBCR_ADDR
    &clk_reg_name="LPASS_AUDIO_WRAPPER_SYSNOC_SWAY_AON_CBCR"
    &clk_name="audio_wrapper_sysnoc_sway_aon_clk"
    &clk_reg_cbcr_type="sm_cbc"
    &clk_vote_bit=-1.
    &clk_multiplier=4.
    &clk_access_mode="&LPASS_access_mode"

    gosub Print_Clk_Info_Line
  )

  &match=0
  &wild_head=0
  &wild_tail=0
  &clk_input_length=STRING.LENGTH("&clk")
  &clk_itr_length=STRING.LENGTH("island_scc_cfg_ahb_aon_clk")

  if (STRING.SCAN("&clk", "*", 0)==0)
  (
    &wild_head=1
  )
  if (STRING.SCAN("&clk", "*", 1)==(STRING.LENGTH("&clk")-1))
  (
    &wild_tail=1
  )

  if ((&wild_head==1)&&(&wild_tail==1))
  (
    if (STRING.SCAN("island_scc_cfg_ahb_aon_clk", STRING.MID("&clk", 1, &clk_input_length-2), 0)!=-1)
    ( 
      &match=1
    )
  )
  else if (&wild_head==1)
  (
    if (STRING.MID("island_scc_cfg_ahb_aon_clk", &clk_itr_length-&clk_input_length+1, &clk_input_length-1)==STRING.CUT("&clk", 1))
    ( 
      &match=1
    )
  )
  else if (&wild_tail==1)
  (
    if (STRING.MID("island_scc_cfg_ahb_aon_clk", 0, &clk_input_length-1)==STRING.CUT("&clk", -1))
    ( 
      &match=1
    )
  )
  else if ("island_scc_cfg_ahb_aon_clk"=="&clk")
  (
    &match=1
  )
  
  if (&match==1)
  (
    &clk_test=&CLK_TEST_ISLAND_SCC_CFG_AHB_AON_CLK
    &clk_reg=&HWIO_LPASS_ISLAND_SCC_CFG_AHB_AON_CBCR_ADDR
    &clk_reg_name="LPASS_ISLAND_SCC_CFG_AHB_AON_CBCR"
    &clk_name="island_scc_cfg_ahb_aon_clk"
    &clk_reg_cbcr_type="sm_cbc"
    &clk_vote_bit=-1.
    &clk_multiplier=4.
    &clk_access_mode="&LPASS_access_mode"

    gosub Print_Clk_Info_Line
  )

  &match=0
  &wild_head=0
  &wild_tail=0
  &clk_input_length=STRING.LENGTH("&clk")
  &clk_itr_length=STRING.LENGTH("island_scc_crif_aon_clk")

  if (STRING.SCAN("&clk", "*", 0)==0)
  (
    &wild_head=1
  )
  if (STRING.SCAN("&clk", "*", 1)==(STRING.LENGTH("&clk")-1))
  (
    &wild_tail=1
  )

  if ((&wild_head==1)&&(&wild_tail==1))
  (
    if (STRING.SCAN("island_scc_crif_aon_clk", STRING.MID("&clk", 1, &clk_input_length-2), 0)!=-1)
    ( 
      &match=1
    )
  )
  else if (&wild_head==1)
  (
    if (STRING.MID("island_scc_crif_aon_clk", &clk_itr_length-&clk_input_length+1, &clk_input_length-1)==STRING.CUT("&clk", 1))
    ( 
      &match=1
    )
  )
  else if (&wild_tail==1)
  (
    if (STRING.MID("island_scc_crif_aon_clk", 0, &clk_input_length-1)==STRING.CUT("&clk", -1))
    ( 
      &match=1
    )
  )
  else if ("island_scc_crif_aon_clk"=="&clk")
  (
    &match=1
  )
  
  if (&match==1)
  (
    &clk_test=&CLK_TEST_ISLAND_SCC_CRIF_AON_CLK
    &clk_reg=&HWIO_LPASS_ISLAND_SCC_CRIF_AON_CBCR_ADDR
    &clk_reg_name="LPASS_ISLAND_SCC_CRIF_AON_CBCR"
    &clk_name="island_scc_crif_aon_clk"
    &clk_reg_cbcr_type="sm_cbc"
    &clk_vote_bit=-1.
    &clk_multiplier=4.
    &clk_access_mode="&LPASS_access_mode"

    gosub Print_Clk_Info_Line
  )

  &match=0
  &wild_head=0
  &wild_tail=0
  &clk_input_length=STRING.LENGTH("&clk")
  &clk_itr_length=STRING.LENGTH("island_scc_csr_h_aon_clk")

  if (STRING.SCAN("&clk", "*", 0)==0)
  (
    &wild_head=1
  )
  if (STRING.SCAN("&clk", "*", 1)==(STRING.LENGTH("&clk")-1))
  (
    &wild_tail=1
  )

  if ((&wild_head==1)&&(&wild_tail==1))
  (
    if (STRING.SCAN("island_scc_csr_h_aon_clk", STRING.MID("&clk", 1, &clk_input_length-2), 0)!=-1)
    ( 
      &match=1
    )
  )
  else if (&wild_head==1)
  (
    if (STRING.MID("island_scc_csr_h_aon_clk", &clk_itr_length-&clk_input_length+1, &clk_input_length-1)==STRING.CUT("&clk", 1))
    ( 
      &match=1
    )
  )
  else if (&wild_tail==1)
  (
    if (STRING.MID("island_scc_csr_h_aon_clk", 0, &clk_input_length-1)==STRING.CUT("&clk", -1))
    ( 
      &match=1
    )
  )
  else if ("island_scc_csr_h_aon_clk"=="&clk")
  (
    &match=1
  )
  
  if (&match==1)
  (
    &clk_test=&CLK_TEST_ISLAND_SCC_CSR_H_AON_CLK
    &clk_reg=&HWIO_LPASS_ISLAND_SCC_CSR_H_AON_CBCR_ADDR
    &clk_reg_name="LPASS_ISLAND_SCC_CSR_H_AON_CBCR"
    &clk_name="island_scc_csr_h_aon_clk"
    &clk_reg_cbcr_type="sm_cbc"
    &clk_vote_bit=-1.
    &clk_multiplier=4.
    &clk_access_mode="&LPASS_access_mode"

    gosub Print_Clk_Info_Line
  )

  &match=0
  &wild_head=0
  &wild_tail=0
  &clk_input_length=STRING.LENGTH("&clk")
  &clk_itr_length=STRING.LENGTH("island_scc_data_h_aon_clk")

  if (STRING.SCAN("&clk", "*", 0)==0)
  (
    &wild_head=1
  )
  if (STRING.SCAN("&clk", "*", 1)==(STRING.LENGTH("&clk")-1))
  (
    &wild_tail=1
  )

  if ((&wild_head==1)&&(&wild_tail==1))
  (
    if (STRING.SCAN("island_scc_data_h_aon_clk", STRING.MID("&clk", 1, &clk_input_length-2), 0)!=-1)
    ( 
      &match=1
    )
  )
  else if (&wild_head==1)
  (
    if (STRING.MID("island_scc_data_h_aon_clk", &clk_itr_length-&clk_input_length+1, &clk_input_length-1)==STRING.CUT("&clk", 1))
    ( 
      &match=1
    )
  )
  else if (&wild_tail==1)
  (
    if (STRING.MID("island_scc_data_h_aon_clk", 0, &clk_input_length-1)==STRING.CUT("&clk", -1))
    ( 
      &match=1
    )
  )
  else if ("island_scc_data_h_aon_clk"=="&clk")
  (
    &match=1
  )
  
  if (&match==1)
  (
    &clk_test=&CLK_TEST_ISLAND_SCC_DATA_H_AON_CLK
    &clk_reg=&HWIO_LPASS_ISLAND_SCC_DATA_H_AON_CBCR_ADDR
    &clk_reg_name="LPASS_ISLAND_SCC_DATA_H_AON_CBCR"
    &clk_name="island_scc_data_h_aon_clk"
    &clk_reg_cbcr_type="sm_cbc"
    &clk_vote_bit=-1.
    &clk_multiplier=4.
    &clk_access_mode="&LPASS_access_mode"

    gosub Print_Clk_Info_Line
  )

  &match=0
  &wild_head=0
  &wild_tail=0
  &clk_input_length=STRING.LENGTH("&clk")
  &clk_itr_length=STRING.LENGTH("island_scc_qdsp_sway_aon_clk")

  if (STRING.SCAN("&clk", "*", 0)==0)
  (
    &wild_head=1
  )
  if (STRING.SCAN("&clk", "*", 1)==(STRING.LENGTH("&clk")-1))
  (
    &wild_tail=1
  )

  if ((&wild_head==1)&&(&wild_tail==1))
  (
    if (STRING.SCAN("island_scc_qdsp_sway_aon_clk", STRING.MID("&clk", 1, &clk_input_length-2), 0)!=-1)
    ( 
      &match=1
    )
  )
  else if (&wild_head==1)
  (
    if (STRING.MID("island_scc_qdsp_sway_aon_clk", &clk_itr_length-&clk_input_length+1, &clk_input_length-1)==STRING.CUT("&clk", 1))
    ( 
      &match=1
    )
  )
  else if (&wild_tail==1)
  (
    if (STRING.MID("island_scc_qdsp_sway_aon_clk", 0, &clk_input_length-1)==STRING.CUT("&clk", -1))
    ( 
      &match=1
    )
  )
  else if ("island_scc_qdsp_sway_aon_clk"=="&clk")
  (
    &match=1
  )
  
  if (&match==1)
  (
    &clk_test=&CLK_TEST_ISLAND_SCC_QDSP_SWAY_AON_CLK
    &clk_reg=&HWIO_LPASS_ISLAND_SCC_QDSP_SWAY_AON_CBCR_ADDR
    &clk_reg_name="LPASS_ISLAND_SCC_QDSP_SWAY_AON_CBCR"
    &clk_name="island_scc_qdsp_sway_aon_clk"
    &clk_reg_cbcr_type="sm_cbc"
    &clk_vote_bit=-1.
    &clk_multiplier=4.
    &clk_access_mode="&LPASS_access_mode"

    gosub Print_Clk_Info_Line
  )

  &match=0
  &wild_head=0
  &wild_tail=0
  &clk_input_length=STRING.LENGTH("&clk")
  &clk_itr_length=STRING.LENGTH("q6ss_ahbm_aon_clk")

  if (STRING.SCAN("&clk", "*", 0)==0)
  (
    &wild_head=1
  )
  if (STRING.SCAN("&clk", "*", 1)==(STRING.LENGTH("&clk")-1))
  (
    &wild_tail=1
  )

  if ((&wild_head==1)&&(&wild_tail==1))
  (
    if (STRING.SCAN("q6ss_ahbm_aon_clk", STRING.MID("&clk", 1, &clk_input_length-2), 0)!=-1)
    ( 
      &match=1
    )
  )
  else if (&wild_head==1)
  (
    if (STRING.MID("q6ss_ahbm_aon_clk", &clk_itr_length-&clk_input_length+1, &clk_input_length-1)==STRING.CUT("&clk", 1))
    ( 
      &match=1
    )
  )
  else if (&wild_tail==1)
  (
    if (STRING.MID("q6ss_ahbm_aon_clk", 0, &clk_input_length-1)==STRING.CUT("&clk", -1))
    ( 
      &match=1
    )
  )
  else if ("q6ss_ahbm_aon_clk"=="&clk")
  (
    &match=1
  )
  
  if (&match==1)
  (
    &clk_test=&CLK_TEST_Q6SS_AHBM_AON_CLK
    &clk_reg=&HWIO_LPASS_Q6SS_AHBM_AON_CBCR_ADDR
    &clk_reg_name="LPASS_Q6SS_AHBM_AON_CBCR"
    &clk_name="q6ss_ahbm_aon_clk"
    &clk_reg_cbcr_type="sm_cbc"
    &clk_vote_bit=-1.
    &clk_multiplier=4.
    &clk_access_mode="&LPASS_access_mode"

    gosub Print_Clk_Info_Line
  )

  &match=0
  &wild_head=0
  &wild_tail=0
  &clk_input_length=STRING.LENGTH("&clk")
  &clk_itr_length=STRING.LENGTH("q6ss_ahbs_aon_clk")

  if (STRING.SCAN("&clk", "*", 0)==0)
  (
    &wild_head=1
  )
  if (STRING.SCAN("&clk", "*", 1)==(STRING.LENGTH("&clk")-1))
  (
    &wild_tail=1
  )

  if ((&wild_head==1)&&(&wild_tail==1))
  (
    if (STRING.SCAN("q6ss_ahbs_aon_clk", STRING.MID("&clk", 1, &clk_input_length-2), 0)!=-1)
    ( 
      &match=1
    )
  )
  else if (&wild_head==1)
  (
    if (STRING.MID("q6ss_ahbs_aon_clk", &clk_itr_length-&clk_input_length+1, &clk_input_length-1)==STRING.CUT("&clk", 1))
    ( 
      &match=1
    )
  )
  else if (&wild_tail==1)
  (
    if (STRING.MID("q6ss_ahbs_aon_clk", 0, &clk_input_length-1)==STRING.CUT("&clk", -1))
    ( 
      &match=1
    )
  )
  else if ("q6ss_ahbs_aon_clk"=="&clk")
  (
    &match=1
  )
  
  if (&match==1)
  (
    &clk_test=&CLK_TEST_Q6SS_AHBS_AON_CLK
    &clk_reg=&HWIO_LPASS_Q6SS_AHBS_AON_CBCR_ADDR
    &clk_reg_name="LPASS_Q6SS_AHBS_AON_CBCR"
    &clk_name="q6ss_ahbs_aon_clk"
    &clk_reg_cbcr_type="sm_cbc"
    &clk_vote_bit=-1.
    &clk_multiplier=4.
    &clk_access_mode="&LPASS_access_mode"

    gosub Print_Clk_Info_Line
  )

  &match=0
  &wild_head=0
  &wild_tail=0
  &clk_input_length=STRING.LENGTH("&clk")
  &clk_itr_length=STRING.LENGTH("atime_clk_src")

  if (STRING.SCAN("&clk", "*", 0)==0)
  (
    &wild_head=1
  )
  if (STRING.SCAN("&clk", "*", 1)==(STRING.LENGTH("&clk")-1))
  (
    &wild_tail=1
  )

  if ((&wild_head==1)&&(&wild_tail==1))
  (
    if (STRING.SCAN("atime_clk_src", STRING.MID("&clk", 1, &clk_input_length-2), 0)!=-1)
    ( 
      &match=1
    )
  )
  else if (&wild_head==1)
  (
    if (STRING.MID("atime_clk_src", &clk_itr_length-&clk_input_length+1, &clk_input_length-1)==STRING.CUT("&clk", 1))
    ( 
      &match=1
    )
  )
  else if (&wild_tail==1)
  (
    if (STRING.MID("atime_clk_src", 0, &clk_input_length-1)==STRING.CUT("&clk", -1))
    ( 
      &match=1
    )
  )
  else if ("atime_clk_src"=="&clk")
  (
    &match=1
  )
  
  if (&match==1)
  (
    &clk_test=&CLK_TEST_ATIME_CLK_SRC
    &clk_reg=0
    &clk_reg_name="No CBCR"
    &clk_name="atime_clk_src"
    &clk_reg_cbcr_type=""
    &clk_vote_bit=-1.
    &clk_multiplier=4.
    &clk_access_mode="&LPASS_access_mode"

    gosub Print_Clk_Info_Line
  )

  &match=0
  &wild_head=0
  &wild_tail=0
  &clk_input_length=STRING.LENGTH("&clk")
  &clk_itr_length=STRING.LENGTH("audio_core_avsync_atime_clk")

  if (STRING.SCAN("&clk", "*", 0)==0)
  (
    &wild_head=1
  )
  if (STRING.SCAN("&clk", "*", 1)==(STRING.LENGTH("&clk")-1))
  (
    &wild_tail=1
  )

  if ((&wild_head==1)&&(&wild_tail==1))
  (
    if (STRING.SCAN("audio_core_avsync_atime_clk", STRING.MID("&clk", 1, &clk_input_length-2), 0)!=-1)
    ( 
      &match=1
    )
  )
  else if (&wild_head==1)
  (
    if (STRING.MID("audio_core_avsync_atime_clk", &clk_itr_length-&clk_input_length+1, &clk_input_length-1)==STRING.CUT("&clk", 1))
    ( 
      &match=1
    )
  )
  else if (&wild_tail==1)
  (
    if (STRING.MID("audio_core_avsync_atime_clk", 0, &clk_input_length-1)==STRING.CUT("&clk", -1))
    ( 
      &match=1
    )
  )
  else if ("audio_core_avsync_atime_clk"=="&clk")
  (
    &match=1
  )
  
  if (&match==1)
  (
    &clk_test=&CLK_TEST_AUDIO_CORE_AVSYNC_ATIME_CLK
    &clk_reg=&HWIO_LPASS_AUDIO_CORE_AVSYNC_ATIME_CBCR_ADDR
    &clk_reg_name="LPASS_AUDIO_CORE_AVSYNC_ATIME_CBCR"
    &clk_name="audio_core_avsync_atime_clk"
    &clk_reg_cbcr_type="sm_cbc"
    &clk_vote_bit=-1.
    &clk_multiplier=4.
    &clk_access_mode="&LPASS_access_mode"

    gosub Print_Clk_Info_Line
  )

  &match=0
  &wild_head=0
  &wild_tail=0
  &clk_input_length=STRING.LENGTH("&clk")
  &clk_itr_length=STRING.LENGTH("aud_slimbus_clk_src")

  if (STRING.SCAN("&clk", "*", 0)==0)
  (
    &wild_head=1
  )
  if (STRING.SCAN("&clk", "*", 1)==(STRING.LENGTH("&clk")-1))
  (
    &wild_tail=1
  )

  if ((&wild_head==1)&&(&wild_tail==1))
  (
    if (STRING.SCAN("aud_slimbus_clk_src", STRING.MID("&clk", 1, &clk_input_length-2), 0)!=-1)
    ( 
      &match=1
    )
  )
  else if (&wild_head==1)
  (
    if (STRING.MID("aud_slimbus_clk_src", &clk_itr_length-&clk_input_length+1, &clk_input_length-1)==STRING.CUT("&clk", 1))
    ( 
      &match=1
    )
  )
  else if (&wild_tail==1)
  (
    if (STRING.MID("aud_slimbus_clk_src", 0, &clk_input_length-1)==STRING.CUT("&clk", -1))
    ( 
      &match=1
    )
  )
  else if ("aud_slimbus_clk_src"=="&clk")
  (
    &match=1
  )
  
  if (&match==1)
  (
    &clk_test=&CLK_TEST_AUD_SLIMBUS_CLK_SRC
    &clk_reg=0
    &clk_reg_name="No CBCR"
    &clk_name="aud_slimbus_clk_src"
    &clk_reg_cbcr_type=""
    &clk_vote_bit=-1.
    &clk_multiplier=4.
    &clk_access_mode="&LPASS_access_mode"

    gosub Print_Clk_Info_Line
  )

  &match=0
  &wild_head=0
  &wild_tail=0
  &clk_input_length=STRING.LENGTH("&clk")
  &clk_itr_length=STRING.LENGTH("audio_core_aud_slimbus_clk")

  if (STRING.SCAN("&clk", "*", 0)==0)
  (
    &wild_head=1
  )
  if (STRING.SCAN("&clk", "*", 1)==(STRING.LENGTH("&clk")-1))
  (
    &wild_tail=1
  )

  if ((&wild_head==1)&&(&wild_tail==1))
  (
    if (STRING.SCAN("audio_core_aud_slimbus_clk", STRING.MID("&clk", 1, &clk_input_length-2), 0)!=-1)
    ( 
      &match=1
    )
  )
  else if (&wild_head==1)
  (
    if (STRING.MID("audio_core_aud_slimbus_clk", &clk_itr_length-&clk_input_length+1, &clk_input_length-1)==STRING.CUT("&clk", 1))
    ( 
      &match=1
    )
  )
  else if (&wild_tail==1)
  (
    if (STRING.MID("audio_core_aud_slimbus_clk", 0, &clk_input_length-1)==STRING.CUT("&clk", -1))
    ( 
      &match=1
    )
  )
  else if ("audio_core_aud_slimbus_clk"=="&clk")
  (
    &match=1
  )
  
  if (&match==1)
  (
    &clk_test=&CLK_TEST_AUDIO_CORE_AUD_SLIMBUS_CLK
    &clk_reg=&HWIO_LPASS_AUDIO_CORE_AUD_SLIMBUS_CBCR_ADDR
    &clk_reg_name="LPASS_AUDIO_CORE_AUD_SLIMBUS_CBCR"
    &clk_name="audio_core_aud_slimbus_clk"
    &clk_reg_cbcr_type="sm_cbc"
    &clk_vote_bit=-1.
    &clk_multiplier=4.
    &clk_access_mode="&LPASS_access_mode"

    gosub Print_Clk_Info_Line
  )

  &match=0
  &wild_head=0
  &wild_tail=0
  &clk_input_length=STRING.LENGTH("&clk")
  &clk_itr_length=STRING.LENGTH("core_clk_src")

  if (STRING.SCAN("&clk", "*", 0)==0)
  (
    &wild_head=1
  )
  if (STRING.SCAN("&clk", "*", 1)==(STRING.LENGTH("&clk")-1))
  (
    &wild_tail=1
  )

  if ((&wild_head==1)&&(&wild_tail==1))
  (
    if (STRING.SCAN("core_clk_src", STRING.MID("&clk", 1, &clk_input_length-2), 0)!=-1)
    ( 
      &match=1
    )
  )
  else if (&wild_head==1)
  (
    if (STRING.MID("core_clk_src", &clk_itr_length-&clk_input_length+1, &clk_input_length-1)==STRING.CUT("&clk", 1))
    ( 
      &match=1
    )
  )
  else if (&wild_tail==1)
  (
    if (STRING.MID("core_clk_src", 0, &clk_input_length-1)==STRING.CUT("&clk", -1))
    ( 
      &match=1
    )
  )
  else if ("core_clk_src"=="&clk")
  (
    &match=1
  )
  
  if (&match==1)
  (
    &clk_test=&CLK_TEST_CORE_CLK_SRC
    &clk_reg=0
    &clk_reg_name="No CBCR"
    &clk_name="core_clk_src"
    &clk_reg_cbcr_type=""
    &clk_vote_bit=-1.
    &clk_multiplier=4.
    &clk_access_mode="&LPASS_access_mode"

    gosub Print_Clk_Info_Line
  )

  &match=0
  &wild_head=0
  &wild_tail=0
  &clk_input_length=STRING.LENGTH("&clk")
  &clk_itr_length=STRING.LENGTH("audio_core_aud_slimbus_core_clk")

  if (STRING.SCAN("&clk", "*", 0)==0)
  (
    &wild_head=1
  )
  if (STRING.SCAN("&clk", "*", 1)==(STRING.LENGTH("&clk")-1))
  (
    &wild_tail=1
  )

  if ((&wild_head==1)&&(&wild_tail==1))
  (
    if (STRING.SCAN("audio_core_aud_slimbus_core_clk", STRING.MID("&clk", 1, &clk_input_length-2), 0)!=-1)
    ( 
      &match=1
    )
  )
  else if (&wild_head==1)
  (
    if (STRING.MID("audio_core_aud_slimbus_core_clk", &clk_itr_length-&clk_input_length+1, &clk_input_length-1)==STRING.CUT("&clk", 1))
    ( 
      &match=1
    )
  )
  else if (&wild_tail==1)
  (
    if (STRING.MID("audio_core_aud_slimbus_core_clk", 0, &clk_input_length-1)==STRING.CUT("&clk", -1))
    ( 
      &match=1
    )
  )
  else if ("audio_core_aud_slimbus_core_clk"=="&clk")
  (
    &match=1
  )
  
  if (&match==1)
  (
    &clk_test=&CLK_TEST_AUDIO_CORE_AUD_SLIMBUS_CORE_CLK
    &clk_reg=&HWIO_LPASS_AUDIO_CORE_AUD_SLIMBUS_CORE_CBCR_ADDR
    &clk_reg_name="LPASS_AUDIO_CORE_AUD_SLIMBUS_CORE_CBCR"
    &clk_name="audio_core_aud_slimbus_core_clk"
    &clk_reg_cbcr_type="sm_pscbc"
    &clk_vote_bit=-1.
    &clk_multiplier=4.
    &clk_access_mode="&LPASS_access_mode"

    gosub Print_Clk_Info_Line
  )

  &match=0
  &wild_head=0
  &wild_tail=0
  &clk_input_length=STRING.LENGTH("&clk")
  &clk_itr_length=STRING.LENGTH("audio_core_bus_timeout_core_clk")

  if (STRING.SCAN("&clk", "*", 0)==0)
  (
    &wild_head=1
  )
  if (STRING.SCAN("&clk", "*", 1)==(STRING.LENGTH("&clk")-1))
  (
    &wild_tail=1
  )

  if ((&wild_head==1)&&(&wild_tail==1))
  (
    if (STRING.SCAN("audio_core_bus_timeout_core_clk", STRING.MID("&clk", 1, &clk_input_length-2), 0)!=-1)
    ( 
      &match=1
    )
  )
  else if (&wild_head==1)
  (
    if (STRING.MID("audio_core_bus_timeout_core_clk", &clk_itr_length-&clk_input_length+1, &clk_input_length-1)==STRING.CUT("&clk", 1))
    ( 
      &match=1
    )
  )
  else if (&wild_tail==1)
  (
    if (STRING.MID("audio_core_bus_timeout_core_clk", 0, &clk_input_length-1)==STRING.CUT("&clk", -1))
    ( 
      &match=1
    )
  )
  else if ("audio_core_bus_timeout_core_clk"=="&clk")
  (
    &match=1
  )
  
  if (&match==1)
  (
    &clk_test=&CLK_TEST_AUDIO_CORE_BUS_TIMEOUT_CORE_CLK
    &clk_reg=&HWIO_LPASS_AUDIO_CORE_BUS_TIMEOUT_CORE_CBCR_ADDR
    &clk_reg_name="LPASS_AUDIO_CORE_BUS_TIMEOUT_CORE_CBCR"
    &clk_name="audio_core_bus_timeout_core_clk"
    &clk_reg_cbcr_type="sm_cbc"
    &clk_vote_bit=-1.
    &clk_multiplier=4.
    &clk_access_mode="&LPASS_access_mode"

    gosub Print_Clk_Info_Line
  )

  &match=0
  &wild_head=0
  &wild_tail=0
  &clk_input_length=STRING.LENGTH("&clk")
  &clk_itr_length=STRING.LENGTH("audio_core_core_clk")

  if (STRING.SCAN("&clk", "*", 0)==0)
  (
    &wild_head=1
  )
  if (STRING.SCAN("&clk", "*", 1)==(STRING.LENGTH("&clk")-1))
  (
    &wild_tail=1
  )

  if ((&wild_head==1)&&(&wild_tail==1))
  (
    if (STRING.SCAN("audio_core_core_clk", STRING.MID("&clk", 1, &clk_input_length-2), 0)!=-1)
    ( 
      &match=1
    )
  )
  else if (&wild_head==1)
  (
    if (STRING.MID("audio_core_core_clk", &clk_itr_length-&clk_input_length+1, &clk_input_length-1)==STRING.CUT("&clk", 1))
    ( 
      &match=1
    )
  )
  else if (&wild_tail==1)
  (
    if (STRING.MID("audio_core_core_clk", 0, &clk_input_length-1)==STRING.CUT("&clk", -1))
    ( 
      &match=1
    )
  )
  else if ("audio_core_core_clk"=="&clk")
  (
    &match=1
  )
  
  if (&match==1)
  (
    &clk_test=&CLK_TEST_AUDIO_CORE_CORE_CLK
    &clk_reg=&HWIO_LPASS_AUDIO_CORE_CORE_CBCR_ADDR
    &clk_reg_name="LPASS_AUDIO_CORE_CORE_CBCR"
    &clk_name="audio_core_core_clk"
    &clk_reg_cbcr_type="sm_cbc"
    &clk_vote_bit=-1.
    &clk_multiplier=4.
    &clk_access_mode="&LPASS_access_mode"

    gosub Print_Clk_Info_Line
  )

  &match=0
  &wild_head=0
  &wild_tail=0
  &clk_input_length=STRING.LENGTH("&clk")
  &clk_itr_length=STRING.LENGTH("audio_core_lpm_core_clk")

  if (STRING.SCAN("&clk", "*", 0)==0)
  (
    &wild_head=1
  )
  if (STRING.SCAN("&clk", "*", 1)==(STRING.LENGTH("&clk")-1))
  (
    &wild_tail=1
  )

  if ((&wild_head==1)&&(&wild_tail==1))
  (
    if (STRING.SCAN("audio_core_lpm_core_clk", STRING.MID("&clk", 1, &clk_input_length-2), 0)!=-1)
    ( 
      &match=1
    )
  )
  else if (&wild_head==1)
  (
    if (STRING.MID("audio_core_lpm_core_clk", &clk_itr_length-&clk_input_length+1, &clk_input_length-1)==STRING.CUT("&clk", 1))
    ( 
      &match=1
    )
  )
  else if (&wild_tail==1)
  (
    if (STRING.MID("audio_core_lpm_core_clk", 0, &clk_input_length-1)==STRING.CUT("&clk", -1))
    ( 
      &match=1
    )
  )
  else if ("audio_core_lpm_core_clk"=="&clk")
  (
    &match=1
  )
  
  if (&match==1)
  (
    &clk_test=&CLK_TEST_AUDIO_CORE_LPM_CORE_CLK
    &clk_reg=&HWIO_LPASS_AUDIO_CORE_LPM_CORE_CBCR_ADDR
    &clk_reg_name="LPASS_AUDIO_CORE_LPM_CORE_CBCR"
    &clk_name="audio_core_lpm_core_clk"
    &clk_reg_cbcr_type="sm_pscbc"
    &clk_vote_bit=-1.
    &clk_multiplier=4.
    &clk_access_mode="&LPASS_access_mode"

    gosub Print_Clk_Info_Line
  )

  &match=0
  &wild_head=0
  &wild_tail=0
  &clk_input_length=STRING.LENGTH("&clk")
  &clk_itr_length=STRING.LENGTH("audio_core_qca_slimbus_core_clk")

  if (STRING.SCAN("&clk", "*", 0)==0)
  (
    &wild_head=1
  )
  if (STRING.SCAN("&clk", "*", 1)==(STRING.LENGTH("&clk")-1))
  (
    &wild_tail=1
  )

  if ((&wild_head==1)&&(&wild_tail==1))
  (
    if (STRING.SCAN("audio_core_qca_slimbus_core_clk", STRING.MID("&clk", 1, &clk_input_length-2), 0)!=-1)
    ( 
      &match=1
    )
  )
  else if (&wild_head==1)
  (
    if (STRING.MID("audio_core_qca_slimbus_core_clk", &clk_itr_length-&clk_input_length+1, &clk_input_length-1)==STRING.CUT("&clk", 1))
    ( 
      &match=1
    )
  )
  else if (&wild_tail==1)
  (
    if (STRING.MID("audio_core_qca_slimbus_core_clk", 0, &clk_input_length-1)==STRING.CUT("&clk", -1))
    ( 
      &match=1
    )
  )
  else if ("audio_core_qca_slimbus_core_clk"=="&clk")
  (
    &match=1
  )
  
  if (&match==1)
  (
    &clk_test=&CLK_TEST_AUDIO_CORE_QCA_SLIMBUS_CORE_CLK
    &clk_reg=&HWIO_LPASS_AUDIO_CORE_QCA_SLIMBUS_CORE_CBCR_ADDR
    &clk_reg_name="LPASS_AUDIO_CORE_QCA_SLIMBUS_CORE_CBCR"
    &clk_name="audio_core_qca_slimbus_core_clk"
    &clk_reg_cbcr_type="sm_pscbc"
    &clk_vote_bit=-1.
    &clk_multiplier=4.
    &clk_access_mode="&LPASS_access_mode"

    gosub Print_Clk_Info_Line
  )

  &match=0
  &wild_head=0
  &wild_tail=0
  &clk_input_length=STRING.LENGTH("&clk")
  &clk_itr_length=STRING.LENGTH("audio_core_sysnoc_mport_core_clk")

  if (STRING.SCAN("&clk", "*", 0)==0)
  (
    &wild_head=1
  )
  if (STRING.SCAN("&clk", "*", 1)==(STRING.LENGTH("&clk")-1))
  (
    &wild_tail=1
  )

  if ((&wild_head==1)&&(&wild_tail==1))
  (
    if (STRING.SCAN("audio_core_sysnoc_mport_core_clk", STRING.MID("&clk", 1, &clk_input_length-2), 0)!=-1)
    ( 
      &match=1
    )
  )
  else if (&wild_head==1)
  (
    if (STRING.MID("audio_core_sysnoc_mport_core_clk", &clk_itr_length-&clk_input_length+1, &clk_input_length-1)==STRING.CUT("&clk", 1))
    ( 
      &match=1
    )
  )
  else if (&wild_tail==1)
  (
    if (STRING.MID("audio_core_sysnoc_mport_core_clk", 0, &clk_input_length-1)==STRING.CUT("&clk", -1))
    ( 
      &match=1
    )
  )
  else if ("audio_core_sysnoc_mport_core_clk"=="&clk")
  (
    &match=1
  )
  
  if (&match==1)
  (
    &clk_test=&CLK_TEST_AUDIO_CORE_SYSNOC_MPORT_CORE_CLK
    &clk_reg=&HWIO_LPASS_AUDIO_CORE_SYSNOC_MPORT_CORE_CBCR_ADDR
    &clk_reg_name="LPASS_AUDIO_CORE_SYSNOC_MPORT_CORE_CBCR"
    &clk_name="audio_core_sysnoc_mport_core_clk"
    &clk_reg_cbcr_type="sm_cbc"
    &clk_vote_bit=-1.
    &clk_multiplier=4.
    &clk_access_mode="&LPASS_access_mode"

    gosub Print_Clk_Info_Line
  )

  &match=0
  &wild_head=0
  &wild_tail=0
  &clk_input_length=STRING.LENGTH("&clk")
  &clk_itr_length=STRING.LENGTH("island_scc_ahb_timeout_core_clk")

  if (STRING.SCAN("&clk", "*", 0)==0)
  (
    &wild_head=1
  )
  if (STRING.SCAN("&clk", "*", 1)==(STRING.LENGTH("&clk")-1))
  (
    &wild_tail=1
  )

  if ((&wild_head==1)&&(&wild_tail==1))
  (
    if (STRING.SCAN("island_scc_ahb_timeout_core_clk", STRING.MID("&clk", 1, &clk_input_length-2), 0)!=-1)
    ( 
      &match=1
    )
  )
  else if (&wild_head==1)
  (
    if (STRING.MID("island_scc_ahb_timeout_core_clk", &clk_itr_length-&clk_input_length+1, &clk_input_length-1)==STRING.CUT("&clk", 1))
    ( 
      &match=1
    )
  )
  else if (&wild_tail==1)
  (
    if (STRING.MID("island_scc_ahb_timeout_core_clk", 0, &clk_input_length-1)==STRING.CUT("&clk", -1))
    ( 
      &match=1
    )
  )
  else if ("island_scc_ahb_timeout_core_clk"=="&clk")
  (
    &match=1
  )
  
  if (&match==1)
  (
    &clk_test=&CLK_TEST_ISLAND_SCC_AHB_TIMEOUT_CORE_CLK
    &clk_reg=&HWIO_LPASS_ISLAND_SCC_AHB_TIMEOUT_CORE_CBCR_ADDR
    &clk_reg_name="LPASS_ISLAND_SCC_AHB_TIMEOUT_CORE_CBCR"
    &clk_name="island_scc_ahb_timeout_core_clk"
    &clk_reg_cbcr_type="sm_cbc"
    &clk_vote_bit=-1.
    &clk_multiplier=4.
    &clk_access_mode="&LPASS_access_mode"

    gosub Print_Clk_Info_Line
  )

  &match=0
  &wild_head=0
  &wild_tail=0
  &clk_input_length=STRING.LENGTH("&clk")
  &clk_itr_length=STRING.LENGTH("island_scc_blsp_h_core_clk")

  if (STRING.SCAN("&clk", "*", 0)==0)
  (
    &wild_head=1
  )
  if (STRING.SCAN("&clk", "*", 1)==(STRING.LENGTH("&clk")-1))
  (
    &wild_tail=1
  )

  if ((&wild_head==1)&&(&wild_tail==1))
  (
    if (STRING.SCAN("island_scc_blsp_h_core_clk", STRING.MID("&clk", 1, &clk_input_length-2), 0)!=-1)
    ( 
      &match=1
    )
  )
  else if (&wild_head==1)
  (
    if (STRING.MID("island_scc_blsp_h_core_clk", &clk_itr_length-&clk_input_length+1, &clk_input_length-1)==STRING.CUT("&clk", 1))
    ( 
      &match=1
    )
  )
  else if (&wild_tail==1)
  (
    if (STRING.MID("island_scc_blsp_h_core_clk", 0, &clk_input_length-1)==STRING.CUT("&clk", -1))
    ( 
      &match=1
    )
  )
  else if ("island_scc_blsp_h_core_clk"=="&clk")
  (
    &match=1
  )
  
  if (&match==1)
  (
    &clk_test=&CLK_TEST_ISLAND_SCC_BLSP_H_CORE_CLK
    &clk_reg=&HWIO_LPASS_ISLAND_SCC_BLSP_H_CORE_CBCR_ADDR
    &clk_reg_name="LPASS_ISLAND_SCC_BLSP_H_CORE_CBCR"
    &clk_name="island_scc_blsp_h_core_clk"
    &clk_reg_cbcr_type="sm_pscbc"
    &clk_vote_bit=-1.
    &clk_multiplier=4.
    &clk_access_mode="&LPASS_access_mode"

    gosub Print_Clk_Info_Line
  )

  &match=0
  &wild_head=0
  &wild_tail=0
  &clk_input_length=STRING.LENGTH("&clk")
  &clk_itr_length=STRING.LENGTH("island_scc_sensor_core_core_clk")

  if (STRING.SCAN("&clk", "*", 0)==0)
  (
    &wild_head=1
  )
  if (STRING.SCAN("&clk", "*", 1)==(STRING.LENGTH("&clk")-1))
  (
    &wild_tail=1
  )

  if ((&wild_head==1)&&(&wild_tail==1))
  (
    if (STRING.SCAN("island_scc_sensor_core_core_clk", STRING.MID("&clk", 1, &clk_input_length-2), 0)!=-1)
    ( 
      &match=1
    )
  )
  else if (&wild_head==1)
  (
    if (STRING.MID("island_scc_sensor_core_core_clk", &clk_itr_length-&clk_input_length+1, &clk_input_length-1)==STRING.CUT("&clk", 1))
    ( 
      &match=1
    )
  )
  else if (&wild_tail==1)
  (
    if (STRING.MID("island_scc_sensor_core_core_clk", 0, &clk_input_length-1)==STRING.CUT("&clk", -1))
    ( 
      &match=1
    )
  )
  else if ("island_scc_sensor_core_core_clk"=="&clk")
  (
    &match=1
  )
  
  if (&match==1)
  (
    &clk_test=&CLK_TEST_ISLAND_SCC_SENSOR_CORE_CORE_CLK
    &clk_reg=&HWIO_LPASS_ISLAND_SCC_SENSOR_CORE_CORE_CBCR_ADDR
    &clk_reg_name="LPASS_ISLAND_SCC_SENSOR_CORE_CORE_CBCR"
    &clk_name="island_scc_sensor_core_core_clk"
    &clk_reg_cbcr_type="sm_cbc"
    &clk_vote_bit=-1.
    &clk_multiplier=4.
    &clk_access_mode="&LPASS_access_mode"

    gosub Print_Clk_Info_Line
  )

  &match=0
  &wild_head=0
  &wild_tail=0
  &clk_input_length=STRING.LENGTH("&clk")
  &clk_itr_length=STRING.LENGTH("island_scc_smem_core_clk")

  if (STRING.SCAN("&clk", "*", 0)==0)
  (
    &wild_head=1
  )
  if (STRING.SCAN("&clk", "*", 1)==(STRING.LENGTH("&clk")-1))
  (
    &wild_tail=1
  )

  if ((&wild_head==1)&&(&wild_tail==1))
  (
    if (STRING.SCAN("island_scc_smem_core_clk", STRING.MID("&clk", 1, &clk_input_length-2), 0)!=-1)
    ( 
      &match=1
    )
  )
  else if (&wild_head==1)
  (
    if (STRING.MID("island_scc_smem_core_clk", &clk_itr_length-&clk_input_length+1, &clk_input_length-1)==STRING.CUT("&clk", 1))
    ( 
      &match=1
    )
  )
  else if (&wild_tail==1)
  (
    if (STRING.MID("island_scc_smem_core_clk", 0, &clk_input_length-1)==STRING.CUT("&clk", -1))
    ( 
      &match=1
    )
  )
  else if ("island_scc_smem_core_clk"=="&clk")
  (
    &match=1
  )
  
  if (&match==1)
  (
    &clk_test=&CLK_TEST_ISLAND_SCC_SMEM_CORE_CLK
    &clk_reg=&HWIO_LPASS_ISLAND_SCC_SMEM_CORE_CBCR_ADDR
    &clk_reg_name="LPASS_ISLAND_SCC_SMEM_CORE_CBCR"
    &clk_name="island_scc_smem_core_clk"
    &clk_reg_cbcr_type="sm_pscbc"
    &clk_vote_bit=-1.
    &clk_multiplier=4.
    &clk_access_mode="&LPASS_access_mode"

    gosub Print_Clk_Info_Line
  )

  &match=0
  &wild_head=0
  &wild_tail=0
  &clk_input_length=STRING.LENGTH("&clk")
  &clk_itr_length=STRING.LENGTH("ext_mclk0_clk_src")

  if (STRING.SCAN("&clk", "*", 0)==0)
  (
    &wild_head=1
  )
  if (STRING.SCAN("&clk", "*", 1)==(STRING.LENGTH("&clk")-1))
  (
    &wild_tail=1
  )

  if ((&wild_head==1)&&(&wild_tail==1))
  (
    if (STRING.SCAN("ext_mclk0_clk_src", STRING.MID("&clk", 1, &clk_input_length-2), 0)!=-1)
    ( 
      &match=1
    )
  )
  else if (&wild_head==1)
  (
    if (STRING.MID("ext_mclk0_clk_src", &clk_itr_length-&clk_input_length+1, &clk_input_length-1)==STRING.CUT("&clk", 1))
    ( 
      &match=1
    )
  )
  else if (&wild_tail==1)
  (
    if (STRING.MID("ext_mclk0_clk_src", 0, &clk_input_length-1)==STRING.CUT("&clk", -1))
    ( 
      &match=1
    )
  )
  else if ("ext_mclk0_clk_src"=="&clk")
  (
    &match=1
  )
  
  if (&match==1)
  (
    &clk_test=&CLK_TEST_EXT_MCLK0_CLK_SRC
    &clk_reg=0
    &clk_reg_name="No CBCR"
    &clk_name="ext_mclk0_clk_src"
    &clk_reg_cbcr_type=""
    &clk_vote_bit=-1.
    &clk_multiplier=4.
    &clk_access_mode="&LPASS_access_mode"

    gosub Print_Clk_Info_Line
  )

  &match=0
  &wild_head=0
  &wild_tail=0
  &clk_input_length=STRING.LENGTH("&clk")
  &clk_itr_length=STRING.LENGTH("audio_wrapper_ext_mclk0_clk")

  if (STRING.SCAN("&clk", "*", 0)==0)
  (
    &wild_head=1
  )
  if (STRING.SCAN("&clk", "*", 1)==(STRING.LENGTH("&clk")-1))
  (
    &wild_tail=1
  )

  if ((&wild_head==1)&&(&wild_tail==1))
  (
    if (STRING.SCAN("audio_wrapper_ext_mclk0_clk", STRING.MID("&clk", 1, &clk_input_length-2), 0)!=-1)
    ( 
      &match=1
    )
  )
  else if (&wild_head==1)
  (
    if (STRING.MID("audio_wrapper_ext_mclk0_clk", &clk_itr_length-&clk_input_length+1, &clk_input_length-1)==STRING.CUT("&clk", 1))
    ( 
      &match=1
    )
  )
  else if (&wild_tail==1)
  (
    if (STRING.MID("audio_wrapper_ext_mclk0_clk", 0, &clk_input_length-1)==STRING.CUT("&clk", -1))
    ( 
      &match=1
    )
  )
  else if ("audio_wrapper_ext_mclk0_clk"=="&clk")
  (
    &match=1
  )
  
  if (&match==1)
  (
    &clk_test=&CLK_TEST_AUDIO_WRAPPER_EXT_MCLK0_CLK
    &clk_reg=&HWIO_LPASS_AUDIO_WRAPPER_EXT_MCLK0_CBCR_ADDR
    &clk_reg_name="LPASS_AUDIO_WRAPPER_EXT_MCLK0_CBCR"
    &clk_name="audio_wrapper_ext_mclk0_clk"
    &clk_reg_cbcr_type="sm_cbc"
    &clk_vote_bit=-1.
    &clk_multiplier=4.
    &clk_access_mode="&LPASS_access_mode"

    gosub Print_Clk_Info_Line
  )

  &match=0
  &wild_head=0
  &wild_tail=0
  &clk_input_length=STRING.LENGTH("&clk")
  &clk_itr_length=STRING.LENGTH("ext_mclk1_clk_src")

  if (STRING.SCAN("&clk", "*", 0)==0)
  (
    &wild_head=1
  )
  if (STRING.SCAN("&clk", "*", 1)==(STRING.LENGTH("&clk")-1))
  (
    &wild_tail=1
  )

  if ((&wild_head==1)&&(&wild_tail==1))
  (
    if (STRING.SCAN("ext_mclk1_clk_src", STRING.MID("&clk", 1, &clk_input_length-2), 0)!=-1)
    ( 
      &match=1
    )
  )
  else if (&wild_head==1)
  (
    if (STRING.MID("ext_mclk1_clk_src", &clk_itr_length-&clk_input_length+1, &clk_input_length-1)==STRING.CUT("&clk", 1))
    ( 
      &match=1
    )
  )
  else if (&wild_tail==1)
  (
    if (STRING.MID("ext_mclk1_clk_src", 0, &clk_input_length-1)==STRING.CUT("&clk", -1))
    ( 
      &match=1
    )
  )
  else if ("ext_mclk1_clk_src"=="&clk")
  (
    &match=1
  )
  
  if (&match==1)
  (
    &clk_test=&CLK_TEST_EXT_MCLK1_CLK_SRC
    &clk_reg=0
    &clk_reg_name="No CBCR"
    &clk_name="ext_mclk1_clk_src"
    &clk_reg_cbcr_type=""
    &clk_vote_bit=-1.
    &clk_multiplier=4.
    &clk_access_mode="&LPASS_access_mode"

    gosub Print_Clk_Info_Line
  )

  &match=0
  &wild_head=0
  &wild_tail=0
  &clk_input_length=STRING.LENGTH("&clk")
  &clk_itr_length=STRING.LENGTH("audio_wrapper_ext_mclk1_clk")

  if (STRING.SCAN("&clk", "*", 0)==0)
  (
    &wild_head=1
  )
  if (STRING.SCAN("&clk", "*", 1)==(STRING.LENGTH("&clk")-1))
  (
    &wild_tail=1
  )

  if ((&wild_head==1)&&(&wild_tail==1))
  (
    if (STRING.SCAN("audio_wrapper_ext_mclk1_clk", STRING.MID("&clk", 1, &clk_input_length-2), 0)!=-1)
    ( 
      &match=1
    )
  )
  else if (&wild_head==1)
  (
    if (STRING.MID("audio_wrapper_ext_mclk1_clk", &clk_itr_length-&clk_input_length+1, &clk_input_length-1)==STRING.CUT("&clk", 1))
    ( 
      &match=1
    )
  )
  else if (&wild_tail==1)
  (
    if (STRING.MID("audio_wrapper_ext_mclk1_clk", 0, &clk_input_length-1)==STRING.CUT("&clk", -1))
    ( 
      &match=1
    )
  )
  else if ("audio_wrapper_ext_mclk1_clk"=="&clk")
  (
    &match=1
  )
  
  if (&match==1)
  (
    &clk_test=&CLK_TEST_AUDIO_WRAPPER_EXT_MCLK1_CLK
    &clk_reg=&HWIO_LPASS_AUDIO_WRAPPER_EXT_MCLK1_CBCR_ADDR
    &clk_reg_name="LPASS_AUDIO_WRAPPER_EXT_MCLK1_CBCR"
    &clk_name="audio_wrapper_ext_mclk1_clk"
    &clk_reg_cbcr_type="sm_cbc"
    &clk_vote_bit=-1.
    &clk_multiplier=4.
    &clk_access_mode="&LPASS_access_mode"

    gosub Print_Clk_Info_Line
  )

  &match=0
  &wild_head=0
  &wild_tail=0
  &clk_input_length=STRING.LENGTH("&clk")
  &clk_itr_length=STRING.LENGTH("ext_mclk2_clk_src")

  if (STRING.SCAN("&clk", "*", 0)==0)
  (
    &wild_head=1
  )
  if (STRING.SCAN("&clk", "*", 1)==(STRING.LENGTH("&clk")-1))
  (
    &wild_tail=1
  )

  if ((&wild_head==1)&&(&wild_tail==1))
  (
    if (STRING.SCAN("ext_mclk2_clk_src", STRING.MID("&clk", 1, &clk_input_length-2), 0)!=-1)
    ( 
      &match=1
    )
  )
  else if (&wild_head==1)
  (
    if (STRING.MID("ext_mclk2_clk_src", &clk_itr_length-&clk_input_length+1, &clk_input_length-1)==STRING.CUT("&clk", 1))
    ( 
      &match=1
    )
  )
  else if (&wild_tail==1)
  (
    if (STRING.MID("ext_mclk2_clk_src", 0, &clk_input_length-1)==STRING.CUT("&clk", -1))
    ( 
      &match=1
    )
  )
  else if ("ext_mclk2_clk_src"=="&clk")
  (
    &match=1
  )
  
  if (&match==1)
  (
    &clk_test=&CLK_TEST_EXT_MCLK2_CLK_SRC
    &clk_reg=0
    &clk_reg_name="No CBCR"
    &clk_name="ext_mclk2_clk_src"
    &clk_reg_cbcr_type=""
    &clk_vote_bit=-1.
    &clk_multiplier=4.
    &clk_access_mode="&LPASS_access_mode"

    gosub Print_Clk_Info_Line
  )

  &match=0
  &wild_head=0
  &wild_tail=0
  &clk_input_length=STRING.LENGTH("&clk")
  &clk_itr_length=STRING.LENGTH("audio_wrapper_ext_mclk2_clk")

  if (STRING.SCAN("&clk", "*", 0)==0)
  (
    &wild_head=1
  )
  if (STRING.SCAN("&clk", "*", 1)==(STRING.LENGTH("&clk")-1))
  (
    &wild_tail=1
  )

  if ((&wild_head==1)&&(&wild_tail==1))
  (
    if (STRING.SCAN("audio_wrapper_ext_mclk2_clk", STRING.MID("&clk", 1, &clk_input_length-2), 0)!=-1)
    ( 
      &match=1
    )
  )
  else if (&wild_head==1)
  (
    if (STRING.MID("audio_wrapper_ext_mclk2_clk", &clk_itr_length-&clk_input_length+1, &clk_input_length-1)==STRING.CUT("&clk", 1))
    ( 
      &match=1
    )
  )
  else if (&wild_tail==1)
  (
    if (STRING.MID("audio_wrapper_ext_mclk2_clk", 0, &clk_input_length-1)==STRING.CUT("&clk", -1))
    ( 
      &match=1
    )
  )
  else if ("audio_wrapper_ext_mclk2_clk"=="&clk")
  (
    &match=1
  )
  
  if (&match==1)
  (
    &clk_test=&CLK_TEST_AUDIO_WRAPPER_EXT_MCLK2_CLK
    &clk_reg=&HWIO_LPASS_AUDIO_WRAPPER_EXT_MCLK2_CBCR_ADDR
    &clk_reg_name="LPASS_AUDIO_WRAPPER_EXT_MCLK2_CBCR"
    &clk_name="audio_wrapper_ext_mclk2_clk"
    &clk_reg_cbcr_type="sm_cbc"
    &clk_vote_bit=-1.
    &clk_multiplier=4.
    &clk_access_mode="&LPASS_access_mode"

    gosub Print_Clk_Info_Line
  )

  &match=0
  &wild_head=0
  &wild_tail=0
  &clk_input_length=STRING.LENGTH("&clk")
  &clk_itr_length=STRING.LENGTH("audio_wrapper_ext_mclk3_clk")

  if (STRING.SCAN("&clk", "*", 0)==0)
  (
    &wild_head=1
  )
  if (STRING.SCAN("&clk", "*", 1)==(STRING.LENGTH("&clk")-1))
  (
    &wild_tail=1
  )

  if ((&wild_head==1)&&(&wild_tail==1))
  (
    if (STRING.SCAN("audio_wrapper_ext_mclk3_clk", STRING.MID("&clk", 1, &clk_input_length-2), 0)!=-1)
    ( 
      &match=1
    )
  )
  else if (&wild_head==1)
  (
    if (STRING.MID("audio_wrapper_ext_mclk3_clk", &clk_itr_length-&clk_input_length+1, &clk_input_length-1)==STRING.CUT("&clk", 1))
    ( 
      &match=1
    )
  )
  else if (&wild_tail==1)
  (
    if (STRING.MID("audio_wrapper_ext_mclk3_clk", 0, &clk_input_length-1)==STRING.CUT("&clk", -1))
    ( 
      &match=1
    )
  )
  else if ("audio_wrapper_ext_mclk3_clk"=="&clk")
  (
    &match=1
  )
  
  if (&match==1)
  (
    &clk_test=&CLK_TEST_AUDIO_WRAPPER_EXT_MCLK3_CLK
    &clk_reg=&HWIO_LPASS_AUDIO_WRAPPER_EXT_MCLK3_CBCR_ADDR
    &clk_reg_name="LPASS_AUDIO_WRAPPER_EXT_MCLK3_CBCR"
    &clk_name="audio_wrapper_ext_mclk3_clk"
    &clk_reg_cbcr_type="sm_cbc"
    &clk_vote_bit=-1.
    &clk_multiplier=4.
    &clk_access_mode="&LPASS_access_mode"

    gosub Print_Clk_Info_Line
  )

  &match=0
  &wild_head=0
  &wild_tail=0
  &clk_input_length=STRING.LENGTH("&clk")
  &clk_itr_length=STRING.LENGTH("audio_core_int_i2s0_1_ibit_clk")

  if (STRING.SCAN("&clk", "*", 0)==0)
  (
    &wild_head=1
  )
  if (STRING.SCAN("&clk", "*", 1)==(STRING.LENGTH("&clk")-1))
  (
    &wild_tail=1
  )

  if ((&wild_head==1)&&(&wild_tail==1))
  (
    if (STRING.SCAN("audio_core_int_i2s0_1_ibit_clk", STRING.MID("&clk", 1, &clk_input_length-2), 0)!=-1)
    ( 
      &match=1
    )
  )
  else if (&wild_head==1)
  (
    if (STRING.MID("audio_core_int_i2s0_1_ibit_clk", &clk_itr_length-&clk_input_length+1, &clk_input_length-1)==STRING.CUT("&clk", 1))
    ( 
      &match=1
    )
  )
  else if (&wild_tail==1)
  (
    if (STRING.MID("audio_core_int_i2s0_1_ibit_clk", 0, &clk_input_length-1)==STRING.CUT("&clk", -1))
    ( 
      &match=1
    )
  )
  else if ("audio_core_int_i2s0_1_ibit_clk"=="&clk")
  (
    &match=1
  )
  
  if (&match==1)
  (
    &clk_test=&CLK_TEST_AUDIO_CORE_INT_I2S0_1_IBIT_CLK
    &clk_reg=&HWIO_LPASS_AUDIO_CORE_INT_I2S0_1_IBIT_CBCR_ADDR
    &clk_reg_name="LPASS_AUDIO_CORE_INT_I2S0_1_IBIT_CBCR"
    &clk_name="audio_core_int_i2s0_1_ibit_clk"
    &clk_reg_cbcr_type="sm_cbc"
    &clk_vote_bit=-1.
    &clk_multiplier=4.
    &clk_access_mode="&LPASS_access_mode"

    gosub Print_Clk_Info_Line
  )

  &match=0
  &wild_head=0
  &wild_tail=0
  &clk_input_length=STRING.LENGTH("&clk")
  &clk_itr_length=STRING.LENGTH("audio_core_int_i2s2_ibit_clk")

  if (STRING.SCAN("&clk", "*", 0)==0)
  (
    &wild_head=1
  )
  if (STRING.SCAN("&clk", "*", 1)==(STRING.LENGTH("&clk")-1))
  (
    &wild_tail=1
  )

  if ((&wild_head==1)&&(&wild_tail==1))
  (
    if (STRING.SCAN("audio_core_int_i2s2_ibit_clk", STRING.MID("&clk", 1, &clk_input_length-2), 0)!=-1)
    ( 
      &match=1
    )
  )
  else if (&wild_head==1)
  (
    if (STRING.MID("audio_core_int_i2s2_ibit_clk", &clk_itr_length-&clk_input_length+1, &clk_input_length-1)==STRING.CUT("&clk", 1))
    ( 
      &match=1
    )
  )
  else if (&wild_tail==1)
  (
    if (STRING.MID("audio_core_int_i2s2_ibit_clk", 0, &clk_input_length-1)==STRING.CUT("&clk", -1))
    ( 
      &match=1
    )
  )
  else if ("audio_core_int_i2s2_ibit_clk"=="&clk")
  (
    &match=1
  )
  
  if (&match==1)
  (
    &clk_test=&CLK_TEST_AUDIO_CORE_INT_I2S2_IBIT_CLK
    &clk_reg=&HWIO_LPASS_AUDIO_CORE_INT_I2S2_IBIT_CBCR_ADDR
    &clk_reg_name="LPASS_AUDIO_CORE_INT_I2S2_IBIT_CBCR"
    &clk_name="audio_core_int_i2s2_ibit_clk"
    &clk_reg_cbcr_type="sm_cbc"
    &clk_vote_bit=-1.
    &clk_multiplier=4.
    &clk_access_mode="&LPASS_access_mode"

    gosub Print_Clk_Info_Line
  )

  &match=0
  &wild_head=0
  &wild_tail=0
  &clk_input_length=STRING.LENGTH("&clk")
  &clk_itr_length=STRING.LENGTH("audio_core_int_i2s3_ibit_clk")

  if (STRING.SCAN("&clk", "*", 0)==0)
  (
    &wild_head=1
  )
  if (STRING.SCAN("&clk", "*", 1)==(STRING.LENGTH("&clk")-1))
  (
    &wild_tail=1
  )

  if ((&wild_head==1)&&(&wild_tail==1))
  (
    if (STRING.SCAN("audio_core_int_i2s3_ibit_clk", STRING.MID("&clk", 1, &clk_input_length-2), 0)!=-1)
    ( 
      &match=1
    )
  )
  else if (&wild_head==1)
  (
    if (STRING.MID("audio_core_int_i2s3_ibit_clk", &clk_itr_length-&clk_input_length+1, &clk_input_length-1)==STRING.CUT("&clk", 1))
    ( 
      &match=1
    )
  )
  else if (&wild_tail==1)
  (
    if (STRING.MID("audio_core_int_i2s3_ibit_clk", 0, &clk_input_length-1)==STRING.CUT("&clk", -1))
    ( 
      &match=1
    )
  )
  else if ("audio_core_int_i2s3_ibit_clk"=="&clk")
  (
    &match=1
  )
  
  if (&match==1)
  (
    &clk_test=&CLK_TEST_AUDIO_CORE_INT_I2S3_IBIT_CLK
    &clk_reg=&HWIO_LPASS_AUDIO_CORE_INT_I2S3_IBIT_CBCR_ADDR
    &clk_reg_name="LPASS_AUDIO_CORE_INT_I2S3_IBIT_CBCR"
    &clk_name="audio_core_int_i2s3_ibit_clk"
    &clk_reg_cbcr_type="sm_cbc"
    &clk_vote_bit=-1.
    &clk_multiplier=4.
    &clk_access_mode="&LPASS_access_mode"

    gosub Print_Clk_Info_Line
  )

  &match=0
  &wild_head=0
  &wild_tail=0
  &clk_input_length=STRING.LENGTH("&clk")
  &clk_itr_length=STRING.LENGTH("audio_core_int_i2s4_ibit_clk")

  if (STRING.SCAN("&clk", "*", 0)==0)
  (
    &wild_head=1
  )
  if (STRING.SCAN("&clk", "*", 1)==(STRING.LENGTH("&clk")-1))
  (
    &wild_tail=1
  )

  if ((&wild_head==1)&&(&wild_tail==1))
  (
    if (STRING.SCAN("audio_core_int_i2s4_ibit_clk", STRING.MID("&clk", 1, &clk_input_length-2), 0)!=-1)
    ( 
      &match=1
    )
  )
  else if (&wild_head==1)
  (
    if (STRING.MID("audio_core_int_i2s4_ibit_clk", &clk_itr_length-&clk_input_length+1, &clk_input_length-1)==STRING.CUT("&clk", 1))
    ( 
      &match=1
    )
  )
  else if (&wild_tail==1)
  (
    if (STRING.MID("audio_core_int_i2s4_ibit_clk", 0, &clk_input_length-1)==STRING.CUT("&clk", -1))
    ( 
      &match=1
    )
  )
  else if ("audio_core_int_i2s4_ibit_clk"=="&clk")
  (
    &match=1
  )
  
  if (&match==1)
  (
    &clk_test=&CLK_TEST_AUDIO_CORE_INT_I2S4_IBIT_CLK
    &clk_reg=&HWIO_LPASS_AUDIO_CORE_INT_I2S4_IBIT_CBCR_ADDR
    &clk_reg_name="LPASS_AUDIO_CORE_INT_I2S4_IBIT_CBCR"
    &clk_name="audio_core_int_i2s4_ibit_clk"
    &clk_reg_cbcr_type="sm_cbc"
    &clk_vote_bit=-1.
    &clk_multiplier=4.
    &clk_access_mode="&LPASS_access_mode"

    gosub Print_Clk_Info_Line
  )

  &match=0
  &wild_head=0
  &wild_tail=0
  &clk_input_length=STRING.LENGTH("&clk")
  &clk_itr_length=STRING.LENGTH("audio_core_int_i2s5_6_ibit_clk")

  if (STRING.SCAN("&clk", "*", 0)==0)
  (
    &wild_head=1
  )
  if (STRING.SCAN("&clk", "*", 1)==(STRING.LENGTH("&clk")-1))
  (
    &wild_tail=1
  )

  if ((&wild_head==1)&&(&wild_tail==1))
  (
    if (STRING.SCAN("audio_core_int_i2s5_6_ibit_clk", STRING.MID("&clk", 1, &clk_input_length-2), 0)!=-1)
    ( 
      &match=1
    )
  )
  else if (&wild_head==1)
  (
    if (STRING.MID("audio_core_int_i2s5_6_ibit_clk", &clk_itr_length-&clk_input_length+1, &clk_input_length-1)==STRING.CUT("&clk", 1))
    ( 
      &match=1
    )
  )
  else if (&wild_tail==1)
  (
    if (STRING.MID("audio_core_int_i2s5_6_ibit_clk", 0, &clk_input_length-1)==STRING.CUT("&clk", -1))
    ( 
      &match=1
    )
  )
  else if ("audio_core_int_i2s5_6_ibit_clk"=="&clk")
  (
    &match=1
  )
  
  if (&match==1)
  (
    &clk_test=&CLK_TEST_AUDIO_CORE_INT_I2S5_6_IBIT_CLK
    &clk_reg=&HWIO_LPASS_AUDIO_CORE_INT_I2S5_6_IBIT_CBCR_ADDR
    &clk_reg_name="LPASS_AUDIO_CORE_INT_I2S5_6_IBIT_CBCR"
    &clk_name="audio_core_int_i2s5_6_ibit_clk"
    &clk_reg_cbcr_type="sm_cbc"
    &clk_vote_bit=-1.
    &clk_multiplier=4.
    &clk_access_mode="&LPASS_access_mode"

    gosub Print_Clk_Info_Line
  )

  &match=0
  &wild_head=0
  &wild_tail=0
  &clk_input_length=STRING.LENGTH("&clk")
  &clk_itr_length=STRING.LENGTH("audio_core_int_mclk0_clk")

  if (STRING.SCAN("&clk", "*", 0)==0)
  (
    &wild_head=1
  )
  if (STRING.SCAN("&clk", "*", 1)==(STRING.LENGTH("&clk")-1))
  (
    &wild_tail=1
  )

  if ((&wild_head==1)&&(&wild_tail==1))
  (
    if (STRING.SCAN("audio_core_int_mclk0_clk", STRING.MID("&clk", 1, &clk_input_length-2), 0)!=-1)
    ( 
      &match=1
    )
  )
  else if (&wild_head==1)
  (
    if (STRING.MID("audio_core_int_mclk0_clk", &clk_itr_length-&clk_input_length+1, &clk_input_length-1)==STRING.CUT("&clk", 1))
    ( 
      &match=1
    )
  )
  else if (&wild_tail==1)
  (
    if (STRING.MID("audio_core_int_mclk0_clk", 0, &clk_input_length-1)==STRING.CUT("&clk", -1))
    ( 
      &match=1
    )
  )
  else if ("audio_core_int_mclk0_clk"=="&clk")
  (
    &match=1
  )
  
  if (&match==1)
  (
    &clk_test=&CLK_TEST_AUDIO_CORE_INT_MCLK0_CLK
    &clk_reg=&HWIO_LPASS_AUDIO_CORE_INT_MCLK0_CBCR_ADDR
    &clk_reg_name="LPASS_AUDIO_CORE_INT_MCLK0_CBCR"
    &clk_name="audio_core_int_mclk0_clk"
    &clk_reg_cbcr_type="sm_cbc"
    &clk_vote_bit=-1.
    &clk_multiplier=4.
    &clk_access_mode="&LPASS_access_mode"

    gosub Print_Clk_Info_Line
  )

  &match=0
  &wild_head=0
  &wild_tail=0
  &clk_input_length=STRING.LENGTH("&clk")
  &clk_itr_length=STRING.LENGTH("audio_core_int_mclk1_clk")

  if (STRING.SCAN("&clk", "*", 0)==0)
  (
    &wild_head=1
  )
  if (STRING.SCAN("&clk", "*", 1)==(STRING.LENGTH("&clk")-1))
  (
    &wild_tail=1
  )

  if ((&wild_head==1)&&(&wild_tail==1))
  (
    if (STRING.SCAN("audio_core_int_mclk1_clk", STRING.MID("&clk", 1, &clk_input_length-2), 0)!=-1)
    ( 
      &match=1
    )
  )
  else if (&wild_head==1)
  (
    if (STRING.MID("audio_core_int_mclk1_clk", &clk_itr_length-&clk_input_length+1, &clk_input_length-1)==STRING.CUT("&clk", 1))
    ( 
      &match=1
    )
  )
  else if (&wild_tail==1)
  (
    if (STRING.MID("audio_core_int_mclk1_clk", 0, &clk_input_length-1)==STRING.CUT("&clk", -1))
    ( 
      &match=1
    )
  )
  else if ("audio_core_int_mclk1_clk"=="&clk")
  (
    &match=1
  )
  
  if (&match==1)
  (
    &clk_test=&CLK_TEST_AUDIO_CORE_INT_MCLK1_CLK
    &clk_reg=&HWIO_LPASS_AUDIO_CORE_INT_MCLK1_CBCR_ADDR
    &clk_reg_name="LPASS_AUDIO_CORE_INT_MCLK1_CBCR"
    &clk_name="audio_core_int_mclk1_clk"
    &clk_reg_cbcr_type="sm_cbc"
    &clk_vote_bit=-1.
    &clk_multiplier=4.
    &clk_access_mode="&LPASS_access_mode"

    gosub Print_Clk_Info_Line
  )

  &match=0
  &wild_head=0
  &wild_tail=0
  &clk_input_length=STRING.LENGTH("&clk")
  &clk_itr_length=STRING.LENGTH("lpaif_pcmoe_clk_src")

  if (STRING.SCAN("&clk", "*", 0)==0)
  (
    &wild_head=1
  )
  if (STRING.SCAN("&clk", "*", 1)==(STRING.LENGTH("&clk")-1))
  (
    &wild_tail=1
  )

  if ((&wild_head==1)&&(&wild_tail==1))
  (
    if (STRING.SCAN("lpaif_pcmoe_clk_src", STRING.MID("&clk", 1, &clk_input_length-2), 0)!=-1)
    ( 
      &match=1
    )
  )
  else if (&wild_head==1)
  (
    if (STRING.MID("lpaif_pcmoe_clk_src", &clk_itr_length-&clk_input_length+1, &clk_input_length-1)==STRING.CUT("&clk", 1))
    ( 
      &match=1
    )
  )
  else if (&wild_tail==1)
  (
    if (STRING.MID("lpaif_pcmoe_clk_src", 0, &clk_input_length-1)==STRING.CUT("&clk", -1))
    ( 
      &match=1
    )
  )
  else if ("lpaif_pcmoe_clk_src"=="&clk")
  (
    &match=1
  )
  
  if (&match==1)
  (
    &clk_test=&CLK_TEST_LPAIF_PCMOE_CLK_SRC
    &clk_reg=0
    &clk_reg_name="No CBCR"
    &clk_name="lpaif_pcmoe_clk_src"
    &clk_reg_cbcr_type=""
    &clk_vote_bit=-1.
    &clk_multiplier=4.
    &clk_access_mode="&LPASS_access_mode"

    gosub Print_Clk_Info_Line
  )

  &match=0
  &wild_head=0
  &wild_tail=0
  &clk_input_length=STRING.LENGTH("&clk")
  &clk_itr_length=STRING.LENGTH("audio_core_lpaif_pcm_data_oe_clk")

  if (STRING.SCAN("&clk", "*", 0)==0)
  (
    &wild_head=1
  )
  if (STRING.SCAN("&clk", "*", 1)==(STRING.LENGTH("&clk")-1))
  (
    &wild_tail=1
  )

  if ((&wild_head==1)&&(&wild_tail==1))
  (
    if (STRING.SCAN("audio_core_lpaif_pcm_data_oe_clk", STRING.MID("&clk", 1, &clk_input_length-2), 0)!=-1)
    ( 
      &match=1
    )
  )
  else if (&wild_head==1)
  (
    if (STRING.MID("audio_core_lpaif_pcm_data_oe_clk", &clk_itr_length-&clk_input_length+1, &clk_input_length-1)==STRING.CUT("&clk", 1))
    ( 
      &match=1
    )
  )
  else if (&wild_tail==1)
  (
    if (STRING.MID("audio_core_lpaif_pcm_data_oe_clk", 0, &clk_input_length-1)==STRING.CUT("&clk", -1))
    ( 
      &match=1
    )
  )
  else if ("audio_core_lpaif_pcm_data_oe_clk"=="&clk")
  (
    &match=1
  )
  
  if (&match==1)
  (
    &clk_test=&CLK_TEST_AUDIO_CORE_LPAIF_PCM_DATA_OE_CLK
    &clk_reg=&HWIO_LPASS_AUDIO_CORE_LPAIF_PCM_DATA_OE_CBCR_ADDR
    &clk_reg_name="LPASS_AUDIO_CORE_LPAIF_PCM_DATA_OE_CBCR"
    &clk_name="audio_core_lpaif_pcm_data_oe_clk"
    &clk_reg_cbcr_type="sm_cbc"
    &clk_vote_bit=-1.
    &clk_multiplier=4.
    &clk_access_mode="&LPASS_access_mode"

    gosub Print_Clk_Info_Line
  )

  &match=0
  &wild_head=0
  &wild_tail=0
  &clk_input_length=STRING.LENGTH("&clk")
  &clk_itr_length=STRING.LENGTH("lpaif_pri_clk_src")

  if (STRING.SCAN("&clk", "*", 0)==0)
  (
    &wild_head=1
  )
  if (STRING.SCAN("&clk", "*", 1)==(STRING.LENGTH("&clk")-1))
  (
    &wild_tail=1
  )

  if ((&wild_head==1)&&(&wild_tail==1))
  (
    if (STRING.SCAN("lpaif_pri_clk_src", STRING.MID("&clk", 1, &clk_input_length-2), 0)!=-1)
    ( 
      &match=1
    )
  )
  else if (&wild_head==1)
  (
    if (STRING.MID("lpaif_pri_clk_src", &clk_itr_length-&clk_input_length+1, &clk_input_length-1)==STRING.CUT("&clk", 1))
    ( 
      &match=1
    )
  )
  else if (&wild_tail==1)
  (
    if (STRING.MID("lpaif_pri_clk_src", 0, &clk_input_length-1)==STRING.CUT("&clk", -1))
    ( 
      &match=1
    )
  )
  else if ("lpaif_pri_clk_src"=="&clk")
  (
    &match=1
  )
  
  if (&match==1)
  (
    &clk_test=&CLK_TEST_LPAIF_PRI_CLK_SRC
    &clk_reg=0
    &clk_reg_name="No CBCR"
    &clk_name="lpaif_pri_clk_src"
    &clk_reg_cbcr_type=""
    &clk_vote_bit=-1.
    &clk_multiplier=4.
    &clk_access_mode="&LPASS_access_mode"

    gosub Print_Clk_Info_Line
  )

  &match=0
  &wild_head=0
  &wild_tail=0
  &clk_input_length=STRING.LENGTH("&clk")
  &clk_itr_length=STRING.LENGTH("audio_core_lpaif_pri_ibit_clk")

  if (STRING.SCAN("&clk", "*", 0)==0)
  (
    &wild_head=1
  )
  if (STRING.SCAN("&clk", "*", 1)==(STRING.LENGTH("&clk")-1))
  (
    &wild_tail=1
  )

  if ((&wild_head==1)&&(&wild_tail==1))
  (
    if (STRING.SCAN("audio_core_lpaif_pri_ibit_clk", STRING.MID("&clk", 1, &clk_input_length-2), 0)!=-1)
    ( 
      &match=1
    )
  )
  else if (&wild_head==1)
  (
    if (STRING.MID("audio_core_lpaif_pri_ibit_clk", &clk_itr_length-&clk_input_length+1, &clk_input_length-1)==STRING.CUT("&clk", 1))
    ( 
      &match=1
    )
  )
  else if (&wild_tail==1)
  (
    if (STRING.MID("audio_core_lpaif_pri_ibit_clk", 0, &clk_input_length-1)==STRING.CUT("&clk", -1))
    ( 
      &match=1
    )
  )
  else if ("audio_core_lpaif_pri_ibit_clk"=="&clk")
  (
    &match=1
  )
  
  if (&match==1)
  (
    &clk_test=&CLK_TEST_AUDIO_CORE_LPAIF_PRI_IBIT_CLK
    &clk_reg=&HWIO_LPASS_AUDIO_CORE_LPAIF_PRI_IBIT_CBCR_ADDR
    &clk_reg_name="LPASS_AUDIO_CORE_LPAIF_PRI_IBIT_CBCR"
    &clk_name="audio_core_lpaif_pri_ibit_clk"
    &clk_reg_cbcr_type="sm_cbc"
    &clk_vote_bit=-1.
    &clk_multiplier=4.
    &clk_access_mode="&LPASS_access_mode"

    gosub Print_Clk_Info_Line
  )

  &match=0
  &wild_head=0
  &wild_tail=0
  &clk_input_length=STRING.LENGTH("&clk")
  &clk_itr_length=STRING.LENGTH("lpaif_quad_clk_src")

  if (STRING.SCAN("&clk", "*", 0)==0)
  (
    &wild_head=1
  )
  if (STRING.SCAN("&clk", "*", 1)==(STRING.LENGTH("&clk")-1))
  (
    &wild_tail=1
  )

  if ((&wild_head==1)&&(&wild_tail==1))
  (
    if (STRING.SCAN("lpaif_quad_clk_src", STRING.MID("&clk", 1, &clk_input_length-2), 0)!=-1)
    ( 
      &match=1
    )
  )
  else if (&wild_head==1)
  (
    if (STRING.MID("lpaif_quad_clk_src", &clk_itr_length-&clk_input_length+1, &clk_input_length-1)==STRING.CUT("&clk", 1))
    ( 
      &match=1
    )
  )
  else if (&wild_tail==1)
  (
    if (STRING.MID("lpaif_quad_clk_src", 0, &clk_input_length-1)==STRING.CUT("&clk", -1))
    ( 
      &match=1
    )
  )
  else if ("lpaif_quad_clk_src"=="&clk")
  (
    &match=1
  )
  
  if (&match==1)
  (
    &clk_test=&CLK_TEST_LPAIF_QUAD_CLK_SRC
    &clk_reg=0
    &clk_reg_name="No CBCR"
    &clk_name="lpaif_quad_clk_src"
    &clk_reg_cbcr_type=""
    &clk_vote_bit=-1.
    &clk_multiplier=4.
    &clk_access_mode="&LPASS_access_mode"

    gosub Print_Clk_Info_Line
  )

  &match=0
  &wild_head=0
  &wild_tail=0
  &clk_input_length=STRING.LENGTH("&clk")
  &clk_itr_length=STRING.LENGTH("audio_core_lpaif_quad_ibit_clk")

  if (STRING.SCAN("&clk", "*", 0)==0)
  (
    &wild_head=1
  )
  if (STRING.SCAN("&clk", "*", 1)==(STRING.LENGTH("&clk")-1))
  (
    &wild_tail=1
  )

  if ((&wild_head==1)&&(&wild_tail==1))
  (
    if (STRING.SCAN("audio_core_lpaif_quad_ibit_clk", STRING.MID("&clk", 1, &clk_input_length-2), 0)!=-1)
    ( 
      &match=1
    )
  )
  else if (&wild_head==1)
  (
    if (STRING.MID("audio_core_lpaif_quad_ibit_clk", &clk_itr_length-&clk_input_length+1, &clk_input_length-1)==STRING.CUT("&clk", 1))
    ( 
      &match=1
    )
  )
  else if (&wild_tail==1)
  (
    if (STRING.MID("audio_core_lpaif_quad_ibit_clk", 0, &clk_input_length-1)==STRING.CUT("&clk", -1))
    ( 
      &match=1
    )
  )
  else if ("audio_core_lpaif_quad_ibit_clk"=="&clk")
  (
    &match=1
  )
  
  if (&match==1)
  (
    &clk_test=&CLK_TEST_AUDIO_CORE_LPAIF_QUAD_IBIT_CLK
    &clk_reg=&HWIO_LPASS_AUDIO_CORE_LPAIF_QUAD_IBIT_CBCR_ADDR
    &clk_reg_name="LPASS_AUDIO_CORE_LPAIF_QUAD_IBIT_CBCR"
    &clk_name="audio_core_lpaif_quad_ibit_clk"
    &clk_reg_cbcr_type="sm_cbc"
    &clk_vote_bit=-1.
    &clk_multiplier=4.
    &clk_access_mode="&LPASS_access_mode"

    gosub Print_Clk_Info_Line
  )

  &match=0
  &wild_head=0
  &wild_tail=0
  &clk_input_length=STRING.LENGTH("&clk")
  &clk_itr_length=STRING.LENGTH("lpaif_sec_clk_src")

  if (STRING.SCAN("&clk", "*", 0)==0)
  (
    &wild_head=1
  )
  if (STRING.SCAN("&clk", "*", 1)==(STRING.LENGTH("&clk")-1))
  (
    &wild_tail=1
  )

  if ((&wild_head==1)&&(&wild_tail==1))
  (
    if (STRING.SCAN("lpaif_sec_clk_src", STRING.MID("&clk", 1, &clk_input_length-2), 0)!=-1)
    ( 
      &match=1
    )
  )
  else if (&wild_head==1)
  (
    if (STRING.MID("lpaif_sec_clk_src", &clk_itr_length-&clk_input_length+1, &clk_input_length-1)==STRING.CUT("&clk", 1))
    ( 
      &match=1
    )
  )
  else if (&wild_tail==1)
  (
    if (STRING.MID("lpaif_sec_clk_src", 0, &clk_input_length-1)==STRING.CUT("&clk", -1))
    ( 
      &match=1
    )
  )
  else if ("lpaif_sec_clk_src"=="&clk")
  (
    &match=1
  )
  
  if (&match==1)
  (
    &clk_test=&CLK_TEST_LPAIF_SEC_CLK_SRC
    &clk_reg=0
    &clk_reg_name="No CBCR"
    &clk_name="lpaif_sec_clk_src"
    &clk_reg_cbcr_type=""
    &clk_vote_bit=-1.
    &clk_multiplier=4.
    &clk_access_mode="&LPASS_access_mode"

    gosub Print_Clk_Info_Line
  )

  &match=0
  &wild_head=0
  &wild_tail=0
  &clk_input_length=STRING.LENGTH("&clk")
  &clk_itr_length=STRING.LENGTH("audio_core_lpaif_sec_ibit_clk")

  if (STRING.SCAN("&clk", "*", 0)==0)
  (
    &wild_head=1
  )
  if (STRING.SCAN("&clk", "*", 1)==(STRING.LENGTH("&clk")-1))
  (
    &wild_tail=1
  )

  if ((&wild_head==1)&&(&wild_tail==1))
  (
    if (STRING.SCAN("audio_core_lpaif_sec_ibit_clk", STRING.MID("&clk", 1, &clk_input_length-2), 0)!=-1)
    ( 
      &match=1
    )
  )
  else if (&wild_head==1)
  (
    if (STRING.MID("audio_core_lpaif_sec_ibit_clk", &clk_itr_length-&clk_input_length+1, &clk_input_length-1)==STRING.CUT("&clk", 1))
    ( 
      &match=1
    )
  )
  else if (&wild_tail==1)
  (
    if (STRING.MID("audio_core_lpaif_sec_ibit_clk", 0, &clk_input_length-1)==STRING.CUT("&clk", -1))
    ( 
      &match=1
    )
  )
  else if ("audio_core_lpaif_sec_ibit_clk"=="&clk")
  (
    &match=1
  )
  
  if (&match==1)
  (
    &clk_test=&CLK_TEST_AUDIO_CORE_LPAIF_SEC_IBIT_CLK
    &clk_reg=&HWIO_LPASS_AUDIO_CORE_LPAIF_SEC_IBIT_CBCR_ADDR
    &clk_reg_name="LPASS_AUDIO_CORE_LPAIF_SEC_IBIT_CBCR"
    &clk_name="audio_core_lpaif_sec_ibit_clk"
    &clk_reg_cbcr_type="sm_cbc"
    &clk_vote_bit=-1.
    &clk_multiplier=4.
    &clk_access_mode="&LPASS_access_mode"

    gosub Print_Clk_Info_Line
  )

  &match=0
  &wild_head=0
  &wild_tail=0
  &clk_input_length=STRING.LENGTH("&clk")
  &clk_itr_length=STRING.LENGTH("lpaif_ter_clk_src")

  if (STRING.SCAN("&clk", "*", 0)==0)
  (
    &wild_head=1
  )
  if (STRING.SCAN("&clk", "*", 1)==(STRING.LENGTH("&clk")-1))
  (
    &wild_tail=1
  )

  if ((&wild_head==1)&&(&wild_tail==1))
  (
    if (STRING.SCAN("lpaif_ter_clk_src", STRING.MID("&clk", 1, &clk_input_length-2), 0)!=-1)
    ( 
      &match=1
    )
  )
  else if (&wild_head==1)
  (
    if (STRING.MID("lpaif_ter_clk_src", &clk_itr_length-&clk_input_length+1, &clk_input_length-1)==STRING.CUT("&clk", 1))
    ( 
      &match=1
    )
  )
  else if (&wild_tail==1)
  (
    if (STRING.MID("lpaif_ter_clk_src", 0, &clk_input_length-1)==STRING.CUT("&clk", -1))
    ( 
      &match=1
    )
  )
  else if ("lpaif_ter_clk_src"=="&clk")
  (
    &match=1
  )
  
  if (&match==1)
  (
    &clk_test=&CLK_TEST_LPAIF_TER_CLK_SRC
    &clk_reg=0
    &clk_reg_name="No CBCR"
    &clk_name="lpaif_ter_clk_src"
    &clk_reg_cbcr_type=""
    &clk_vote_bit=-1.
    &clk_multiplier=4.
    &clk_access_mode="&LPASS_access_mode"

    gosub Print_Clk_Info_Line
  )

  &match=0
  &wild_head=0
  &wild_tail=0
  &clk_input_length=STRING.LENGTH("&clk")
  &clk_itr_length=STRING.LENGTH("audio_core_lpaif_ter_ibit_clk")

  if (STRING.SCAN("&clk", "*", 0)==0)
  (
    &wild_head=1
  )
  if (STRING.SCAN("&clk", "*", 1)==(STRING.LENGTH("&clk")-1))
  (
    &wild_tail=1
  )

  if ((&wild_head==1)&&(&wild_tail==1))
  (
    if (STRING.SCAN("audio_core_lpaif_ter_ibit_clk", STRING.MID("&clk", 1, &clk_input_length-2), 0)!=-1)
    ( 
      &match=1
    )
  )
  else if (&wild_head==1)
  (
    if (STRING.MID("audio_core_lpaif_ter_ibit_clk", &clk_itr_length-&clk_input_length+1, &clk_input_length-1)==STRING.CUT("&clk", 1))
    ( 
      &match=1
    )
  )
  else if (&wild_tail==1)
  (
    if (STRING.MID("audio_core_lpaif_ter_ibit_clk", 0, &clk_input_length-1)==STRING.CUT("&clk", -1))
    ( 
      &match=1
    )
  )
  else if ("audio_core_lpaif_ter_ibit_clk"=="&clk")
  (
    &match=1
  )
  
  if (&match==1)
  (
    &clk_test=&CLK_TEST_AUDIO_CORE_LPAIF_TER_IBIT_CLK
    &clk_reg=&HWIO_LPASS_AUDIO_CORE_LPAIF_TER_IBIT_CBCR_ADDR
    &clk_reg_name="LPASS_AUDIO_CORE_LPAIF_TER_IBIT_CBCR"
    &clk_name="audio_core_lpaif_ter_ibit_clk"
    &clk_reg_cbcr_type="sm_cbc"
    &clk_vote_bit=-1.
    &clk_multiplier=4.
    &clk_access_mode="&LPASS_access_mode"

    gosub Print_Clk_Info_Line
  )

  &match=0
  &wild_head=0
  &wild_tail=0
  &clk_input_length=STRING.LENGTH("&clk")
  &clk_itr_length=STRING.LENGTH("audio_core_lpaif_pri_ebit_clk")

  if (STRING.SCAN("&clk", "*", 0)==0)
  (
    &wild_head=1
  )
  if (STRING.SCAN("&clk", "*", 1)==(STRING.LENGTH("&clk")-1))
  (
    &wild_tail=1
  )

  if ((&wild_head==1)&&(&wild_tail==1))
  (
    if (STRING.SCAN("audio_core_lpaif_pri_ebit_clk", STRING.MID("&clk", 1, &clk_input_length-2), 0)!=-1)
    ( 
      &match=1
    )
  )
  else if (&wild_head==1)
  (
    if (STRING.MID("audio_core_lpaif_pri_ebit_clk", &clk_itr_length-&clk_input_length+1, &clk_input_length-1)==STRING.CUT("&clk", 1))
    ( 
      &match=1
    )
  )
  else if (&wild_tail==1)
  (
    if (STRING.MID("audio_core_lpaif_pri_ebit_clk", 0, &clk_input_length-1)==STRING.CUT("&clk", -1))
    ( 
      &match=1
    )
  )
  else if ("audio_core_lpaif_pri_ebit_clk"=="&clk")
  (
    &match=1
  )
  
  if (&match==1)
  (
    &clk_test=0
    &clk_reg=&HWIO_LPASS_AUDIO_CORE_LPAIF_PRI_EBIT_CBCR_ADDR
    &clk_reg_name="LPASS_AUDIO_CORE_LPAIF_PRI_EBIT_CBCR"
    &clk_name="audio_core_lpaif_pri_ebit_clk"
    &clk_reg_cbcr_type="sm_cbc"
    &clk_vote_bit=-1.
    &clk_multiplier=4.
    &clk_access_mode="&LPASS_access_mode"

    gosub Print_Clk_Info_Line
  )

  &match=0
  &wild_head=0
  &wild_tail=0
  &clk_input_length=STRING.LENGTH("&clk")
  &clk_itr_length=STRING.LENGTH("island_scc_q6_spm_clk")

  if (STRING.SCAN("&clk", "*", 0)==0)
  (
    &wild_head=1
  )
  if (STRING.SCAN("&clk", "*", 1)==(STRING.LENGTH("&clk")-1))
  (
    &wild_tail=1
  )

  if ((&wild_head==1)&&(&wild_tail==1))
  (
    if (STRING.SCAN("island_scc_q6_spm_clk", STRING.MID("&clk", 1, &clk_input_length-2), 0)!=-1)
    ( 
      &match=1
    )
  )
  else if (&wild_head==1)
  (
    if (STRING.MID("island_scc_q6_spm_clk", &clk_itr_length-&clk_input_length+1, &clk_input_length-1)==STRING.CUT("&clk", 1))
    ( 
      &match=1
    )
  )
  else if (&wild_tail==1)
  (
    if (STRING.MID("island_scc_q6_spm_clk", 0, &clk_input_length-1)==STRING.CUT("&clk", -1))
    ( 
      &match=1
    )
  )
  else if ("island_scc_q6_spm_clk"=="&clk")
  (
    &match=1
  )
  
  if (&match==1)
  (
    &clk_test=&CLK_TEST_ISLAND_SCC_Q6_SPM_CLK
    &clk_reg=&HWIO_LPASS_ISLAND_SCC_Q6_SPM_CBCR_ADDR
    &clk_reg_name="LPASS_ISLAND_SCC_Q6_SPM_CBCR"
    &clk_name="island_scc_q6_spm_clk"
    &clk_reg_cbcr_type="sm_cbc"
    &clk_vote_bit=-1.
    &clk_multiplier=4.
    &clk_access_mode="&LPASS_access_mode"

    gosub Print_Clk_Info_Line
  )

  &match=0
  &wild_head=0
  &wild_tail=0
  &clk_input_length=STRING.LENGTH("&clk")
  &clk_itr_length=STRING.LENGTH("island_scc_sensor_core_bcr_xo_clk")

  if (STRING.SCAN("&clk", "*", 0)==0)
  (
    &wild_head=1
  )
  if (STRING.SCAN("&clk", "*", 1)==(STRING.LENGTH("&clk")-1))
  (
    &wild_tail=1
  )

  if ((&wild_head==1)&&(&wild_tail==1))
  (
    if (STRING.SCAN("island_scc_sensor_core_bcr_xo_clk", STRING.MID("&clk", 1, &clk_input_length-2), 0)!=-1)
    ( 
      &match=1
    )
  )
  else if (&wild_head==1)
  (
    if (STRING.MID("island_scc_sensor_core_bcr_xo_clk", &clk_itr_length-&clk_input_length+1, &clk_input_length-1)==STRING.CUT("&clk", 1))
    ( 
      &match=1
    )
  )
  else if (&wild_tail==1)
  (
    if (STRING.MID("island_scc_sensor_core_bcr_xo_clk", 0, &clk_input_length-1)==STRING.CUT("&clk", -1))
    ( 
      &match=1
    )
  )
  else if ("island_scc_sensor_core_bcr_xo_clk"=="&clk")
  (
    &match=1
  )
  
  if (&match==1)
  (
    &clk_test=&CLK_TEST_ISLAND_SCC_SENSOR_CORE_BCR_XO_CLK
    &clk_reg=&HWIO_LPASS_ISLAND_SCC_SENSOR_CORE_BCR_XO_CBCR_ADDR
    &clk_reg_name="LPASS_ISLAND_SCC_SENSOR_CORE_BCR_XO_CBCR"
    &clk_name="island_scc_sensor_core_bcr_xo_clk"
    &clk_reg_cbcr_type="sm_cbc"
    &clk_vote_bit=-1.
    &clk_multiplier=4.
    &clk_access_mode="&LPASS_access_mode"

    gosub Print_Clk_Info_Line
  )

  &match=0
  &wild_head=0
  &wild_tail=0
  &clk_input_length=STRING.LENGTH("&clk")
  &clk_itr_length=STRING.LENGTH("qca_slimbus_clk_src")

  if (STRING.SCAN("&clk", "*", 0)==0)
  (
    &wild_head=1
  )
  if (STRING.SCAN("&clk", "*", 1)==(STRING.LENGTH("&clk")-1))
  (
    &wild_tail=1
  )

  if ((&wild_head==1)&&(&wild_tail==1))
  (
    if (STRING.SCAN("qca_slimbus_clk_src", STRING.MID("&clk", 1, &clk_input_length-2), 0)!=-1)
    ( 
      &match=1
    )
  )
  else if (&wild_head==1)
  (
    if (STRING.MID("qca_slimbus_clk_src", &clk_itr_length-&clk_input_length+1, &clk_input_length-1)==STRING.CUT("&clk", 1))
    ( 
      &match=1
    )
  )
  else if (&wild_tail==1)
  (
    if (STRING.MID("qca_slimbus_clk_src", 0, &clk_input_length-1)==STRING.CUT("&clk", -1))
    ( 
      &match=1
    )
  )
  else if ("qca_slimbus_clk_src"=="&clk")
  (
    &match=1
  )
  
  if (&match==1)
  (
    &clk_test=&CLK_TEST_QCA_SLIMBUS_CLK_SRC
    &clk_reg=0
    &clk_reg_name="No CBCR"
    &clk_name="qca_slimbus_clk_src"
    &clk_reg_cbcr_type=""
    &clk_vote_bit=-1.
    &clk_multiplier=4.
    &clk_access_mode="&LPASS_access_mode"

    gosub Print_Clk_Info_Line
  )

  &match=0
  &wild_head=0
  &wild_tail=0
  &clk_input_length=STRING.LENGTH("&clk")
  &clk_itr_length=STRING.LENGTH("audio_core_qca_slimbus_clk")

  if (STRING.SCAN("&clk", "*", 0)==0)
  (
    &wild_head=1
  )
  if (STRING.SCAN("&clk", "*", 1)==(STRING.LENGTH("&clk")-1))
  (
    &wild_tail=1
  )

  if ((&wild_head==1)&&(&wild_tail==1))
  (
    if (STRING.SCAN("audio_core_qca_slimbus_clk", STRING.MID("&clk", 1, &clk_input_length-2), 0)!=-1)
    ( 
      &match=1
    )
  )
  else if (&wild_head==1)
  (
    if (STRING.MID("audio_core_qca_slimbus_clk", &clk_itr_length-&clk_input_length+1, &clk_input_length-1)==STRING.CUT("&clk", 1))
    ( 
      &match=1
    )
  )
  else if (&wild_tail==1)
  (
    if (STRING.MID("audio_core_qca_slimbus_clk", 0, &clk_input_length-1)==STRING.CUT("&clk", -1))
    ( 
      &match=1
    )
  )
  else if ("audio_core_qca_slimbus_clk"=="&clk")
  (
    &match=1
  )
  
  if (&match==1)
  (
    &clk_test=&CLK_TEST_AUDIO_CORE_QCA_SLIMBUS_CLK
    &clk_reg=&HWIO_LPASS_AUDIO_CORE_QCA_SLIMBUS_CBCR_ADDR
    &clk_reg_name="LPASS_AUDIO_CORE_QCA_SLIMBUS_CBCR"
    &clk_name="audio_core_qca_slimbus_clk"
    &clk_reg_cbcr_type="sm_cbc"
    &clk_vote_bit=-1.
    &clk_multiplier=4.
    &clk_access_mode="&LPASS_access_mode"

    gosub Print_Clk_Info_Line
  )

  &match=0
  &wild_head=0
  &wild_tail=0
  &clk_input_length=STRING.LENGTH("&clk")
  &clk_itr_length=STRING.LENGTH("qos_fixed_lat_counter_clk_src")

  if (STRING.SCAN("&clk", "*", 0)==0)
  (
    &wild_head=1
  )
  if (STRING.SCAN("&clk", "*", 1)==(STRING.LENGTH("&clk")-1))
  (
    &wild_tail=1
  )

  if ((&wild_head==1)&&(&wild_tail==1))
  (
    if (STRING.SCAN("qos_fixed_lat_counter_clk_src", STRING.MID("&clk", 1, &clk_input_length-2), 0)!=-1)
    ( 
      &match=1
    )
  )
  else if (&wild_head==1)
  (
    if (STRING.MID("qos_fixed_lat_counter_clk_src", &clk_itr_length-&clk_input_length+1, &clk_input_length-1)==STRING.CUT("&clk", 1))
    ( 
      &match=1
    )
  )
  else if (&wild_tail==1)
  (
    if (STRING.MID("qos_fixed_lat_counter_clk_src", 0, &clk_input_length-1)==STRING.CUT("&clk", -1))
    ( 
      &match=1
    )
  )
  else if ("qos_fixed_lat_counter_clk_src"=="&clk")
  (
    &match=1
  )
  
  if (&match==1)
  (
    &clk_test=&CLK_TEST_QOS_FIXED_LAT_COUNTER_CLK_SRC
    &clk_reg=0
    &clk_reg_name="No CBCR"
    &clk_name="qos_fixed_lat_counter_clk_src"
    &clk_reg_cbcr_type=""
    &clk_vote_bit=-1.
    &clk_multiplier=4.
    &clk_access_mode="&LPASS_access_mode"

    gosub Print_Clk_Info_Line
  )

  &match=0
  &wild_head=0
  &wild_tail=0
  &clk_input_length=STRING.LENGTH("&clk")
  &clk_itr_length=STRING.LENGTH("audio_core_qos_dmonitor_fixed_lat_counter_clk")

  if (STRING.SCAN("&clk", "*", 0)==0)
  (
    &wild_head=1
  )
  if (STRING.SCAN("&clk", "*", 1)==(STRING.LENGTH("&clk")-1))
  (
    &wild_tail=1
  )

  if ((&wild_head==1)&&(&wild_tail==1))
  (
    if (STRING.SCAN("audio_core_qos_dmonitor_fixed_lat_counter_clk", STRING.MID("&clk", 1, &clk_input_length-2), 0)!=-1)
    ( 
      &match=1
    )
  )
  else if (&wild_head==1)
  (
    if (STRING.MID("audio_core_qos_dmonitor_fixed_lat_counter_clk", &clk_itr_length-&clk_input_length+1, &clk_input_length-1)==STRING.CUT("&clk", 1))
    ( 
      &match=1
    )
  )
  else if (&wild_tail==1)
  (
    if (STRING.MID("audio_core_qos_dmonitor_fixed_lat_counter_clk", 0, &clk_input_length-1)==STRING.CUT("&clk", -1))
    ( 
      &match=1
    )
  )
  else if ("audio_core_qos_dmonitor_fixed_lat_counter_clk"=="&clk")
  (
    &match=1
  )
  
  if (&match==1)
  (
    &clk_test=&CLK_TEST_AUDIO_CORE_QOS_DMONITOR_FIXED_LAT_COUNTER_CLK
    &clk_reg=&MACRO_TOO_LONG_1
    &clk_reg_name="LPASS_AUDIO_CORE_QOS_DMONITOR_FIXED_LAT_COUNTER_CBCR"
    &clk_name="audio_core_qos_dmonitor_fixed_lat_counter_clk"
    &clk_reg_cbcr_type="sm_cbc"
    &clk_vote_bit=-1.
    &clk_multiplier=4.
    &clk_access_mode="&LPASS_access_mode"

    gosub Print_Clk_Info_Line
  )

  &match=0
  &wild_head=0
  &wild_tail=0
  &clk_input_length=STRING.LENGTH("&clk")
  &clk_itr_length=STRING.LENGTH("audio_wrapper_qos_danger_fixed_lat_counter_clk")

  if (STRING.SCAN("&clk", "*", 0)==0)
  (
    &wild_head=1
  )
  if (STRING.SCAN("&clk", "*", 1)==(STRING.LENGTH("&clk")-1))
  (
    &wild_tail=1
  )

  if ((&wild_head==1)&&(&wild_tail==1))
  (
    if (STRING.SCAN("audio_wrapper_qos_danger_fixed_lat_counter_clk", STRING.MID("&clk", 1, &clk_input_length-2), 0)!=-1)
    ( 
      &match=1
    )
  )
  else if (&wild_head==1)
  (
    if (STRING.MID("audio_wrapper_qos_danger_fixed_lat_counter_clk", &clk_itr_length-&clk_input_length+1, &clk_input_length-1)==STRING.CUT("&clk", 1))
    ( 
      &match=1
    )
  )
  else if (&wild_tail==1)
  (
    if (STRING.MID("audio_wrapper_qos_danger_fixed_lat_counter_clk", 0, &clk_input_length-1)==STRING.CUT("&clk", -1))
    ( 
      &match=1
    )
  )
  else if ("audio_wrapper_qos_danger_fixed_lat_counter_clk"=="&clk")
  (
    &match=1
  )
  
  if (&match==1)
  (
    &clk_test=&CLK_TEST_AUDIO_WRAPPER_QOS_DANGER_FIXED_LAT_COUNTER_CLK
    &clk_reg=&MACRO_TOO_LONG_2
    &clk_reg_name="LPASS_AUDIO_WRAPPER_QOS_DANGER_FIXED_LAT_COUNTER_CBCR"
    &clk_name="audio_wrapper_qos_danger_fixed_lat_counter_clk"
    &clk_reg_cbcr_type="sm_cbc"
    &clk_vote_bit=-1.
    &clk_multiplier=4.
    &clk_access_mode="&LPASS_access_mode"

    gosub Print_Clk_Info_Line
  )

  &match=0
  &wild_head=0
  &wild_tail=0
  &clk_input_length=STRING.LENGTH("&clk")
  &clk_itr_length=STRING.LENGTH("audio_wrapper_qos_dmonitor_fixed_lat_counter_clk")

  if (STRING.SCAN("&clk", "*", 0)==0)
  (
    &wild_head=1
  )
  if (STRING.SCAN("&clk", "*", 1)==(STRING.LENGTH("&clk")-1))
  (
    &wild_tail=1
  )

  if ((&wild_head==1)&&(&wild_tail==1))
  (
    if (STRING.SCAN("audio_wrapper_qos_dmonitor_fixed_lat_counter_clk", STRING.MID("&clk", 1, &clk_input_length-2), 0)!=-1)
    ( 
      &match=1
    )
  )
  else if (&wild_head==1)
  (
    if (STRING.MID("audio_wrapper_qos_dmonitor_fixed_lat_counter_clk", &clk_itr_length-&clk_input_length+1, &clk_input_length-1)==STRING.CUT("&clk", 1))
    ( 
      &match=1
    )
  )
  else if (&wild_tail==1)
  (
    if (STRING.MID("audio_wrapper_qos_dmonitor_fixed_lat_counter_clk", 0, &clk_input_length-1)==STRING.CUT("&clk", -1))
    ( 
      &match=1
    )
  )
  else if ("audio_wrapper_qos_dmonitor_fixed_lat_counter_clk"=="&clk")
  (
    &match=1
  )
  
  if (&match==1)
  (
    &clk_test=&CLK_TEST_AUDIO_WRAPPER_QOS_DMONITOR_FIXED_LAT_COUNTER_CLK
    &clk_reg=&MACRO_TOO_LONG_3
    &clk_reg_name="LPASS_AUDIO_WRAPPER_QOS_DMONITOR_FIXED_LAT_COUNTER_CBCR"
    &clk_name="audio_wrapper_qos_dmonitor_fixed_lat_counter_clk"
    &clk_reg_cbcr_type="sm_cbc"
    &clk_vote_bit=-1.
    &clk_multiplier=4.
    &clk_access_mode="&LPASS_access_mode"

    gosub Print_Clk_Info_Line
  )

  &match=0
  &wild_head=0
  &wild_tail=0
  &clk_input_length=STRING.LENGTH("&clk")
  &clk_itr_length=STRING.LENGTH("audio_core_lpaif_quad_ebit_clk")

  if (STRING.SCAN("&clk", "*", 0)==0)
  (
    &wild_head=1
  )
  if (STRING.SCAN("&clk", "*", 1)==(STRING.LENGTH("&clk")-1))
  (
    &wild_tail=1
  )

  if ((&wild_head==1)&&(&wild_tail==1))
  (
    if (STRING.SCAN("audio_core_lpaif_quad_ebit_clk", STRING.MID("&clk", 1, &clk_input_length-2), 0)!=-1)
    ( 
      &match=1
    )
  )
  else if (&wild_head==1)
  (
    if (STRING.MID("audio_core_lpaif_quad_ebit_clk", &clk_itr_length-&clk_input_length+1, &clk_input_length-1)==STRING.CUT("&clk", 1))
    ( 
      &match=1
    )
  )
  else if (&wild_tail==1)
  (
    if (STRING.MID("audio_core_lpaif_quad_ebit_clk", 0, &clk_input_length-1)==STRING.CUT("&clk", -1))
    ( 
      &match=1
    )
  )
  else if ("audio_core_lpaif_quad_ebit_clk"=="&clk")
  (
    &match=1
  )
  
  if (&match==1)
  (
    &clk_test=0
    &clk_reg=&HWIO_LPASS_AUDIO_CORE_LPAIF_QUAD_EBIT_CBCR_ADDR
    &clk_reg_name="LPASS_AUDIO_CORE_LPAIF_QUAD_EBIT_CBCR"
    &clk_name="audio_core_lpaif_quad_ebit_clk"
    &clk_reg_cbcr_type="sm_cbc"
    &clk_vote_bit=-1.
    &clk_multiplier=4.
    &clk_access_mode="&LPASS_access_mode"

    gosub Print_Clk_Info_Line
  )

  &match=0
  &wild_head=0
  &wild_tail=0
  &clk_input_length=STRING.LENGTH("&clk")
  &clk_itr_length=STRING.LENGTH("resampler_clk_src")

  if (STRING.SCAN("&clk", "*", 0)==0)
  (
    &wild_head=1
  )
  if (STRING.SCAN("&clk", "*", 1)==(STRING.LENGTH("&clk")-1))
  (
    &wild_tail=1
  )

  if ((&wild_head==1)&&(&wild_tail==1))
  (
    if (STRING.SCAN("resampler_clk_src", STRING.MID("&clk", 1, &clk_input_length-2), 0)!=-1)
    ( 
      &match=1
    )
  )
  else if (&wild_head==1)
  (
    if (STRING.MID("resampler_clk_src", &clk_itr_length-&clk_input_length+1, &clk_input_length-1)==STRING.CUT("&clk", 1))
    ( 
      &match=1
    )
  )
  else if (&wild_tail==1)
  (
    if (STRING.MID("resampler_clk_src", 0, &clk_input_length-1)==STRING.CUT("&clk", -1))
    ( 
      &match=1
    )
  )
  else if ("resampler_clk_src"=="&clk")
  (
    &match=1
  )
  
  if (&match==1)
  (
    &clk_test=&CLK_TEST_RESAMPLER_CLK_SRC
    &clk_reg=0
    &clk_reg_name="No CBCR"
    &clk_name="resampler_clk_src"
    &clk_reg_cbcr_type=""
    &clk_vote_bit=-1.
    &clk_multiplier=4.
    &clk_access_mode="&LPASS_access_mode"

    gosub Print_Clk_Info_Line
  )

  &match=0
  &wild_head=0
  &wild_tail=0
  &clk_input_length=STRING.LENGTH("&clk")
  &clk_itr_length=STRING.LENGTH("audio_core_resampler_clk")

  if (STRING.SCAN("&clk", "*", 0)==0)
  (
    &wild_head=1
  )
  if (STRING.SCAN("&clk", "*", 1)==(STRING.LENGTH("&clk")-1))
  (
    &wild_tail=1
  )

  if ((&wild_head==1)&&(&wild_tail==1))
  (
    if (STRING.SCAN("audio_core_resampler_clk", STRING.MID("&clk", 1, &clk_input_length-2), 0)!=-1)
    ( 
      &match=1
    )
  )
  else if (&wild_head==1)
  (
    if (STRING.MID("audio_core_resampler_clk", &clk_itr_length-&clk_input_length+1, &clk_input_length-1)==STRING.CUT("&clk", 1))
    ( 
      &match=1
    )
  )
  else if (&wild_tail==1)
  (
    if (STRING.MID("audio_core_resampler_clk", 0, &clk_input_length-1)==STRING.CUT("&clk", -1))
    ( 
      &match=1
    )
  )
  else if ("audio_core_resampler_clk"=="&clk")
  (
    &match=1
  )
  
  if (&match==1)
  (
    &clk_test=&CLK_TEST_AUDIO_CORE_RESAMPLER_CLK
    &clk_reg=&HWIO_LPASS_AUDIO_CORE_RESAMPLER_CBCR_ADDR
    &clk_reg_name="LPASS_AUDIO_CORE_RESAMPLER_CBCR"
    &clk_name="audio_core_resampler_clk"
    &clk_reg_cbcr_type="sm_pscbc"
    &clk_vote_bit=-1.
    &clk_multiplier=4.
    &clk_access_mode="&LPASS_access_mode"

    gosub Print_Clk_Info_Line
  )

  &match=0
  &wild_head=0
  &wild_tail=0
  &clk_input_length=STRING.LENGTH("&clk")
  &clk_itr_length=STRING.LENGTH("island_scc_qup_i2c1_clk")

  if (STRING.SCAN("&clk", "*", 0)==0)
  (
    &wild_head=1
  )
  if (STRING.SCAN("&clk", "*", 1)==(STRING.LENGTH("&clk")-1))
  (
    &wild_tail=1
  )

  if ((&wild_head==1)&&(&wild_tail==1))
  (
    if (STRING.SCAN("island_scc_qup_i2c1_clk", STRING.MID("&clk", 1, &clk_input_length-2), 0)!=-1)
    ( 
      &match=1
    )
  )
  else if (&wild_head==1)
  (
    if (STRING.MID("island_scc_qup_i2c1_clk", &clk_itr_length-&clk_input_length+1, &clk_input_length-1)==STRING.CUT("&clk", 1))
    ( 
      &match=1
    )
  )
  else if (&wild_tail==1)
  (
    if (STRING.MID("island_scc_qup_i2c1_clk", 0, &clk_input_length-1)==STRING.CUT("&clk", -1))
    ( 
      &match=1
    )
  )
  else if ("island_scc_qup_i2c1_clk"=="&clk")
  (
    &match=1
  )
  
  if (&match==1)
  (
    &clk_test=&CLK_TEST_ISLAND_SCC_QUP_I2C1_CLK
    &clk_reg=&HWIO_LPASS_ISLAND_SCC_QUP_I2C1_CBCR_ADDR
    &clk_reg_name="LPASS_ISLAND_SCC_QUP_I2C1_CBCR"
    &clk_name="island_scc_qup_i2c1_clk"
    &clk_reg_cbcr_type="sm_cbc"
    &clk_vote_bit=-1.
    &clk_multiplier=4.
    &clk_access_mode="&LPASS_access_mode"

    gosub Print_Clk_Info_Line
  )

  &match=0
  &wild_head=0
  &wild_tail=0
  &clk_input_length=STRING.LENGTH("&clk")
  &clk_itr_length=STRING.LENGTH("island_scc_qup_i2c2_clk")

  if (STRING.SCAN("&clk", "*", 0)==0)
  (
    &wild_head=1
  )
  if (STRING.SCAN("&clk", "*", 1)==(STRING.LENGTH("&clk")-1))
  (
    &wild_tail=1
  )

  if ((&wild_head==1)&&(&wild_tail==1))
  (
    if (STRING.SCAN("island_scc_qup_i2c2_clk", STRING.MID("&clk", 1, &clk_input_length-2), 0)!=-1)
    ( 
      &match=1
    )
  )
  else if (&wild_head==1)
  (
    if (STRING.MID("island_scc_qup_i2c2_clk", &clk_itr_length-&clk_input_length+1, &clk_input_length-1)==STRING.CUT("&clk", 1))
    ( 
      &match=1
    )
  )
  else if (&wild_tail==1)
  (
    if (STRING.MID("island_scc_qup_i2c2_clk", 0, &clk_input_length-1)==STRING.CUT("&clk", -1))
    ( 
      &match=1
    )
  )
  else if ("island_scc_qup_i2c2_clk"=="&clk")
  (
    &match=1
  )
  
  if (&match==1)
  (
    &clk_test=&CLK_TEST_ISLAND_SCC_QUP_I2C2_CLK
    &clk_reg=&HWIO_LPASS_ISLAND_SCC_QUP_I2C2_CBCR_ADDR
    &clk_reg_name="LPASS_ISLAND_SCC_QUP_I2C2_CBCR"
    &clk_name="island_scc_qup_i2c2_clk"
    &clk_reg_cbcr_type="sm_cbc"
    &clk_vote_bit=-1.
    &clk_multiplier=4.
    &clk_access_mode="&LPASS_access_mode"

    gosub Print_Clk_Info_Line
  )

  &match=0
  &wild_head=0
  &wild_tail=0
  &clk_input_length=STRING.LENGTH("&clk")
  &clk_itr_length=STRING.LENGTH("island_scc_qup_i2c3_clk")

  if (STRING.SCAN("&clk", "*", 0)==0)
  (
    &wild_head=1
  )
  if (STRING.SCAN("&clk", "*", 1)==(STRING.LENGTH("&clk")-1))
  (
    &wild_tail=1
  )

  if ((&wild_head==1)&&(&wild_tail==1))
  (
    if (STRING.SCAN("island_scc_qup_i2c3_clk", STRING.MID("&clk", 1, &clk_input_length-2), 0)!=-1)
    ( 
      &match=1
    )
  )
  else if (&wild_head==1)
  (
    if (STRING.MID("island_scc_qup_i2c3_clk", &clk_itr_length-&clk_input_length+1, &clk_input_length-1)==STRING.CUT("&clk", 1))
    ( 
      &match=1
    )
  )
  else if (&wild_tail==1)
  (
    if (STRING.MID("island_scc_qup_i2c3_clk", 0, &clk_input_length-1)==STRING.CUT("&clk", -1))
    ( 
      &match=1
    )
  )
  else if ("island_scc_qup_i2c3_clk"=="&clk")
  (
    &match=1
  )
  
  if (&match==1)
  (
    &clk_test=&CLK_TEST_ISLAND_SCC_QUP_I2C3_CLK
    &clk_reg=&HWIO_LPASS_ISLAND_SCC_QUP_I2C3_CBCR_ADDR
    &clk_reg_name="LPASS_ISLAND_SCC_QUP_I2C3_CBCR"
    &clk_name="island_scc_qup_i2c3_clk"
    &clk_reg_cbcr_type="sm_cbc"
    &clk_vote_bit=-1.
    &clk_multiplier=4.
    &clk_access_mode="&LPASS_access_mode"

    gosub Print_Clk_Info_Line
  )

  &match=0
  &wild_head=0
  &wild_tail=0
  &clk_input_length=STRING.LENGTH("&clk")
  &clk_itr_length=STRING.LENGTH("island_scc_qup_spi1_clk")

  if (STRING.SCAN("&clk", "*", 0)==0)
  (
    &wild_head=1
  )
  if (STRING.SCAN("&clk", "*", 1)==(STRING.LENGTH("&clk")-1))
  (
    &wild_tail=1
  )

  if ((&wild_head==1)&&(&wild_tail==1))
  (
    if (STRING.SCAN("island_scc_qup_spi1_clk", STRING.MID("&clk", 1, &clk_input_length-2), 0)!=-1)
    ( 
      &match=1
    )
  )
  else if (&wild_head==1)
  (
    if (STRING.MID("island_scc_qup_spi1_clk", &clk_itr_length-&clk_input_length+1, &clk_input_length-1)==STRING.CUT("&clk", 1))
    ( 
      &match=1
    )
  )
  else if (&wild_tail==1)
  (
    if (STRING.MID("island_scc_qup_spi1_clk", 0, &clk_input_length-1)==STRING.CUT("&clk", -1))
    ( 
      &match=1
    )
  )
  else if ("island_scc_qup_spi1_clk"=="&clk")
  (
    &match=1
  )
  
  if (&match==1)
  (
    &clk_test=&CLK_TEST_ISLAND_SCC_QUP_SPI1_CLK
    &clk_reg=&HWIO_LPASS_ISLAND_SCC_QUP_SPI1_CBCR_ADDR
    &clk_reg_name="LPASS_ISLAND_SCC_QUP_SPI1_CBCR"
    &clk_name="island_scc_qup_spi1_clk"
    &clk_reg_cbcr_type="sm_cbc"
    &clk_vote_bit=-1.
    &clk_multiplier=4.
    &clk_access_mode="&LPASS_access_mode"

    gosub Print_Clk_Info_Line
  )

  &match=0
  &wild_head=0
  &wild_tail=0
  &clk_input_length=STRING.LENGTH("&clk")
  &clk_itr_length=STRING.LENGTH("island_scc_qup_spi2_clk")

  if (STRING.SCAN("&clk", "*", 0)==0)
  (
    &wild_head=1
  )
  if (STRING.SCAN("&clk", "*", 1)==(STRING.LENGTH("&clk")-1))
  (
    &wild_tail=1
  )

  if ((&wild_head==1)&&(&wild_tail==1))
  (
    if (STRING.SCAN("island_scc_qup_spi2_clk", STRING.MID("&clk", 1, &clk_input_length-2), 0)!=-1)
    ( 
      &match=1
    )
  )
  else if (&wild_head==1)
  (
    if (STRING.MID("island_scc_qup_spi2_clk", &clk_itr_length-&clk_input_length+1, &clk_input_length-1)==STRING.CUT("&clk", 1))
    ( 
      &match=1
    )
  )
  else if (&wild_tail==1)
  (
    if (STRING.MID("island_scc_qup_spi2_clk", 0, &clk_input_length-1)==STRING.CUT("&clk", -1))
    ( 
      &match=1
    )
  )
  else if ("island_scc_qup_spi2_clk"=="&clk")
  (
    &match=1
  )
  
  if (&match==1)
  (
    &clk_test=&CLK_TEST_ISLAND_SCC_QUP_SPI2_CLK
    &clk_reg=&HWIO_LPASS_ISLAND_SCC_QUP_SPI2_CBCR_ADDR
    &clk_reg_name="LPASS_ISLAND_SCC_QUP_SPI2_CBCR"
    &clk_name="island_scc_qup_spi2_clk"
    &clk_reg_cbcr_type="sm_cbc"
    &clk_vote_bit=-1.
    &clk_multiplier=4.
    &clk_access_mode="&LPASS_access_mode"

    gosub Print_Clk_Info_Line
  )

  &match=0
  &wild_head=0
  &wild_tail=0
  &clk_input_length=STRING.LENGTH("&clk")
  &clk_itr_length=STRING.LENGTH("island_scc_qup_spi3_clk")

  if (STRING.SCAN("&clk", "*", 0)==0)
  (
    &wild_head=1
  )
  if (STRING.SCAN("&clk", "*", 1)==(STRING.LENGTH("&clk")-1))
  (
    &wild_tail=1
  )

  if ((&wild_head==1)&&(&wild_tail==1))
  (
    if (STRING.SCAN("island_scc_qup_spi3_clk", STRING.MID("&clk", 1, &clk_input_length-2), 0)!=-1)
    ( 
      &match=1
    )
  )
  else if (&wild_head==1)
  (
    if (STRING.MID("island_scc_qup_spi3_clk", &clk_itr_length-&clk_input_length+1, &clk_input_length-1)==STRING.CUT("&clk", 1))
    ( 
      &match=1
    )
  )
  else if (&wild_tail==1)
  (
    if (STRING.MID("island_scc_qup_spi3_clk", 0, &clk_input_length-1)==STRING.CUT("&clk", -1))
    ( 
      &match=1
    )
  )
  else if ("island_scc_qup_spi3_clk"=="&clk")
  (
    &match=1
  )
  
  if (&match==1)
  (
    &clk_test=&CLK_TEST_ISLAND_SCC_QUP_SPI3_CLK
    &clk_reg=&HWIO_LPASS_ISLAND_SCC_QUP_SPI3_CBCR_ADDR
    &clk_reg_name="LPASS_ISLAND_SCC_QUP_SPI3_CBCR"
    &clk_name="island_scc_qup_spi3_clk"
    &clk_reg_cbcr_type="sm_cbc"
    &clk_vote_bit=-1.
    &clk_multiplier=4.
    &clk_access_mode="&LPASS_access_mode"

    gosub Print_Clk_Info_Line
  )

  &match=0
  &wild_head=0
  &wild_tail=0
  &clk_input_length=STRING.LENGTH("&clk")
  &clk_itr_length=STRING.LENGTH("island_scc_at_clk")

  if (STRING.SCAN("&clk", "*", 0)==0)
  (
    &wild_head=1
  )
  if (STRING.SCAN("&clk", "*", 1)==(STRING.LENGTH("&clk")-1))
  (
    &wild_tail=1
  )

  if ((&wild_head==1)&&(&wild_tail==1))
  (
    if (STRING.SCAN("island_scc_at_clk", STRING.MID("&clk", 1, &clk_input_length-2), 0)!=-1)
    ( 
      &match=1
    )
  )
  else if (&wild_head==1)
  (
    if (STRING.MID("island_scc_at_clk", &clk_itr_length-&clk_input_length+1, &clk_input_length-1)==STRING.CUT("&clk", 1))
    ( 
      &match=1
    )
  )
  else if (&wild_tail==1)
  (
    if (STRING.MID("island_scc_at_clk", 0, &clk_input_length-1)==STRING.CUT("&clk", -1))
    ( 
      &match=1
    )
  )
  else if ("island_scc_at_clk"=="&clk")
  (
    &match=1
  )
  
  if (&match==1)
  (
    &clk_test=&CLK_TEST_ISLAND_SCC_AT_CLK
    &clk_reg=&HWIO_LPASS_ISLAND_SCC_AT_CBCR_ADDR
    &clk_reg_name="LPASS_ISLAND_SCC_AT_CBCR"
    &clk_name="island_scc_at_clk"
    &clk_reg_cbcr_type="sm_pscbc"
    &clk_vote_bit=-1.
    &clk_multiplier=4.
    &clk_access_mode="&LPASS_access_mode"

    gosub Print_Clk_Info_Line
  )

  &match=0
  &wild_head=0
  &wild_tail=0
  &clk_input_length=STRING.LENGTH("&clk")
  &clk_itr_length=STRING.LENGTH("island_scc_pclkdbg_clk")

  if (STRING.SCAN("&clk", "*", 0)==0)
  (
    &wild_head=1
  )
  if (STRING.SCAN("&clk", "*", 1)==(STRING.LENGTH("&clk")-1))
  (
    &wild_tail=1
  )

  if ((&wild_head==1)&&(&wild_tail==1))
  (
    if (STRING.SCAN("island_scc_pclkdbg_clk", STRING.MID("&clk", 1, &clk_input_length-2), 0)!=-1)
    ( 
      &match=1
    )
  )
  else if (&wild_head==1)
  (
    if (STRING.MID("island_scc_pclkdbg_clk", &clk_itr_length-&clk_input_length+1, &clk_input_length-1)==STRING.CUT("&clk", 1))
    ( 
      &match=1
    )
  )
  else if (&wild_tail==1)
  (
    if (STRING.MID("island_scc_pclkdbg_clk", 0, &clk_input_length-1)==STRING.CUT("&clk", -1))
    ( 
      &match=1
    )
  )
  else if ("island_scc_pclkdbg_clk"=="&clk")
  (
    &match=1
  )
  
  if (&match==1)
  (
    &clk_test=&CLK_TEST_ISLAND_SCC_PCLKDBG_CLK
    &clk_reg=&HWIO_LPASS_ISLAND_SCC_PCLKDBG_CBCR_ADDR
    &clk_reg_name="LPASS_ISLAND_SCC_PCLKDBG_CBCR"
    &clk_name="island_scc_pclkdbg_clk"
    &clk_reg_cbcr_type="sm_cbc"
    &clk_vote_bit=-1.
    &clk_multiplier=4.
    &clk_access_mode="&LPASS_access_mode"

    gosub Print_Clk_Info_Line
  )

  &match=0
  &wild_head=0
  &wild_tail=0
  &clk_input_length=STRING.LENGTH("&clk")
  &clk_itr_length=STRING.LENGTH("island_scc_q6_atbm_clk")

  if (STRING.SCAN("&clk", "*", 0)==0)
  (
    &wild_head=1
  )
  if (STRING.SCAN("&clk", "*", 1)==(STRING.LENGTH("&clk")-1))
  (
    &wild_tail=1
  )

  if ((&wild_head==1)&&(&wild_tail==1))
  (
    if (STRING.SCAN("island_scc_q6_atbm_clk", STRING.MID("&clk", 1, &clk_input_length-2), 0)!=-1)
    ( 
      &match=1
    )
  )
  else if (&wild_head==1)
  (
    if (STRING.MID("island_scc_q6_atbm_clk", &clk_itr_length-&clk_input_length+1, &clk_input_length-1)==STRING.CUT("&clk", 1))
    ( 
      &match=1
    )
  )
  else if (&wild_tail==1)
  (
    if (STRING.MID("island_scc_q6_atbm_clk", 0, &clk_input_length-1)==STRING.CUT("&clk", -1))
    ( 
      &match=1
    )
  )
  else if ("island_scc_q6_atbm_clk"=="&clk")
  (
    &match=1
  )
  
  if (&match==1)
  (
    &clk_test=&CLK_TEST_ISLAND_SCC_Q6_ATBM_CLK
    &clk_reg=&HWIO_LPASS_ISLAND_SCC_Q6_ATBM_CBCR_ADDR
    &clk_reg_name="LPASS_ISLAND_SCC_Q6_ATBM_CBCR"
    &clk_name="island_scc_q6_atbm_clk"
    &clk_reg_cbcr_type="sm_cbc"
    &clk_vote_bit=-1.
    &clk_multiplier=4.
    &clk_access_mode="&LPASS_access_mode"

    gosub Print_Clk_Info_Line
  )

  &match=0
  &wild_head=0
  &wild_tail=0
  &clk_input_length=STRING.LENGTH("&clk")
  &clk_itr_length=STRING.LENGTH("island_scc_dbg_tsctr_clk")

  if (STRING.SCAN("&clk", "*", 0)==0)
  (
    &wild_head=1
  )
  if (STRING.SCAN("&clk", "*", 1)==(STRING.LENGTH("&clk")-1))
  (
    &wild_tail=1
  )

  if ((&wild_head==1)&&(&wild_tail==1))
  (
    if (STRING.SCAN("island_scc_dbg_tsctr_clk", STRING.MID("&clk", 1, &clk_input_length-2), 0)!=-1)
    ( 
      &match=1
    )
  )
  else if (&wild_head==1)
  (
    if (STRING.MID("island_scc_dbg_tsctr_clk", &clk_itr_length-&clk_input_length+1, &clk_input_length-1)==STRING.CUT("&clk", 1))
    ( 
      &match=1
    )
  )
  else if (&wild_tail==1)
  (
    if (STRING.MID("island_scc_dbg_tsctr_clk", 0, &clk_input_length-1)==STRING.CUT("&clk", -1))
    ( 
      &match=1
    )
  )
  else if ("island_scc_dbg_tsctr_clk"=="&clk")
  (
    &match=1
  )
  
  if (&match==1)
  (
    &clk_test=&CLK_TEST_ISLAND_SCC_DBG_TSCTR_CLK
    &clk_reg=&HWIO_LPASS_ISLAND_SCC_DBG_TSCTR_CBCR_ADDR
    &clk_reg_name="LPASS_ISLAND_SCC_DBG_TSCTR_CBCR"
    &clk_name="island_scc_dbg_tsctr_clk"
    &clk_reg_cbcr_type="sm_cbc"
    &clk_vote_bit=-1.
    &clk_multiplier=4.
    &clk_access_mode="&LPASS_access_mode"

    gosub Print_Clk_Info_Line
  )

  &match=0
  &wild_head=0
  &wild_tail=0
  &clk_input_length=STRING.LENGTH("&clk")
  &clk_itr_length=STRING.LENGTH("scc_uart1_clk_src")

  if (STRING.SCAN("&clk", "*", 0)==0)
  (
    &wild_head=1
  )
  if (STRING.SCAN("&clk", "*", 1)==(STRING.LENGTH("&clk")-1))
  (
    &wild_tail=1
  )

  if ((&wild_head==1)&&(&wild_tail==1))
  (
    if (STRING.SCAN("scc_uart1_clk_src", STRING.MID("&clk", 1, &clk_input_length-2), 0)!=-1)
    ( 
      &match=1
    )
  )
  else if (&wild_head==1)
  (
    if (STRING.MID("scc_uart1_clk_src", &clk_itr_length-&clk_input_length+1, &clk_input_length-1)==STRING.CUT("&clk", 1))
    ( 
      &match=1
    )
  )
  else if (&wild_tail==1)
  (
    if (STRING.MID("scc_uart1_clk_src", 0, &clk_input_length-1)==STRING.CUT("&clk", -1))
    ( 
      &match=1
    )
  )
  else if ("scc_uart1_clk_src"=="&clk")
  (
    &match=1
  )
  
  if (&match==1)
  (
    &clk_test=&CLK_TEST_SCC_UART1_CLK_SRC
    &clk_reg=0
    &clk_reg_name="No CBCR"
    &clk_name="scc_uart1_clk_src"
    &clk_reg_cbcr_type=""
    &clk_vote_bit=-1.
    &clk_multiplier=4.
    &clk_access_mode="&LPASS_access_mode"

    gosub Print_Clk_Info_Line
  )

  &match=0
  &wild_head=0
  &wild_tail=0
  &clk_input_length=STRING.LENGTH("&clk")
  &clk_itr_length=STRING.LENGTH("island_scc_uart_dm_uart1_clk")

  if (STRING.SCAN("&clk", "*", 0)==0)
  (
    &wild_head=1
  )
  if (STRING.SCAN("&clk", "*", 1)==(STRING.LENGTH("&clk")-1))
  (
    &wild_tail=1
  )

  if ((&wild_head==1)&&(&wild_tail==1))
  (
    if (STRING.SCAN("island_scc_uart_dm_uart1_clk", STRING.MID("&clk", 1, &clk_input_length-2), 0)!=-1)
    ( 
      &match=1
    )
  )
  else if (&wild_head==1)
  (
    if (STRING.MID("island_scc_uart_dm_uart1_clk", &clk_itr_length-&clk_input_length+1, &clk_input_length-1)==STRING.CUT("&clk", 1))
    ( 
      &match=1
    )
  )
  else if (&wild_tail==1)
  (
    if (STRING.MID("island_scc_uart_dm_uart1_clk", 0, &clk_input_length-1)==STRING.CUT("&clk", -1))
    ( 
      &match=1
    )
  )
  else if ("island_scc_uart_dm_uart1_clk"=="&clk")
  (
    &match=1
  )
  
  if (&match==1)
  (
    &clk_test=&CLK_TEST_ISLAND_SCC_UART_DM_UART1_CLK
    &clk_reg=&HWIO_LPASS_ISLAND_SCC_UART_DM_UART1_CBCR_ADDR
    &clk_reg_name="LPASS_ISLAND_SCC_UART_DM_UART1_CBCR"
    &clk_name="island_scc_uart_dm_uart1_clk"
    &clk_reg_cbcr_type="sm_cbc"
    &clk_vote_bit=-1.
    &clk_multiplier=4.
    &clk_access_mode="&LPASS_access_mode"

    gosub Print_Clk_Info_Line
  )

  &match=0
  &wild_head=0
  &wild_tail=0
  &clk_input_length=STRING.LENGTH("&clk")
  &clk_itr_length=STRING.LENGTH("scc_uart2_clk_src")

  if (STRING.SCAN("&clk", "*", 0)==0)
  (
    &wild_head=1
  )
  if (STRING.SCAN("&clk", "*", 1)==(STRING.LENGTH("&clk")-1))
  (
    &wild_tail=1
  )

  if ((&wild_head==1)&&(&wild_tail==1))
  (
    if (STRING.SCAN("scc_uart2_clk_src", STRING.MID("&clk", 1, &clk_input_length-2), 0)!=-1)
    ( 
      &match=1
    )
  )
  else if (&wild_head==1)
  (
    if (STRING.MID("scc_uart2_clk_src", &clk_itr_length-&clk_input_length+1, &clk_input_length-1)==STRING.CUT("&clk", 1))
    ( 
      &match=1
    )
  )
  else if (&wild_tail==1)
  (
    if (STRING.MID("scc_uart2_clk_src", 0, &clk_input_length-1)==STRING.CUT("&clk", -1))
    ( 
      &match=1
    )
  )
  else if ("scc_uart2_clk_src"=="&clk")
  (
    &match=1
  )
  
  if (&match==1)
  (
    &clk_test=&CLK_TEST_SCC_UART2_CLK_SRC
    &clk_reg=0
    &clk_reg_name="No CBCR"
    &clk_name="scc_uart2_clk_src"
    &clk_reg_cbcr_type=""
    &clk_vote_bit=-1.
    &clk_multiplier=4.
    &clk_access_mode="&LPASS_access_mode"

    gosub Print_Clk_Info_Line
  )

  &match=0
  &wild_head=0
  &wild_tail=0
  &clk_input_length=STRING.LENGTH("&clk")
  &clk_itr_length=STRING.LENGTH("island_scc_uart_dm_uart2_clk")

  if (STRING.SCAN("&clk", "*", 0)==0)
  (
    &wild_head=1
  )
  if (STRING.SCAN("&clk", "*", 1)==(STRING.LENGTH("&clk")-1))
  (
    &wild_tail=1
  )

  if ((&wild_head==1)&&(&wild_tail==1))
  (
    if (STRING.SCAN("island_scc_uart_dm_uart2_clk", STRING.MID("&clk", 1, &clk_input_length-2), 0)!=-1)
    ( 
      &match=1
    )
  )
  else if (&wild_head==1)
  (
    if (STRING.MID("island_scc_uart_dm_uart2_clk", &clk_itr_length-&clk_input_length+1, &clk_input_length-1)==STRING.CUT("&clk", 1))
    ( 
      &match=1
    )
  )
  else if (&wild_tail==1)
  (
    if (STRING.MID("island_scc_uart_dm_uart2_clk", 0, &clk_input_length-1)==STRING.CUT("&clk", -1))
    ( 
      &match=1
    )
  )
  else if ("island_scc_uart_dm_uart2_clk"=="&clk")
  (
    &match=1
  )
  
  if (&match==1)
  (
    &clk_test=&CLK_TEST_ISLAND_SCC_UART_DM_UART2_CLK
    &clk_reg=&HWIO_LPASS_ISLAND_SCC_UART_DM_UART2_CBCR_ADDR
    &clk_reg_name="LPASS_ISLAND_SCC_UART_DM_UART2_CBCR"
    &clk_name="island_scc_uart_dm_uart2_clk"
    &clk_reg_cbcr_type="sm_cbc"
    &clk_vote_bit=-1.
    &clk_multiplier=4.
    &clk_access_mode="&LPASS_access_mode"

    gosub Print_Clk_Info_Line
  )

  &match=0
  &wild_head=0
  &wild_tail=0
  &clk_input_length=STRING.LENGTH("&clk")
  &clk_itr_length=STRING.LENGTH("scc_uart3_clk_src")

  if (STRING.SCAN("&clk", "*", 0)==0)
  (
    &wild_head=1
  )
  if (STRING.SCAN("&clk", "*", 1)==(STRING.LENGTH("&clk")-1))
  (
    &wild_tail=1
  )

  if ((&wild_head==1)&&(&wild_tail==1))
  (
    if (STRING.SCAN("scc_uart3_clk_src", STRING.MID("&clk", 1, &clk_input_length-2), 0)!=-1)
    ( 
      &match=1
    )
  )
  else if (&wild_head==1)
  (
    if (STRING.MID("scc_uart3_clk_src", &clk_itr_length-&clk_input_length+1, &clk_input_length-1)==STRING.CUT("&clk", 1))
    ( 
      &match=1
    )
  )
  else if (&wild_tail==1)
  (
    if (STRING.MID("scc_uart3_clk_src", 0, &clk_input_length-1)==STRING.CUT("&clk", -1))
    ( 
      &match=1
    )
  )
  else if ("scc_uart3_clk_src"=="&clk")
  (
    &match=1
  )
  
  if (&match==1)
  (
    &clk_test=&CLK_TEST_SCC_UART3_CLK_SRC
    &clk_reg=0
    &clk_reg_name="No CBCR"
    &clk_name="scc_uart3_clk_src"
    &clk_reg_cbcr_type=""
    &clk_vote_bit=-1.
    &clk_multiplier=4.
    &clk_access_mode="&LPASS_access_mode"

    gosub Print_Clk_Info_Line
  )

  &match=0
  &wild_head=0
  &wild_tail=0
  &clk_input_length=STRING.LENGTH("&clk")
  &clk_itr_length=STRING.LENGTH("island_scc_uart_dm_uart3_clk")

  if (STRING.SCAN("&clk", "*", 0)==0)
  (
    &wild_head=1
  )
  if (STRING.SCAN("&clk", "*", 1)==(STRING.LENGTH("&clk")-1))
  (
    &wild_tail=1
  )

  if ((&wild_head==1)&&(&wild_tail==1))
  (
    if (STRING.SCAN("island_scc_uart_dm_uart3_clk", STRING.MID("&clk", 1, &clk_input_length-2), 0)!=-1)
    ( 
      &match=1
    )
  )
  else if (&wild_head==1)
  (
    if (STRING.MID("island_scc_uart_dm_uart3_clk", &clk_itr_length-&clk_input_length+1, &clk_input_length-1)==STRING.CUT("&clk", 1))
    ( 
      &match=1
    )
  )
  else if (&wild_tail==1)
  (
    if (STRING.MID("island_scc_uart_dm_uart3_clk", 0, &clk_input_length-1)==STRING.CUT("&clk", -1))
    ( 
      &match=1
    )
  )
  else if ("island_scc_uart_dm_uart3_clk"=="&clk")
  (
    &match=1
  )
  
  if (&match==1)
  (
    &clk_test=&CLK_TEST_ISLAND_SCC_UART_DM_UART3_CLK
    &clk_reg=&HWIO_LPASS_ISLAND_SCC_UART_DM_UART3_CBCR_ADDR
    &clk_reg_name="LPASS_ISLAND_SCC_UART_DM_UART3_CBCR"
    &clk_name="island_scc_uart_dm_uart3_clk"
    &clk_reg_cbcr_type="sm_cbc"
    &clk_vote_bit=-1.
    &clk_multiplier=4.
    &clk_access_mode="&LPASS_access_mode"

    gosub Print_Clk_Info_Line
  )

  &match=0
  &wild_head=0
  &wild_tail=0
  &clk_input_length=STRING.LENGTH("&clk")
  &clk_itr_length=STRING.LENGTH("scc_uart4_clk_src")

  if (STRING.SCAN("&clk", "*", 0)==0)
  (
    &wild_head=1
  )
  if (STRING.SCAN("&clk", "*", 1)==(STRING.LENGTH("&clk")-1))
  (
    &wild_tail=1
  )

  if ((&wild_head==1)&&(&wild_tail==1))
  (
    if (STRING.SCAN("scc_uart4_clk_src", STRING.MID("&clk", 1, &clk_input_length-2), 0)!=-1)
    ( 
      &match=1
    )
  )
  else if (&wild_head==1)
  (
    if (STRING.MID("scc_uart4_clk_src", &clk_itr_length-&clk_input_length+1, &clk_input_length-1)==STRING.CUT("&clk", 1))
    ( 
      &match=1
    )
  )
  else if (&wild_tail==1)
  (
    if (STRING.MID("scc_uart4_clk_src", 0, &clk_input_length-1)==STRING.CUT("&clk", -1))
    ( 
      &match=1
    )
  )
  else if ("scc_uart4_clk_src"=="&clk")
  (
    &match=1
  )
  
  if (&match==1)
  (
    &clk_test=&CLK_TEST_SCC_UART4_CLK_SRC
    &clk_reg=0
    &clk_reg_name="No CBCR"
    &clk_name="scc_uart4_clk_src"
    &clk_reg_cbcr_type=""
    &clk_vote_bit=-1.
    &clk_multiplier=4.
    &clk_access_mode="&LPASS_access_mode"

    gosub Print_Clk_Info_Line
  )

  &match=0
  &wild_head=0
  &wild_tail=0
  &clk_input_length=STRING.LENGTH("&clk")
  &clk_itr_length=STRING.LENGTH("island_scc_uart_dm_uart4_clk")

  if (STRING.SCAN("&clk", "*", 0)==0)
  (
    &wild_head=1
  )
  if (STRING.SCAN("&clk", "*", 1)==(STRING.LENGTH("&clk")-1))
  (
    &wild_tail=1
  )

  if ((&wild_head==1)&&(&wild_tail==1))
  (
    if (STRING.SCAN("island_scc_uart_dm_uart4_clk", STRING.MID("&clk", 1, &clk_input_length-2), 0)!=-1)
    ( 
      &match=1
    )
  )
  else if (&wild_head==1)
  (
    if (STRING.MID("island_scc_uart_dm_uart4_clk", &clk_itr_length-&clk_input_length+1, &clk_input_length-1)==STRING.CUT("&clk", 1))
    ( 
      &match=1
    )
  )
  else if (&wild_tail==1)
  (
    if (STRING.MID("island_scc_uart_dm_uart4_clk", 0, &clk_input_length-1)==STRING.CUT("&clk", -1))
    ( 
      &match=1
    )
  )
  else if ("island_scc_uart_dm_uart4_clk"=="&clk")
  (
    &match=1
  )
  
  if (&match==1)
  (
    &clk_test=&CLK_TEST_ISLAND_SCC_UART_DM_UART4_CLK
    &clk_reg=&HWIO_LPASS_ISLAND_SCC_UART_DM_UART4_CBCR_ADDR
    &clk_reg_name="LPASS_ISLAND_SCC_UART_DM_UART4_CBCR"
    &clk_name="island_scc_uart_dm_uart4_clk"
    &clk_reg_cbcr_type="sm_cbc"
    &clk_vote_bit=-1.
    &clk_multiplier=4.
    &clk_access_mode="&LPASS_access_mode"

    gosub Print_Clk_Info_Line
  )

  &match=0
  &wild_head=0
  &wild_tail=0
  &clk_input_length=STRING.LENGTH("&clk")
  &clk_itr_length=STRING.LENGTH("island_scc_vs_vddcx_clk")

  if (STRING.SCAN("&clk", "*", 0)==0)
  (
    &wild_head=1
  )
  if (STRING.SCAN("&clk", "*", 1)==(STRING.LENGTH("&clk")-1))
  (
    &wild_tail=1
  )

  if ((&wild_head==1)&&(&wild_tail==1))
  (
    if (STRING.SCAN("island_scc_vs_vddcx_clk", STRING.MID("&clk", 1, &clk_input_length-2), 0)!=-1)
    ( 
      &match=1
    )
  )
  else if (&wild_head==1)
  (
    if (STRING.MID("island_scc_vs_vddcx_clk", &clk_itr_length-&clk_input_length+1, &clk_input_length-1)==STRING.CUT("&clk", 1))
    ( 
      &match=1
    )
  )
  else if (&wild_tail==1)
  (
    if (STRING.MID("island_scc_vs_vddcx_clk", 0, &clk_input_length-1)==STRING.CUT("&clk", -1))
    ( 
      &match=1
    )
  )
  else if ("island_scc_vs_vddcx_clk"=="&clk")
  (
    &match=1
  )
  
  if (&match==1)
  (
    &clk_test=&CLK_TEST_ISLAND_SCC_VS_VDDCX_CLK
    &clk_reg=&HWIO_LPASS_ISLAND_SCC_VS_VDDCX_CBCR_ADDR
    &clk_reg_name="LPASS_ISLAND_SCC_VS_VDDCX_CBCR"
    &clk_name="island_scc_vs_vddcx_clk"
    &clk_reg_cbcr_type="sm_cbc"
    &clk_vote_bit=-1.
    &clk_multiplier=4.
    &clk_access_mode="&LPASS_access_mode"

    gosub Print_Clk_Info_Line
  )

  &match=0
  &wild_head=0
  &wild_tail=0
  &clk_input_length=STRING.LENGTH("&clk")
  &clk_itr_length=STRING.LENGTH("island_scc_vs_vddmx_clk")

  if (STRING.SCAN("&clk", "*", 0)==0)
  (
    &wild_head=1
  )
  if (STRING.SCAN("&clk", "*", 1)==(STRING.LENGTH("&clk")-1))
  (
    &wild_tail=1
  )

  if ((&wild_head==1)&&(&wild_tail==1))
  (
    if (STRING.SCAN("island_scc_vs_vddmx_clk", STRING.MID("&clk", 1, &clk_input_length-2), 0)!=-1)
    ( 
      &match=1
    )
  )
  else if (&wild_head==1)
  (
    if (STRING.MID("island_scc_vs_vddmx_clk", &clk_itr_length-&clk_input_length+1, &clk_input_length-1)==STRING.CUT("&clk", 1))
    ( 
      &match=1
    )
  )
  else if (&wild_tail==1)
  (
    if (STRING.MID("island_scc_vs_vddmx_clk", 0, &clk_input_length-1)==STRING.CUT("&clk", -1))
    ( 
      &match=1
    )
  )
  else if ("island_scc_vs_vddmx_clk"=="&clk")
  (
    &match=1
  )
  
  if (&match==1)
  (
    &clk_test=&CLK_TEST_ISLAND_SCC_VS_VDDMX_CLK
    &clk_reg=&HWIO_LPASS_ISLAND_SCC_VS_VDDMX_CBCR_ADDR
    &clk_reg_name="LPASS_ISLAND_SCC_VS_VDDMX_CBCR"
    &clk_name="island_scc_vs_vddmx_clk"
    &clk_reg_cbcr_type="sm_cbc"
    &clk_vote_bit=-1.
    &clk_multiplier=4.
    &clk_access_mode="&LPASS_access_mode"

    gosub Print_Clk_Info_Line
  )

  &match=0
  &wild_head=0
  &wild_tail=0
  &clk_input_length=STRING.LENGTH("&clk")
  &clk_itr_length=STRING.LENGTH("audio_core_lpaif_sec_ebit_clk")

  if (STRING.SCAN("&clk", "*", 0)==0)
  (
    &wild_head=1
  )
  if (STRING.SCAN("&clk", "*", 1)==(STRING.LENGTH("&clk")-1))
  (
    &wild_tail=1
  )

  if ((&wild_head==1)&&(&wild_tail==1))
  (
    if (STRING.SCAN("audio_core_lpaif_sec_ebit_clk", STRING.MID("&clk", 1, &clk_input_length-2), 0)!=-1)
    ( 
      &match=1
    )
  )
  else if (&wild_head==1)
  (
    if (STRING.MID("audio_core_lpaif_sec_ebit_clk", &clk_itr_length-&clk_input_length+1, &clk_input_length-1)==STRING.CUT("&clk", 1))
    ( 
      &match=1
    )
  )
  else if (&wild_tail==1)
  (
    if (STRING.MID("audio_core_lpaif_sec_ebit_clk", 0, &clk_input_length-1)==STRING.CUT("&clk", -1))
    ( 
      &match=1
    )
  )
  else if ("audio_core_lpaif_sec_ebit_clk"=="&clk")
  (
    &match=1
  )
  
  if (&match==1)
  (
    &clk_test=0
    &clk_reg=&HWIO_LPASS_AUDIO_CORE_LPAIF_SEC_EBIT_CBCR_ADDR
    &clk_reg_name="LPASS_AUDIO_CORE_LPAIF_SEC_EBIT_CBCR"
    &clk_name="audio_core_lpaif_sec_ebit_clk"
    &clk_reg_cbcr_type="sm_cbc"
    &clk_vote_bit=-1.
    &clk_multiplier=4.
    &clk_access_mode="&LPASS_access_mode"

    gosub Print_Clk_Info_Line
  )

  &match=0
  &wild_head=0
  &wild_tail=0
  &clk_input_length=STRING.LENGTH("&clk")
  &clk_itr_length=STRING.LENGTH("sleep_clk_src")

  if (STRING.SCAN("&clk", "*", 0)==0)
  (
    &wild_head=1
  )
  if (STRING.SCAN("&clk", "*", 1)==(STRING.LENGTH("&clk")-1))
  (
    &wild_tail=1
  )

  if ((&wild_head==1)&&(&wild_tail==1))
  (
    if (STRING.SCAN("sleep_clk_src", STRING.MID("&clk", 1, &clk_input_length-2), 0)!=-1)
    ( 
      &match=1
    )
  )
  else if (&wild_head==1)
  (
    if (STRING.MID("sleep_clk_src", &clk_itr_length-&clk_input_length+1, &clk_input_length-1)==STRING.CUT("&clk", 1))
    ( 
      &match=1
    )
  )
  else if (&wild_tail==1)
  (
    if (STRING.MID("sleep_clk_src", 0, &clk_input_length-1)==STRING.CUT("&clk", -1))
    ( 
      &match=1
    )
  )
  else if ("sleep_clk_src"=="&clk")
  (
    &match=1
  )
  
  if (&match==1)
  (
    &clk_test=&CLK_TEST_SLEEP_CLK_SRC
    &clk_reg=0
    &clk_reg_name="No CBCR"
    &clk_name="sleep_clk_src"
    &clk_reg_cbcr_type=""
    &clk_vote_bit=-1.
    &clk_multiplier=4.
    &clk_access_mode="&LPASS_access_mode"

    gosub Print_Clk_Info_Line
  )

  &match=0
  &wild_head=0
  &wild_tail=0
  &clk_input_length=STRING.LENGTH("&clk")
  &clk_itr_length=STRING.LENGTH("audio_core_bcr_slp_clk")

  if (STRING.SCAN("&clk", "*", 0)==0)
  (
    &wild_head=1
  )
  if (STRING.SCAN("&clk", "*", 1)==(STRING.LENGTH("&clk")-1))
  (
    &wild_tail=1
  )

  if ((&wild_head==1)&&(&wild_tail==1))
  (
    if (STRING.SCAN("audio_core_bcr_slp_clk", STRING.MID("&clk", 1, &clk_input_length-2), 0)!=-1)
    ( 
      &match=1
    )
  )
  else if (&wild_head==1)
  (
    if (STRING.MID("audio_core_bcr_slp_clk", &clk_itr_length-&clk_input_length+1, &clk_input_length-1)==STRING.CUT("&clk", 1))
    ( 
      &match=1
    )
  )
  else if (&wild_tail==1)
  (
    if (STRING.MID("audio_core_bcr_slp_clk", 0, &clk_input_length-1)==STRING.CUT("&clk", -1))
    ( 
      &match=1
    )
  )
  else if ("audio_core_bcr_slp_clk"=="&clk")
  (
    &match=1
  )
  
  if (&match==1)
  (
    &clk_test=&CLK_TEST_AUDIO_CORE_BCR_SLP_CLK
    &clk_reg=&HWIO_LPASS_AUDIO_CORE_BCR_SLP_CBCR_ADDR
    &clk_reg_name="LPASS_AUDIO_CORE_BCR_SLP_CBCR"
    &clk_name="audio_core_bcr_slp_clk"
    &clk_reg_cbcr_type="sm_cbc"
    &clk_vote_bit=-1.
    &clk_multiplier=4.
    &clk_access_mode="&LPASS_access_mode"

    gosub Print_Clk_Info_Line
  )

  &match=0
  &wild_head=0
  &wild_tail=0
  &clk_input_length=STRING.LENGTH("&clk")
  &clk_itr_length=STRING.LENGTH("island_scc_sensor_core_bcr_slp_clk")

  if (STRING.SCAN("&clk", "*", 0)==0)
  (
    &wild_head=1
  )
  if (STRING.SCAN("&clk", "*", 1)==(STRING.LENGTH("&clk")-1))
  (
    &wild_tail=1
  )

  if ((&wild_head==1)&&(&wild_tail==1))
  (
    if (STRING.SCAN("island_scc_sensor_core_bcr_slp_clk", STRING.MID("&clk", 1, &clk_input_length-2), 0)!=-1)
    ( 
      &match=1
    )
  )
  else if (&wild_head==1)
  (
    if (STRING.MID("island_scc_sensor_core_bcr_slp_clk", &clk_itr_length-&clk_input_length+1, &clk_input_length-1)==STRING.CUT("&clk", 1))
    ( 
      &match=1
    )
  )
  else if (&wild_tail==1)
  (
    if (STRING.MID("island_scc_sensor_core_bcr_slp_clk", 0, &clk_input_length-1)==STRING.CUT("&clk", -1))
    ( 
      &match=1
    )
  )
  else if ("island_scc_sensor_core_bcr_slp_clk"=="&clk")
  (
    &match=1
  )
  
  if (&match==1)
  (
    &clk_test=&CLK_TEST_ISLAND_SCC_SENSOR_CORE_BCR_SLP_CLK
    &clk_reg=&HWIO_LPASS_ISLAND_SCC_SENSOR_CORE_BCR_SLP_CBCR_ADDR
    &clk_reg_name="LPASS_ISLAND_SCC_SENSOR_CORE_BCR_SLP_CBCR"
    &clk_name="island_scc_sensor_core_bcr_slp_clk"
    &clk_reg_cbcr_type="sm_cbc"
    &clk_vote_bit=-1.
    &clk_multiplier=4.
    &clk_access_mode="&LPASS_access_mode"

    gosub Print_Clk_Info_Line
  )

  &match=0
  &wild_head=0
  &wild_tail=0
  &clk_input_length=STRING.LENGTH("&clk")
  &clk_itr_length=STRING.LENGTH("q6ss_bcr_slp_clk")

  if (STRING.SCAN("&clk", "*", 0)==0)
  (
    &wild_head=1
  )
  if (STRING.SCAN("&clk", "*", 1)==(STRING.LENGTH("&clk")-1))
  (
    &wild_tail=1
  )

  if ((&wild_head==1)&&(&wild_tail==1))
  (
    if (STRING.SCAN("q6ss_bcr_slp_clk", STRING.MID("&clk", 1, &clk_input_length-2), 0)!=-1)
    ( 
      &match=1
    )
  )
  else if (&wild_head==1)
  (
    if (STRING.MID("q6ss_bcr_slp_clk", &clk_itr_length-&clk_input_length+1, &clk_input_length-1)==STRING.CUT("&clk", 1))
    ( 
      &match=1
    )
  )
  else if (&wild_tail==1)
  (
    if (STRING.MID("q6ss_bcr_slp_clk", 0, &clk_input_length-1)==STRING.CUT("&clk", -1))
    ( 
      &match=1
    )
  )
  else if ("q6ss_bcr_slp_clk"=="&clk")
  (
    &match=1
  )
  
  if (&match==1)
  (
    &clk_test=&CLK_TEST_Q6SS_BCR_SLP_CLK
    &clk_reg=&HWIO_LPASS_Q6SS_BCR_SLP_CBCR_ADDR
    &clk_reg_name="LPASS_Q6SS_BCR_SLP_CBCR"
    &clk_name="q6ss_bcr_slp_clk"
    &clk_reg_cbcr_type="sm_cbc"
    &clk_vote_bit=-1.
    &clk_multiplier=4.
    &clk_access_mode="&LPASS_access_mode"

    gosub Print_Clk_Info_Line
  )

  &match=0
  &wild_head=0
  &wild_tail=0
  &clk_input_length=STRING.LENGTH("&clk")
  &clk_itr_length=STRING.LENGTH("q6ss_slp_clk")

  if (STRING.SCAN("&clk", "*", 0)==0)
  (
    &wild_head=1
  )
  if (STRING.SCAN("&clk", "*", 1)==(STRING.LENGTH("&clk")-1))
  (
    &wild_tail=1
  )

  if ((&wild_head==1)&&(&wild_tail==1))
  (
    if (STRING.SCAN("q6ss_slp_clk", STRING.MID("&clk", 1, &clk_input_length-2), 0)!=-1)
    ( 
      &match=1
    )
  )
  else if (&wild_head==1)
  (
    if (STRING.MID("q6ss_slp_clk", &clk_itr_length-&clk_input_length+1, &clk_input_length-1)==STRING.CUT("&clk", 1))
    ( 
      &match=1
    )
  )
  else if (&wild_tail==1)
  (
    if (STRING.MID("q6ss_slp_clk", 0, &clk_input_length-1)==STRING.CUT("&clk", -1))
    ( 
      &match=1
    )
  )
  else if ("q6ss_slp_clk"=="&clk")
  (
    &match=1
  )
  
  if (&match==1)
  (
    &clk_test=0
    &clk_reg=0
    &clk_reg_name="No CBCR"
    &clk_name="q6ss_slp_clk"
    &clk_reg_cbcr_type=""
    &clk_vote_bit=-1.
    &clk_multiplier=4.
    &clk_access_mode="&LPASS_access_mode"

    gosub Print_Clk_Info_Line
  )

  &match=0
  &wild_head=0
  &wild_tail=0
  &clk_input_length=STRING.LENGTH("&clk")
  &clk_itr_length=STRING.LENGTH("audio_wrapper_sw_npl_clk")

  if (STRING.SCAN("&clk", "*", 0)==0)
  (
    &wild_head=1
  )
  if (STRING.SCAN("&clk", "*", 1)==(STRING.LENGTH("&clk")-1))
  (
    &wild_tail=1
  )

  if ((&wild_head==1)&&(&wild_tail==1))
  (
    if (STRING.SCAN("audio_wrapper_sw_npl_clk", STRING.MID("&clk", 1, &clk_input_length-2), 0)!=-1)
    ( 
      &match=1
    )
  )
  else if (&wild_head==1)
  (
    if (STRING.MID("audio_wrapper_sw_npl_clk", &clk_itr_length-&clk_input_length+1, &clk_input_length-1)==STRING.CUT("&clk", 1))
    ( 
      &match=1
    )
  )
  else if (&wild_tail==1)
  (
    if (STRING.MID("audio_wrapper_sw_npl_clk", 0, &clk_input_length-1)==STRING.CUT("&clk", -1))
    ( 
      &match=1
    )
  )
  else if ("audio_wrapper_sw_npl_clk"=="&clk")
  (
    &match=1
  )
  
  if (&match==1)
  (
    &clk_test=&CLK_TEST_AUDIO_WRAPPER_SW_NPL_CLK
    &clk_reg=&HWIO_LPASS_AUDIO_WRAPPER_SW_NPL_CBCR_ADDR
    &clk_reg_name="LPASS_AUDIO_WRAPPER_SW_NPL_CBCR"
    &clk_name="audio_wrapper_sw_npl_clk"
    &clk_reg_cbcr_type="sm_cbc"
    &clk_vote_bit=-1.
    &clk_multiplier=4.
    &clk_access_mode="&LPASS_access_mode"

    gosub Print_Clk_Info_Line
  )

  &match=0
  &wild_head=0
  &wild_tail=0
  &clk_input_length=STRING.LENGTH("&clk")
  &clk_itr_length=STRING.LENGTH("audio_core_lpaif_ter_ebit_clk")

  if (STRING.SCAN("&clk", "*", 0)==0)
  (
    &wild_head=1
  )
  if (STRING.SCAN("&clk", "*", 1)==(STRING.LENGTH("&clk")-1))
  (
    &wild_tail=1
  )

  if ((&wild_head==1)&&(&wild_tail==1))
  (
    if (STRING.SCAN("audio_core_lpaif_ter_ebit_clk", STRING.MID("&clk", 1, &clk_input_length-2), 0)!=-1)
    ( 
      &match=1
    )
  )
  else if (&wild_head==1)
  (
    if (STRING.MID("audio_core_lpaif_ter_ebit_clk", &clk_itr_length-&clk_input_length+1, &clk_input_length-1)==STRING.CUT("&clk", 1))
    ( 
      &match=1
    )
  )
  else if (&wild_tail==1)
  (
    if (STRING.MID("audio_core_lpaif_ter_ebit_clk", 0, &clk_input_length-1)==STRING.CUT("&clk", -1))
    ( 
      &match=1
    )
  )
  else if ("audio_core_lpaif_ter_ebit_clk"=="&clk")
  (
    &match=1
  )
  
  if (&match==1)
  (
    &clk_test=0
    &clk_reg=&HWIO_LPASS_AUDIO_CORE_LPAIF_TER_EBIT_CBCR_ADDR
    &clk_reg_name="LPASS_AUDIO_CORE_LPAIF_TER_EBIT_CBCR"
    &clk_name="audio_core_lpaif_ter_ebit_clk"
    &clk_reg_cbcr_type="sm_cbc"
    &clk_vote_bit=-1.
    &clk_multiplier=4.
    &clk_access_mode="&LPASS_access_mode"

    gosub Print_Clk_Info_Line
  )

  &match=0
  &wild_head=0
  &wild_tail=0
  &clk_input_length=STRING.LENGTH("&clk")
  &clk_itr_length=STRING.LENGTH("xo_clk_src")

  if (STRING.SCAN("&clk", "*", 0)==0)
  (
    &wild_head=1
  )
  if (STRING.SCAN("&clk", "*", 1)==(STRING.LENGTH("&clk")-1))
  (
    &wild_tail=1
  )

  if ((&wild_head==1)&&(&wild_tail==1))
  (
    if (STRING.SCAN("xo_clk_src", STRING.MID("&clk", 1, &clk_input_length-2), 0)!=-1)
    ( 
      &match=1
    )
  )
  else if (&wild_head==1)
  (
    if (STRING.MID("xo_clk_src", &clk_itr_length-&clk_input_length+1, &clk_input_length-1)==STRING.CUT("&clk", 1))
    ( 
      &match=1
    )
  )
  else if (&wild_tail==1)
  (
    if (STRING.MID("xo_clk_src", 0, &clk_input_length-1)==STRING.CUT("&clk", -1))
    ( 
      &match=1
    )
  )
  else if ("xo_clk_src"=="&clk")
  (
    &match=1
  )
  
  if (&match==1)
  (
    &clk_test=&CLK_TEST_XO_CLK_SRC
    &clk_reg=0
    &clk_reg_name="No CBCR"
    &clk_name="xo_clk_src"
    &clk_reg_cbcr_type=""
    &clk_vote_bit=-1.
    &clk_multiplier=4.
    &clk_access_mode="&LPASS_access_mode"

    gosub Print_Clk_Info_Line
  )

  &match=0
  &wild_head=0
  &wild_tail=0
  &clk_input_length=STRING.LENGTH("&clk")
  &clk_itr_length=STRING.LENGTH("audio_core_avsync_stc_clk")

  if (STRING.SCAN("&clk", "*", 0)==0)
  (
    &wild_head=1
  )
  if (STRING.SCAN("&clk", "*", 1)==(STRING.LENGTH("&clk")-1))
  (
    &wild_tail=1
  )

  if ((&wild_head==1)&&(&wild_tail==1))
  (
    if (STRING.SCAN("audio_core_avsync_stc_clk", STRING.MID("&clk", 1, &clk_input_length-2), 0)!=-1)
    ( 
      &match=1
    )
  )
  else if (&wild_head==1)
  (
    if (STRING.MID("audio_core_avsync_stc_clk", &clk_itr_length-&clk_input_length+1, &clk_input_length-1)==STRING.CUT("&clk", 1))
    ( 
      &match=1
    )
  )
  else if (&wild_tail==1)
  (
    if (STRING.MID("audio_core_avsync_stc_clk", 0, &clk_input_length-1)==STRING.CUT("&clk", -1))
    ( 
      &match=1
    )
  )
  else if ("audio_core_avsync_stc_clk"=="&clk")
  (
    &match=1
  )
  
  if (&match==1)
  (
    &clk_test=&CLK_TEST_AUDIO_CORE_AVSYNC_STC_CLK
    &clk_reg=&HWIO_LPASS_AUDIO_CORE_AVSYNC_STC_CBCR_ADDR
    &clk_reg_name="LPASS_AUDIO_CORE_AVSYNC_STC_CBCR"
    &clk_name="audio_core_avsync_stc_clk"
    &clk_reg_cbcr_type="sm_cbc"
    &clk_vote_bit=-1.
    &clk_multiplier=4.
    &clk_access_mode="&LPASS_access_mode"

    gosub Print_Clk_Info_Line
  )

  &match=0
  &wild_head=0
  &wild_tail=0
  &clk_input_length=STRING.LENGTH("&clk")
  &clk_itr_length=STRING.LENGTH("audio_core_gdsc_xo_clk")

  if (STRING.SCAN("&clk", "*", 0)==0)
  (
    &wild_head=1
  )
  if (STRING.SCAN("&clk", "*", 1)==(STRING.LENGTH("&clk")-1))
  (
    &wild_tail=1
  )

  if ((&wild_head==1)&&(&wild_tail==1))
  (
    if (STRING.SCAN("audio_core_gdsc_xo_clk", STRING.MID("&clk", 1, &clk_input_length-2), 0)!=-1)
    ( 
      &match=1
    )
  )
  else if (&wild_head==1)
  (
    if (STRING.MID("audio_core_gdsc_xo_clk", &clk_itr_length-&clk_input_length+1, &clk_input_length-1)==STRING.CUT("&clk", 1))
    ( 
      &match=1
    )
  )
  else if (&wild_tail==1)
  (
    if (STRING.MID("audio_core_gdsc_xo_clk", 0, &clk_input_length-1)==STRING.CUT("&clk", -1))
    ( 
      &match=1
    )
  )
  else if ("audio_core_gdsc_xo_clk"=="&clk")
  (
    &match=1
  )
  
  if (&match==1)
  (
    &clk_test=&CLK_TEST_AUDIO_CORE_GDSC_XO_CLK
    &clk_reg=&HWIO_LPASS_AUDIO_CORE_GDSC_XO_CBCR_ADDR
    &clk_reg_name="LPASS_AUDIO_CORE_GDSC_XO_CBCR"
    &clk_name="audio_core_gdsc_xo_clk"
    &clk_reg_cbcr_type="sm_cbc"
    &clk_vote_bit=-1.
    &clk_multiplier=4.
    &clk_access_mode="&LPASS_access_mode"

    gosub Print_Clk_Info_Line
  )

  &match=0
  &wild_head=0
  &wild_tail=0
  &clk_input_length=STRING.LENGTH("&clk")
  &clk_itr_length=STRING.LENGTH("audio_wrapper_qos_xo_lat_counter_clk")

  if (STRING.SCAN("&clk", "*", 0)==0)
  (
    &wild_head=1
  )
  if (STRING.SCAN("&clk", "*", 1)==(STRING.LENGTH("&clk")-1))
  (
    &wild_tail=1
  )

  if ((&wild_head==1)&&(&wild_tail==1))
  (
    if (STRING.SCAN("audio_wrapper_qos_xo_lat_counter_clk", STRING.MID("&clk", 1, &clk_input_length-2), 0)!=-1)
    ( 
      &match=1
    )
  )
  else if (&wild_head==1)
  (
    if (STRING.MID("audio_wrapper_qos_xo_lat_counter_clk", &clk_itr_length-&clk_input_length+1, &clk_input_length-1)==STRING.CUT("&clk", 1))
    ( 
      &match=1
    )
  )
  else if (&wild_tail==1)
  (
    if (STRING.MID("audio_wrapper_qos_xo_lat_counter_clk", 0, &clk_input_length-1)==STRING.CUT("&clk", -1))
    ( 
      &match=1
    )
  )
  else if ("audio_wrapper_qos_xo_lat_counter_clk"=="&clk")
  (
    &match=1
  )
  
  if (&match==1)
  (
    &clk_test=&CLK_TEST_AUDIO_WRAPPER_QOS_XO_LAT_COUNTER_CLK
    &clk_reg=&HWIO_LPASS_AUDIO_WRAPPER_QOS_XO_LAT_COUNTER_CBCR_ADDR
    &clk_reg_name="LPASS_AUDIO_WRAPPER_QOS_XO_LAT_COUNTER_CBCR"
    &clk_name="audio_wrapper_qos_xo_lat_counter_clk"
    &clk_reg_cbcr_type="sm_cbc"
    &clk_vote_bit=-1.
    &clk_multiplier=4.
    &clk_access_mode="&LPASS_access_mode"

    gosub Print_Clk_Info_Line
  )

  &match=0
  &wild_head=0
  &wild_tail=0
  &clk_input_length=STRING.LENGTH("&clk")
  &clk_itr_length=STRING.LENGTH("q6ss_xo_clk")

  if (STRING.SCAN("&clk", "*", 0)==0)
  (
    &wild_head=1
  )
  if (STRING.SCAN("&clk", "*", 1)==(STRING.LENGTH("&clk")-1))
  (
    &wild_tail=1
  )

  if ((&wild_head==1)&&(&wild_tail==1))
  (
    if (STRING.SCAN("q6ss_xo_clk", STRING.MID("&clk", 1, &clk_input_length-2), 0)!=-1)
    ( 
      &match=1
    )
  )
  else if (&wild_head==1)
  (
    if (STRING.MID("q6ss_xo_clk", &clk_itr_length-&clk_input_length+1, &clk_input_length-1)==STRING.CUT("&clk", 1))
    ( 
      &match=1
    )
  )
  else if (&wild_tail==1)
  (
    if (STRING.MID("q6ss_xo_clk", 0, &clk_input_length-1)==STRING.CUT("&clk", -1))
    ( 
      &match=1
    )
  )
  else if ("q6ss_xo_clk"=="&clk")
  (
    &match=1
  )
  
  if (&match==1)
  (
    &clk_test=0
    &clk_reg=0
    &clk_reg_name="No CBCR"
    &clk_name="q6ss_xo_clk"
    &clk_reg_cbcr_type=""
    &clk_vote_bit=-1.
    &clk_multiplier=4.
    &clk_access_mode="&LPASS_access_mode"

    gosub Print_Clk_Info_Line
  )

  &match=0
  &wild_head=0
  &wild_tail=0
  &clk_input_length=STRING.LENGTH("&clk")
  &clk_itr_length=STRING.LENGTH("lpass_qdsp6ss_q6_core_clk")

  if (STRING.SCAN("&clk", "*", 0)==0)
  (
    &wild_head=1
  )
  if (STRING.SCAN("&clk", "*", 1)==(STRING.LENGTH("&clk")-1))
  (
    &wild_tail=1
  )

  if ((&wild_head==1)&&(&wild_tail==1))
  (
    if (STRING.SCAN("lpass_qdsp6ss_q6_core_clk", STRING.MID("&clk", 1, &clk_input_length-2), 0)!=-1)
    ( 
      &match=1
    )
  )
  else if (&wild_head==1)
  (
    if (STRING.MID("lpass_qdsp6ss_q6_core_clk", &clk_itr_length-&clk_input_length+1, &clk_input_length-1)==STRING.CUT("&clk", 1))
    ( 
      &match=1
    )
  )
  else if (&wild_tail==1)
  (
    if (STRING.MID("lpass_qdsp6ss_q6_core_clk", 0, &clk_input_length-1)==STRING.CUT("&clk", -1))
    ( 
      &match=1
    )
  )
  else if ("lpass_qdsp6ss_q6_core_clk"=="&clk")||("cpus"=="&clk")
  (
    &match=1
  )
  
  if (&match==1)
  (
    &clk_test=&CLK_TEST_LPASS_QDSP6SS_Q6_CORE_CLK
    &clk_reg=0
    &clk_reg_name="No CBCR"
    &clk_name="lpass_qdsp6ss_q6_core_clk"
    &clk_reg_cbcr_type=""
    &clk_vote_bit=-1.
    &clk_multiplier=4.
    &clk_access_mode="&LPASS_access_mode"

    gosub Print_Clk_Info_Line
  )

  &match=0
  &wild_head=0
  &wild_tail=0
  &clk_input_length=STRING.LENGTH("&clk")
  &clk_itr_length=STRING.LENGTH("lpass_qdsp6ss_axi_m_clk")

  if (STRING.SCAN("&clk", "*", 0)==0)
  (
    &wild_head=1
  )
  if (STRING.SCAN("&clk", "*", 1)==(STRING.LENGTH("&clk")-1))
  (
    &wild_tail=1
  )

  if ((&wild_head==1)&&(&wild_tail==1))
  (
    if (STRING.SCAN("lpass_qdsp6ss_axi_m_clk", STRING.MID("&clk", 1, &clk_input_length-2), 0)!=-1)
    ( 
      &match=1
    )
  )
  else if (&wild_head==1)
  (
    if (STRING.MID("lpass_qdsp6ss_axi_m_clk", &clk_itr_length-&clk_input_length+1, &clk_input_length-1)==STRING.CUT("&clk", 1))
    ( 
      &match=1
    )
  )
  else if (&wild_tail==1)
  (
    if (STRING.MID("lpass_qdsp6ss_axi_m_clk", 0, &clk_input_length-1)==STRING.CUT("&clk", -1))
    ( 
      &match=1
    )
  )
  else if ("lpass_qdsp6ss_axi_m_clk"=="&clk")
  (
    &match=1
  )
  
  if (&match==1)
  (
    &clk_test=&CLK_TEST_LPASS_QDSP6SS_AXI_M_CLK
    &clk_reg=0
    &clk_reg_name="No CBCR"
    &clk_name="lpass_qdsp6ss_axi_m_clk"
    &clk_reg_cbcr_type=""
    &clk_vote_bit=-1.
    &clk_multiplier=4.
    &clk_access_mode="&LPASS_access_mode"

    gosub Print_Clk_Info_Line
  )

  &match=0
  &wild_head=0
  &wild_tail=0
  &clk_input_length=STRING.LENGTH("&clk")
  &clk_itr_length=STRING.LENGTH("lpass_qdsp6ss_ldo_nmo_out")

  if (STRING.SCAN("&clk", "*", 0)==0)
  (
    &wild_head=1
  )
  if (STRING.SCAN("&clk", "*", 1)==(STRING.LENGTH("&clk")-1))
  (
    &wild_tail=1
  )

  if ((&wild_head==1)&&(&wild_tail==1))
  (
    if (STRING.SCAN("lpass_qdsp6ss_ldo_nmo_out", STRING.MID("&clk", 1, &clk_input_length-2), 0)!=-1)
    ( 
      &match=1
    )
  )
  else if (&wild_head==1)
  (
    if (STRING.MID("lpass_qdsp6ss_ldo_nmo_out", &clk_itr_length-&clk_input_length+1, &clk_input_length-1)==STRING.CUT("&clk", 1))
    ( 
      &match=1
    )
  )
  else if (&wild_tail==1)
  (
    if (STRING.MID("lpass_qdsp6ss_ldo_nmo_out", 0, &clk_input_length-1)==STRING.CUT("&clk", -1))
    ( 
      &match=1
    )
  )
  else if ("lpass_qdsp6ss_ldo_nmo_out"=="&clk")
  (
    &match=1
  )
  
  if (&match==1)
  (
    &clk_test=&CLK_TEST_LPASS_QDSP6SS_LDO_NMO_OUT
    &clk_reg=0
    &clk_reg_name="No CBCR"
    &clk_name="lpass_qdsp6ss_ldo_nmo_out"
    &clk_reg_cbcr_type=""
    &clk_vote_bit=-1.
    &clk_multiplier=4.
    &clk_access_mode="&LPASS_access_mode"

    gosub Print_Clk_Info_Line
  )

  &match=0
  &wild_head=0
  &wild_tail=0
  &clk_input_length=STRING.LENGTH("&clk")
  &clk_itr_length=STRING.LENGTH("lpass_qdsp6ss_ahb_m_clk")

  if (STRING.SCAN("&clk", "*", 0)==0)
  (
    &wild_head=1
  )
  if (STRING.SCAN("&clk", "*", 1)==(STRING.LENGTH("&clk")-1))
  (
    &wild_tail=1
  )

  if ((&wild_head==1)&&(&wild_tail==1))
  (
    if (STRING.SCAN("lpass_qdsp6ss_ahb_m_clk", STRING.MID("&clk", 1, &clk_input_length-2), 0)!=-1)
    ( 
      &match=1
    )
  )
  else if (&wild_head==1)
  (
    if (STRING.MID("lpass_qdsp6ss_ahb_m_clk", &clk_itr_length-&clk_input_length+1, &clk_input_length-1)==STRING.CUT("&clk", 1))
    ( 
      &match=1
    )
  )
  else if (&wild_tail==1)
  (
    if (STRING.MID("lpass_qdsp6ss_ahb_m_clk", 0, &clk_input_length-1)==STRING.CUT("&clk", -1))
    ( 
      &match=1
    )
  )
  else if ("lpass_qdsp6ss_ahb_m_clk"=="&clk")
  (
    &match=1
  )
  
  if (&match==1)
  (
    &clk_test=&CLK_TEST_LPASS_QDSP6SS_AHB_M_CLK
    &clk_reg=0
    &clk_reg_name="No CBCR"
    &clk_name="lpass_qdsp6ss_ahb_m_clk"
    &clk_reg_cbcr_type=""
    &clk_vote_bit=-1.
    &clk_multiplier=4.
    &clk_access_mode="&LPASS_access_mode"

    gosub Print_Clk_Info_Line
  )

  &match=0
  &wild_head=0
  &wild_tail=0
  &clk_input_length=STRING.LENGTH("&clk")
  &clk_itr_length=STRING.LENGTH("lpass_qdsp6ss_ahb_s_clk")

  if (STRING.SCAN("&clk", "*", 0)==0)
  (
    &wild_head=1
  )
  if (STRING.SCAN("&clk", "*", 1)==(STRING.LENGTH("&clk")-1))
  (
    &wild_tail=1
  )

  if ((&wild_head==1)&&(&wild_tail==1))
  (
    if (STRING.SCAN("lpass_qdsp6ss_ahb_s_clk", STRING.MID("&clk", 1, &clk_input_length-2), 0)!=-1)
    ( 
      &match=1
    )
  )
  else if (&wild_head==1)
  (
    if (STRING.MID("lpass_qdsp6ss_ahb_s_clk", &clk_itr_length-&clk_input_length+1, &clk_input_length-1)==STRING.CUT("&clk", 1))
    ( 
      &match=1
    )
  )
  else if (&wild_tail==1)
  (
    if (STRING.MID("lpass_qdsp6ss_ahb_s_clk", 0, &clk_input_length-1)==STRING.CUT("&clk", -1))
    ( 
      &match=1
    )
  )
  else if ("lpass_qdsp6ss_ahb_s_clk"=="&clk")
  (
    &match=1
  )
  
  if (&match==1)
  (
    &clk_test=&CLK_TEST_LPASS_QDSP6SS_AHB_S_CLK
    &clk_reg=0
    &clk_reg_name="No CBCR"
    &clk_name="lpass_qdsp6ss_ahb_s_clk"
    &clk_reg_cbcr_type=""
    &clk_vote_bit=-1.
    &clk_multiplier=4.
    &clk_access_mode="&LPASS_access_mode"

    gosub Print_Clk_Info_Line
  )

  &match=0
  &wild_head=0
  &wild_tail=0
  &clk_input_length=STRING.LENGTH("&clk")
  &clk_itr_length=STRING.LENGTH("lpass_qdsp6ss_xo_clk")

  if (STRING.SCAN("&clk", "*", 0)==0)
  (
    &wild_head=1
  )
  if (STRING.SCAN("&clk", "*", 1)==(STRING.LENGTH("&clk")-1))
  (
    &wild_tail=1
  )

  if ((&wild_head==1)&&(&wild_tail==1))
  (
    if (STRING.SCAN("lpass_qdsp6ss_xo_clk", STRING.MID("&clk", 1, &clk_input_length-2), 0)!=-1)
    ( 
      &match=1
    )
  )
  else if (&wild_head==1)
  (
    if (STRING.MID("lpass_qdsp6ss_xo_clk", &clk_itr_length-&clk_input_length+1, &clk_input_length-1)==STRING.CUT("&clk", 1))
    ( 
      &match=1
    )
  )
  else if (&wild_tail==1)
  (
    if (STRING.MID("lpass_qdsp6ss_xo_clk", 0, &clk_input_length-1)==STRING.CUT("&clk", -1))
    ( 
      &match=1
    )
  )
  else if ("lpass_qdsp6ss_xo_clk"=="&clk")
  (
    &match=1
  )
  
  if (&match==1)
  (
    &clk_test=&CLK_TEST_LPASS_QDSP6SS_XO_CLK
    &clk_reg=0
    &clk_reg_name="No CBCR"
    &clk_name="lpass_qdsp6ss_xo_clk"
    &clk_reg_cbcr_type=""
    &clk_vote_bit=-1.
    &clk_multiplier=4.
    &clk_access_mode="&LPASS_access_mode"

    gosub Print_Clk_Info_Line
  )

  &match=0
  &wild_head=0
  &wild_tail=0
  &clk_input_length=STRING.LENGTH("&clk")
  &clk_itr_length=STRING.LENGTH("lpass_qdsp6ss_sleep_clk")

  if (STRING.SCAN("&clk", "*", 0)==0)
  (
    &wild_head=1
  )
  if (STRING.SCAN("&clk", "*", 1)==(STRING.LENGTH("&clk")-1))
  (
    &wild_tail=1
  )

  if ((&wild_head==1)&&(&wild_tail==1))
  (
    if (STRING.SCAN("lpass_qdsp6ss_sleep_clk", STRING.MID("&clk", 1, &clk_input_length-2), 0)!=-1)
    ( 
      &match=1
    )
  )
  else if (&wild_head==1)
  (
    if (STRING.MID("lpass_qdsp6ss_sleep_clk", &clk_itr_length-&clk_input_length+1, &clk_input_length-1)==STRING.CUT("&clk", 1))
    ( 
      &match=1
    )
  )
  else if (&wild_tail==1)
  (
    if (STRING.MID("lpass_qdsp6ss_sleep_clk", 0, &clk_input_length-1)==STRING.CUT("&clk", -1))
    ( 
      &match=1
    )
  )
  else if ("lpass_qdsp6ss_sleep_clk"=="&clk")
  (
    &match=1
  )
  
  if (&match==1)
  (
    &clk_test=&CLK_TEST_LPASS_QDSP6SS_SLEEP_CLK
    &clk_reg=0
    &clk_reg_name="No CBCR"
    &clk_name="lpass_qdsp6ss_sleep_clk"
    &clk_reg_cbcr_type=""
    &clk_vote_bit=-1.
    &clk_multiplier=4.
    &clk_access_mode="&LPASS_access_mode"

    gosub Print_Clk_Info_Line
  )

  &match=0
  &wild_head=0
  &wild_tail=0
  &clk_input_length=STRING.LENGTH("&clk")
  &clk_itr_length=STRING.LENGTH("lpass_qdsp6ss_jtag_tck")

  if (STRING.SCAN("&clk", "*", 0)==0)
  (
    &wild_head=1
  )
  if (STRING.SCAN("&clk", "*", 1)==(STRING.LENGTH("&clk")-1))
  (
    &wild_tail=1
  )

  if ((&wild_head==1)&&(&wild_tail==1))
  (
    if (STRING.SCAN("lpass_qdsp6ss_jtag_tck", STRING.MID("&clk", 1, &clk_input_length-2), 0)!=-1)
    ( 
      &match=1
    )
  )
  else if (&wild_head==1)
  (
    if (STRING.MID("lpass_qdsp6ss_jtag_tck", &clk_itr_length-&clk_input_length+1, &clk_input_length-1)==STRING.CUT("&clk", 1))
    ( 
      &match=1
    )
  )
  else if (&wild_tail==1)
  (
    if (STRING.MID("lpass_qdsp6ss_jtag_tck", 0, &clk_input_length-1)==STRING.CUT("&clk", -1))
    ( 
      &match=1
    )
  )
  else if ("lpass_qdsp6ss_jtag_tck"=="&clk")
  (
    &match=1
  )
  
  if (&match==1)
  (
    &clk_test=&CLK_TEST_LPASS_QDSP6SS_JTAG_TCK
    &clk_reg=0
    &clk_reg_name="No CBCR"
    &clk_name="lpass_qdsp6ss_jtag_tck"
    &clk_reg_cbcr_type=""
    &clk_vote_bit=-1.
    &clk_multiplier=4.
    &clk_access_mode="&LPASS_access_mode"

    gosub Print_Clk_Info_Line
  )

  &match=0
  &wild_head=0
  &wild_tail=0
  &clk_input_length=STRING.LENGTH("&clk")
  &clk_itr_length=STRING.LENGTH("lpass_qdsp6ss_atb_clk")

  if (STRING.SCAN("&clk", "*", 0)==0)
  (
    &wild_head=1
  )
  if (STRING.SCAN("&clk", "*", 1)==(STRING.LENGTH("&clk")-1))
  (
    &wild_tail=1
  )

  if ((&wild_head==1)&&(&wild_tail==1))
  (
    if (STRING.SCAN("lpass_qdsp6ss_atb_clk", STRING.MID("&clk", 1, &clk_input_length-2), 0)!=-1)
    ( 
      &match=1
    )
  )
  else if (&wild_head==1)
  (
    if (STRING.MID("lpass_qdsp6ss_atb_clk", &clk_itr_length-&clk_input_length+1, &clk_input_length-1)==STRING.CUT("&clk", 1))
    ( 
      &match=1
    )
  )
  else if (&wild_tail==1)
  (
    if (STRING.MID("lpass_qdsp6ss_atb_clk", 0, &clk_input_length-1)==STRING.CUT("&clk", -1))
    ( 
      &match=1
    )
  )
  else if ("lpass_qdsp6ss_atb_clk"=="&clk")
  (
    &match=1
  )
  
  if (&match==1)
  (
    &clk_test=&CLK_TEST_LPASS_QDSP6SS_ATB_CLK
    &clk_reg=0
    &clk_reg_name="No CBCR"
    &clk_name="lpass_qdsp6ss_atb_clk"
    &clk_reg_cbcr_type=""
    &clk_vote_bit=-1.
    &clk_multiplier=4.
    &clk_access_mode="&LPASS_access_mode"

    gosub Print_Clk_Info_Line
  )

  &match=0
  &wild_head=0
  &wild_tail=0
  &clk_input_length=STRING.LENGTH("&clk")
  &clk_itr_length=STRING.LENGTH("lpass_qdsp6ss_apb_clk")

  if (STRING.SCAN("&clk", "*", 0)==0)
  (
    &wild_head=1
  )
  if (STRING.SCAN("&clk", "*", 1)==(STRING.LENGTH("&clk")-1))
  (
    &wild_tail=1
  )

  if ((&wild_head==1)&&(&wild_tail==1))
  (
    if (STRING.SCAN("lpass_qdsp6ss_apb_clk", STRING.MID("&clk", 1, &clk_input_length-2), 0)!=-1)
    ( 
      &match=1
    )
  )
  else if (&wild_head==1)
  (
    if (STRING.MID("lpass_qdsp6ss_apb_clk", &clk_itr_length-&clk_input_length+1, &clk_input_length-1)==STRING.CUT("&clk", 1))
    ( 
      &match=1
    )
  )
  else if (&wild_tail==1)
  (
    if (STRING.MID("lpass_qdsp6ss_apb_clk", 0, &clk_input_length-1)==STRING.CUT("&clk", -1))
    ( 
      &match=1
    )
  )
  else if ("lpass_qdsp6ss_apb_clk"=="&clk")
  (
    &match=1
  )
  
  if (&match==1)
  (
    &clk_test=&CLK_TEST_LPASS_QDSP6SS_APB_CLK
    &clk_reg=0
    &clk_reg_name="No CBCR"
    &clk_name="lpass_qdsp6ss_apb_clk"
    &clk_reg_cbcr_type=""
    &clk_vote_bit=-1.
    &clk_multiplier=4.
    &clk_access_mode="&LPASS_access_mode"

    gosub Print_Clk_Info_Line
  )

  &match=0
  &wild_head=0
  &wild_tail=0
  &clk_input_length=STRING.LENGTH("&clk")
  &clk_itr_length=STRING.LENGTH("lpass_qdsp6ss_timestamp_clk")

  if (STRING.SCAN("&clk", "*", 0)==0)
  (
    &wild_head=1
  )
  if (STRING.SCAN("&clk", "*", 1)==(STRING.LENGTH("&clk")-1))
  (
    &wild_tail=1
  )

  if ((&wild_head==1)&&(&wild_tail==1))
  (
    if (STRING.SCAN("lpass_qdsp6ss_timestamp_clk", STRING.MID("&clk", 1, &clk_input_length-2), 0)!=-1)
    ( 
      &match=1
    )
  )
  else if (&wild_head==1)
  (
    if (STRING.MID("lpass_qdsp6ss_timestamp_clk", &clk_itr_length-&clk_input_length+1, &clk_input_length-1)==STRING.CUT("&clk", 1))
    ( 
      &match=1
    )
  )
  else if (&wild_tail==1)
  (
    if (STRING.MID("lpass_qdsp6ss_timestamp_clk", 0, &clk_input_length-1)==STRING.CUT("&clk", -1))
    ( 
      &match=1
    )
  )
  else if ("lpass_qdsp6ss_timestamp_clk"=="&clk")
  (
    &match=1
  )
  
  if (&match==1)
  (
    &clk_test=&CLK_TEST_LPASS_QDSP6SS_TIMESTAMP_CLK
    &clk_reg=0
    &clk_reg_name="No CBCR"
    &clk_name="lpass_qdsp6ss_timestamp_clk"
    &clk_reg_cbcr_type=""
    &clk_vote_bit=-1.
    &clk_multiplier=4.
    &clk_access_mode="&LPASS_access_mode"

    gosub Print_Clk_Info_Line
  )

  &match=0
  &wild_head=0
  &wild_tail=0
  &clk_input_length=STRING.LENGTH("&clk")
  &clk_itr_length=STRING.LENGTH("mmss_bimc_smmu_ahb_clk")

  if (STRING.SCAN("&clk", "*", 0)==0)
  (
    &wild_head=1
  )
  if (STRING.SCAN("&clk", "*", 1)==(STRING.LENGTH("&clk")-1))
  (
    &wild_tail=1
  )

  if ((&wild_head==1)&&(&wild_tail==1))
  (
    if (STRING.SCAN("mmss_bimc_smmu_ahb_clk", STRING.MID("&clk", 1, &clk_input_length-2), 0)!=-1)
    ( 
      &match=1
    )
  )
  else if (&wild_head==1)
  (
    if (STRING.MID("mmss_bimc_smmu_ahb_clk", &clk_itr_length-&clk_input_length+1, &clk_input_length-1)==STRING.CUT("&clk", 1))
    ( 
      &match=1
    )
  )
  else if (&wild_tail==1)
  (
    if (STRING.MID("mmss_bimc_smmu_ahb_clk", 0, &clk_input_length-1)==STRING.CUT("&clk", -1))
    ( 
      &match=1
    )
  )
  else if ("mmss_bimc_smmu_ahb_clk"=="&clk")
  (
    &match=1
  )
  
  if (&match==1)
  (
    &clk_test=&CLK_TEST_MMSS_BIMC_SMMU_AHB_CLK
    &clk_reg=&HWIO_MMSS_BIMC_SMMU_AHB_CBCR_ADDR
    &clk_reg_name="MMSS_BIMC_SMMU_AHB_CBCR"
    &clk_name="mmss_bimc_smmu_ahb_clk"
    &clk_reg_cbcr_type="sm_cbc"
    &clk_vote_bit=-1.
    &clk_multiplier=12.
    &clk_access_mode="&MMSS_access_mode"

    gosub Print_Clk_Info_Line
  )

  &match=0
  &wild_head=0
  &wild_tail=0
  &clk_input_length=STRING.LENGTH("&clk")
  &clk_itr_length=STRING.LENGTH("mmss_bto_ahb_clk")

  if (STRING.SCAN("&clk", "*", 0)==0)
  (
    &wild_head=1
  )
  if (STRING.SCAN("&clk", "*", 1)==(STRING.LENGTH("&clk")-1))
  (
    &wild_tail=1
  )

  if ((&wild_head==1)&&(&wild_tail==1))
  (
    if (STRING.SCAN("mmss_bto_ahb_clk", STRING.MID("&clk", 1, &clk_input_length-2), 0)!=-1)
    ( 
      &match=1
    )
  )
  else if (&wild_head==1)
  (
    if (STRING.MID("mmss_bto_ahb_clk", &clk_itr_length-&clk_input_length+1, &clk_input_length-1)==STRING.CUT("&clk", 1))
    ( 
      &match=1
    )
  )
  else if (&wild_tail==1)
  (
    if (STRING.MID("mmss_bto_ahb_clk", 0, &clk_input_length-1)==STRING.CUT("&clk", -1))
    ( 
      &match=1
    )
  )
  else if ("mmss_bto_ahb_clk"=="&clk")
  (
    &match=1
  )
  
  if (&match==1)
  (
    &clk_test=&CLK_TEST_MMSS_BTO_AHB_CLK
    &clk_reg=&HWIO_MMSS_BTO_AHB_CBCR_ADDR
    &clk_reg_name="MMSS_BTO_AHB_CBCR"
    &clk_name="mmss_bto_ahb_clk"
    &clk_reg_cbcr_type="sm_cbc"
    &clk_vote_bit=-1.
    &clk_multiplier=12.
    &clk_access_mode="&MMSS_access_mode"

    gosub Print_Clk_Info_Line
  )

  &match=0
  &wild_head=0
  &wild_tail=0
  &clk_input_length=STRING.LENGTH("&clk")
  &clk_itr_length=STRING.LENGTH("mmss_camss_ahb_clk")

  if (STRING.SCAN("&clk", "*", 0)==0)
  (
    &wild_head=1
  )
  if (STRING.SCAN("&clk", "*", 1)==(STRING.LENGTH("&clk")-1))
  (
    &wild_tail=1
  )

  if ((&wild_head==1)&&(&wild_tail==1))
  (
    if (STRING.SCAN("mmss_camss_ahb_clk", STRING.MID("&clk", 1, &clk_input_length-2), 0)!=-1)
    ( 
      &match=1
    )
  )
  else if (&wild_head==1)
  (
    if (STRING.MID("mmss_camss_ahb_clk", &clk_itr_length-&clk_input_length+1, &clk_input_length-1)==STRING.CUT("&clk", 1))
    ( 
      &match=1
    )
  )
  else if (&wild_tail==1)
  (
    if (STRING.MID("mmss_camss_ahb_clk", 0, &clk_input_length-1)==STRING.CUT("&clk", -1))
    ( 
      &match=1
    )
  )
  else if ("mmss_camss_ahb_clk"=="&clk")
  (
    &match=1
  )
  
  if (&match==1)
  (
    &clk_test=&CLK_TEST_MMSS_CAMSS_AHB_CLK
    &clk_reg=&HWIO_MMSS_CAMSS_AHB_CBCR_ADDR
    &clk_reg_name="MMSS_CAMSS_AHB_CBCR"
    &clk_name="mmss_camss_ahb_clk"
    &clk_reg_cbcr_type="sm_cbc"
    &clk_vote_bit=-1.
    &clk_multiplier=12.
    &clk_access_mode="&MMSS_access_mode"

    gosub Print_Clk_Info_Line
  )

  &match=0
  &wild_head=0
  &wild_tail=0
  &clk_input_length=STRING.LENGTH("&clk")
  &clk_itr_length=STRING.LENGTH("mmss_camss_cci_ahb_clk")

  if (STRING.SCAN("&clk", "*", 0)==0)
  (
    &wild_head=1
  )
  if (STRING.SCAN("&clk", "*", 1)==(STRING.LENGTH("&clk")-1))
  (
    &wild_tail=1
  )

  if ((&wild_head==1)&&(&wild_tail==1))
  (
    if (STRING.SCAN("mmss_camss_cci_ahb_clk", STRING.MID("&clk", 1, &clk_input_length-2), 0)!=-1)
    ( 
      &match=1
    )
  )
  else if (&wild_head==1)
  (
    if (STRING.MID("mmss_camss_cci_ahb_clk", &clk_itr_length-&clk_input_length+1, &clk_input_length-1)==STRING.CUT("&clk", 1))
    ( 
      &match=1
    )
  )
  else if (&wild_tail==1)
  (
    if (STRING.MID("mmss_camss_cci_ahb_clk", 0, &clk_input_length-1)==STRING.CUT("&clk", -1))
    ( 
      &match=1
    )
  )
  else if ("mmss_camss_cci_ahb_clk"=="&clk")
  (
    &match=1
  )
  
  if (&match==1)
  (
    &clk_test=&CLK_TEST_MMSS_CAMSS_CCI_AHB_CLK
    &clk_reg=&HWIO_MMSS_CAMSS_CCI_AHB_CBCR_ADDR
    &clk_reg_name="MMSS_CAMSS_CCI_AHB_CBCR"
    &clk_name="mmss_camss_cci_ahb_clk"
    &clk_reg_cbcr_type="sm_cbc"
    &clk_vote_bit=-1.
    &clk_multiplier=12.
    &clk_access_mode="&MMSS_access_mode"

    gosub Print_Clk_Info_Line
  )

  &match=0
  &wild_head=0
  &wild_tail=0
  &clk_input_length=STRING.LENGTH("&clk")
  &clk_itr_length=STRING.LENGTH("mmss_camss_cpp_ahb_clk")

  if (STRING.SCAN("&clk", "*", 0)==0)
  (
    &wild_head=1
  )
  if (STRING.SCAN("&clk", "*", 1)==(STRING.LENGTH("&clk")-1))
  (
    &wild_tail=1
  )

  if ((&wild_head==1)&&(&wild_tail==1))
  (
    if (STRING.SCAN("mmss_camss_cpp_ahb_clk", STRING.MID("&clk", 1, &clk_input_length-2), 0)!=-1)
    ( 
      &match=1
    )
  )
  else if (&wild_head==1)
  (
    if (STRING.MID("mmss_camss_cpp_ahb_clk", &clk_itr_length-&clk_input_length+1, &clk_input_length-1)==STRING.CUT("&clk", 1))
    ( 
      &match=1
    )
  )
  else if (&wild_tail==1)
  (
    if (STRING.MID("mmss_camss_cpp_ahb_clk", 0, &clk_input_length-1)==STRING.CUT("&clk", -1))
    ( 
      &match=1
    )
  )
  else if ("mmss_camss_cpp_ahb_clk"=="&clk")
  (
    &match=1
  )
  
  if (&match==1)
  (
    &clk_test=&CLK_TEST_MMSS_CAMSS_CPP_AHB_CLK
    &clk_reg=&HWIO_MMSS_CAMSS_CPP_AHB_CBCR_ADDR
    &clk_reg_name="MMSS_CAMSS_CPP_AHB_CBCR"
    &clk_name="mmss_camss_cpp_ahb_clk"
    &clk_reg_cbcr_type="sm_cbc"
    &clk_vote_bit=-1.
    &clk_multiplier=12.
    &clk_access_mode="&MMSS_access_mode"

    gosub Print_Clk_Info_Line
  )

  &match=0
  &wild_head=0
  &wild_tail=0
  &clk_input_length=STRING.LENGTH("&clk")
  &clk_itr_length=STRING.LENGTH("mmss_camss_cpp_vbif_ahb_clk")

  if (STRING.SCAN("&clk", "*", 0)==0)
  (
    &wild_head=1
  )
  if (STRING.SCAN("&clk", "*", 1)==(STRING.LENGTH("&clk")-1))
  (
    &wild_tail=1
  )

  if ((&wild_head==1)&&(&wild_tail==1))
  (
    if (STRING.SCAN("mmss_camss_cpp_vbif_ahb_clk", STRING.MID("&clk", 1, &clk_input_length-2), 0)!=-1)
    ( 
      &match=1
    )
  )
  else if (&wild_head==1)
  (
    if (STRING.MID("mmss_camss_cpp_vbif_ahb_clk", &clk_itr_length-&clk_input_length+1, &clk_input_length-1)==STRING.CUT("&clk", 1))
    ( 
      &match=1
    )
  )
  else if (&wild_tail==1)
  (
    if (STRING.MID("mmss_camss_cpp_vbif_ahb_clk", 0, &clk_input_length-1)==STRING.CUT("&clk", -1))
    ( 
      &match=1
    )
  )
  else if ("mmss_camss_cpp_vbif_ahb_clk"=="&clk")
  (
    &match=1
  )
  
  if (&match==1)
  (
    &clk_test=&CLK_TEST_MMSS_CAMSS_CPP_VBIF_AHB_CLK
    &clk_reg=&HWIO_MMSS_CAMSS_CPP_VBIF_AHB_CBCR_ADDR
    &clk_reg_name="MMSS_CAMSS_CPP_VBIF_AHB_CBCR"
    &clk_name="mmss_camss_cpp_vbif_ahb_clk"
    &clk_reg_cbcr_type="sm_cbc"
    &clk_vote_bit=-1.
    &clk_multiplier=12.
    &clk_access_mode="&MMSS_access_mode"

    gosub Print_Clk_Info_Line
  )

  &match=0
  &wild_head=0
  &wild_tail=0
  &clk_input_length=STRING.LENGTH("&clk")
  &clk_itr_length=STRING.LENGTH("mmss_camss_csi0_ahb_clk")

  if (STRING.SCAN("&clk", "*", 0)==0)
  (
    &wild_head=1
  )
  if (STRING.SCAN("&clk", "*", 1)==(STRING.LENGTH("&clk")-1))
  (
    &wild_tail=1
  )

  if ((&wild_head==1)&&(&wild_tail==1))
  (
    if (STRING.SCAN("mmss_camss_csi0_ahb_clk", STRING.MID("&clk", 1, &clk_input_length-2), 0)!=-1)
    ( 
      &match=1
    )
  )
  else if (&wild_head==1)
  (
    if (STRING.MID("mmss_camss_csi0_ahb_clk", &clk_itr_length-&clk_input_length+1, &clk_input_length-1)==STRING.CUT("&clk", 1))
    ( 
      &match=1
    )
  )
  else if (&wild_tail==1)
  (
    if (STRING.MID("mmss_camss_csi0_ahb_clk", 0, &clk_input_length-1)==STRING.CUT("&clk", -1))
    ( 
      &match=1
    )
  )
  else if ("mmss_camss_csi0_ahb_clk"=="&clk")
  (
    &match=1
  )
  
  if (&match==1)
  (
    &clk_test=&CLK_TEST_MMSS_CAMSS_CSI0_AHB_CLK
    &clk_reg=&HWIO_MMSS_CAMSS_CSI0_AHB_CBCR_ADDR
    &clk_reg_name="MMSS_CAMSS_CSI0_AHB_CBCR"
    &clk_name="mmss_camss_csi0_ahb_clk"
    &clk_reg_cbcr_type="sm_cbc"
    &clk_vote_bit=-1.
    &clk_multiplier=12.
    &clk_access_mode="&MMSS_access_mode"

    gosub Print_Clk_Info_Line
  )

  &match=0
  &wild_head=0
  &wild_tail=0
  &clk_input_length=STRING.LENGTH("&clk")
  &clk_itr_length=STRING.LENGTH("mmss_camss_csi1_ahb_clk")

  if (STRING.SCAN("&clk", "*", 0)==0)
  (
    &wild_head=1
  )
  if (STRING.SCAN("&clk", "*", 1)==(STRING.LENGTH("&clk")-1))
  (
    &wild_tail=1
  )

  if ((&wild_head==1)&&(&wild_tail==1))
  (
    if (STRING.SCAN("mmss_camss_csi1_ahb_clk", STRING.MID("&clk", 1, &clk_input_length-2), 0)!=-1)
    ( 
      &match=1
    )
  )
  else if (&wild_head==1)
  (
    if (STRING.MID("mmss_camss_csi1_ahb_clk", &clk_itr_length-&clk_input_length+1, &clk_input_length-1)==STRING.CUT("&clk", 1))
    ( 
      &match=1
    )
  )
  else if (&wild_tail==1)
  (
    if (STRING.MID("mmss_camss_csi1_ahb_clk", 0, &clk_input_length-1)==STRING.CUT("&clk", -1))
    ( 
      &match=1
    )
  )
  else if ("mmss_camss_csi1_ahb_clk"=="&clk")
  (
    &match=1
  )
  
  if (&match==1)
  (
    &clk_test=&CLK_TEST_MMSS_CAMSS_CSI1_AHB_CLK
    &clk_reg=&HWIO_MMSS_CAMSS_CSI1_AHB_CBCR_ADDR
    &clk_reg_name="MMSS_CAMSS_CSI1_AHB_CBCR"
    &clk_name="mmss_camss_csi1_ahb_clk"
    &clk_reg_cbcr_type="sm_cbc"
    &clk_vote_bit=-1.
    &clk_multiplier=12.
    &clk_access_mode="&MMSS_access_mode"

    gosub Print_Clk_Info_Line
  )

  &match=0
  &wild_head=0
  &wild_tail=0
  &clk_input_length=STRING.LENGTH("&clk")
  &clk_itr_length=STRING.LENGTH("mmss_camss_csi2_ahb_clk")

  if (STRING.SCAN("&clk", "*", 0)==0)
  (
    &wild_head=1
  )
  if (STRING.SCAN("&clk", "*", 1)==(STRING.LENGTH("&clk")-1))
  (
    &wild_tail=1
  )

  if ((&wild_head==1)&&(&wild_tail==1))
  (
    if (STRING.SCAN("mmss_camss_csi2_ahb_clk", STRING.MID("&clk", 1, &clk_input_length-2), 0)!=-1)
    ( 
      &match=1
    )
  )
  else if (&wild_head==1)
  (
    if (STRING.MID("mmss_camss_csi2_ahb_clk", &clk_itr_length-&clk_input_length+1, &clk_input_length-1)==STRING.CUT("&clk", 1))
    ( 
      &match=1
    )
  )
  else if (&wild_tail==1)
  (
    if (STRING.MID("mmss_camss_csi2_ahb_clk", 0, &clk_input_length-1)==STRING.CUT("&clk", -1))
    ( 
      &match=1
    )
  )
  else if ("mmss_camss_csi2_ahb_clk"=="&clk")
  (
    &match=1
  )
  
  if (&match==1)
  (
    &clk_test=&CLK_TEST_MMSS_CAMSS_CSI2_AHB_CLK
    &clk_reg=&HWIO_MMSS_CAMSS_CSI2_AHB_CBCR_ADDR
    &clk_reg_name="MMSS_CAMSS_CSI2_AHB_CBCR"
    &clk_name="mmss_camss_csi2_ahb_clk"
    &clk_reg_cbcr_type="sm_cbc"
    &clk_vote_bit=-1.
    &clk_multiplier=12.
    &clk_access_mode="&MMSS_access_mode"

    gosub Print_Clk_Info_Line
  )

  &match=0
  &wild_head=0
  &wild_tail=0
  &clk_input_length=STRING.LENGTH("&clk")
  &clk_itr_length=STRING.LENGTH("mmss_camss_csi3_ahb_clk")

  if (STRING.SCAN("&clk", "*", 0)==0)
  (
    &wild_head=1
  )
  if (STRING.SCAN("&clk", "*", 1)==(STRING.LENGTH("&clk")-1))
  (
    &wild_tail=1
  )

  if ((&wild_head==1)&&(&wild_tail==1))
  (
    if (STRING.SCAN("mmss_camss_csi3_ahb_clk", STRING.MID("&clk", 1, &clk_input_length-2), 0)!=-1)
    ( 
      &match=1
    )
  )
  else if (&wild_head==1)
  (
    if (STRING.MID("mmss_camss_csi3_ahb_clk", &clk_itr_length-&clk_input_length+1, &clk_input_length-1)==STRING.CUT("&clk", 1))
    ( 
      &match=1
    )
  )
  else if (&wild_tail==1)
  (
    if (STRING.MID("mmss_camss_csi3_ahb_clk", 0, &clk_input_length-1)==STRING.CUT("&clk", -1))
    ( 
      &match=1
    )
  )
  else if ("mmss_camss_csi3_ahb_clk"=="&clk")
  (
    &match=1
  )
  
  if (&match==1)
  (
    &clk_test=&CLK_TEST_MMSS_CAMSS_CSI3_AHB_CLK
    &clk_reg=&HWIO_MMSS_CAMSS_CSI3_AHB_CBCR_ADDR
    &clk_reg_name="MMSS_CAMSS_CSI3_AHB_CBCR"
    &clk_name="mmss_camss_csi3_ahb_clk"
    &clk_reg_cbcr_type="sm_cbc"
    &clk_vote_bit=-1.
    &clk_multiplier=12.
    &clk_access_mode="&MMSS_access_mode"

    gosub Print_Clk_Info_Line
  )

  &match=0
  &wild_head=0
  &wild_tail=0
  &clk_input_length=STRING.LENGTH("&clk")
  &clk_itr_length=STRING.LENGTH("mmss_camss_ispif_ahb_clk")

  if (STRING.SCAN("&clk", "*", 0)==0)
  (
    &wild_head=1
  )
  if (STRING.SCAN("&clk", "*", 1)==(STRING.LENGTH("&clk")-1))
  (
    &wild_tail=1
  )

  if ((&wild_head==1)&&(&wild_tail==1))
  (
    if (STRING.SCAN("mmss_camss_ispif_ahb_clk", STRING.MID("&clk", 1, &clk_input_length-2), 0)!=-1)
    ( 
      &match=1
    )
  )
  else if (&wild_head==1)
  (
    if (STRING.MID("mmss_camss_ispif_ahb_clk", &clk_itr_length-&clk_input_length+1, &clk_input_length-1)==STRING.CUT("&clk", 1))
    ( 
      &match=1
    )
  )
  else if (&wild_tail==1)
  (
    if (STRING.MID("mmss_camss_ispif_ahb_clk", 0, &clk_input_length-1)==STRING.CUT("&clk", -1))
    ( 
      &match=1
    )
  )
  else if ("mmss_camss_ispif_ahb_clk"=="&clk")
  (
    &match=1
  )
  
  if (&match==1)
  (
    &clk_test=&CLK_TEST_MMSS_CAMSS_ISPIF_AHB_CLK
    &clk_reg=&HWIO_MMSS_CAMSS_ISPIF_AHB_CBCR_ADDR
    &clk_reg_name="MMSS_CAMSS_ISPIF_AHB_CBCR"
    &clk_name="mmss_camss_ispif_ahb_clk"
    &clk_reg_cbcr_type="sm_cbc"
    &clk_vote_bit=-1.
    &clk_multiplier=12.
    &clk_access_mode="&MMSS_access_mode"

    gosub Print_Clk_Info_Line
  )

  &match=0
  &wild_head=0
  &wild_tail=0
  &clk_input_length=STRING.LENGTH("&clk")
  &clk_itr_length=STRING.LENGTH("mmss_camss_jpeg_ahb_clk")

  if (STRING.SCAN("&clk", "*", 0)==0)
  (
    &wild_head=1
  )
  if (STRING.SCAN("&clk", "*", 1)==(STRING.LENGTH("&clk")-1))
  (
    &wild_tail=1
  )

  if ((&wild_head==1)&&(&wild_tail==1))
  (
    if (STRING.SCAN("mmss_camss_jpeg_ahb_clk", STRING.MID("&clk", 1, &clk_input_length-2), 0)!=-1)
    ( 
      &match=1
    )
  )
  else if (&wild_head==1)
  (
    if (STRING.MID("mmss_camss_jpeg_ahb_clk", &clk_itr_length-&clk_input_length+1, &clk_input_length-1)==STRING.CUT("&clk", 1))
    ( 
      &match=1
    )
  )
  else if (&wild_tail==1)
  (
    if (STRING.MID("mmss_camss_jpeg_ahb_clk", 0, &clk_input_length-1)==STRING.CUT("&clk", -1))
    ( 
      &match=1
    )
  )
  else if ("mmss_camss_jpeg_ahb_clk"=="&clk")
  (
    &match=1
  )
  
  if (&match==1)
  (
    &clk_test=&CLK_TEST_MMSS_CAMSS_JPEG_AHB_CLK
    &clk_reg=&HWIO_MMSS_CAMSS_JPEG_AHB_CBCR_ADDR
    &clk_reg_name="MMSS_CAMSS_JPEG_AHB_CBCR"
    &clk_name="mmss_camss_jpeg_ahb_clk"
    &clk_reg_cbcr_type="sm_cbc"
    &clk_vote_bit=-1.
    &clk_multiplier=12.
    &clk_access_mode="&MMSS_access_mode"

    gosub Print_Clk_Info_Line
  )

  &match=0
  &wild_head=0
  &wild_tail=0
  &clk_input_length=STRING.LENGTH("&clk")
  &clk_itr_length=STRING.LENGTH("mmss_camss_micro_ahb_clk")

  if (STRING.SCAN("&clk", "*", 0)==0)
  (
    &wild_head=1
  )
  if (STRING.SCAN("&clk", "*", 1)==(STRING.LENGTH("&clk")-1))
  (
    &wild_tail=1
  )

  if ((&wild_head==1)&&(&wild_tail==1))
  (
    if (STRING.SCAN("mmss_camss_micro_ahb_clk", STRING.MID("&clk", 1, &clk_input_length-2), 0)!=-1)
    ( 
      &match=1
    )
  )
  else if (&wild_head==1)
  (
    if (STRING.MID("mmss_camss_micro_ahb_clk", &clk_itr_length-&clk_input_length+1, &clk_input_length-1)==STRING.CUT("&clk", 1))
    ( 
      &match=1
    )
  )
  else if (&wild_tail==1)
  (
    if (STRING.MID("mmss_camss_micro_ahb_clk", 0, &clk_input_length-1)==STRING.CUT("&clk", -1))
    ( 
      &match=1
    )
  )
  else if ("mmss_camss_micro_ahb_clk"=="&clk")
  (
    &match=1
  )
  
  if (&match==1)
  (
    &clk_test=&CLK_TEST_MMSS_CAMSS_MICRO_AHB_CLK
    &clk_reg=&HWIO_MMSS_CAMSS_MICRO_AHB_CBCR_ADDR
    &clk_reg_name="MMSS_CAMSS_MICRO_AHB_CBCR"
    &clk_name="mmss_camss_micro_ahb_clk"
    &clk_reg_cbcr_type="sm_sreg_pscbc"
    &clk_vote_bit=-1.
    &clk_multiplier=12.
    &clk_access_mode="&MMSS_access_mode"

    gosub Print_Clk_Info_Line
  )

  &match=0
  &wild_head=0
  &wild_tail=0
  &clk_input_length=STRING.LENGTH("&clk")
  &clk_itr_length=STRING.LENGTH("mmss_camss_top_ahb_clk")

  if (STRING.SCAN("&clk", "*", 0)==0)
  (
    &wild_head=1
  )
  if (STRING.SCAN("&clk", "*", 1)==(STRING.LENGTH("&clk")-1))
  (
    &wild_tail=1
  )

  if ((&wild_head==1)&&(&wild_tail==1))
  (
    if (STRING.SCAN("mmss_camss_top_ahb_clk", STRING.MID("&clk", 1, &clk_input_length-2), 0)!=-1)
    ( 
      &match=1
    )
  )
  else if (&wild_head==1)
  (
    if (STRING.MID("mmss_camss_top_ahb_clk", &clk_itr_length-&clk_input_length+1, &clk_input_length-1)==STRING.CUT("&clk", 1))
    ( 
      &match=1
    )
  )
  else if (&wild_tail==1)
  (
    if (STRING.MID("mmss_camss_top_ahb_clk", 0, &clk_input_length-1)==STRING.CUT("&clk", -1))
    ( 
      &match=1
    )
  )
  else if ("mmss_camss_top_ahb_clk"=="&clk")
  (
    &match=1
  )
  
  if (&match==1)
  (
    &clk_test=&CLK_TEST_MMSS_CAMSS_TOP_AHB_CLK
    &clk_reg=&HWIO_MMSS_CAMSS_TOP_AHB_CBCR_ADDR
    &clk_reg_name="MMSS_CAMSS_TOP_AHB_CBCR"
    &clk_name="mmss_camss_top_ahb_clk"
    &clk_reg_cbcr_type="sm_cbc"
    &clk_vote_bit=-1.
    &clk_multiplier=12.
    &clk_access_mode="&MMSS_access_mode"

    gosub Print_Clk_Info_Line
  )

  &match=0
  &wild_head=0
  &wild_tail=0
  &clk_input_length=STRING.LENGTH("&clk")
  &clk_itr_length=STRING.LENGTH("mmss_camss_vfe0_ahb_clk")

  if (STRING.SCAN("&clk", "*", 0)==0)
  (
    &wild_head=1
  )
  if (STRING.SCAN("&clk", "*", 1)==(STRING.LENGTH("&clk")-1))
  (
    &wild_tail=1
  )

  if ((&wild_head==1)&&(&wild_tail==1))
  (
    if (STRING.SCAN("mmss_camss_vfe0_ahb_clk", STRING.MID("&clk", 1, &clk_input_length-2), 0)!=-1)
    ( 
      &match=1
    )
  )
  else if (&wild_head==1)
  (
    if (STRING.MID("mmss_camss_vfe0_ahb_clk", &clk_itr_length-&clk_input_length+1, &clk_input_length-1)==STRING.CUT("&clk", 1))
    ( 
      &match=1
    )
  )
  else if (&wild_tail==1)
  (
    if (STRING.MID("mmss_camss_vfe0_ahb_clk", 0, &clk_input_length-1)==STRING.CUT("&clk", -1))
    ( 
      &match=1
    )
  )
  else if ("mmss_camss_vfe0_ahb_clk"=="&clk")
  (
    &match=1
  )
  
  if (&match==1)
  (
    &clk_test=&CLK_TEST_MMSS_CAMSS_VFE0_AHB_CLK
    &clk_reg=&HWIO_MMSS_CAMSS_VFE0_AHB_CBCR_ADDR
    &clk_reg_name="MMSS_CAMSS_VFE0_AHB_CBCR"
    &clk_name="mmss_camss_vfe0_ahb_clk"
    &clk_reg_cbcr_type="sm_cbc"
    &clk_vote_bit=-1.
    &clk_multiplier=12.
    &clk_access_mode="&MMSS_access_mode"

    gosub Print_Clk_Info_Line
  )

  &match=0
  &wild_head=0
  &wild_tail=0
  &clk_input_length=STRING.LENGTH("&clk")
  &clk_itr_length=STRING.LENGTH("mmss_camss_vfe1_ahb_clk")

  if (STRING.SCAN("&clk", "*", 0)==0)
  (
    &wild_head=1
  )
  if (STRING.SCAN("&clk", "*", 1)==(STRING.LENGTH("&clk")-1))
  (
    &wild_tail=1
  )

  if ((&wild_head==1)&&(&wild_tail==1))
  (
    if (STRING.SCAN("mmss_camss_vfe1_ahb_clk", STRING.MID("&clk", 1, &clk_input_length-2), 0)!=-1)
    ( 
      &match=1
    )
  )
  else if (&wild_head==1)
  (
    if (STRING.MID("mmss_camss_vfe1_ahb_clk", &clk_itr_length-&clk_input_length+1, &clk_input_length-1)==STRING.CUT("&clk", 1))
    ( 
      &match=1
    )
  )
  else if (&wild_tail==1)
  (
    if (STRING.MID("mmss_camss_vfe1_ahb_clk", 0, &clk_input_length-1)==STRING.CUT("&clk", -1))
    ( 
      &match=1
    )
  )
  else if ("mmss_camss_vfe1_ahb_clk"=="&clk")
  (
    &match=1
  )
  
  if (&match==1)
  (
    &clk_test=&CLK_TEST_MMSS_CAMSS_VFE1_AHB_CLK
    &clk_reg=&HWIO_MMSS_CAMSS_VFE1_AHB_CBCR_ADDR
    &clk_reg_name="MMSS_CAMSS_VFE1_AHB_CBCR"
    &clk_name="mmss_camss_vfe1_ahb_clk"
    &clk_reg_cbcr_type="sm_cbc"
    &clk_vote_bit=-1.
    &clk_multiplier=12.
    &clk_access_mode="&MMSS_access_mode"

    gosub Print_Clk_Info_Line
  )

  &match=0
  &wild_head=0
  &wild_tail=0
  &clk_input_length=STRING.LENGTH("&clk")
  &clk_itr_length=STRING.LENGTH("mmss_camss_vfe_vbif_ahb_clk")

  if (STRING.SCAN("&clk", "*", 0)==0)
  (
    &wild_head=1
  )
  if (STRING.SCAN("&clk", "*", 1)==(STRING.LENGTH("&clk")-1))
  (
    &wild_tail=1
  )

  if ((&wild_head==1)&&(&wild_tail==1))
  (
    if (STRING.SCAN("mmss_camss_vfe_vbif_ahb_clk", STRING.MID("&clk", 1, &clk_input_length-2), 0)!=-1)
    ( 
      &match=1
    )
  )
  else if (&wild_head==1)
  (
    if (STRING.MID("mmss_camss_vfe_vbif_ahb_clk", &clk_itr_length-&clk_input_length+1, &clk_input_length-1)==STRING.CUT("&clk", 1))
    ( 
      &match=1
    )
  )
  else if (&wild_tail==1)
  (
    if (STRING.MID("mmss_camss_vfe_vbif_ahb_clk", 0, &clk_input_length-1)==STRING.CUT("&clk", -1))
    ( 
      &match=1
    )
  )
  else if ("mmss_camss_vfe_vbif_ahb_clk"=="&clk")
  (
    &match=1
  )
  
  if (&match==1)
  (
    &clk_test=&CLK_TEST_MMSS_CAMSS_VFE_VBIF_AHB_CLK
    &clk_reg=&HWIO_MMSS_CAMSS_VFE_VBIF_AHB_CBCR_ADDR
    &clk_reg_name="MMSS_CAMSS_VFE_VBIF_AHB_CBCR"
    &clk_name="mmss_camss_vfe_vbif_ahb_clk"
    &clk_reg_cbcr_type="sm_cbc"
    &clk_vote_bit=-1.
    &clk_multiplier=12.
    &clk_access_mode="&MMSS_access_mode"

    gosub Print_Clk_Info_Line
  )

  &match=0
  &wild_head=0
  &wild_tail=0
  &clk_input_length=STRING.LENGTH("&clk")
  &clk_itr_length=STRING.LENGTH("mmss_csiphy_ahb2crif_clk")

  if (STRING.SCAN("&clk", "*", 0)==0)
  (
    &wild_head=1
  )
  if (STRING.SCAN("&clk", "*", 1)==(STRING.LENGTH("&clk")-1))
  (
    &wild_tail=1
  )

  if ((&wild_head==1)&&(&wild_tail==1))
  (
    if (STRING.SCAN("mmss_csiphy_ahb2crif_clk", STRING.MID("&clk", 1, &clk_input_length-2), 0)!=-1)
    ( 
      &match=1
    )
  )
  else if (&wild_head==1)
  (
    if (STRING.MID("mmss_csiphy_ahb2crif_clk", &clk_itr_length-&clk_input_length+1, &clk_input_length-1)==STRING.CUT("&clk", 1))
    ( 
      &match=1
    )
  )
  else if (&wild_tail==1)
  (
    if (STRING.MID("mmss_csiphy_ahb2crif_clk", 0, &clk_input_length-1)==STRING.CUT("&clk", -1))
    ( 
      &match=1
    )
  )
  else if ("mmss_csiphy_ahb2crif_clk"=="&clk")
  (
    &match=1
  )
  
  if (&match==1)
  (
    &clk_test=&CLK_TEST_MMSS_CSIPHY_AHB2CRIF_CLK
    &clk_reg=&HWIO_MMSS_CSIPHY_AHB2CRIF_CBCR_ADDR
    &clk_reg_name="MMSS_CSIPHY_AHB2CRIF_CBCR"
    &clk_name="mmss_csiphy_ahb2crif_clk"
    &clk_reg_cbcr_type="sm_cbc"
    &clk_vote_bit=-1.
    &clk_multiplier=12.
    &clk_access_mode="&MMSS_access_mode"

    gosub Print_Clk_Info_Line
  )

  &match=0
  &wild_head=0
  &wild_tail=0
  &clk_input_length=STRING.LENGTH("&clk")
  &clk_itr_length=STRING.LENGTH("mmss_mdss_ahb_clk")

  if (STRING.SCAN("&clk", "*", 0)==0)
  (
    &wild_head=1
  )
  if (STRING.SCAN("&clk", "*", 1)==(STRING.LENGTH("&clk")-1))
  (
    &wild_tail=1
  )

  if ((&wild_head==1)&&(&wild_tail==1))
  (
    if (STRING.SCAN("mmss_mdss_ahb_clk", STRING.MID("&clk", 1, &clk_input_length-2), 0)!=-1)
    ( 
      &match=1
    )
  )
  else if (&wild_head==1)
  (
    if (STRING.MID("mmss_mdss_ahb_clk", &clk_itr_length-&clk_input_length+1, &clk_input_length-1)==STRING.CUT("&clk", 1))
    ( 
      &match=1
    )
  )
  else if (&wild_tail==1)
  (
    if (STRING.MID("mmss_mdss_ahb_clk", 0, &clk_input_length-1)==STRING.CUT("&clk", -1))
    ( 
      &match=1
    )
  )
  else if ("mmss_mdss_ahb_clk"=="&clk")
  (
    &match=1
  )
  
  if (&match==1)
  (
    &clk_test=&CLK_TEST_MMSS_MDSS_AHB_CLK
    &clk_reg=&HWIO_MMSS_MDSS_AHB_CBCR_ADDR
    &clk_reg_name="MMSS_MDSS_AHB_CBCR"
    &clk_name="mmss_mdss_ahb_clk"
    &clk_reg_cbcr_type="sm_cbc"
    &clk_vote_bit=-1.
    &clk_multiplier=12.
    &clk_access_mode="&MMSS_access_mode"

    gosub Print_Clk_Info_Line
  )

  &match=0
  &wild_head=0
  &wild_tail=0
  &clk_input_length=STRING.LENGTH("&clk")
  &clk_itr_length=STRING.LENGTH("mmss_mdss_hdmi_dp_ahb_clk")

  if (STRING.SCAN("&clk", "*", 0)==0)
  (
    &wild_head=1
  )
  if (STRING.SCAN("&clk", "*", 1)==(STRING.LENGTH("&clk")-1))
  (
    &wild_tail=1
  )

  if ((&wild_head==1)&&(&wild_tail==1))
  (
    if (STRING.SCAN("mmss_mdss_hdmi_dp_ahb_clk", STRING.MID("&clk", 1, &clk_input_length-2), 0)!=-1)
    ( 
      &match=1
    )
  )
  else if (&wild_head==1)
  (
    if (STRING.MID("mmss_mdss_hdmi_dp_ahb_clk", &clk_itr_length-&clk_input_length+1, &clk_input_length-1)==STRING.CUT("&clk", 1))
    ( 
      &match=1
    )
  )
  else if (&wild_tail==1)
  (
    if (STRING.MID("mmss_mdss_hdmi_dp_ahb_clk", 0, &clk_input_length-1)==STRING.CUT("&clk", -1))
    ( 
      &match=1
    )
  )
  else if ("mmss_mdss_hdmi_dp_ahb_clk"=="&clk")
  (
    &match=1
  )
  
  if (&match==1)
  (
    &clk_test=&CLK_TEST_MMSS_MDSS_HDMI_DP_AHB_CLK
    &clk_reg=&HWIO_MMSS_MDSS_HDMI_DP_AHB_CBCR_ADDR
    &clk_reg_name="MMSS_MDSS_HDMI_DP_AHB_CBCR"
    &clk_name="mmss_mdss_hdmi_dp_ahb_clk"
    &clk_reg_cbcr_type="sm_cbc"
    &clk_vote_bit=-1.
    &clk_multiplier=12.
    &clk_access_mode="&MMSS_access_mode"

    gosub Print_Clk_Info_Line
  )

  &match=0
  &wild_head=0
  &wild_tail=0
  &clk_input_length=STRING.LENGTH("&clk")
  &clk_itr_length=STRING.LENGTH("mmss_misc_ahb_clk")

  if (STRING.SCAN("&clk", "*", 0)==0)
  (
    &wild_head=1
  )
  if (STRING.SCAN("&clk", "*", 1)==(STRING.LENGTH("&clk")-1))
  (
    &wild_tail=1
  )

  if ((&wild_head==1)&&(&wild_tail==1))
  (
    if (STRING.SCAN("mmss_misc_ahb_clk", STRING.MID("&clk", 1, &clk_input_length-2), 0)!=-1)
    ( 
      &match=1
    )
  )
  else if (&wild_head==1)
  (
    if (STRING.MID("mmss_misc_ahb_clk", &clk_itr_length-&clk_input_length+1, &clk_input_length-1)==STRING.CUT("&clk", 1))
    ( 
      &match=1
    )
  )
  else if (&wild_tail==1)
  (
    if (STRING.MID("mmss_misc_ahb_clk", 0, &clk_input_length-1)==STRING.CUT("&clk", -1))
    ( 
      &match=1
    )
  )
  else if ("mmss_misc_ahb_clk"=="&clk")
  (
    &match=1
  )
  
  if (&match==1)
  (
    &clk_test=&CLK_TEST_MMSS_MISC_AHB_CLK
    &clk_reg=&HWIO_MMSS_MISC_AHB_CBCR_ADDR
    &clk_reg_name="MMSS_MISC_AHB_CBCR"
    &clk_name="mmss_misc_ahb_clk"
    &clk_reg_cbcr_type="sm_cbc"
    &clk_vote_bit=-1.
    &clk_multiplier=12.
    &clk_access_mode="&MMSS_access_mode"

    gosub Print_Clk_Info_Line
  )

  &match=0
  &wild_head=0
  &wild_tail=0
  &clk_input_length=STRING.LENGTH("&clk")
  &clk_itr_length=STRING.LENGTH("mmss_mnoc_ahb_clk")

  if (STRING.SCAN("&clk", "*", 0)==0)
  (
    &wild_head=1
  )
  if (STRING.SCAN("&clk", "*", 1)==(STRING.LENGTH("&clk")-1))
  (
    &wild_tail=1
  )

  if ((&wild_head==1)&&(&wild_tail==1))
  (
    if (STRING.SCAN("mmss_mnoc_ahb_clk", STRING.MID("&clk", 1, &clk_input_length-2), 0)!=-1)
    ( 
      &match=1
    )
  )
  else if (&wild_head==1)
  (
    if (STRING.MID("mmss_mnoc_ahb_clk", &clk_itr_length-&clk_input_length+1, &clk_input_length-1)==STRING.CUT("&clk", 1))
    ( 
      &match=1
    )
  )
  else if (&wild_tail==1)
  (
    if (STRING.MID("mmss_mnoc_ahb_clk", 0, &clk_input_length-1)==STRING.CUT("&clk", -1))
    ( 
      &match=1
    )
  )
  else if ("mmss_mnoc_ahb_clk"=="&clk")
  (
    &match=1
  )
  
  if (&match==1)
  (
    &clk_test=&CLK_TEST_MMSS_MNOC_AHB_CLK
    &clk_reg=&HWIO_MMSS_MNOC_AHB_CBCR_ADDR
    &clk_reg_name="MMSS_MNOC_AHB_CBCR"
    &clk_name="mmss_mnoc_ahb_clk"
    &clk_reg_cbcr_type="sm_cbc"
    &clk_vote_bit=-1.
    &clk_multiplier=12.
    &clk_access_mode="&MMSS_access_mode"

    gosub Print_Clk_Info_Line
  )

  &match=0
  &wild_head=0
  &wild_tail=0
  &clk_input_length=STRING.LENGTH("&clk")
  &clk_itr_length=STRING.LENGTH("mmss_spdm_ahb_clk")

  if (STRING.SCAN("&clk", "*", 0)==0)
  (
    &wild_head=1
  )
  if (STRING.SCAN("&clk", "*", 1)==(STRING.LENGTH("&clk")-1))
  (
    &wild_tail=1
  )

  if ((&wild_head==1)&&(&wild_tail==1))
  (
    if (STRING.SCAN("mmss_spdm_ahb_clk", STRING.MID("&clk", 1, &clk_input_length-2), 0)!=-1)
    ( 
      &match=1
    )
  )
  else if (&wild_head==1)
  (
    if (STRING.MID("mmss_spdm_ahb_clk", &clk_itr_length-&clk_input_length+1, &clk_input_length-1)==STRING.CUT("&clk", 1))
    ( 
      &match=1
    )
  )
  else if (&wild_tail==1)
  (
    if (STRING.MID("mmss_spdm_ahb_clk", 0, &clk_input_length-1)==STRING.CUT("&clk", -1))
    ( 
      &match=1
    )
  )
  else if ("mmss_spdm_ahb_clk"=="&clk")
  (
    &match=1
  )
  
  if (&match==1)
  (
    &clk_test=&CLK_TEST_MMSS_SPDM_AHB_CLK
    &clk_reg=&HWIO_MMSS_SPDM_AHB_CBCR_ADDR
    &clk_reg_name="MMSS_SPDM_AHB_CBCR"
    &clk_name="mmss_spdm_ahb_clk"
    &clk_reg_cbcr_type="sm_cbc"
    &clk_vote_bit=-1.
    &clk_multiplier=12.
    &clk_access_mode="&MMSS_access_mode"

    gosub Print_Clk_Info_Line
  )

  &match=0
  &wild_head=0
  &wild_tail=0
  &clk_input_length=STRING.LENGTH("&clk")
  &clk_itr_length=STRING.LENGTH("mmss_throttle_camss_ahb_clk")

  if (STRING.SCAN("&clk", "*", 0)==0)
  (
    &wild_head=1
  )
  if (STRING.SCAN("&clk", "*", 1)==(STRING.LENGTH("&clk")-1))
  (
    &wild_tail=1
  )

  if ((&wild_head==1)&&(&wild_tail==1))
  (
    if (STRING.SCAN("mmss_throttle_camss_ahb_clk", STRING.MID("&clk", 1, &clk_input_length-2), 0)!=-1)
    ( 
      &match=1
    )
  )
  else if (&wild_head==1)
  (
    if (STRING.MID("mmss_throttle_camss_ahb_clk", &clk_itr_length-&clk_input_length+1, &clk_input_length-1)==STRING.CUT("&clk", 1))
    ( 
      &match=1
    )
  )
  else if (&wild_tail==1)
  (
    if (STRING.MID("mmss_throttle_camss_ahb_clk", 0, &clk_input_length-1)==STRING.CUT("&clk", -1))
    ( 
      &match=1
    )
  )
  else if ("mmss_throttle_camss_ahb_clk"=="&clk")
  (
    &match=1
  )
  
  if (&match==1)
  (
    &clk_test=&CLK_TEST_MMSS_THROTTLE_CAMSS_AHB_CLK
    &clk_reg=&HWIO_MMSS_THROTTLE_CAMSS_AHB_CBCR_ADDR
    &clk_reg_name="MMSS_THROTTLE_CAMSS_AHB_CBCR"
    &clk_name="mmss_throttle_camss_ahb_clk"
    &clk_reg_cbcr_type="sm_cbc"
    &clk_vote_bit=-1.
    &clk_multiplier=12.
    &clk_access_mode="&MMSS_access_mode"

    gosub Print_Clk_Info_Line
  )

  &match=0
  &wild_head=0
  &wild_tail=0
  &clk_input_length=STRING.LENGTH("&clk")
  &clk_itr_length=STRING.LENGTH("mmss_throttle_mdss_ahb_clk")

  if (STRING.SCAN("&clk", "*", 0)==0)
  (
    &wild_head=1
  )
  if (STRING.SCAN("&clk", "*", 1)==(STRING.LENGTH("&clk")-1))
  (
    &wild_tail=1
  )

  if ((&wild_head==1)&&(&wild_tail==1))
  (
    if (STRING.SCAN("mmss_throttle_mdss_ahb_clk", STRING.MID("&clk", 1, &clk_input_length-2), 0)!=-1)
    ( 
      &match=1
    )
  )
  else if (&wild_head==1)
  (
    if (STRING.MID("mmss_throttle_mdss_ahb_clk", &clk_itr_length-&clk_input_length+1, &clk_input_length-1)==STRING.CUT("&clk", 1))
    ( 
      &match=1
    )
  )
  else if (&wild_tail==1)
  (
    if (STRING.MID("mmss_throttle_mdss_ahb_clk", 0, &clk_input_length-1)==STRING.CUT("&clk", -1))
    ( 
      &match=1
    )
  )
  else if ("mmss_throttle_mdss_ahb_clk"=="&clk")
  (
    &match=1
  )
  
  if (&match==1)
  (
    &clk_test=&CLK_TEST_MMSS_THROTTLE_MDSS_AHB_CLK
    &clk_reg=&HWIO_MMSS_THROTTLE_MDSS_AHB_CBCR_ADDR
    &clk_reg_name="MMSS_THROTTLE_MDSS_AHB_CBCR"
    &clk_name="mmss_throttle_mdss_ahb_clk"
    &clk_reg_cbcr_type="sm_cbc"
    &clk_vote_bit=-1.
    &clk_multiplier=12.
    &clk_access_mode="&MMSS_access_mode"

    gosub Print_Clk_Info_Line
  )

  &match=0
  &wild_head=0
  &wild_tail=0
  &clk_input_length=STRING.LENGTH("&clk")
  &clk_itr_length=STRING.LENGTH("mmss_throttle_video_ahb_clk")

  if (STRING.SCAN("&clk", "*", 0)==0)
  (
    &wild_head=1
  )
  if (STRING.SCAN("&clk", "*", 1)==(STRING.LENGTH("&clk")-1))
  (
    &wild_tail=1
  )

  if ((&wild_head==1)&&(&wild_tail==1))
  (
    if (STRING.SCAN("mmss_throttle_video_ahb_clk", STRING.MID("&clk", 1, &clk_input_length-2), 0)!=-1)
    ( 
      &match=1
    )
  )
  else if (&wild_head==1)
  (
    if (STRING.MID("mmss_throttle_video_ahb_clk", &clk_itr_length-&clk_input_length+1, &clk_input_length-1)==STRING.CUT("&clk", 1))
    ( 
      &match=1
    )
  )
  else if (&wild_tail==1)
  (
    if (STRING.MID("mmss_throttle_video_ahb_clk", 0, &clk_input_length-1)==STRING.CUT("&clk", -1))
    ( 
      &match=1
    )
  )
  else if ("mmss_throttle_video_ahb_clk"=="&clk")
  (
    &match=1
  )
  
  if (&match==1)
  (
    &clk_test=&CLK_TEST_MMSS_THROTTLE_VIDEO_AHB_CLK
    &clk_reg=&HWIO_MMSS_THROTTLE_VIDEO_AHB_CBCR_ADDR
    &clk_reg_name="MMSS_THROTTLE_VIDEO_AHB_CBCR"
    &clk_name="mmss_throttle_video_ahb_clk"
    &clk_reg_cbcr_type="sm_cbc"
    &clk_vote_bit=-1.
    &clk_multiplier=12.
    &clk_access_mode="&MMSS_access_mode"

    gosub Print_Clk_Info_Line
  )

  &match=0
  &wild_head=0
  &wild_tail=0
  &clk_input_length=STRING.LENGTH("&clk")
  &clk_itr_length=STRING.LENGTH("mmss_video_ahb_clk")

  if (STRING.SCAN("&clk", "*", 0)==0)
  (
    &wild_head=1
  )
  if (STRING.SCAN("&clk", "*", 1)==(STRING.LENGTH("&clk")-1))
  (
    &wild_tail=1
  )

  if ((&wild_head==1)&&(&wild_tail==1))
  (
    if (STRING.SCAN("mmss_video_ahb_clk", STRING.MID("&clk", 1, &clk_input_length-2), 0)!=-1)
    ( 
      &match=1
    )
  )
  else if (&wild_head==1)
  (
    if (STRING.MID("mmss_video_ahb_clk", &clk_itr_length-&clk_input_length+1, &clk_input_length-1)==STRING.CUT("&clk", 1))
    ( 
      &match=1
    )
  )
  else if (&wild_tail==1)
  (
    if (STRING.MID("mmss_video_ahb_clk", 0, &clk_input_length-1)==STRING.CUT("&clk", -1))
    ( 
      &match=1
    )
  )
  else if ("mmss_video_ahb_clk"=="&clk")
  (
    &match=1
  )
  
  if (&match==1)
  (
    &clk_test=&CLK_TEST_MMSS_VIDEO_AHB_CLK
    &clk_reg=&HWIO_MMSS_VIDEO_AHB_CBCR_ADDR
    &clk_reg_name="MMSS_VIDEO_AHB_CBCR"
    &clk_name="mmss_video_ahb_clk"
    &clk_reg_cbcr_type="sm_cbc"
    &clk_vote_bit=-1.
    &clk_multiplier=12.
    &clk_access_mode="&MMSS_access_mode"

    gosub Print_Clk_Info_Line
  )

  &match=0
  &wild_head=0
  &wild_tail=0
  &clk_input_length=STRING.LENGTH("&clk")
  &clk_itr_length=STRING.LENGTH("mmss_bimc_smmu_axi_clk")

  if (STRING.SCAN("&clk", "*", 0)==0)
  (
    &wild_head=1
  )
  if (STRING.SCAN("&clk", "*", 1)==(STRING.LENGTH("&clk")-1))
  (
    &wild_tail=1
  )

  if ((&wild_head==1)&&(&wild_tail==1))
  (
    if (STRING.SCAN("mmss_bimc_smmu_axi_clk", STRING.MID("&clk", 1, &clk_input_length-2), 0)!=-1)
    ( 
      &match=1
    )
  )
  else if (&wild_head==1)
  (
    if (STRING.MID("mmss_bimc_smmu_axi_clk", &clk_itr_length-&clk_input_length+1, &clk_input_length-1)==STRING.CUT("&clk", 1))
    ( 
      &match=1
    )
  )
  else if (&wild_tail==1)
  (
    if (STRING.MID("mmss_bimc_smmu_axi_clk", 0, &clk_input_length-1)==STRING.CUT("&clk", -1))
    ( 
      &match=1
    )
  )
  else if ("mmss_bimc_smmu_axi_clk"=="&clk")
  (
    &match=1
  )
  
  if (&match==1)
  (
    &clk_test=&CLK_TEST_MMSS_BIMC_SMMU_AXI_CLK
    &clk_reg=&HWIO_MMSS_BIMC_SMMU_AXI_CBCR_ADDR
    &clk_reg_name="MMSS_BIMC_SMMU_AXI_CBCR"
    &clk_name="mmss_bimc_smmu_axi_clk"
    &clk_reg_cbcr_type="sm_pscbc"
    &clk_vote_bit=-1.
    &clk_multiplier=12.
    &clk_access_mode="&MMSS_access_mode"

    gosub Print_Clk_Info_Line
  )

  &match=0
  &wild_head=0
  &wild_tail=0
  &clk_input_length=STRING.LENGTH("&clk")
  &clk_itr_length=STRING.LENGTH("mmss_camss_cpp_axi_clk")

  if (STRING.SCAN("&clk", "*", 0)==0)
  (
    &wild_head=1
  )
  if (STRING.SCAN("&clk", "*", 1)==(STRING.LENGTH("&clk")-1))
  (
    &wild_tail=1
  )

  if ((&wild_head==1)&&(&wild_tail==1))
  (
    if (STRING.SCAN("mmss_camss_cpp_axi_clk", STRING.MID("&clk", 1, &clk_input_length-2), 0)!=-1)
    ( 
      &match=1
    )
  )
  else if (&wild_head==1)
  (
    if (STRING.MID("mmss_camss_cpp_axi_clk", &clk_itr_length-&clk_input_length+1, &clk_input_length-1)==STRING.CUT("&clk", 1))
    ( 
      &match=1
    )
  )
  else if (&wild_tail==1)
  (
    if (STRING.MID("mmss_camss_cpp_axi_clk", 0, &clk_input_length-1)==STRING.CUT("&clk", -1))
    ( 
      &match=1
    )
  )
  else if ("mmss_camss_cpp_axi_clk"=="&clk")
  (
    &match=1
  )
  
  if (&match==1)
  (
    &clk_test=&CLK_TEST_MMSS_CAMSS_CPP_AXI_CLK
    &clk_reg=&HWIO_MMSS_CAMSS_CPP_AXI_CBCR_ADDR
    &clk_reg_name="MMSS_CAMSS_CPP_AXI_CBCR"
    &clk_name="mmss_camss_cpp_axi_clk"
    &clk_reg_cbcr_type="sm_sreg_pscbc"
    &clk_vote_bit=-1.
    &clk_multiplier=12.
    &clk_access_mode="&MMSS_access_mode"

    gosub Print_Clk_Info_Line
  )

  &match=0
  &wild_head=0
  &wild_tail=0
  &clk_input_length=STRING.LENGTH("&clk")
  &clk_itr_length=STRING.LENGTH("mmss_camss_jpeg_axi_clk")

  if (STRING.SCAN("&clk", "*", 0)==0)
  (
    &wild_head=1
  )
  if (STRING.SCAN("&clk", "*", 1)==(STRING.LENGTH("&clk")-1))
  (
    &wild_tail=1
  )

  if ((&wild_head==1)&&(&wild_tail==1))
  (
    if (STRING.SCAN("mmss_camss_jpeg_axi_clk", STRING.MID("&clk", 1, &clk_input_length-2), 0)!=-1)
    ( 
      &match=1
    )
  )
  else if (&wild_head==1)
  (
    if (STRING.MID("mmss_camss_jpeg_axi_clk", &clk_itr_length-&clk_input_length+1, &clk_input_length-1)==STRING.CUT("&clk", 1))
    ( 
      &match=1
    )
  )
  else if (&wild_tail==1)
  (
    if (STRING.MID("mmss_camss_jpeg_axi_clk", 0, &clk_input_length-1)==STRING.CUT("&clk", -1))
    ( 
      &match=1
    )
  )
  else if ("mmss_camss_jpeg_axi_clk"=="&clk")
  (
    &match=1
  )
  
  if (&match==1)
  (
    &clk_test=&CLK_TEST_MMSS_CAMSS_JPEG_AXI_CLK
    &clk_reg=&HWIO_MMSS_CAMSS_JPEG_AXI_CBCR_ADDR
    &clk_reg_name="MMSS_CAMSS_JPEG_AXI_CBCR"
    &clk_name="mmss_camss_jpeg_axi_clk"
    &clk_reg_cbcr_type="sm_sreg_pscbc"
    &clk_vote_bit=-1.
    &clk_multiplier=12.
    &clk_access_mode="&MMSS_access_mode"

    gosub Print_Clk_Info_Line
  )

  &match=0
  &wild_head=0
  &wild_tail=0
  &clk_input_length=STRING.LENGTH("&clk")
  &clk_itr_length=STRING.LENGTH("mmss_camss_vfe_vbif_axi_clk")

  if (STRING.SCAN("&clk", "*", 0)==0)
  (
    &wild_head=1
  )
  if (STRING.SCAN("&clk", "*", 1)==(STRING.LENGTH("&clk")-1))
  (
    &wild_tail=1
  )

  if ((&wild_head==1)&&(&wild_tail==1))
  (
    if (STRING.SCAN("mmss_camss_vfe_vbif_axi_clk", STRING.MID("&clk", 1, &clk_input_length-2), 0)!=-1)
    ( 
      &match=1
    )
  )
  else if (&wild_head==1)
  (
    if (STRING.MID("mmss_camss_vfe_vbif_axi_clk", &clk_itr_length-&clk_input_length+1, &clk_input_length-1)==STRING.CUT("&clk", 1))
    ( 
      &match=1
    )
  )
  else if (&wild_tail==1)
  (
    if (STRING.MID("mmss_camss_vfe_vbif_axi_clk", 0, &clk_input_length-1)==STRING.CUT("&clk", -1))
    ( 
      &match=1
    )
  )
  else if ("mmss_camss_vfe_vbif_axi_clk"=="&clk")
  (
    &match=1
  )
  
  if (&match==1)
  (
    &clk_test=&CLK_TEST_MMSS_CAMSS_VFE_VBIF_AXI_CLK
    &clk_reg=&HWIO_MMSS_CAMSS_VFE_VBIF_AXI_CBCR_ADDR
    &clk_reg_name="MMSS_CAMSS_VFE_VBIF_AXI_CBCR"
    &clk_name="mmss_camss_vfe_vbif_axi_clk"
    &clk_reg_cbcr_type="sm_sreg_pscbc"
    &clk_vote_bit=-1.
    &clk_multiplier=12.
    &clk_access_mode="&MMSS_access_mode"

    gosub Print_Clk_Info_Line
  )

  &match=0
  &wild_head=0
  &wild_tail=0
  &clk_input_length=STRING.LENGTH("&clk")
  &clk_itr_length=STRING.LENGTH("mmss_mdss_axi_clk")

  if (STRING.SCAN("&clk", "*", 0)==0)
  (
    &wild_head=1
  )
  if (STRING.SCAN("&clk", "*", 1)==(STRING.LENGTH("&clk")-1))
  (
    &wild_tail=1
  )

  if ((&wild_head==1)&&(&wild_tail==1))
  (
    if (STRING.SCAN("mmss_mdss_axi_clk", STRING.MID("&clk", 1, &clk_input_length-2), 0)!=-1)
    ( 
      &match=1
    )
  )
  else if (&wild_head==1)
  (
    if (STRING.MID("mmss_mdss_axi_clk", &clk_itr_length-&clk_input_length+1, &clk_input_length-1)==STRING.CUT("&clk", 1))
    ( 
      &match=1
    )
  )
  else if (&wild_tail==1)
  (
    if (STRING.MID("mmss_mdss_axi_clk", 0, &clk_input_length-1)==STRING.CUT("&clk", -1))
    ( 
      &match=1
    )
  )
  else if ("mmss_mdss_axi_clk"=="&clk")
  (
    &match=1
  )
  
  if (&match==1)
  (
    &clk_test=&CLK_TEST_MMSS_MDSS_AXI_CLK
    &clk_reg=&HWIO_MMSS_MDSS_AXI_CBCR_ADDR
    &clk_reg_name="MMSS_MDSS_AXI_CBCR"
    &clk_name="mmss_mdss_axi_clk"
    &clk_reg_cbcr_type="sm_sreg_pscbc"
    &clk_vote_bit=-1.
    &clk_multiplier=12.
    &clk_access_mode="&MMSS_access_mode"

    gosub Print_Clk_Info_Line
  )

  &match=0
  &wild_head=0
  &wild_tail=0
  &clk_input_length=STRING.LENGTH("&clk")
  &clk_itr_length=STRING.LENGTH("mmss_mnoc_axi_clk")

  if (STRING.SCAN("&clk", "*", 0)==0)
  (
    &wild_head=1
  )
  if (STRING.SCAN("&clk", "*", 1)==(STRING.LENGTH("&clk")-1))
  (
    &wild_tail=1
  )

  if ((&wild_head==1)&&(&wild_tail==1))
  (
    if (STRING.SCAN("mmss_mnoc_axi_clk", STRING.MID("&clk", 1, &clk_input_length-2), 0)!=-1)
    ( 
      &match=1
    )
  )
  else if (&wild_head==1)
  (
    if (STRING.MID("mmss_mnoc_axi_clk", &clk_itr_length-&clk_input_length+1, &clk_input_length-1)==STRING.CUT("&clk", 1))
    ( 
      &match=1
    )
  )
  else if (&wild_tail==1)
  (
    if (STRING.MID("mmss_mnoc_axi_clk", 0, &clk_input_length-1)==STRING.CUT("&clk", -1))
    ( 
      &match=1
    )
  )
  else if ("mmss_mnoc_axi_clk"=="&clk")
  (
    &match=1
  )
  
  if (&match==1)
  (
    &clk_test=&CLK_TEST_MMSS_MNOC_AXI_CLK
    &clk_reg=&HWIO_MMSS_MNOC_AXI_CBCR_ADDR
    &clk_reg_name="MMSS_MNOC_AXI_CBCR"
    &clk_name="mmss_mnoc_axi_clk"
    &clk_reg_cbcr_type="sm_cbc"
    &clk_vote_bit=-1.
    &clk_multiplier=12.
    &clk_access_mode="&MMSS_access_mode"

    gosub Print_Clk_Info_Line
  )

  &match=0
  &wild_head=0
  &wild_tail=0
  &clk_input_length=STRING.LENGTH("&clk")
  &clk_itr_length=STRING.LENGTH("mmss_s0_axi_clk")

  if (STRING.SCAN("&clk", "*", 0)==0)
  (
    &wild_head=1
  )
  if (STRING.SCAN("&clk", "*", 1)==(STRING.LENGTH("&clk")-1))
  (
    &wild_tail=1
  )

  if ((&wild_head==1)&&(&wild_tail==1))
  (
    if (STRING.SCAN("mmss_s0_axi_clk", STRING.MID("&clk", 1, &clk_input_length-2), 0)!=-1)
    ( 
      &match=1
    )
  )
  else if (&wild_head==1)
  (
    if (STRING.MID("mmss_s0_axi_clk", &clk_itr_length-&clk_input_length+1, &clk_input_length-1)==STRING.CUT("&clk", 1))
    ( 
      &match=1
    )
  )
  else if (&wild_tail==1)
  (
    if (STRING.MID("mmss_s0_axi_clk", 0, &clk_input_length-1)==STRING.CUT("&clk", -1))
    ( 
      &match=1
    )
  )
  else if ("mmss_s0_axi_clk"=="&clk")
  (
    &match=1
  )
  
  if (&match==1)
  (
    &clk_test=&CLK_TEST_MMSS_S0_AXI_CLK
    &clk_reg=&HWIO_MMSS_S0_AXI_CBCR_ADDR
    &clk_reg_name="MMSS_S0_AXI_CBCR"
    &clk_name="mmss_s0_axi_clk"
    &clk_reg_cbcr_type="sm_cbc"
    &clk_vote_bit=-1.
    &clk_multiplier=12.
    &clk_access_mode="&MMSS_access_mode"

    gosub Print_Clk_Info_Line
  )

  &match=0
  &wild_head=0
  &wild_tail=0
  &clk_input_length=STRING.LENGTH("&clk")
  &clk_itr_length=STRING.LENGTH("mmss_snoc_dvm_axi_clk")

  if (STRING.SCAN("&clk", "*", 0)==0)
  (
    &wild_head=1
  )
  if (STRING.SCAN("&clk", "*", 1)==(STRING.LENGTH("&clk")-1))
  (
    &wild_tail=1
  )

  if ((&wild_head==1)&&(&wild_tail==1))
  (
    if (STRING.SCAN("mmss_snoc_dvm_axi_clk", STRING.MID("&clk", 1, &clk_input_length-2), 0)!=-1)
    ( 
      &match=1
    )
  )
  else if (&wild_head==1)
  (
    if (STRING.MID("mmss_snoc_dvm_axi_clk", &clk_itr_length-&clk_input_length+1, &clk_input_length-1)==STRING.CUT("&clk", 1))
    ( 
      &match=1
    )
  )
  else if (&wild_tail==1)
  (
    if (STRING.MID("mmss_snoc_dvm_axi_clk", 0, &clk_input_length-1)==STRING.CUT("&clk", -1))
    ( 
      &match=1
    )
  )
  else if ("mmss_snoc_dvm_axi_clk"=="&clk")
  (
    &match=1
  )
  
  if (&match==1)
  (
    &clk_test=&CLK_TEST_MMSS_SNOC_DVM_AXI_CLK
    &clk_reg=&HWIO_MMSS_SNOC_DVM_AXI_CBCR_ADDR
    &clk_reg_name="MMSS_SNOC_DVM_AXI_CBCR"
    &clk_name="mmss_snoc_dvm_axi_clk"
    &clk_reg_cbcr_type="sm_cbc"
    &clk_vote_bit=-1.
    &clk_multiplier=12.
    &clk_access_mode="&MMSS_access_mode"

    gosub Print_Clk_Info_Line
  )

  &match=0
  &wild_head=0
  &wild_tail=0
  &clk_input_length=STRING.LENGTH("&clk")
  &clk_itr_length=STRING.LENGTH("mmss_spdm_axi_clk")

  if (STRING.SCAN("&clk", "*", 0)==0)
  (
    &wild_head=1
  )
  if (STRING.SCAN("&clk", "*", 1)==(STRING.LENGTH("&clk")-1))
  (
    &wild_tail=1
  )

  if ((&wild_head==1)&&(&wild_tail==1))
  (
    if (STRING.SCAN("mmss_spdm_axi_clk", STRING.MID("&clk", 1, &clk_input_length-2), 0)!=-1)
    ( 
      &match=1
    )
  )
  else if (&wild_head==1)
  (
    if (STRING.MID("mmss_spdm_axi_clk", &clk_itr_length-&clk_input_length+1, &clk_input_length-1)==STRING.CUT("&clk", 1))
    ( 
      &match=1
    )
  )
  else if (&wild_tail==1)
  (
    if (STRING.MID("mmss_spdm_axi_clk", 0, &clk_input_length-1)==STRING.CUT("&clk", -1))
    ( 
      &match=1
    )
  )
  else if ("mmss_spdm_axi_clk"=="&clk")
  (
    &match=1
  )
  
  if (&match==1)
  (
    &clk_test=&CLK_TEST_MMSS_SPDM_AXI_CLK
    &clk_reg=&HWIO_MMSS_SPDM_AXI_CBCR_ADDR
    &clk_reg_name="MMSS_SPDM_AXI_CBCR"
    &clk_name="mmss_spdm_axi_clk"
    &clk_reg_cbcr_type="sm_cbc"
    &clk_vote_bit=-1.
    &clk_multiplier=12.
    &clk_access_mode="&MMSS_access_mode"

    gosub Print_Clk_Info_Line
  )

  &match=0
  &wild_head=0
  &wild_tail=0
  &clk_input_length=STRING.LENGTH("&clk")
  &clk_itr_length=STRING.LENGTH("mmss_spdm_rm_axi_clk")

  if (STRING.SCAN("&clk", "*", 0)==0)
  (
    &wild_head=1
  )
  if (STRING.SCAN("&clk", "*", 1)==(STRING.LENGTH("&clk")-1))
  (
    &wild_tail=1
  )

  if ((&wild_head==1)&&(&wild_tail==1))
  (
    if (STRING.SCAN("mmss_spdm_rm_axi_clk", STRING.MID("&clk", 1, &clk_input_length-2), 0)!=-1)
    ( 
      &match=1
    )
  )
  else if (&wild_head==1)
  (
    if (STRING.MID("mmss_spdm_rm_axi_clk", &clk_itr_length-&clk_input_length+1, &clk_input_length-1)==STRING.CUT("&clk", 1))
    ( 
      &match=1
    )
  )
  else if (&wild_tail==1)
  (
    if (STRING.MID("mmss_spdm_rm_axi_clk", 0, &clk_input_length-1)==STRING.CUT("&clk", -1))
    ( 
      &match=1
    )
  )
  else if ("mmss_spdm_rm_axi_clk"=="&clk")
  (
    &match=1
  )
  
  if (&match==1)
  (
    &clk_test=&CLK_TEST_MMSS_SPDM_RM_AXI_CLK
    &clk_reg=&HWIO_MMSS_SPDM_RM_AXI_CBCR_ADDR
    &clk_reg_name="MMSS_SPDM_RM_AXI_CBCR"
    &clk_name="mmss_spdm_rm_axi_clk"
    &clk_reg_cbcr_type="sm_cbc"
    &clk_vote_bit=-1.
    &clk_multiplier=12.
    &clk_access_mode="&MMSS_access_mode"

    gosub Print_Clk_Info_Line
  )

  &match=0
  &wild_head=0
  &wild_tail=0
  &clk_input_length=STRING.LENGTH("&clk")
  &clk_itr_length=STRING.LENGTH("mmss_throttle_camss_axi_clk")

  if (STRING.SCAN("&clk", "*", 0)==0)
  (
    &wild_head=1
  )
  if (STRING.SCAN("&clk", "*", 1)==(STRING.LENGTH("&clk")-1))
  (
    &wild_tail=1
  )

  if ((&wild_head==1)&&(&wild_tail==1))
  (
    if (STRING.SCAN("mmss_throttle_camss_axi_clk", STRING.MID("&clk", 1, &clk_input_length-2), 0)!=-1)
    ( 
      &match=1
    )
  )
  else if (&wild_head==1)
  (
    if (STRING.MID("mmss_throttle_camss_axi_clk", &clk_itr_length-&clk_input_length+1, &clk_input_length-1)==STRING.CUT("&clk", 1))
    ( 
      &match=1
    )
  )
  else if (&wild_tail==1)
  (
    if (STRING.MID("mmss_throttle_camss_axi_clk", 0, &clk_input_length-1)==STRING.CUT("&clk", -1))
    ( 
      &match=1
    )
  )
  else if ("mmss_throttle_camss_axi_clk"=="&clk")
  (
    &match=1
  )
  
  if (&match==1)
  (
    &clk_test=&CLK_TEST_MMSS_THROTTLE_CAMSS_AXI_CLK
    &clk_reg=&HWIO_MMSS_THROTTLE_CAMSS_AXI_CBCR_ADDR
    &clk_reg_name="MMSS_THROTTLE_CAMSS_AXI_CBCR"
    &clk_name="mmss_throttle_camss_axi_clk"
    &clk_reg_cbcr_type="sm_cbc"
    &clk_vote_bit=-1.
    &clk_multiplier=12.
    &clk_access_mode="&MMSS_access_mode"

    gosub Print_Clk_Info_Line
  )

  &match=0
  &wild_head=0
  &wild_tail=0
  &clk_input_length=STRING.LENGTH("&clk")
  &clk_itr_length=STRING.LENGTH("mmss_throttle_mdss_axi_clk")

  if (STRING.SCAN("&clk", "*", 0)==0)
  (
    &wild_head=1
  )
  if (STRING.SCAN("&clk", "*", 1)==(STRING.LENGTH("&clk")-1))
  (
    &wild_tail=1
  )

  if ((&wild_head==1)&&(&wild_tail==1))
  (
    if (STRING.SCAN("mmss_throttle_mdss_axi_clk", STRING.MID("&clk", 1, &clk_input_length-2), 0)!=-1)
    ( 
      &match=1
    )
  )
  else if (&wild_head==1)
  (
    if (STRING.MID("mmss_throttle_mdss_axi_clk", &clk_itr_length-&clk_input_length+1, &clk_input_length-1)==STRING.CUT("&clk", 1))
    ( 
      &match=1
    )
  )
  else if (&wild_tail==1)
  (
    if (STRING.MID("mmss_throttle_mdss_axi_clk", 0, &clk_input_length-1)==STRING.CUT("&clk", -1))
    ( 
      &match=1
    )
  )
  else if ("mmss_throttle_mdss_axi_clk"=="&clk")
  (
    &match=1
  )
  
  if (&match==1)
  (
    &clk_test=&CLK_TEST_MMSS_THROTTLE_MDSS_AXI_CLK
    &clk_reg=&HWIO_MMSS_THROTTLE_MDSS_AXI_CBCR_ADDR
    &clk_reg_name="MMSS_THROTTLE_MDSS_AXI_CBCR"
    &clk_name="mmss_throttle_mdss_axi_clk"
    &clk_reg_cbcr_type="sm_cbc"
    &clk_vote_bit=-1.
    &clk_multiplier=12.
    &clk_access_mode="&MMSS_access_mode"

    gosub Print_Clk_Info_Line
  )

  &match=0
  &wild_head=0
  &wild_tail=0
  &clk_input_length=STRING.LENGTH("&clk")
  &clk_itr_length=STRING.LENGTH("mmss_throttle_video_axi_clk")

  if (STRING.SCAN("&clk", "*", 0)==0)
  (
    &wild_head=1
  )
  if (STRING.SCAN("&clk", "*", 1)==(STRING.LENGTH("&clk")-1))
  (
    &wild_tail=1
  )

  if ((&wild_head==1)&&(&wild_tail==1))
  (
    if (STRING.SCAN("mmss_throttle_video_axi_clk", STRING.MID("&clk", 1, &clk_input_length-2), 0)!=-1)
    ( 
      &match=1
    )
  )
  else if (&wild_head==1)
  (
    if (STRING.MID("mmss_throttle_video_axi_clk", &clk_itr_length-&clk_input_length+1, &clk_input_length-1)==STRING.CUT("&clk", 1))
    ( 
      &match=1
    )
  )
  else if (&wild_tail==1)
  (
    if (STRING.MID("mmss_throttle_video_axi_clk", 0, &clk_input_length-1)==STRING.CUT("&clk", -1))
    ( 
      &match=1
    )
  )
  else if ("mmss_throttle_video_axi_clk"=="&clk")
  (
    &match=1
  )
  
  if (&match==1)
  (
    &clk_test=&CLK_TEST_MMSS_THROTTLE_VIDEO_AXI_CLK
    &clk_reg=&HWIO_MMSS_THROTTLE_VIDEO_AXI_CBCR_ADDR
    &clk_reg_name="MMSS_THROTTLE_VIDEO_AXI_CBCR"
    &clk_name="mmss_throttle_video_axi_clk"
    &clk_reg_cbcr_type="sm_cbc"
    &clk_vote_bit=-1.
    &clk_multiplier=12.
    &clk_access_mode="&MMSS_access_mode"

    gosub Print_Clk_Info_Line
  )

  &match=0
  &wild_head=0
  &wild_tail=0
  &clk_input_length=STRING.LENGTH("&clk")
  &clk_itr_length=STRING.LENGTH("mmss_video_axi_clk")

  if (STRING.SCAN("&clk", "*", 0)==0)
  (
    &wild_head=1
  )
  if (STRING.SCAN("&clk", "*", 1)==(STRING.LENGTH("&clk")-1))
  (
    &wild_tail=1
  )

  if ((&wild_head==1)&&(&wild_tail==1))
  (
    if (STRING.SCAN("mmss_video_axi_clk", STRING.MID("&clk", 1, &clk_input_length-2), 0)!=-1)
    ( 
      &match=1
    )
  )
  else if (&wild_head==1)
  (
    if (STRING.MID("mmss_video_axi_clk", &clk_itr_length-&clk_input_length+1, &clk_input_length-1)==STRING.CUT("&clk", 1))
    ( 
      &match=1
    )
  )
  else if (&wild_tail==1)
  (
    if (STRING.MID("mmss_video_axi_clk", 0, &clk_input_length-1)==STRING.CUT("&clk", -1))
    ( 
      &match=1
    )
  )
  else if ("mmss_video_axi_clk"=="&clk")
  (
    &match=1
  )
  
  if (&match==1)
  (
    &clk_test=&CLK_TEST_MMSS_VIDEO_AXI_CLK
    &clk_reg=&HWIO_MMSS_VIDEO_AXI_CBCR_ADDR
    &clk_reg_name="MMSS_VIDEO_AXI_CBCR"
    &clk_name="mmss_video_axi_clk"
    &clk_reg_cbcr_type="sm_pscbc"
    &clk_vote_bit=-1.
    &clk_multiplier=12.
    &clk_access_mode="&MMSS_access_mode"

    gosub Print_Clk_Info_Line
  )

  &match=0
  &wild_head=0
  &wild_tail=0
  &clk_input_length=STRING.LENGTH("&clk")
  &clk_itr_length=STRING.LENGTH("mmss_mdss_byte0_clk")

  if (STRING.SCAN("&clk", "*", 0)==0)
  (
    &wild_head=1
  )
  if (STRING.SCAN("&clk", "*", 1)==(STRING.LENGTH("&clk")-1))
  (
    &wild_tail=1
  )

  if ((&wild_head==1)&&(&wild_tail==1))
  (
    if (STRING.SCAN("mmss_mdss_byte0_clk", STRING.MID("&clk", 1, &clk_input_length-2), 0)!=-1)
    ( 
      &match=1
    )
  )
  else if (&wild_head==1)
  (
    if (STRING.MID("mmss_mdss_byte0_clk", &clk_itr_length-&clk_input_length+1, &clk_input_length-1)==STRING.CUT("&clk", 1))
    ( 
      &match=1
    )
  )
  else if (&wild_tail==1)
  (
    if (STRING.MID("mmss_mdss_byte0_clk", 0, &clk_input_length-1)==STRING.CUT("&clk", -1))
    ( 
      &match=1
    )
  )
  else if ("mmss_mdss_byte0_clk"=="&clk")
  (
    &match=1
  )
  
  if (&match==1)
  (
    &clk_test=&CLK_TEST_MMSS_MDSS_BYTE0_CLK
    &clk_reg=&HWIO_MMSS_MDSS_BYTE0_CBCR_ADDR
    &clk_reg_name="MMSS_MDSS_BYTE0_CBCR"
    &clk_name="mmss_mdss_byte0_clk"
    &clk_reg_cbcr_type="sm_cbc"
    &clk_vote_bit=-1.
    &clk_multiplier=12.
    &clk_access_mode="&MMSS_access_mode"

    gosub Print_Clk_Info_Line
  )

  &match=0
  &wild_head=0
  &wild_tail=0
  &clk_input_length=STRING.LENGTH("&clk")
  &clk_itr_length=STRING.LENGTH("mmss_mdss_byte0_intf_clk")

  if (STRING.SCAN("&clk", "*", 0)==0)
  (
    &wild_head=1
  )
  if (STRING.SCAN("&clk", "*", 1)==(STRING.LENGTH("&clk")-1))
  (
    &wild_tail=1
  )

  if ((&wild_head==1)&&(&wild_tail==1))
  (
    if (STRING.SCAN("mmss_mdss_byte0_intf_clk", STRING.MID("&clk", 1, &clk_input_length-2), 0)!=-1)
    ( 
      &match=1
    )
  )
  else if (&wild_head==1)
  (
    if (STRING.MID("mmss_mdss_byte0_intf_clk", &clk_itr_length-&clk_input_length+1, &clk_input_length-1)==STRING.CUT("&clk", 1))
    ( 
      &match=1
    )
  )
  else if (&wild_tail==1)
  (
    if (STRING.MID("mmss_mdss_byte0_intf_clk", 0, &clk_input_length-1)==STRING.CUT("&clk", -1))
    ( 
      &match=1
    )
  )
  else if ("mmss_mdss_byte0_intf_clk"=="&clk")
  (
    &match=1
  )
  
  if (&match==1)
  (
    &clk_test=&CLK_TEST_MMSS_MDSS_BYTE0_INTF_CLK
    &clk_reg=&HWIO_MMSS_MDSS_BYTE0_INTF_CBCR_ADDR
    &clk_reg_name="MMSS_MDSS_BYTE0_INTF_CBCR"
    &clk_name="mmss_mdss_byte0_intf_clk"
    &clk_reg_cbcr_type="sm_cbc"
    &clk_vote_bit=-1.
    &clk_multiplier=12.
    &clk_access_mode="&MMSS_access_mode"

    gosub Print_Clk_Info_Line
  )

  &match=0
  &wild_head=0
  &wild_tail=0
  &clk_input_length=STRING.LENGTH("&clk")
  &clk_itr_length=STRING.LENGTH("mmss_mdss_byte1_clk")

  if (STRING.SCAN("&clk", "*", 0)==0)
  (
    &wild_head=1
  )
  if (STRING.SCAN("&clk", "*", 1)==(STRING.LENGTH("&clk")-1))
  (
    &wild_tail=1
  )

  if ((&wild_head==1)&&(&wild_tail==1))
  (
    if (STRING.SCAN("mmss_mdss_byte1_clk", STRING.MID("&clk", 1, &clk_input_length-2), 0)!=-1)
    ( 
      &match=1
    )
  )
  else if (&wild_head==1)
  (
    if (STRING.MID("mmss_mdss_byte1_clk", &clk_itr_length-&clk_input_length+1, &clk_input_length-1)==STRING.CUT("&clk", 1))
    ( 
      &match=1
    )
  )
  else if (&wild_tail==1)
  (
    if (STRING.MID("mmss_mdss_byte1_clk", 0, &clk_input_length-1)==STRING.CUT("&clk", -1))
    ( 
      &match=1
    )
  )
  else if ("mmss_mdss_byte1_clk"=="&clk")
  (
    &match=1
  )
  
  if (&match==1)
  (
    &clk_test=&CLK_TEST_MMSS_MDSS_BYTE1_CLK
    &clk_reg=&HWIO_MMSS_MDSS_BYTE1_CBCR_ADDR
    &clk_reg_name="MMSS_MDSS_BYTE1_CBCR"
    &clk_name="mmss_mdss_byte1_clk"
    &clk_reg_cbcr_type="sm_cbc"
    &clk_vote_bit=-1.
    &clk_multiplier=12.
    &clk_access_mode="&MMSS_access_mode"

    gosub Print_Clk_Info_Line
  )

  &match=0
  &wild_head=0
  &wild_tail=0
  &clk_input_length=STRING.LENGTH("&clk")
  &clk_itr_length=STRING.LENGTH("mmss_mdss_byte1_intf_clk")

  if (STRING.SCAN("&clk", "*", 0)==0)
  (
    &wild_head=1
  )
  if (STRING.SCAN("&clk", "*", 1)==(STRING.LENGTH("&clk")-1))
  (
    &wild_tail=1
  )

  if ((&wild_head==1)&&(&wild_tail==1))
  (
    if (STRING.SCAN("mmss_mdss_byte1_intf_clk", STRING.MID("&clk", 1, &clk_input_length-2), 0)!=-1)
    ( 
      &match=1
    )
  )
  else if (&wild_head==1)
  (
    if (STRING.MID("mmss_mdss_byte1_intf_clk", &clk_itr_length-&clk_input_length+1, &clk_input_length-1)==STRING.CUT("&clk", 1))
    ( 
      &match=1
    )
  )
  else if (&wild_tail==1)
  (
    if (STRING.MID("mmss_mdss_byte1_intf_clk", 0, &clk_input_length-1)==STRING.CUT("&clk", -1))
    ( 
      &match=1
    )
  )
  else if ("mmss_mdss_byte1_intf_clk"=="&clk")
  (
    &match=1
  )
  
  if (&match==1)
  (
    &clk_test=&CLK_TEST_MMSS_MDSS_BYTE1_INTF_CLK
    &clk_reg=&HWIO_MMSS_MDSS_BYTE1_INTF_CBCR_ADDR
    &clk_reg_name="MMSS_MDSS_BYTE1_INTF_CBCR"
    &clk_name="mmss_mdss_byte1_intf_clk"
    &clk_reg_cbcr_type="sm_cbc"
    &clk_vote_bit=-1.
    &clk_multiplier=12.
    &clk_access_mode="&MMSS_access_mode"

    gosub Print_Clk_Info_Line
  )

  &match=0
  &wild_head=0
  &wild_tail=0
  &clk_input_length=STRING.LENGTH("&clk")
  &clk_itr_length=STRING.LENGTH("mmss_camss_gp0_clk")

  if (STRING.SCAN("&clk", "*", 0)==0)
  (
    &wild_head=1
  )
  if (STRING.SCAN("&clk", "*", 1)==(STRING.LENGTH("&clk")-1))
  (
    &wild_tail=1
  )

  if ((&wild_head==1)&&(&wild_tail==1))
  (
    if (STRING.SCAN("mmss_camss_gp0_clk", STRING.MID("&clk", 1, &clk_input_length-2), 0)!=-1)
    ( 
      &match=1
    )
  )
  else if (&wild_head==1)
  (
    if (STRING.MID("mmss_camss_gp0_clk", &clk_itr_length-&clk_input_length+1, &clk_input_length-1)==STRING.CUT("&clk", 1))
    ( 
      &match=1
    )
  )
  else if (&wild_tail==1)
  (
    if (STRING.MID("mmss_camss_gp0_clk", 0, &clk_input_length-1)==STRING.CUT("&clk", -1))
    ( 
      &match=1
    )
  )
  else if ("mmss_camss_gp0_clk"=="&clk")
  (
    &match=1
  )
  
  if (&match==1)
  (
    &clk_test=&CLK_TEST_MMSS_CAMSS_GP0_CLK
    &clk_reg=&HWIO_MMSS_CAMSS_GP0_CBCR_ADDR
    &clk_reg_name="MMSS_CAMSS_GP0_CBCR"
    &clk_name="mmss_camss_gp0_clk"
    &clk_reg_cbcr_type="sm_cbc"
    &clk_vote_bit=-1.
    &clk_multiplier=12.
    &clk_access_mode="&MMSS_access_mode"

    gosub Print_Clk_Info_Line
  )

  &match=0
  &wild_head=0
  &wild_tail=0
  &clk_input_length=STRING.LENGTH("&clk")
  &clk_itr_length=STRING.LENGTH("mmss_camss_gp1_clk")

  if (STRING.SCAN("&clk", "*", 0)==0)
  (
    &wild_head=1
  )
  if (STRING.SCAN("&clk", "*", 1)==(STRING.LENGTH("&clk")-1))
  (
    &wild_tail=1
  )

  if ((&wild_head==1)&&(&wild_tail==1))
  (
    if (STRING.SCAN("mmss_camss_gp1_clk", STRING.MID("&clk", 1, &clk_input_length-2), 0)!=-1)
    ( 
      &match=1
    )
  )
  else if (&wild_head==1)
  (
    if (STRING.MID("mmss_camss_gp1_clk", &clk_itr_length-&clk_input_length+1, &clk_input_length-1)==STRING.CUT("&clk", 1))
    ( 
      &match=1
    )
  )
  else if (&wild_tail==1)
  (
    if (STRING.MID("mmss_camss_gp1_clk", 0, &clk_input_length-1)==STRING.CUT("&clk", -1))
    ( 
      &match=1
    )
  )
  else if ("mmss_camss_gp1_clk"=="&clk")
  (
    &match=1
  )
  
  if (&match==1)
  (
    &clk_test=&CLK_TEST_MMSS_CAMSS_GP1_CLK
    &clk_reg=&HWIO_MMSS_CAMSS_GP1_CBCR_ADDR
    &clk_reg_name="MMSS_CAMSS_GP1_CBCR"
    &clk_name="mmss_camss_gp1_clk"
    &clk_reg_cbcr_type="sm_cbc"
    &clk_vote_bit=-1.
    &clk_multiplier=12.
    &clk_access_mode="&MMSS_access_mode"

    gosub Print_Clk_Info_Line
  )

  &match=0
  &wild_head=0
  &wild_tail=0
  &clk_input_length=STRING.LENGTH("&clk")
  &clk_itr_length=STRING.LENGTH("mmss_camss_cci_clk")

  if (STRING.SCAN("&clk", "*", 0)==0)
  (
    &wild_head=1
  )
  if (STRING.SCAN("&clk", "*", 1)==(STRING.LENGTH("&clk")-1))
  (
    &wild_tail=1
  )

  if ((&wild_head==1)&&(&wild_tail==1))
  (
    if (STRING.SCAN("mmss_camss_cci_clk", STRING.MID("&clk", 1, &clk_input_length-2), 0)!=-1)
    ( 
      &match=1
    )
  )
  else if (&wild_head==1)
  (
    if (STRING.MID("mmss_camss_cci_clk", &clk_itr_length-&clk_input_length+1, &clk_input_length-1)==STRING.CUT("&clk", 1))
    ( 
      &match=1
    )
  )
  else if (&wild_tail==1)
  (
    if (STRING.MID("mmss_camss_cci_clk", 0, &clk_input_length-1)==STRING.CUT("&clk", -1))
    ( 
      &match=1
    )
  )
  else if ("mmss_camss_cci_clk"=="&clk")
  (
    &match=1
  )
  
  if (&match==1)
  (
    &clk_test=&CLK_TEST_MMSS_CAMSS_CCI_CLK
    &clk_reg=&HWIO_MMSS_CAMSS_CCI_CBCR_ADDR
    &clk_reg_name="MMSS_CAMSS_CCI_CBCR"
    &clk_name="mmss_camss_cci_clk"
    &clk_reg_cbcr_type="sm_cbc"
    &clk_vote_bit=-1.
    &clk_multiplier=12.
    &clk_access_mode="&MMSS_access_mode"

    gosub Print_Clk_Info_Line
  )

  &match=0
  &wild_head=0
  &wild_tail=0
  &clk_input_length=STRING.LENGTH("&clk")
  &clk_itr_length=STRING.LENGTH("mmss_sleep_clk")

  if (STRING.SCAN("&clk", "*", 0)==0)
  (
    &wild_head=1
  )
  if (STRING.SCAN("&clk", "*", 1)==(STRING.LENGTH("&clk")-1))
  (
    &wild_tail=1
  )

  if ((&wild_head==1)&&(&wild_tail==1))
  (
    if (STRING.SCAN("mmss_sleep_clk", STRING.MID("&clk", 1, &clk_input_length-2), 0)!=-1)
    ( 
      &match=1
    )
  )
  else if (&wild_head==1)
  (
    if (STRING.MID("mmss_sleep_clk", &clk_itr_length-&clk_input_length+1, &clk_input_length-1)==STRING.CUT("&clk", 1))
    ( 
      &match=1
    )
  )
  else if (&wild_tail==1)
  (
    if (STRING.MID("mmss_sleep_clk", 0, &clk_input_length-1)==STRING.CUT("&clk", -1))
    ( 
      &match=1
    )
  )
  else if ("mmss_sleep_clk"=="&clk")
  (
    &match=1
  )
  
  if (&match==1)
  (
    &clk_test=0
    &clk_reg=&HWIO_MMSS_SLEEP_CBCR_ADDR
    &clk_reg_name="MMSS_SLEEP_CBCR"
    &clk_name="mmss_sleep_clk"
    &clk_reg_cbcr_type="sm_cbc"
    &clk_vote_bit=-1.
    &clk_multiplier=12.
    &clk_access_mode="&MMSS_access_mode"

    gosub Print_Clk_Info_Line
  )

  &match=0
  &wild_head=0
  &wild_tail=0
  &clk_input_length=STRING.LENGTH("&clk")
  &clk_itr_length=STRING.LENGTH("mmss_camss_cpp_clk")

  if (STRING.SCAN("&clk", "*", 0)==0)
  (
    &wild_head=1
  )
  if (STRING.SCAN("&clk", "*", 1)==(STRING.LENGTH("&clk")-1))
  (
    &wild_tail=1
  )

  if ((&wild_head==1)&&(&wild_tail==1))
  (
    if (STRING.SCAN("mmss_camss_cpp_clk", STRING.MID("&clk", 1, &clk_input_length-2), 0)!=-1)
    ( 
      &match=1
    )
  )
  else if (&wild_head==1)
  (
    if (STRING.MID("mmss_camss_cpp_clk", &clk_itr_length-&clk_input_length+1, &clk_input_length-1)==STRING.CUT("&clk", 1))
    ( 
      &match=1
    )
  )
  else if (&wild_tail==1)
  (
    if (STRING.MID("mmss_camss_cpp_clk", 0, &clk_input_length-1)==STRING.CUT("&clk", -1))
    ( 
      &match=1
    )
  )
  else if ("mmss_camss_cpp_clk"=="&clk")
  (
    &match=1
  )
  
  if (&match==1)
  (
    &clk_test=&CLK_TEST_MMSS_CAMSS_CPP_CLK
    &clk_reg=&HWIO_MMSS_CAMSS_CPP_CBCR_ADDR
    &clk_reg_name="MMSS_CAMSS_CPP_CBCR"
    &clk_name="mmss_camss_cpp_clk"
    &clk_reg_cbcr_type="sm_sreg_pscbc"
    &clk_vote_bit=-1.
    &clk_multiplier=12.
    &clk_access_mode="&MMSS_access_mode"

    gosub Print_Clk_Info_Line
  )

  &match=0
  &wild_head=0
  &wild_tail=0
  &clk_input_length=STRING.LENGTH("&clk")
  &clk_itr_length=STRING.LENGTH("mmss_spdm_cpp_clk")

  if (STRING.SCAN("&clk", "*", 0)==0)
  (
    &wild_head=1
  )
  if (STRING.SCAN("&clk", "*", 1)==(STRING.LENGTH("&clk")-1))
  (
    &wild_tail=1
  )

  if ((&wild_head==1)&&(&wild_tail==1))
  (
    if (STRING.SCAN("mmss_spdm_cpp_clk", STRING.MID("&clk", 1, &clk_input_length-2), 0)!=-1)
    ( 
      &match=1
    )
  )
  else if (&wild_head==1)
  (
    if (STRING.MID("mmss_spdm_cpp_clk", &clk_itr_length-&clk_input_length+1, &clk_input_length-1)==STRING.CUT("&clk", 1))
    ( 
      &match=1
    )
  )
  else if (&wild_tail==1)
  (
    if (STRING.MID("mmss_spdm_cpp_clk", 0, &clk_input_length-1)==STRING.CUT("&clk", -1))
    ( 
      &match=1
    )
  )
  else if ("mmss_spdm_cpp_clk"=="&clk")
  (
    &match=1
  )
  
  if (&match==1)
  (
    &clk_test=&CLK_TEST_MMSS_SPDM_CPP_CLK
    &clk_reg=&HWIO_MMSS_SPDM_CPP_CBCR_ADDR
    &clk_reg_name="MMSS_SPDM_CPP_CBCR"
    &clk_name="mmss_spdm_cpp_clk"
    &clk_reg_cbcr_type="sm_cbc"
    &clk_vote_bit=-1.
    &clk_multiplier=12.
    &clk_access_mode="&MMSS_access_mode"

    gosub Print_Clk_Info_Line
  )

  &match=0
  &wild_head=0
  &wild_tail=0
  &clk_input_length=STRING.LENGTH("&clk")
  &clk_itr_length=STRING.LENGTH("mmss_camss_csi0_clk")

  if (STRING.SCAN("&clk", "*", 0)==0)
  (
    &wild_head=1
  )
  if (STRING.SCAN("&clk", "*", 1)==(STRING.LENGTH("&clk")-1))
  (
    &wild_tail=1
  )

  if ((&wild_head==1)&&(&wild_tail==1))
  (
    if (STRING.SCAN("mmss_camss_csi0_clk", STRING.MID("&clk", 1, &clk_input_length-2), 0)!=-1)
    ( 
      &match=1
    )
  )
  else if (&wild_head==1)
  (
    if (STRING.MID("mmss_camss_csi0_clk", &clk_itr_length-&clk_input_length+1, &clk_input_length-1)==STRING.CUT("&clk", 1))
    ( 
      &match=1
    )
  )
  else if (&wild_tail==1)
  (
    if (STRING.MID("mmss_camss_csi0_clk", 0, &clk_input_length-1)==STRING.CUT("&clk", -1))
    ( 
      &match=1
    )
  )
  else if ("mmss_camss_csi0_clk"=="&clk")
  (
    &match=1
  )
  
  if (&match==1)
  (
    &clk_test=&CLK_TEST_MMSS_CAMSS_CSI0_CLK
    &clk_reg=&HWIO_MMSS_CAMSS_CSI0_CBCR_ADDR
    &clk_reg_name="MMSS_CAMSS_CSI0_CBCR"
    &clk_name="mmss_camss_csi0_clk"
    &clk_reg_cbcr_type="sm_cbc"
    &clk_vote_bit=-1.
    &clk_multiplier=12.
    &clk_access_mode="&MMSS_access_mode"

    gosub Print_Clk_Info_Line
  )

  &match=0
  &wild_head=0
  &wild_tail=0
  &clk_input_length=STRING.LENGTH("&clk")
  &clk_itr_length=STRING.LENGTH("mmss_camss_csi0pix_clk")

  if (STRING.SCAN("&clk", "*", 0)==0)
  (
    &wild_head=1
  )
  if (STRING.SCAN("&clk", "*", 1)==(STRING.LENGTH("&clk")-1))
  (
    &wild_tail=1
  )

  if ((&wild_head==1)&&(&wild_tail==1))
  (
    if (STRING.SCAN("mmss_camss_csi0pix_clk", STRING.MID("&clk", 1, &clk_input_length-2), 0)!=-1)
    ( 
      &match=1
    )
  )
  else if (&wild_head==1)
  (
    if (STRING.MID("mmss_camss_csi0pix_clk", &clk_itr_length-&clk_input_length+1, &clk_input_length-1)==STRING.CUT("&clk", 1))
    ( 
      &match=1
    )
  )
  else if (&wild_tail==1)
  (
    if (STRING.MID("mmss_camss_csi0pix_clk", 0, &clk_input_length-1)==STRING.CUT("&clk", -1))
    ( 
      &match=1
    )
  )
  else if ("mmss_camss_csi0pix_clk"=="&clk")
  (
    &match=1
  )
  
  if (&match==1)
  (
    &clk_test=&CLK_TEST_MMSS_CAMSS_CSI0PIX_CLK
    &clk_reg=&HWIO_MMSS_CAMSS_CSI0PIX_CBCR_ADDR
    &clk_reg_name="MMSS_CAMSS_CSI0PIX_CBCR"
    &clk_name="mmss_camss_csi0pix_clk"
    &clk_reg_cbcr_type="sm_cbc"
    &clk_vote_bit=-1.
    &clk_multiplier=12.
    &clk_access_mode="&MMSS_access_mode"

    gosub Print_Clk_Info_Line
  )

  &match=0
  &wild_head=0
  &wild_tail=0
  &clk_input_length=STRING.LENGTH("&clk")
  &clk_itr_length=STRING.LENGTH("mmss_camss_csi0rdi_clk")

  if (STRING.SCAN("&clk", "*", 0)==0)
  (
    &wild_head=1
  )
  if (STRING.SCAN("&clk", "*", 1)==(STRING.LENGTH("&clk")-1))
  (
    &wild_tail=1
  )

  if ((&wild_head==1)&&(&wild_tail==1))
  (
    if (STRING.SCAN("mmss_camss_csi0rdi_clk", STRING.MID("&clk", 1, &clk_input_length-2), 0)!=-1)
    ( 
      &match=1
    )
  )
  else if (&wild_head==1)
  (
    if (STRING.MID("mmss_camss_csi0rdi_clk", &clk_itr_length-&clk_input_length+1, &clk_input_length-1)==STRING.CUT("&clk", 1))
    ( 
      &match=1
    )
  )
  else if (&wild_tail==1)
  (
    if (STRING.MID("mmss_camss_csi0rdi_clk", 0, &clk_input_length-1)==STRING.CUT("&clk", -1))
    ( 
      &match=1
    )
  )
  else if ("mmss_camss_csi0rdi_clk"=="&clk")
  (
    &match=1
  )
  
  if (&match==1)
  (
    &clk_test=&CLK_TEST_MMSS_CAMSS_CSI0RDI_CLK
    &clk_reg=&HWIO_MMSS_CAMSS_CSI0RDI_CBCR_ADDR
    &clk_reg_name="MMSS_CAMSS_CSI0RDI_CBCR"
    &clk_name="mmss_camss_csi0rdi_clk"
    &clk_reg_cbcr_type="sm_cbc"
    &clk_vote_bit=-1.
    &clk_multiplier=12.
    &clk_access_mode="&MMSS_access_mode"

    gosub Print_Clk_Info_Line
  )

  &match=0
  &wild_head=0
  &wild_tail=0
  &clk_input_length=STRING.LENGTH("&clk")
  &clk_itr_length=STRING.LENGTH("mmss_spdm_csi0_clk")

  if (STRING.SCAN("&clk", "*", 0)==0)
  (
    &wild_head=1
  )
  if (STRING.SCAN("&clk", "*", 1)==(STRING.LENGTH("&clk")-1))
  (
    &wild_tail=1
  )

  if ((&wild_head==1)&&(&wild_tail==1))
  (
    if (STRING.SCAN("mmss_spdm_csi0_clk", STRING.MID("&clk", 1, &clk_input_length-2), 0)!=-1)
    ( 
      &match=1
    )
  )
  else if (&wild_head==1)
  (
    if (STRING.MID("mmss_spdm_csi0_clk", &clk_itr_length-&clk_input_length+1, &clk_input_length-1)==STRING.CUT("&clk", 1))
    ( 
      &match=1
    )
  )
  else if (&wild_tail==1)
  (
    if (STRING.MID("mmss_spdm_csi0_clk", 0, &clk_input_length-1)==STRING.CUT("&clk", -1))
    ( 
      &match=1
    )
  )
  else if ("mmss_spdm_csi0_clk"=="&clk")
  (
    &match=1
  )
  
  if (&match==1)
  (
    &clk_test=&CLK_TEST_MMSS_SPDM_CSI0_CLK
    &clk_reg=&HWIO_MMSS_SPDM_CSI0_CBCR_ADDR
    &clk_reg_name="MMSS_SPDM_CSI0_CBCR"
    &clk_name="mmss_spdm_csi0_clk"
    &clk_reg_cbcr_type="sm_cbc"
    &clk_vote_bit=-1.
    &clk_multiplier=12.
    &clk_access_mode="&MMSS_access_mode"

    gosub Print_Clk_Info_Line
  )

  &match=0
  &wild_head=0
  &wild_tail=0
  &clk_input_length=STRING.LENGTH("&clk")
  &clk_itr_length=STRING.LENGTH("mmss_spdm_debug_clk")

  if (STRING.SCAN("&clk", "*", 0)==0)
  (
    &wild_head=1
  )
  if (STRING.SCAN("&clk", "*", 1)==(STRING.LENGTH("&clk")-1))
  (
    &wild_tail=1
  )

  if ((&wild_head==1)&&(&wild_tail==1))
  (
    if (STRING.SCAN("mmss_spdm_debug_clk", STRING.MID("&clk", 1, &clk_input_length-2), 0)!=-1)
    ( 
      &match=1
    )
  )
  else if (&wild_head==1)
  (
    if (STRING.MID("mmss_spdm_debug_clk", &clk_itr_length-&clk_input_length+1, &clk_input_length-1)==STRING.CUT("&clk", 1))
    ( 
      &match=1
    )
  )
  else if (&wild_tail==1)
  (
    if (STRING.MID("mmss_spdm_debug_clk", 0, &clk_input_length-1)==STRING.CUT("&clk", -1))
    ( 
      &match=1
    )
  )
  else if ("mmss_spdm_debug_clk"=="&clk")
  (
    &match=1
  )
  
  if (&match==1)
  (
    &clk_test=0
    &clk_reg=&HWIO_MMSS_SPDM_DEBUG_CBCR_ADDR
    &clk_reg_name="MMSS_SPDM_DEBUG_CBCR"
    &clk_name="mmss_spdm_debug_clk"
    &clk_reg_cbcr_type="sm_cbc"
    &clk_vote_bit=-1.
    &clk_multiplier=12.
    &clk_access_mode="&MMSS_access_mode"

    gosub Print_Clk_Info_Line
  )

  &match=0
  &wild_head=0
  &wild_tail=0
  &clk_input_length=STRING.LENGTH("&clk")
  &clk_itr_length=STRING.LENGTH("mmss_camss_csi0phytimer_clk")

  if (STRING.SCAN("&clk", "*", 0)==0)
  (
    &wild_head=1
  )
  if (STRING.SCAN("&clk", "*", 1)==(STRING.LENGTH("&clk")-1))
  (
    &wild_tail=1
  )

  if ((&wild_head==1)&&(&wild_tail==1))
  (
    if (STRING.SCAN("mmss_camss_csi0phytimer_clk", STRING.MID("&clk", 1, &clk_input_length-2), 0)!=-1)
    ( 
      &match=1
    )
  )
  else if (&wild_head==1)
  (
    if (STRING.MID("mmss_camss_csi0phytimer_clk", &clk_itr_length-&clk_input_length+1, &clk_input_length-1)==STRING.CUT("&clk", 1))
    ( 
      &match=1
    )
  )
  else if (&wild_tail==1)
  (
    if (STRING.MID("mmss_camss_csi0phytimer_clk", 0, &clk_input_length-1)==STRING.CUT("&clk", -1))
    ( 
      &match=1
    )
  )
  else if ("mmss_camss_csi0phytimer_clk"=="&clk")
  (
    &match=1
  )
  
  if (&match==1)
  (
    &clk_test=&CLK_TEST_MMSS_CAMSS_CSI0PHYTIMER_CLK
    &clk_reg=&HWIO_MMSS_CAMSS_CSI0PHYTIMER_CBCR_ADDR
    &clk_reg_name="MMSS_CAMSS_CSI0PHYTIMER_CBCR"
    &clk_name="mmss_camss_csi0phytimer_clk"
    &clk_reg_cbcr_type="sm_cbc"
    &clk_vote_bit=-1.
    &clk_multiplier=12.
    &clk_access_mode="&MMSS_access_mode"

    gosub Print_Clk_Info_Line
  )

  &match=0
  &wild_head=0
  &wild_tail=0
  &clk_input_length=STRING.LENGTH("&clk")
  &clk_itr_length=STRING.LENGTH("mmss_camss_csi1_clk")

  if (STRING.SCAN("&clk", "*", 0)==0)
  (
    &wild_head=1
  )
  if (STRING.SCAN("&clk", "*", 1)==(STRING.LENGTH("&clk")-1))
  (
    &wild_tail=1
  )

  if ((&wild_head==1)&&(&wild_tail==1))
  (
    if (STRING.SCAN("mmss_camss_csi1_clk", STRING.MID("&clk", 1, &clk_input_length-2), 0)!=-1)
    ( 
      &match=1
    )
  )
  else if (&wild_head==1)
  (
    if (STRING.MID("mmss_camss_csi1_clk", &clk_itr_length-&clk_input_length+1, &clk_input_length-1)==STRING.CUT("&clk", 1))
    ( 
      &match=1
    )
  )
  else if (&wild_tail==1)
  (
    if (STRING.MID("mmss_camss_csi1_clk", 0, &clk_input_length-1)==STRING.CUT("&clk", -1))
    ( 
      &match=1
    )
  )
  else if ("mmss_camss_csi1_clk"=="&clk")
  (
    &match=1
  )
  
  if (&match==1)
  (
    &clk_test=&CLK_TEST_MMSS_CAMSS_CSI1_CLK
    &clk_reg=&HWIO_MMSS_CAMSS_CSI1_CBCR_ADDR
    &clk_reg_name="MMSS_CAMSS_CSI1_CBCR"
    &clk_name="mmss_camss_csi1_clk"
    &clk_reg_cbcr_type="sm_cbc"
    &clk_vote_bit=-1.
    &clk_multiplier=12.
    &clk_access_mode="&MMSS_access_mode"

    gosub Print_Clk_Info_Line
  )

  &match=0
  &wild_head=0
  &wild_tail=0
  &clk_input_length=STRING.LENGTH("&clk")
  &clk_itr_length=STRING.LENGTH("mmss_camss_csi1pix_clk")

  if (STRING.SCAN("&clk", "*", 0)==0)
  (
    &wild_head=1
  )
  if (STRING.SCAN("&clk", "*", 1)==(STRING.LENGTH("&clk")-1))
  (
    &wild_tail=1
  )

  if ((&wild_head==1)&&(&wild_tail==1))
  (
    if (STRING.SCAN("mmss_camss_csi1pix_clk", STRING.MID("&clk", 1, &clk_input_length-2), 0)!=-1)
    ( 
      &match=1
    )
  )
  else if (&wild_head==1)
  (
    if (STRING.MID("mmss_camss_csi1pix_clk", &clk_itr_length-&clk_input_length+1, &clk_input_length-1)==STRING.CUT("&clk", 1))
    ( 
      &match=1
    )
  )
  else if (&wild_tail==1)
  (
    if (STRING.MID("mmss_camss_csi1pix_clk", 0, &clk_input_length-1)==STRING.CUT("&clk", -1))
    ( 
      &match=1
    )
  )
  else if ("mmss_camss_csi1pix_clk"=="&clk")
  (
    &match=1
  )
  
  if (&match==1)
  (
    &clk_test=&CLK_TEST_MMSS_CAMSS_CSI1PIX_CLK
    &clk_reg=&HWIO_MMSS_CAMSS_CSI1PIX_CBCR_ADDR
    &clk_reg_name="MMSS_CAMSS_CSI1PIX_CBCR"
    &clk_name="mmss_camss_csi1pix_clk"
    &clk_reg_cbcr_type="sm_cbc"
    &clk_vote_bit=-1.
    &clk_multiplier=12.
    &clk_access_mode="&MMSS_access_mode"

    gosub Print_Clk_Info_Line
  )

  &match=0
  &wild_head=0
  &wild_tail=0
  &clk_input_length=STRING.LENGTH("&clk")
  &clk_itr_length=STRING.LENGTH("mmss_camss_csi1rdi_clk")

  if (STRING.SCAN("&clk", "*", 0)==0)
  (
    &wild_head=1
  )
  if (STRING.SCAN("&clk", "*", 1)==(STRING.LENGTH("&clk")-1))
  (
    &wild_tail=1
  )

  if ((&wild_head==1)&&(&wild_tail==1))
  (
    if (STRING.SCAN("mmss_camss_csi1rdi_clk", STRING.MID("&clk", 1, &clk_input_length-2), 0)!=-1)
    ( 
      &match=1
    )
  )
  else if (&wild_head==1)
  (
    if (STRING.MID("mmss_camss_csi1rdi_clk", &clk_itr_length-&clk_input_length+1, &clk_input_length-1)==STRING.CUT("&clk", 1))
    ( 
      &match=1
    )
  )
  else if (&wild_tail==1)
  (
    if (STRING.MID("mmss_camss_csi1rdi_clk", 0, &clk_input_length-1)==STRING.CUT("&clk", -1))
    ( 
      &match=1
    )
  )
  else if ("mmss_camss_csi1rdi_clk"=="&clk")
  (
    &match=1
  )
  
  if (&match==1)
  (
    &clk_test=&CLK_TEST_MMSS_CAMSS_CSI1RDI_CLK
    &clk_reg=&HWIO_MMSS_CAMSS_CSI1RDI_CBCR_ADDR
    &clk_reg_name="MMSS_CAMSS_CSI1RDI_CBCR"
    &clk_name="mmss_camss_csi1rdi_clk"
    &clk_reg_cbcr_type="sm_cbc"
    &clk_vote_bit=-1.
    &clk_multiplier=12.
    &clk_access_mode="&MMSS_access_mode"

    gosub Print_Clk_Info_Line
  )

  &match=0
  &wild_head=0
  &wild_tail=0
  &clk_input_length=STRING.LENGTH("&clk")
  &clk_itr_length=STRING.LENGTH("mmss_camss_csi1phytimer_clk")

  if (STRING.SCAN("&clk", "*", 0)==0)
  (
    &wild_head=1
  )
  if (STRING.SCAN("&clk", "*", 1)==(STRING.LENGTH("&clk")-1))
  (
    &wild_tail=1
  )

  if ((&wild_head==1)&&(&wild_tail==1))
  (
    if (STRING.SCAN("mmss_camss_csi1phytimer_clk", STRING.MID("&clk", 1, &clk_input_length-2), 0)!=-1)
    ( 
      &match=1
    )
  )
  else if (&wild_head==1)
  (
    if (STRING.MID("mmss_camss_csi1phytimer_clk", &clk_itr_length-&clk_input_length+1, &clk_input_length-1)==STRING.CUT("&clk", 1))
    ( 
      &match=1
    )
  )
  else if (&wild_tail==1)
  (
    if (STRING.MID("mmss_camss_csi1phytimer_clk", 0, &clk_input_length-1)==STRING.CUT("&clk", -1))
    ( 
      &match=1
    )
  )
  else if ("mmss_camss_csi1phytimer_clk"=="&clk")
  (
    &match=1
  )
  
  if (&match==1)
  (
    &clk_test=&CLK_TEST_MMSS_CAMSS_CSI1PHYTIMER_CLK
    &clk_reg=&HWIO_MMSS_CAMSS_CSI1PHYTIMER_CBCR_ADDR
    &clk_reg_name="MMSS_CAMSS_CSI1PHYTIMER_CBCR"
    &clk_name="mmss_camss_csi1phytimer_clk"
    &clk_reg_cbcr_type="sm_cbc"
    &clk_vote_bit=-1.
    &clk_multiplier=12.
    &clk_access_mode="&MMSS_access_mode"

    gosub Print_Clk_Info_Line
  )

  &match=0
  &wild_head=0
  &wild_tail=0
  &clk_input_length=STRING.LENGTH("&clk")
  &clk_itr_length=STRING.LENGTH("mmss_camss_csi2_clk")

  if (STRING.SCAN("&clk", "*", 0)==0)
  (
    &wild_head=1
  )
  if (STRING.SCAN("&clk", "*", 1)==(STRING.LENGTH("&clk")-1))
  (
    &wild_tail=1
  )

  if ((&wild_head==1)&&(&wild_tail==1))
  (
    if (STRING.SCAN("mmss_camss_csi2_clk", STRING.MID("&clk", 1, &clk_input_length-2), 0)!=-1)
    ( 
      &match=1
    )
  )
  else if (&wild_head==1)
  (
    if (STRING.MID("mmss_camss_csi2_clk", &clk_itr_length-&clk_input_length+1, &clk_input_length-1)==STRING.CUT("&clk", 1))
    ( 
      &match=1
    )
  )
  else if (&wild_tail==1)
  (
    if (STRING.MID("mmss_camss_csi2_clk", 0, &clk_input_length-1)==STRING.CUT("&clk", -1))
    ( 
      &match=1
    )
  )
  else if ("mmss_camss_csi2_clk"=="&clk")
  (
    &match=1
  )
  
  if (&match==1)
  (
    &clk_test=&CLK_TEST_MMSS_CAMSS_CSI2_CLK
    &clk_reg=&HWIO_MMSS_CAMSS_CSI2_CBCR_ADDR
    &clk_reg_name="MMSS_CAMSS_CSI2_CBCR"
    &clk_name="mmss_camss_csi2_clk"
    &clk_reg_cbcr_type="sm_cbc"
    &clk_vote_bit=-1.
    &clk_multiplier=12.
    &clk_access_mode="&MMSS_access_mode"

    gosub Print_Clk_Info_Line
  )

  &match=0
  &wild_head=0
  &wild_tail=0
  &clk_input_length=STRING.LENGTH("&clk")
  &clk_itr_length=STRING.LENGTH("mmss_camss_csi2pix_clk")

  if (STRING.SCAN("&clk", "*", 0)==0)
  (
    &wild_head=1
  )
  if (STRING.SCAN("&clk", "*", 1)==(STRING.LENGTH("&clk")-1))
  (
    &wild_tail=1
  )

  if ((&wild_head==1)&&(&wild_tail==1))
  (
    if (STRING.SCAN("mmss_camss_csi2pix_clk", STRING.MID("&clk", 1, &clk_input_length-2), 0)!=-1)
    ( 
      &match=1
    )
  )
  else if (&wild_head==1)
  (
    if (STRING.MID("mmss_camss_csi2pix_clk", &clk_itr_length-&clk_input_length+1, &clk_input_length-1)==STRING.CUT("&clk", 1))
    ( 
      &match=1
    )
  )
  else if (&wild_tail==1)
  (
    if (STRING.MID("mmss_camss_csi2pix_clk", 0, &clk_input_length-1)==STRING.CUT("&clk", -1))
    ( 
      &match=1
    )
  )
  else if ("mmss_camss_csi2pix_clk"=="&clk")
  (
    &match=1
  )
  
  if (&match==1)
  (
    &clk_test=&CLK_TEST_MMSS_CAMSS_CSI2PIX_CLK
    &clk_reg=&HWIO_MMSS_CAMSS_CSI2PIX_CBCR_ADDR
    &clk_reg_name="MMSS_CAMSS_CSI2PIX_CBCR"
    &clk_name="mmss_camss_csi2pix_clk"
    &clk_reg_cbcr_type="sm_cbc"
    &clk_vote_bit=-1.
    &clk_multiplier=12.
    &clk_access_mode="&MMSS_access_mode"

    gosub Print_Clk_Info_Line
  )

  &match=0
  &wild_head=0
  &wild_tail=0
  &clk_input_length=STRING.LENGTH("&clk")
  &clk_itr_length=STRING.LENGTH("mmss_camss_csi2rdi_clk")

  if (STRING.SCAN("&clk", "*", 0)==0)
  (
    &wild_head=1
  )
  if (STRING.SCAN("&clk", "*", 1)==(STRING.LENGTH("&clk")-1))
  (
    &wild_tail=1
  )

  if ((&wild_head==1)&&(&wild_tail==1))
  (
    if (STRING.SCAN("mmss_camss_csi2rdi_clk", STRING.MID("&clk", 1, &clk_input_length-2), 0)!=-1)
    ( 
      &match=1
    )
  )
  else if (&wild_head==1)
  (
    if (STRING.MID("mmss_camss_csi2rdi_clk", &clk_itr_length-&clk_input_length+1, &clk_input_length-1)==STRING.CUT("&clk", 1))
    ( 
      &match=1
    )
  )
  else if (&wild_tail==1)
  (
    if (STRING.MID("mmss_camss_csi2rdi_clk", 0, &clk_input_length-1)==STRING.CUT("&clk", -1))
    ( 
      &match=1
    )
  )
  else if ("mmss_camss_csi2rdi_clk"=="&clk")
  (
    &match=1
  )
  
  if (&match==1)
  (
    &clk_test=&CLK_TEST_MMSS_CAMSS_CSI2RDI_CLK
    &clk_reg=&HWIO_MMSS_CAMSS_CSI2RDI_CBCR_ADDR
    &clk_reg_name="MMSS_CAMSS_CSI2RDI_CBCR"
    &clk_name="mmss_camss_csi2rdi_clk"
    &clk_reg_cbcr_type="sm_cbc"
    &clk_vote_bit=-1.
    &clk_multiplier=12.
    &clk_access_mode="&MMSS_access_mode"

    gosub Print_Clk_Info_Line
  )

  &match=0
  &wild_head=0
  &wild_tail=0
  &clk_input_length=STRING.LENGTH("&clk")
  &clk_itr_length=STRING.LENGTH("mmss_camss_csi2phytimer_clk")

  if (STRING.SCAN("&clk", "*", 0)==0)
  (
    &wild_head=1
  )
  if (STRING.SCAN("&clk", "*", 1)==(STRING.LENGTH("&clk")-1))
  (
    &wild_tail=1
  )

  if ((&wild_head==1)&&(&wild_tail==1))
  (
    if (STRING.SCAN("mmss_camss_csi2phytimer_clk", STRING.MID("&clk", 1, &clk_input_length-2), 0)!=-1)
    ( 
      &match=1
    )
  )
  else if (&wild_head==1)
  (
    if (STRING.MID("mmss_camss_csi2phytimer_clk", &clk_itr_length-&clk_input_length+1, &clk_input_length-1)==STRING.CUT("&clk", 1))
    ( 
      &match=1
    )
  )
  else if (&wild_tail==1)
  (
    if (STRING.MID("mmss_camss_csi2phytimer_clk", 0, &clk_input_length-1)==STRING.CUT("&clk", -1))
    ( 
      &match=1
    )
  )
  else if ("mmss_camss_csi2phytimer_clk"=="&clk")
  (
    &match=1
  )
  
  if (&match==1)
  (
    &clk_test=&CLK_TEST_MMSS_CAMSS_CSI2PHYTIMER_CLK
    &clk_reg=&HWIO_MMSS_CAMSS_CSI2PHYTIMER_CBCR_ADDR
    &clk_reg_name="MMSS_CAMSS_CSI2PHYTIMER_CBCR"
    &clk_name="mmss_camss_csi2phytimer_clk"
    &clk_reg_cbcr_type="sm_cbc"
    &clk_vote_bit=-1.
    &clk_multiplier=12.
    &clk_access_mode="&MMSS_access_mode"

    gosub Print_Clk_Info_Line
  )

  &match=0
  &wild_head=0
  &wild_tail=0
  &clk_input_length=STRING.LENGTH("&clk")
  &clk_itr_length=STRING.LENGTH("mmss_camss_csi3_clk")

  if (STRING.SCAN("&clk", "*", 0)==0)
  (
    &wild_head=1
  )
  if (STRING.SCAN("&clk", "*", 1)==(STRING.LENGTH("&clk")-1))
  (
    &wild_tail=1
  )

  if ((&wild_head==1)&&(&wild_tail==1))
  (
    if (STRING.SCAN("mmss_camss_csi3_clk", STRING.MID("&clk", 1, &clk_input_length-2), 0)!=-1)
    ( 
      &match=1
    )
  )
  else if (&wild_head==1)
  (
    if (STRING.MID("mmss_camss_csi3_clk", &clk_itr_length-&clk_input_length+1, &clk_input_length-1)==STRING.CUT("&clk", 1))
    ( 
      &match=1
    )
  )
  else if (&wild_tail==1)
  (
    if (STRING.MID("mmss_camss_csi3_clk", 0, &clk_input_length-1)==STRING.CUT("&clk", -1))
    ( 
      &match=1
    )
  )
  else if ("mmss_camss_csi3_clk"=="&clk")
  (
    &match=1
  )
  
  if (&match==1)
  (
    &clk_test=&CLK_TEST_MMSS_CAMSS_CSI3_CLK
    &clk_reg=&HWIO_MMSS_CAMSS_CSI3_CBCR_ADDR
    &clk_reg_name="MMSS_CAMSS_CSI3_CBCR"
    &clk_name="mmss_camss_csi3_clk"
    &clk_reg_cbcr_type="sm_cbc"
    &clk_vote_bit=-1.
    &clk_multiplier=12.
    &clk_access_mode="&MMSS_access_mode"

    gosub Print_Clk_Info_Line
  )

  &match=0
  &wild_head=0
  &wild_tail=0
  &clk_input_length=STRING.LENGTH("&clk")
  &clk_itr_length=STRING.LENGTH("mmss_camss_csi3pix_clk")

  if (STRING.SCAN("&clk", "*", 0)==0)
  (
    &wild_head=1
  )
  if (STRING.SCAN("&clk", "*", 1)==(STRING.LENGTH("&clk")-1))
  (
    &wild_tail=1
  )

  if ((&wild_head==1)&&(&wild_tail==1))
  (
    if (STRING.SCAN("mmss_camss_csi3pix_clk", STRING.MID("&clk", 1, &clk_input_length-2), 0)!=-1)
    ( 
      &match=1
    )
  )
  else if (&wild_head==1)
  (
    if (STRING.MID("mmss_camss_csi3pix_clk", &clk_itr_length-&clk_input_length+1, &clk_input_length-1)==STRING.CUT("&clk", 1))
    ( 
      &match=1
    )
  )
  else if (&wild_tail==1)
  (
    if (STRING.MID("mmss_camss_csi3pix_clk", 0, &clk_input_length-1)==STRING.CUT("&clk", -1))
    ( 
      &match=1
    )
  )
  else if ("mmss_camss_csi3pix_clk"=="&clk")
  (
    &match=1
  )
  
  if (&match==1)
  (
    &clk_test=&CLK_TEST_MMSS_CAMSS_CSI3PIX_CLK
    &clk_reg=&HWIO_MMSS_CAMSS_CSI3PIX_CBCR_ADDR
    &clk_reg_name="MMSS_CAMSS_CSI3PIX_CBCR"
    &clk_name="mmss_camss_csi3pix_clk"
    &clk_reg_cbcr_type="sm_cbc"
    &clk_vote_bit=-1.
    &clk_multiplier=12.
    &clk_access_mode="&MMSS_access_mode"

    gosub Print_Clk_Info_Line
  )

  &match=0
  &wild_head=0
  &wild_tail=0
  &clk_input_length=STRING.LENGTH("&clk")
  &clk_itr_length=STRING.LENGTH("mmss_camss_csi3rdi_clk")

  if (STRING.SCAN("&clk", "*", 0)==0)
  (
    &wild_head=1
  )
  if (STRING.SCAN("&clk", "*", 1)==(STRING.LENGTH("&clk")-1))
  (
    &wild_tail=1
  )

  if ((&wild_head==1)&&(&wild_tail==1))
  (
    if (STRING.SCAN("mmss_camss_csi3rdi_clk", STRING.MID("&clk", 1, &clk_input_length-2), 0)!=-1)
    ( 
      &match=1
    )
  )
  else if (&wild_head==1)
  (
    if (STRING.MID("mmss_camss_csi3rdi_clk", &clk_itr_length-&clk_input_length+1, &clk_input_length-1)==STRING.CUT("&clk", 1))
    ( 
      &match=1
    )
  )
  else if (&wild_tail==1)
  (
    if (STRING.MID("mmss_camss_csi3rdi_clk", 0, &clk_input_length-1)==STRING.CUT("&clk", -1))
    ( 
      &match=1
    )
  )
  else if ("mmss_camss_csi3rdi_clk"=="&clk")
  (
    &match=1
  )
  
  if (&match==1)
  (
    &clk_test=&CLK_TEST_MMSS_CAMSS_CSI3RDI_CLK
    &clk_reg=&HWIO_MMSS_CAMSS_CSI3RDI_CBCR_ADDR
    &clk_reg_name="MMSS_CAMSS_CSI3RDI_CBCR"
    &clk_name="mmss_camss_csi3rdi_clk"
    &clk_reg_cbcr_type="sm_cbc"
    &clk_vote_bit=-1.
    &clk_multiplier=12.
    &clk_access_mode="&MMSS_access_mode"

    gosub Print_Clk_Info_Line
  )

  &match=0
  &wild_head=0
  &wild_tail=0
  &clk_input_length=STRING.LENGTH("&clk")
  &clk_itr_length=STRING.LENGTH("mmss_camss_cphy_csid0_clk")

  if (STRING.SCAN("&clk", "*", 0)==0)
  (
    &wild_head=1
  )
  if (STRING.SCAN("&clk", "*", 1)==(STRING.LENGTH("&clk")-1))
  (
    &wild_tail=1
  )

  if ((&wild_head==1)&&(&wild_tail==1))
  (
    if (STRING.SCAN("mmss_camss_cphy_csid0_clk", STRING.MID("&clk", 1, &clk_input_length-2), 0)!=-1)
    ( 
      &match=1
    )
  )
  else if (&wild_head==1)
  (
    if (STRING.MID("mmss_camss_cphy_csid0_clk", &clk_itr_length-&clk_input_length+1, &clk_input_length-1)==STRING.CUT("&clk", 1))
    ( 
      &match=1
    )
  )
  else if (&wild_tail==1)
  (
    if (STRING.MID("mmss_camss_cphy_csid0_clk", 0, &clk_input_length-1)==STRING.CUT("&clk", -1))
    ( 
      &match=1
    )
  )
  else if ("mmss_camss_cphy_csid0_clk"=="&clk")
  (
    &match=1
  )
  
  if (&match==1)
  (
    &clk_test=&CLK_TEST_MMSS_CAMSS_CPHY_CSID0_CLK
    &clk_reg=&HWIO_MMSS_CAMSS_CPHY_CSID0_CBCR_ADDR
    &clk_reg_name="MMSS_CAMSS_CPHY_CSID0_CBCR"
    &clk_name="mmss_camss_cphy_csid0_clk"
    &clk_reg_cbcr_type="sm_cbc"
    &clk_vote_bit=-1.
    &clk_multiplier=12.
    &clk_access_mode="&MMSS_access_mode"

    gosub Print_Clk_Info_Line
  )

  &match=0
  &wild_head=0
  &wild_tail=0
  &clk_input_length=STRING.LENGTH("&clk")
  &clk_itr_length=STRING.LENGTH("mmss_camss_cphy_csid1_clk")

  if (STRING.SCAN("&clk", "*", 0)==0)
  (
    &wild_head=1
  )
  if (STRING.SCAN("&clk", "*", 1)==(STRING.LENGTH("&clk")-1))
  (
    &wild_tail=1
  )

  if ((&wild_head==1)&&(&wild_tail==1))
  (
    if (STRING.SCAN("mmss_camss_cphy_csid1_clk", STRING.MID("&clk", 1, &clk_input_length-2), 0)!=-1)
    ( 
      &match=1
    )
  )
  else if (&wild_head==1)
  (
    if (STRING.MID("mmss_camss_cphy_csid1_clk", &clk_itr_length-&clk_input_length+1, &clk_input_length-1)==STRING.CUT("&clk", 1))
    ( 
      &match=1
    )
  )
  else if (&wild_tail==1)
  (
    if (STRING.MID("mmss_camss_cphy_csid1_clk", 0, &clk_input_length-1)==STRING.CUT("&clk", -1))
    ( 
      &match=1
    )
  )
  else if ("mmss_camss_cphy_csid1_clk"=="&clk")
  (
    &match=1
  )
  
  if (&match==1)
  (
    &clk_test=&CLK_TEST_MMSS_CAMSS_CPHY_CSID1_CLK
    &clk_reg=&HWIO_MMSS_CAMSS_CPHY_CSID1_CBCR_ADDR
    &clk_reg_name="MMSS_CAMSS_CPHY_CSID1_CBCR"
    &clk_name="mmss_camss_cphy_csid1_clk"
    &clk_reg_cbcr_type="sm_cbc"
    &clk_vote_bit=-1.
    &clk_multiplier=12.
    &clk_access_mode="&MMSS_access_mode"

    gosub Print_Clk_Info_Line
  )

  &match=0
  &wild_head=0
  &wild_tail=0
  &clk_input_length=STRING.LENGTH("&clk")
  &clk_itr_length=STRING.LENGTH("mmss_camss_cphy_csid2_clk")

  if (STRING.SCAN("&clk", "*", 0)==0)
  (
    &wild_head=1
  )
  if (STRING.SCAN("&clk", "*", 1)==(STRING.LENGTH("&clk")-1))
  (
    &wild_tail=1
  )

  if ((&wild_head==1)&&(&wild_tail==1))
  (
    if (STRING.SCAN("mmss_camss_cphy_csid2_clk", STRING.MID("&clk", 1, &clk_input_length-2), 0)!=-1)
    ( 
      &match=1
    )
  )
  else if (&wild_head==1)
  (
    if (STRING.MID("mmss_camss_cphy_csid2_clk", &clk_itr_length-&clk_input_length+1, &clk_input_length-1)==STRING.CUT("&clk", 1))
    ( 
      &match=1
    )
  )
  else if (&wild_tail==1)
  (
    if (STRING.MID("mmss_camss_cphy_csid2_clk", 0, &clk_input_length-1)==STRING.CUT("&clk", -1))
    ( 
      &match=1
    )
  )
  else if ("mmss_camss_cphy_csid2_clk"=="&clk")
  (
    &match=1
  )
  
  if (&match==1)
  (
    &clk_test=&CLK_TEST_MMSS_CAMSS_CPHY_CSID2_CLK
    &clk_reg=&HWIO_MMSS_CAMSS_CPHY_CSID2_CBCR_ADDR
    &clk_reg_name="MMSS_CAMSS_CPHY_CSID2_CBCR"
    &clk_name="mmss_camss_cphy_csid2_clk"
    &clk_reg_cbcr_type="sm_cbc"
    &clk_vote_bit=-1.
    &clk_multiplier=12.
    &clk_access_mode="&MMSS_access_mode"

    gosub Print_Clk_Info_Line
  )

  &match=0
  &wild_head=0
  &wild_tail=0
  &clk_input_length=STRING.LENGTH("&clk")
  &clk_itr_length=STRING.LENGTH("mmss_camss_cphy_csid3_clk")

  if (STRING.SCAN("&clk", "*", 0)==0)
  (
    &wild_head=1
  )
  if (STRING.SCAN("&clk", "*", 1)==(STRING.LENGTH("&clk")-1))
  (
    &wild_tail=1
  )

  if ((&wild_head==1)&&(&wild_tail==1))
  (
    if (STRING.SCAN("mmss_camss_cphy_csid3_clk", STRING.MID("&clk", 1, &clk_input_length-2), 0)!=-1)
    ( 
      &match=1
    )
  )
  else if (&wild_head==1)
  (
    if (STRING.MID("mmss_camss_cphy_csid3_clk", &clk_itr_length-&clk_input_length+1, &clk_input_length-1)==STRING.CUT("&clk", 1))
    ( 
      &match=1
    )
  )
  else if (&wild_tail==1)
  (
    if (STRING.MID("mmss_camss_cphy_csid3_clk", 0, &clk_input_length-1)==STRING.CUT("&clk", -1))
    ( 
      &match=1
    )
  )
  else if ("mmss_camss_cphy_csid3_clk"=="&clk")
  (
    &match=1
  )
  
  if (&match==1)
  (
    &clk_test=&CLK_TEST_MMSS_CAMSS_CPHY_CSID3_CLK
    &clk_reg=&HWIO_MMSS_CAMSS_CPHY_CSID3_CBCR_ADDR
    &clk_reg_name="MMSS_CAMSS_CPHY_CSID3_CBCR"
    &clk_name="mmss_camss_cphy_csid3_clk"
    &clk_reg_cbcr_type="sm_cbc"
    &clk_vote_bit=-1.
    &clk_multiplier=12.
    &clk_access_mode="&MMSS_access_mode"

    gosub Print_Clk_Info_Line
  )

  &match=0
  &wild_head=0
  &wild_tail=0
  &clk_input_length=STRING.LENGTH("&clk")
  &clk_itr_length=STRING.LENGTH("mmss_camss_csiphy0_clk")

  if (STRING.SCAN("&clk", "*", 0)==0)
  (
    &wild_head=1
  )
  if (STRING.SCAN("&clk", "*", 1)==(STRING.LENGTH("&clk")-1))
  (
    &wild_tail=1
  )

  if ((&wild_head==1)&&(&wild_tail==1))
  (
    if (STRING.SCAN("mmss_camss_csiphy0_clk", STRING.MID("&clk", 1, &clk_input_length-2), 0)!=-1)
    ( 
      &match=1
    )
  )
  else if (&wild_head==1)
  (
    if (STRING.MID("mmss_camss_csiphy0_clk", &clk_itr_length-&clk_input_length+1, &clk_input_length-1)==STRING.CUT("&clk", 1))
    ( 
      &match=1
    )
  )
  else if (&wild_tail==1)
  (
    if (STRING.MID("mmss_camss_csiphy0_clk", 0, &clk_input_length-1)==STRING.CUT("&clk", -1))
    ( 
      &match=1
    )
  )
  else if ("mmss_camss_csiphy0_clk"=="&clk")
  (
    &match=1
  )
  
  if (&match==1)
  (
    &clk_test=&CLK_TEST_MMSS_CAMSS_CSIPHY0_CLK
    &clk_reg=&HWIO_MMSS_CAMSS_CSIPHY0_CBCR_ADDR
    &clk_reg_name="MMSS_CAMSS_CSIPHY0_CBCR"
    &clk_name="mmss_camss_csiphy0_clk"
    &clk_reg_cbcr_type="sm_cbc"
    &clk_vote_bit=-1.
    &clk_multiplier=12.
    &clk_access_mode="&MMSS_access_mode"

    gosub Print_Clk_Info_Line
  )

  &match=0
  &wild_head=0
  &wild_tail=0
  &clk_input_length=STRING.LENGTH("&clk")
  &clk_itr_length=STRING.LENGTH("mmss_camss_csiphy1_clk")

  if (STRING.SCAN("&clk", "*", 0)==0)
  (
    &wild_head=1
  )
  if (STRING.SCAN("&clk", "*", 1)==(STRING.LENGTH("&clk")-1))
  (
    &wild_tail=1
  )

  if ((&wild_head==1)&&(&wild_tail==1))
  (
    if (STRING.SCAN("mmss_camss_csiphy1_clk", STRING.MID("&clk", 1, &clk_input_length-2), 0)!=-1)
    ( 
      &match=1
    )
  )
  else if (&wild_head==1)
  (
    if (STRING.MID("mmss_camss_csiphy1_clk", &clk_itr_length-&clk_input_length+1, &clk_input_length-1)==STRING.CUT("&clk", 1))
    ( 
      &match=1
    )
  )
  else if (&wild_tail==1)
  (
    if (STRING.MID("mmss_camss_csiphy1_clk", 0, &clk_input_length-1)==STRING.CUT("&clk", -1))
    ( 
      &match=1
    )
  )
  else if ("mmss_camss_csiphy1_clk"=="&clk")
  (
    &match=1
  )
  
  if (&match==1)
  (
    &clk_test=&CLK_TEST_MMSS_CAMSS_CSIPHY1_CLK
    &clk_reg=&HWIO_MMSS_CAMSS_CSIPHY1_CBCR_ADDR
    &clk_reg_name="MMSS_CAMSS_CSIPHY1_CBCR"
    &clk_name="mmss_camss_csiphy1_clk"
    &clk_reg_cbcr_type="sm_cbc"
    &clk_vote_bit=-1.
    &clk_multiplier=12.
    &clk_access_mode="&MMSS_access_mode"

    gosub Print_Clk_Info_Line
  )

  &match=0
  &wild_head=0
  &wild_tail=0
  &clk_input_length=STRING.LENGTH("&clk")
  &clk_itr_length=STRING.LENGTH("mmss_camss_csiphy2_clk")

  if (STRING.SCAN("&clk", "*", 0)==0)
  (
    &wild_head=1
  )
  if (STRING.SCAN("&clk", "*", 1)==(STRING.LENGTH("&clk")-1))
  (
    &wild_tail=1
  )

  if ((&wild_head==1)&&(&wild_tail==1))
  (
    if (STRING.SCAN("mmss_camss_csiphy2_clk", STRING.MID("&clk", 1, &clk_input_length-2), 0)!=-1)
    ( 
      &match=1
    )
  )
  else if (&wild_head==1)
  (
    if (STRING.MID("mmss_camss_csiphy2_clk", &clk_itr_length-&clk_input_length+1, &clk_input_length-1)==STRING.CUT("&clk", 1))
    ( 
      &match=1
    )
  )
  else if (&wild_tail==1)
  (
    if (STRING.MID("mmss_camss_csiphy2_clk", 0, &clk_input_length-1)==STRING.CUT("&clk", -1))
    ( 
      &match=1
    )
  )
  else if ("mmss_camss_csiphy2_clk"=="&clk")
  (
    &match=1
  )
  
  if (&match==1)
  (
    &clk_test=&CLK_TEST_MMSS_CAMSS_CSIPHY2_CLK
    &clk_reg=&HWIO_MMSS_CAMSS_CSIPHY2_CBCR_ADDR
    &clk_reg_name="MMSS_CAMSS_CSIPHY2_CBCR"
    &clk_name="mmss_camss_csiphy2_clk"
    &clk_reg_cbcr_type="sm_cbc"
    &clk_vote_bit=-1.
    &clk_multiplier=12.
    &clk_access_mode="&MMSS_access_mode"

    gosub Print_Clk_Info_Line
  )

  &match=0
  &wild_head=0
  &wild_tail=0
  &clk_input_length=STRING.LENGTH("&clk")
  &clk_itr_length=STRING.LENGTH("mmss_cxo_clk")

  if (STRING.SCAN("&clk", "*", 0)==0)
  (
    &wild_head=1
  )
  if (STRING.SCAN("&clk", "*", 1)==(STRING.LENGTH("&clk")-1))
  (
    &wild_tail=1
  )

  if ((&wild_head==1)&&(&wild_tail==1))
  (
    if (STRING.SCAN("mmss_cxo_clk", STRING.MID("&clk", 1, &clk_input_length-2), 0)!=-1)
    ( 
      &match=1
    )
  )
  else if (&wild_head==1)
  (
    if (STRING.MID("mmss_cxo_clk", &clk_itr_length-&clk_input_length+1, &clk_input_length-1)==STRING.CUT("&clk", 1))
    ( 
      &match=1
    )
  )
  else if (&wild_tail==1)
  (
    if (STRING.MID("mmss_cxo_clk", 0, &clk_input_length-1)==STRING.CUT("&clk", -1))
    ( 
      &match=1
    )
  )
  else if ("mmss_cxo_clk"=="&clk")
  (
    &match=1
  )
  
  if (&match==1)
  (
    &clk_test=0
    &clk_reg=&HWIO_MMSS_CXO_CBCR_ADDR
    &clk_reg_name="MMSS_CXO_CBCR"
    &clk_name="mmss_cxo_clk"
    &clk_reg_cbcr_type="sm_cbc"
    &clk_vote_bit=-1.
    &clk_multiplier=12.
    &clk_access_mode="&MMSS_access_mode"

    gosub Print_Clk_Info_Line
  )

  &match=0
  &wild_head=0
  &wild_tail=0
  &clk_input_length=STRING.LENGTH("&clk")
  &clk_itr_length=STRING.LENGTH("mmss_misc_cxo_clk")

  if (STRING.SCAN("&clk", "*", 0)==0)
  (
    &wild_head=1
  )
  if (STRING.SCAN("&clk", "*", 1)==(STRING.LENGTH("&clk")-1))
  (
    &wild_tail=1
  )

  if ((&wild_head==1)&&(&wild_tail==1))
  (
    if (STRING.SCAN("mmss_misc_cxo_clk", STRING.MID("&clk", 1, &clk_input_length-2), 0)!=-1)
    ( 
      &match=1
    )
  )
  else if (&wild_head==1)
  (
    if (STRING.MID("mmss_misc_cxo_clk", &clk_itr_length-&clk_input_length+1, &clk_input_length-1)==STRING.CUT("&clk", 1))
    ( 
      &match=1
    )
  )
  else if (&wild_tail==1)
  (
    if (STRING.MID("mmss_misc_cxo_clk", 0, &clk_input_length-1)==STRING.CUT("&clk", -1))
    ( 
      &match=1
    )
  )
  else if ("mmss_misc_cxo_clk"=="&clk")
  (
    &match=1
  )
  
  if (&match==1)
  (
    &clk_test=&CLK_TEST_MMSS_MISC_CXO_CLK
    &clk_reg=&HWIO_MMSS_MISC_CXO_CBCR_ADDR
    &clk_reg_name="MMSS_MISC_CXO_CBCR"
    &clk_name="mmss_misc_cxo_clk"
    &clk_reg_cbcr_type="sm_cbc"
    &clk_vote_bit=-1.
    &clk_multiplier=12.
    &clk_access_mode="&MMSS_access_mode"

    gosub Print_Clk_Info_Line
  )

  &match=0
  &wild_head=0
  &wild_tail=0
  &clk_input_length=STRING.LENGTH("&clk")
  &clk_itr_length=STRING.LENGTH("mmss_throttle_camss_cxo_clk")

  if (STRING.SCAN("&clk", "*", 0)==0)
  (
    &wild_head=1
  )
  if (STRING.SCAN("&clk", "*", 1)==(STRING.LENGTH("&clk")-1))
  (
    &wild_tail=1
  )

  if ((&wild_head==1)&&(&wild_tail==1))
  (
    if (STRING.SCAN("mmss_throttle_camss_cxo_clk", STRING.MID("&clk", 1, &clk_input_length-2), 0)!=-1)
    ( 
      &match=1
    )
  )
  else if (&wild_head==1)
  (
    if (STRING.MID("mmss_throttle_camss_cxo_clk", &clk_itr_length-&clk_input_length+1, &clk_input_length-1)==STRING.CUT("&clk", 1))
    ( 
      &match=1
    )
  )
  else if (&wild_tail==1)
  (
    if (STRING.MID("mmss_throttle_camss_cxo_clk", 0, &clk_input_length-1)==STRING.CUT("&clk", -1))
    ( 
      &match=1
    )
  )
  else if ("mmss_throttle_camss_cxo_clk"=="&clk")
  (
    &match=1
  )
  
  if (&match==1)
  (
    &clk_test=&CLK_TEST_MMSS_THROTTLE_CAMSS_CXO_CLK
    &clk_reg=&HWIO_MMSS_THROTTLE_CAMSS_CXO_CBCR_ADDR
    &clk_reg_name="MMSS_THROTTLE_CAMSS_CXO_CBCR"
    &clk_name="mmss_throttle_camss_cxo_clk"
    &clk_reg_cbcr_type="sm_cbc"
    &clk_vote_bit=-1.
    &clk_multiplier=12.
    &clk_access_mode="&MMSS_access_mode"

    gosub Print_Clk_Info_Line
  )

  &match=0
  &wild_head=0
  &wild_tail=0
  &clk_input_length=STRING.LENGTH("&clk")
  &clk_itr_length=STRING.LENGTH("mmss_throttle_mdss_cxo_clk")

  if (STRING.SCAN("&clk", "*", 0)==0)
  (
    &wild_head=1
  )
  if (STRING.SCAN("&clk", "*", 1)==(STRING.LENGTH("&clk")-1))
  (
    &wild_tail=1
  )

  if ((&wild_head==1)&&(&wild_tail==1))
  (
    if (STRING.SCAN("mmss_throttle_mdss_cxo_clk", STRING.MID("&clk", 1, &clk_input_length-2), 0)!=-1)
    ( 
      &match=1
    )
  )
  else if (&wild_head==1)
  (
    if (STRING.MID("mmss_throttle_mdss_cxo_clk", &clk_itr_length-&clk_input_length+1, &clk_input_length-1)==STRING.CUT("&clk", 1))
    ( 
      &match=1
    )
  )
  else if (&wild_tail==1)
  (
    if (STRING.MID("mmss_throttle_mdss_cxo_clk", 0, &clk_input_length-1)==STRING.CUT("&clk", -1))
    ( 
      &match=1
    )
  )
  else if ("mmss_throttle_mdss_cxo_clk"=="&clk")
  (
    &match=1
  )
  
  if (&match==1)
  (
    &clk_test=&CLK_TEST_MMSS_THROTTLE_MDSS_CXO_CLK
    &clk_reg=&HWIO_MMSS_THROTTLE_MDSS_CXO_CBCR_ADDR
    &clk_reg_name="MMSS_THROTTLE_MDSS_CXO_CBCR"
    &clk_name="mmss_throttle_mdss_cxo_clk"
    &clk_reg_cbcr_type="sm_cbc"
    &clk_vote_bit=-1.
    &clk_multiplier=12.
    &clk_access_mode="&MMSS_access_mode"

    gosub Print_Clk_Info_Line
  )

  &match=0
  &wild_head=0
  &wild_tail=0
  &clk_input_length=STRING.LENGTH("&clk")
  &clk_itr_length=STRING.LENGTH("mmss_throttle_video_cxo_clk")

  if (STRING.SCAN("&clk", "*", 0)==0)
  (
    &wild_head=1
  )
  if (STRING.SCAN("&clk", "*", 1)==(STRING.LENGTH("&clk")-1))
  (
    &wild_tail=1
  )

  if ((&wild_head==1)&&(&wild_tail==1))
  (
    if (STRING.SCAN("mmss_throttle_video_cxo_clk", STRING.MID("&clk", 1, &clk_input_length-2), 0)!=-1)
    ( 
      &match=1
    )
  )
  else if (&wild_head==1)
  (
    if (STRING.MID("mmss_throttle_video_cxo_clk", &clk_itr_length-&clk_input_length+1, &clk_input_length-1)==STRING.CUT("&clk", 1))
    ( 
      &match=1
    )
  )
  else if (&wild_tail==1)
  (
    if (STRING.MID("mmss_throttle_video_cxo_clk", 0, &clk_input_length-1)==STRING.CUT("&clk", -1))
    ( 
      &match=1
    )
  )
  else if ("mmss_throttle_video_cxo_clk"=="&clk")
  (
    &match=1
  )
  
  if (&match==1)
  (
    &clk_test=&CLK_TEST_MMSS_THROTTLE_VIDEO_CXO_CLK
    &clk_reg=&HWIO_MMSS_THROTTLE_VIDEO_CXO_CBCR_ADDR
    &clk_reg_name="MMSS_THROTTLE_VIDEO_CXO_CBCR"
    &clk_name="mmss_throttle_video_cxo_clk"
    &clk_reg_cbcr_type="sm_cbc"
    &clk_vote_bit=-1.
    &clk_multiplier=12.
    &clk_access_mode="&MMSS_access_mode"

    gosub Print_Clk_Info_Line
  )

  &match=0
  &wild_head=0
  &wild_tail=0
  &clk_input_length=STRING.LENGTH("&clk")
  &clk_itr_length=STRING.LENGTH("mmss_mdss_dp_aux_clk")

  if (STRING.SCAN("&clk", "*", 0)==0)
  (
    &wild_head=1
  )
  if (STRING.SCAN("&clk", "*", 1)==(STRING.LENGTH("&clk")-1))
  (
    &wild_tail=1
  )

  if ((&wild_head==1)&&(&wild_tail==1))
  (
    if (STRING.SCAN("mmss_mdss_dp_aux_clk", STRING.MID("&clk", 1, &clk_input_length-2), 0)!=-1)
    ( 
      &match=1
    )
  )
  else if (&wild_head==1)
  (
    if (STRING.MID("mmss_mdss_dp_aux_clk", &clk_itr_length-&clk_input_length+1, &clk_input_length-1)==STRING.CUT("&clk", 1))
    ( 
      &match=1
    )
  )
  else if (&wild_tail==1)
  (
    if (STRING.MID("mmss_mdss_dp_aux_clk", 0, &clk_input_length-1)==STRING.CUT("&clk", -1))
    ( 
      &match=1
    )
  )
  else if ("mmss_mdss_dp_aux_clk"=="&clk")
  (
    &match=1
  )
  
  if (&match==1)
  (
    &clk_test=&CLK_TEST_MMSS_MDSS_DP_AUX_CLK
    &clk_reg=&HWIO_MMSS_MDSS_DP_AUX_CBCR_ADDR
    &clk_reg_name="MMSS_MDSS_DP_AUX_CBCR"
    &clk_name="mmss_mdss_dp_aux_clk"
    &clk_reg_cbcr_type="sm_cbc"
    &clk_vote_bit=-1.
    &clk_multiplier=12.
    &clk_access_mode="&MMSS_access_mode"

    gosub Print_Clk_Info_Line
  )

  &match=0
  &wild_head=0
  &wild_tail=0
  &clk_input_length=STRING.LENGTH("&clk")
  &clk_itr_length=STRING.LENGTH("mmss_mdss_dp_crypto_clk")

  if (STRING.SCAN("&clk", "*", 0)==0)
  (
    &wild_head=1
  )
  if (STRING.SCAN("&clk", "*", 1)==(STRING.LENGTH("&clk")-1))
  (
    &wild_tail=1
  )

  if ((&wild_head==1)&&(&wild_tail==1))
  (
    if (STRING.SCAN("mmss_mdss_dp_crypto_clk", STRING.MID("&clk", 1, &clk_input_length-2), 0)!=-1)
    ( 
      &match=1
    )
  )
  else if (&wild_head==1)
  (
    if (STRING.MID("mmss_mdss_dp_crypto_clk", &clk_itr_length-&clk_input_length+1, &clk_input_length-1)==STRING.CUT("&clk", 1))
    ( 
      &match=1
    )
  )
  else if (&wild_tail==1)
  (
    if (STRING.MID("mmss_mdss_dp_crypto_clk", 0, &clk_input_length-1)==STRING.CUT("&clk", -1))
    ( 
      &match=1
    )
  )
  else if ("mmss_mdss_dp_crypto_clk"=="&clk")
  (
    &match=1
  )
  
  if (&match==1)
  (
    &clk_test=&CLK_TEST_MMSS_MDSS_DP_CRYPTO_CLK
    &clk_reg=&HWIO_MMSS_MDSS_DP_CRYPTO_CBCR_ADDR
    &clk_reg_name="MMSS_MDSS_DP_CRYPTO_CBCR"
    &clk_name="mmss_mdss_dp_crypto_clk"
    &clk_reg_cbcr_type="sm_cbc"
    &clk_vote_bit=-1.
    &clk_multiplier=12.
    &clk_access_mode="&MMSS_access_mode"

    gosub Print_Clk_Info_Line
  )

  &match=0
  &wild_head=0
  &wild_tail=0
  &clk_input_length=STRING.LENGTH("&clk")
  &clk_itr_length=STRING.LENGTH("mmss_spdm_dp_crypto_clk")

  if (STRING.SCAN("&clk", "*", 0)==0)
  (
    &wild_head=1
  )
  if (STRING.SCAN("&clk", "*", 1)==(STRING.LENGTH("&clk")-1))
  (
    &wild_tail=1
  )

  if ((&wild_head==1)&&(&wild_tail==1))
  (
    if (STRING.SCAN("mmss_spdm_dp_crypto_clk", STRING.MID("&clk", 1, &clk_input_length-2), 0)!=-1)
    ( 
      &match=1
    )
  )
  else if (&wild_head==1)
  (
    if (STRING.MID("mmss_spdm_dp_crypto_clk", &clk_itr_length-&clk_input_length+1, &clk_input_length-1)==STRING.CUT("&clk", 1))
    ( 
      &match=1
    )
  )
  else if (&wild_tail==1)
  (
    if (STRING.MID("mmss_spdm_dp_crypto_clk", 0, &clk_input_length-1)==STRING.CUT("&clk", -1))
    ( 
      &match=1
    )
  )
  else if ("mmss_spdm_dp_crypto_clk"=="&clk")
  (
    &match=1
  )
  
  if (&match==1)
  (
    &clk_test=&CLK_TEST_MMSS_SPDM_DP_CRYPTO_CLK
    &clk_reg=&HWIO_MMSS_SPDM_DP_CRYPTO_CBCR_ADDR
    &clk_reg_name="MMSS_SPDM_DP_CRYPTO_CBCR"
    &clk_name="mmss_spdm_dp_crypto_clk"
    &clk_reg_cbcr_type="sm_cbc"
    &clk_vote_bit=-1.
    &clk_multiplier=12.
    &clk_access_mode="&MMSS_access_mode"

    gosub Print_Clk_Info_Line
  )

  &match=0
  &wild_head=0
  &wild_tail=0
  &clk_input_length=STRING.LENGTH("&clk")
  &clk_itr_length=STRING.LENGTH("mmss_mdss_dp_gtc_clk")

  if (STRING.SCAN("&clk", "*", 0)==0)
  (
    &wild_head=1
  )
  if (STRING.SCAN("&clk", "*", 1)==(STRING.LENGTH("&clk")-1))
  (
    &wild_tail=1
  )

  if ((&wild_head==1)&&(&wild_tail==1))
  (
    if (STRING.SCAN("mmss_mdss_dp_gtc_clk", STRING.MID("&clk", 1, &clk_input_length-2), 0)!=-1)
    ( 
      &match=1
    )
  )
  else if (&wild_head==1)
  (
    if (STRING.MID("mmss_mdss_dp_gtc_clk", &clk_itr_length-&clk_input_length+1, &clk_input_length-1)==STRING.CUT("&clk", 1))
    ( 
      &match=1
    )
  )
  else if (&wild_tail==1)
  (
    if (STRING.MID("mmss_mdss_dp_gtc_clk", 0, &clk_input_length-1)==STRING.CUT("&clk", -1))
    ( 
      &match=1
    )
  )
  else if ("mmss_mdss_dp_gtc_clk"=="&clk")
  (
    &match=1
  )
  
  if (&match==1)
  (
    &clk_test=&CLK_TEST_MMSS_MDSS_DP_GTC_CLK
    &clk_reg=&HWIO_MMSS_MDSS_DP_GTC_CBCR_ADDR
    &clk_reg_name="MMSS_MDSS_DP_GTC_CBCR"
    &clk_name="mmss_mdss_dp_gtc_clk"
    &clk_reg_cbcr_type="sm_cbc"
    &clk_vote_bit=-1.
    &clk_multiplier=12.
    &clk_access_mode="&MMSS_access_mode"

    gosub Print_Clk_Info_Line
  )

  &match=0
  &wild_head=0
  &wild_tail=0
  &clk_input_length=STRING.LENGTH("&clk")
  &clk_itr_length=STRING.LENGTH("mmss_mdss_dp_link_clk")

  if (STRING.SCAN("&clk", "*", 0)==0)
  (
    &wild_head=1
  )
  if (STRING.SCAN("&clk", "*", 1)==(STRING.LENGTH("&clk")-1))
  (
    &wild_tail=1
  )

  if ((&wild_head==1)&&(&wild_tail==1))
  (
    if (STRING.SCAN("mmss_mdss_dp_link_clk", STRING.MID("&clk", 1, &clk_input_length-2), 0)!=-1)
    ( 
      &match=1
    )
  )
  else if (&wild_head==1)
  (
    if (STRING.MID("mmss_mdss_dp_link_clk", &clk_itr_length-&clk_input_length+1, &clk_input_length-1)==STRING.CUT("&clk", 1))
    ( 
      &match=1
    )
  )
  else if (&wild_tail==1)
  (
    if (STRING.MID("mmss_mdss_dp_link_clk", 0, &clk_input_length-1)==STRING.CUT("&clk", -1))
    ( 
      &match=1
    )
  )
  else if ("mmss_mdss_dp_link_clk"=="&clk")
  (
    &match=1
  )
  
  if (&match==1)
  (
    &clk_test=&CLK_TEST_MMSS_MDSS_DP_LINK_CLK
    &clk_reg=&HWIO_MMSS_MDSS_DP_LINK_CBCR_ADDR
    &clk_reg_name="MMSS_MDSS_DP_LINK_CBCR"
    &clk_name="mmss_mdss_dp_link_clk"
    &clk_reg_cbcr_type="sm_cbc"
    &clk_vote_bit=-1.
    &clk_multiplier=12.
    &clk_access_mode="&MMSS_access_mode"

    gosub Print_Clk_Info_Line
  )

  &match=0
  &wild_head=0
  &wild_tail=0
  &clk_input_length=STRING.LENGTH("&clk")
  &clk_itr_length=STRING.LENGTH("mmss_mdss_dp_link_intf_clk")

  if (STRING.SCAN("&clk", "*", 0)==0)
  (
    &wild_head=1
  )
  if (STRING.SCAN("&clk", "*", 1)==(STRING.LENGTH("&clk")-1))
  (
    &wild_tail=1
  )

  if ((&wild_head==1)&&(&wild_tail==1))
  (
    if (STRING.SCAN("mmss_mdss_dp_link_intf_clk", STRING.MID("&clk", 1, &clk_input_length-2), 0)!=-1)
    ( 
      &match=1
    )
  )
  else if (&wild_head==1)
  (
    if (STRING.MID("mmss_mdss_dp_link_intf_clk", &clk_itr_length-&clk_input_length+1, &clk_input_length-1)==STRING.CUT("&clk", 1))
    ( 
      &match=1
    )
  )
  else if (&wild_tail==1)
  (
    if (STRING.MID("mmss_mdss_dp_link_intf_clk", 0, &clk_input_length-1)==STRING.CUT("&clk", -1))
    ( 
      &match=1
    )
  )
  else if ("mmss_mdss_dp_link_intf_clk"=="&clk")
  (
    &match=1
  )
  
  if (&match==1)
  (
    &clk_test=&CLK_TEST_MMSS_MDSS_DP_LINK_INTF_CLK
    &clk_reg=&HWIO_MMSS_MDSS_DP_LINK_INTF_CBCR_ADDR
    &clk_reg_name="MMSS_MDSS_DP_LINK_INTF_CBCR"
    &clk_name="mmss_mdss_dp_link_intf_clk"
    &clk_reg_cbcr_type="sm_cbc"
    &clk_vote_bit=-1.
    &clk_multiplier=12.
    &clk_access_mode="&MMSS_access_mode"

    gosub Print_Clk_Info_Line
  )

  &match=0
  &wild_head=0
  &wild_tail=0
  &clk_input_length=STRING.LENGTH("&clk")
  &clk_itr_length=STRING.LENGTH("mmss_mdss_dp_pixel_clk")

  if (STRING.SCAN("&clk", "*", 0)==0)
  (
    &wild_head=1
  )
  if (STRING.SCAN("&clk", "*", 1)==(STRING.LENGTH("&clk")-1))
  (
    &wild_tail=1
  )

  if ((&wild_head==1)&&(&wild_tail==1))
  (
    if (STRING.SCAN("mmss_mdss_dp_pixel_clk", STRING.MID("&clk", 1, &clk_input_length-2), 0)!=-1)
    ( 
      &match=1
    )
  )
  else if (&wild_head==1)
  (
    if (STRING.MID("mmss_mdss_dp_pixel_clk", &clk_itr_length-&clk_input_length+1, &clk_input_length-1)==STRING.CUT("&clk", 1))
    ( 
      &match=1
    )
  )
  else if (&wild_tail==1)
  (
    if (STRING.MID("mmss_mdss_dp_pixel_clk", 0, &clk_input_length-1)==STRING.CUT("&clk", -1))
    ( 
      &match=1
    )
  )
  else if ("mmss_mdss_dp_pixel_clk"=="&clk")
  (
    &match=1
  )
  
  if (&match==1)
  (
    &clk_test=&CLK_TEST_MMSS_MDSS_DP_PIXEL_CLK
    &clk_reg=&HWIO_MMSS_MDSS_DP_PIXEL_CBCR_ADDR
    &clk_reg_name="MMSS_MDSS_DP_PIXEL_CBCR"
    &clk_name="mmss_mdss_dp_pixel_clk"
    &clk_reg_cbcr_type="sm_cbc"
    &clk_vote_bit=-1.
    &clk_multiplier=12.
    &clk_access_mode="&MMSS_access_mode"

    gosub Print_Clk_Info_Line
  )

  &match=0
  &wild_head=0
  &wild_tail=0
  &clk_input_length=STRING.LENGTH("&clk")
  &clk_itr_length=STRING.LENGTH("mmss_spdm_dp_pixel_clk")

  if (STRING.SCAN("&clk", "*", 0)==0)
  (
    &wild_head=1
  )
  if (STRING.SCAN("&clk", "*", 1)==(STRING.LENGTH("&clk")-1))
  (
    &wild_tail=1
  )

  if ((&wild_head==1)&&(&wild_tail==1))
  (
    if (STRING.SCAN("mmss_spdm_dp_pixel_clk", STRING.MID("&clk", 1, &clk_input_length-2), 0)!=-1)
    ( 
      &match=1
    )
  )
  else if (&wild_head==1)
  (
    if (STRING.MID("mmss_spdm_dp_pixel_clk", &clk_itr_length-&clk_input_length+1, &clk_input_length-1)==STRING.CUT("&clk", 1))
    ( 
      &match=1
    )
  )
  else if (&wild_tail==1)
  (
    if (STRING.MID("mmss_spdm_dp_pixel_clk", 0, &clk_input_length-1)==STRING.CUT("&clk", -1))
    ( 
      &match=1
    )
  )
  else if ("mmss_spdm_dp_pixel_clk"=="&clk")
  (
    &match=1
  )
  
  if (&match==1)
  (
    &clk_test=&CLK_TEST_MMSS_SPDM_DP_PIXEL_CLK
    &clk_reg=&HWIO_MMSS_SPDM_DP_PIXEL_CBCR_ADDR
    &clk_reg_name="MMSS_SPDM_DP_PIXEL_CBCR"
    &clk_name="mmss_spdm_dp_pixel_clk"
    &clk_reg_cbcr_type="sm_cbc"
    &clk_vote_bit=-1.
    &clk_multiplier=12.
    &clk_access_mode="&MMSS_access_mode"

    gosub Print_Clk_Info_Line
  )

  &match=0
  &wild_head=0
  &wild_tail=0
  &clk_input_length=STRING.LENGTH("&clk")
  &clk_itr_length=STRING.LENGTH("mmss_mdss_esc0_clk")

  if (STRING.SCAN("&clk", "*", 0)==0)
  (
    &wild_head=1
  )
  if (STRING.SCAN("&clk", "*", 1)==(STRING.LENGTH("&clk")-1))
  (
    &wild_tail=1
  )

  if ((&wild_head==1)&&(&wild_tail==1))
  (
    if (STRING.SCAN("mmss_mdss_esc0_clk", STRING.MID("&clk", 1, &clk_input_length-2), 0)!=-1)
    ( 
      &match=1
    )
  )
  else if (&wild_head==1)
  (
    if (STRING.MID("mmss_mdss_esc0_clk", &clk_itr_length-&clk_input_length+1, &clk_input_length-1)==STRING.CUT("&clk", 1))
    ( 
      &match=1
    )
  )
  else if (&wild_tail==1)
  (
    if (STRING.MID("mmss_mdss_esc0_clk", 0, &clk_input_length-1)==STRING.CUT("&clk", -1))
    ( 
      &match=1
    )
  )
  else if ("mmss_mdss_esc0_clk"=="&clk")
  (
    &match=1
  )
  
  if (&match==1)
  (
    &clk_test=&CLK_TEST_MMSS_MDSS_ESC0_CLK
    &clk_reg=&HWIO_MMSS_MDSS_ESC0_CBCR_ADDR
    &clk_reg_name="MMSS_MDSS_ESC0_CBCR"
    &clk_name="mmss_mdss_esc0_clk"
    &clk_reg_cbcr_type="sm_cbc"
    &clk_vote_bit=-1.
    &clk_multiplier=12.
    &clk_access_mode="&MMSS_access_mode"

    gosub Print_Clk_Info_Line
  )

  &match=0
  &wild_head=0
  &wild_tail=0
  &clk_input_length=STRING.LENGTH("&clk")
  &clk_itr_length=STRING.LENGTH("mmss_mdss_esc1_clk")

  if (STRING.SCAN("&clk", "*", 0)==0)
  (
    &wild_head=1
  )
  if (STRING.SCAN("&clk", "*", 1)==(STRING.LENGTH("&clk")-1))
  (
    &wild_tail=1
  )

  if ((&wild_head==1)&&(&wild_tail==1))
  (
    if (STRING.SCAN("mmss_mdss_esc1_clk", STRING.MID("&clk", 1, &clk_input_length-2), 0)!=-1)
    ( 
      &match=1
    )
  )
  else if (&wild_head==1)
  (
    if (STRING.MID("mmss_mdss_esc1_clk", &clk_itr_length-&clk_input_length+1, &clk_input_length-1)==STRING.CUT("&clk", 1))
    ( 
      &match=1
    )
  )
  else if (&wild_tail==1)
  (
    if (STRING.MID("mmss_mdss_esc1_clk", 0, &clk_input_length-1)==STRING.CUT("&clk", -1))
    ( 
      &match=1
    )
  )
  else if ("mmss_mdss_esc1_clk"=="&clk")
  (
    &match=1
  )
  
  if (&match==1)
  (
    &clk_test=&CLK_TEST_MMSS_MDSS_ESC1_CLK
    &clk_reg=&HWIO_MMSS_MDSS_ESC1_CBCR_ADDR
    &clk_reg_name="MMSS_MDSS_ESC1_CBCR"
    &clk_name="mmss_mdss_esc1_clk"
    &clk_reg_cbcr_type="sm_cbc"
    &clk_vote_bit=-1.
    &clk_multiplier=12.
    &clk_access_mode="&MMSS_access_mode"

    gosub Print_Clk_Info_Line
  )

  &match=0
  &wild_head=0
  &wild_tail=0
  &clk_input_length=STRING.LENGTH("&clk")
  &clk_itr_length=STRING.LENGTH("mmss_camss_jpeg0_clk")

  if (STRING.SCAN("&clk", "*", 0)==0)
  (
    &wild_head=1
  )
  if (STRING.SCAN("&clk", "*", 1)==(STRING.LENGTH("&clk")-1))
  (
    &wild_tail=1
  )

  if ((&wild_head==1)&&(&wild_tail==1))
  (
    if (STRING.SCAN("mmss_camss_jpeg0_clk", STRING.MID("&clk", 1, &clk_input_length-2), 0)!=-1)
    ( 
      &match=1
    )
  )
  else if (&wild_head==1)
  (
    if (STRING.MID("mmss_camss_jpeg0_clk", &clk_itr_length-&clk_input_length+1, &clk_input_length-1)==STRING.CUT("&clk", 1))
    ( 
      &match=1
    )
  )
  else if (&wild_tail==1)
  (
    if (STRING.MID("mmss_camss_jpeg0_clk", 0, &clk_input_length-1)==STRING.CUT("&clk", -1))
    ( 
      &match=1
    )
  )
  else if ("mmss_camss_jpeg0_clk"=="&clk")
  (
    &match=1
  )
  
  if (&match==1)
  (
    &clk_test=&CLK_TEST_MMSS_CAMSS_JPEG0_CLK
    &clk_reg=&HWIO_MMSS_CAMSS_JPEG0_CBCR_ADDR
    &clk_reg_name="MMSS_CAMSS_JPEG0_CBCR"
    &clk_name="mmss_camss_jpeg0_clk"
    &clk_reg_cbcr_type="sm_sreg_pscbc"
    &clk_vote_bit=-1.
    &clk_multiplier=12.
    &clk_access_mode="&MMSS_access_mode"

    gosub Print_Clk_Info_Line
  )

  &match=0
  &wild_head=0
  &wild_tail=0
  &clk_input_length=STRING.LENGTH("&clk")
  &clk_itr_length=STRING.LENGTH("mmss_spdm_jpeg0_clk")

  if (STRING.SCAN("&clk", "*", 0)==0)
  (
    &wild_head=1
  )
  if (STRING.SCAN("&clk", "*", 1)==(STRING.LENGTH("&clk")-1))
  (
    &wild_tail=1
  )

  if ((&wild_head==1)&&(&wild_tail==1))
  (
    if (STRING.SCAN("mmss_spdm_jpeg0_clk", STRING.MID("&clk", 1, &clk_input_length-2), 0)!=-1)
    ( 
      &match=1
    )
  )
  else if (&wild_head==1)
  (
    if (STRING.MID("mmss_spdm_jpeg0_clk", &clk_itr_length-&clk_input_length+1, &clk_input_length-1)==STRING.CUT("&clk", 1))
    ( 
      &match=1
    )
  )
  else if (&wild_tail==1)
  (
    if (STRING.MID("mmss_spdm_jpeg0_clk", 0, &clk_input_length-1)==STRING.CUT("&clk", -1))
    ( 
      &match=1
    )
  )
  else if ("mmss_spdm_jpeg0_clk"=="&clk")
  (
    &match=1
  )
  
  if (&match==1)
  (
    &clk_test=&CLK_TEST_MMSS_SPDM_JPEG0_CLK
    &clk_reg=&HWIO_MMSS_SPDM_JPEG0_CBCR_ADDR
    &clk_reg_name="MMSS_SPDM_JPEG0_CBCR"
    &clk_name="mmss_spdm_jpeg0_clk"
    &clk_reg_cbcr_type="sm_cbc"
    &clk_vote_bit=-1.
    &clk_multiplier=12.
    &clk_access_mode="&MMSS_access_mode"

    gosub Print_Clk_Info_Line
  )

  &match=0
  &wild_head=0
  &wild_tail=0
  &clk_input_length=STRING.LENGTH("&clk")
  &clk_itr_length=STRING.LENGTH("mmss_camss_mclk0_clk")

  if (STRING.SCAN("&clk", "*", 0)==0)
  (
    &wild_head=1
  )
  if (STRING.SCAN("&clk", "*", 1)==(STRING.LENGTH("&clk")-1))
  (
    &wild_tail=1
  )

  if ((&wild_head==1)&&(&wild_tail==1))
  (
    if (STRING.SCAN("mmss_camss_mclk0_clk", STRING.MID("&clk", 1, &clk_input_length-2), 0)!=-1)
    ( 
      &match=1
    )
  )
  else if (&wild_head==1)
  (
    if (STRING.MID("mmss_camss_mclk0_clk", &clk_itr_length-&clk_input_length+1, &clk_input_length-1)==STRING.CUT("&clk", 1))
    ( 
      &match=1
    )
  )
  else if (&wild_tail==1)
  (
    if (STRING.MID("mmss_camss_mclk0_clk", 0, &clk_input_length-1)==STRING.CUT("&clk", -1))
    ( 
      &match=1
    )
  )
  else if ("mmss_camss_mclk0_clk"=="&clk")
  (
    &match=1
  )
  
  if (&match==1)
  (
    &clk_test=&CLK_TEST_MMSS_CAMSS_MCLK0_CLK
    &clk_reg=&HWIO_MMSS_CAMSS_MCLK0_CBCR_ADDR
    &clk_reg_name="MMSS_CAMSS_MCLK0_CBCR"
    &clk_name="mmss_camss_mclk0_clk"
    &clk_reg_cbcr_type="sm_cbc"
    &clk_vote_bit=-1.
    &clk_multiplier=12.
    &clk_access_mode="&MMSS_access_mode"

    gosub Print_Clk_Info_Line
  )

  &match=0
  &wild_head=0
  &wild_tail=0
  &clk_input_length=STRING.LENGTH("&clk")
  &clk_itr_length=STRING.LENGTH("mmss_camss_mclk1_clk")

  if (STRING.SCAN("&clk", "*", 0)==0)
  (
    &wild_head=1
  )
  if (STRING.SCAN("&clk", "*", 1)==(STRING.LENGTH("&clk")-1))
  (
    &wild_tail=1
  )

  if ((&wild_head==1)&&(&wild_tail==1))
  (
    if (STRING.SCAN("mmss_camss_mclk1_clk", STRING.MID("&clk", 1, &clk_input_length-2), 0)!=-1)
    ( 
      &match=1
    )
  )
  else if (&wild_head==1)
  (
    if (STRING.MID("mmss_camss_mclk1_clk", &clk_itr_length-&clk_input_length+1, &clk_input_length-1)==STRING.CUT("&clk", 1))
    ( 
      &match=1
    )
  )
  else if (&wild_tail==1)
  (
    if (STRING.MID("mmss_camss_mclk1_clk", 0, &clk_input_length-1)==STRING.CUT("&clk", -1))
    ( 
      &match=1
    )
  )
  else if ("mmss_camss_mclk1_clk"=="&clk")
  (
    &match=1
  )
  
  if (&match==1)
  (
    &clk_test=&CLK_TEST_MMSS_CAMSS_MCLK1_CLK
    &clk_reg=&HWIO_MMSS_CAMSS_MCLK1_CBCR_ADDR
    &clk_reg_name="MMSS_CAMSS_MCLK1_CBCR"
    &clk_name="mmss_camss_mclk1_clk"
    &clk_reg_cbcr_type="sm_cbc"
    &clk_vote_bit=-1.
    &clk_multiplier=12.
    &clk_access_mode="&MMSS_access_mode"

    gosub Print_Clk_Info_Line
  )

  &match=0
  &wild_head=0
  &wild_tail=0
  &clk_input_length=STRING.LENGTH("&clk")
  &clk_itr_length=STRING.LENGTH("mmss_camss_mclk2_clk")

  if (STRING.SCAN("&clk", "*", 0)==0)
  (
    &wild_head=1
  )
  if (STRING.SCAN("&clk", "*", 1)==(STRING.LENGTH("&clk")-1))
  (
    &wild_tail=1
  )

  if ((&wild_head==1)&&(&wild_tail==1))
  (
    if (STRING.SCAN("mmss_camss_mclk2_clk", STRING.MID("&clk", 1, &clk_input_length-2), 0)!=-1)
    ( 
      &match=1
    )
  )
  else if (&wild_head==1)
  (
    if (STRING.MID("mmss_camss_mclk2_clk", &clk_itr_length-&clk_input_length+1, &clk_input_length-1)==STRING.CUT("&clk", 1))
    ( 
      &match=1
    )
  )
  else if (&wild_tail==1)
  (
    if (STRING.MID("mmss_camss_mclk2_clk", 0, &clk_input_length-1)==STRING.CUT("&clk", -1))
    ( 
      &match=1
    )
  )
  else if ("mmss_camss_mclk2_clk"=="&clk")
  (
    &match=1
  )
  
  if (&match==1)
  (
    &clk_test=&CLK_TEST_MMSS_CAMSS_MCLK2_CLK
    &clk_reg=&HWIO_MMSS_CAMSS_MCLK2_CBCR_ADDR
    &clk_reg_name="MMSS_CAMSS_MCLK2_CBCR"
    &clk_name="mmss_camss_mclk2_clk"
    &clk_reg_cbcr_type="sm_cbc"
    &clk_vote_bit=-1.
    &clk_multiplier=12.
    &clk_access_mode="&MMSS_access_mode"

    gosub Print_Clk_Info_Line
  )

  &match=0
  &wild_head=0
  &wild_tail=0
  &clk_input_length=STRING.LENGTH("&clk")
  &clk_itr_length=STRING.LENGTH("mmss_camss_mclk3_clk")

  if (STRING.SCAN("&clk", "*", 0)==0)
  (
    &wild_head=1
  )
  if (STRING.SCAN("&clk", "*", 1)==(STRING.LENGTH("&clk")-1))
  (
    &wild_tail=1
  )

  if ((&wild_head==1)&&(&wild_tail==1))
  (
    if (STRING.SCAN("mmss_camss_mclk3_clk", STRING.MID("&clk", 1, &clk_input_length-2), 0)!=-1)
    ( 
      &match=1
    )
  )
  else if (&wild_head==1)
  (
    if (STRING.MID("mmss_camss_mclk3_clk", &clk_itr_length-&clk_input_length+1, &clk_input_length-1)==STRING.CUT("&clk", 1))
    ( 
      &match=1
    )
  )
  else if (&wild_tail==1)
  (
    if (STRING.MID("mmss_camss_mclk3_clk", 0, &clk_input_length-1)==STRING.CUT("&clk", -1))
    ( 
      &match=1
    )
  )
  else if ("mmss_camss_mclk3_clk"=="&clk")
  (
    &match=1
  )
  
  if (&match==1)
  (
    &clk_test=&CLK_TEST_MMSS_CAMSS_MCLK3_CLK
    &clk_reg=&HWIO_MMSS_CAMSS_MCLK3_CBCR_ADDR
    &clk_reg_name="MMSS_CAMSS_MCLK3_CBCR"
    &clk_name="mmss_camss_mclk3_clk"
    &clk_reg_cbcr_type="sm_cbc"
    &clk_vote_bit=-1.
    &clk_multiplier=12.
    &clk_access_mode="&MMSS_access_mode"

    gosub Print_Clk_Info_Line
  )

  &match=0
  &wild_head=0
  &wild_tail=0
  &clk_input_length=STRING.LENGTH("&clk")
  &clk_itr_length=STRING.LENGTH("mmss_mdss_mdp_clk")

  if (STRING.SCAN("&clk", "*", 0)==0)
  (
    &wild_head=1
  )
  if (STRING.SCAN("&clk", "*", 1)==(STRING.LENGTH("&clk")-1))
  (
    &wild_tail=1
  )

  if ((&wild_head==1)&&(&wild_tail==1))
  (
    if (STRING.SCAN("mmss_mdss_mdp_clk", STRING.MID("&clk", 1, &clk_input_length-2), 0)!=-1)
    ( 
      &match=1
    )
  )
  else if (&wild_head==1)
  (
    if (STRING.MID("mmss_mdss_mdp_clk", &clk_itr_length-&clk_input_length+1, &clk_input_length-1)==STRING.CUT("&clk", 1))
    ( 
      &match=1
    )
  )
  else if (&wild_tail==1)
  (
    if (STRING.MID("mmss_mdss_mdp_clk", 0, &clk_input_length-1)==STRING.CUT("&clk", -1))
    ( 
      &match=1
    )
  )
  else if ("mmss_mdss_mdp_clk"=="&clk")
  (
    &match=1
  )
  
  if (&match==1)
  (
    &clk_test=&CLK_TEST_MMSS_MDSS_MDP_CLK
    &clk_reg=&HWIO_MMSS_MDSS_MDP_CBCR_ADDR
    &clk_reg_name="MMSS_MDSS_MDP_CBCR"
    &clk_name="mmss_mdss_mdp_clk"
    &clk_reg_cbcr_type="sm_sreg_pscbc"
    &clk_vote_bit=-1.
    &clk_multiplier=12.
    &clk_access_mode="&MMSS_access_mode"

    gosub Print_Clk_Info_Line
  )

  &match=0
  &wild_head=0
  &wild_tail=0
  &clk_input_length=STRING.LENGTH("&clk")
  &clk_itr_length=STRING.LENGTH("mmss_spdm_mdp_clk")

  if (STRING.SCAN("&clk", "*", 0)==0)
  (
    &wild_head=1
  )
  if (STRING.SCAN("&clk", "*", 1)==(STRING.LENGTH("&clk")-1))
  (
    &wild_tail=1
  )

  if ((&wild_head==1)&&(&wild_tail==1))
  (
    if (STRING.SCAN("mmss_spdm_mdp_clk", STRING.MID("&clk", 1, &clk_input_length-2), 0)!=-1)
    ( 
      &match=1
    )
  )
  else if (&wild_head==1)
  (
    if (STRING.MID("mmss_spdm_mdp_clk", &clk_itr_length-&clk_input_length+1, &clk_input_length-1)==STRING.CUT("&clk", 1))
    ( 
      &match=1
    )
  )
  else if (&wild_tail==1)
  (
    if (STRING.MID("mmss_spdm_mdp_clk", 0, &clk_input_length-1)==STRING.CUT("&clk", -1))
    ( 
      &match=1
    )
  )
  else if ("mmss_spdm_mdp_clk"=="&clk")
  (
    &match=1
  )
  
  if (&match==1)
  (
    &clk_test=&CLK_TEST_MMSS_SPDM_MDP_CLK
    &clk_reg=&HWIO_MMSS_SPDM_MDP_CBCR_ADDR
    &clk_reg_name="MMSS_SPDM_MDP_CBCR"
    &clk_name="mmss_spdm_mdp_clk"
    &clk_reg_cbcr_type="sm_cbc"
    &clk_vote_bit=-1.
    &clk_multiplier=12.
    &clk_access_mode="&MMSS_access_mode"

    gosub Print_Clk_Info_Line
  )

  &match=0
  &wild_head=0
  &wild_tail=0
  &clk_input_length=STRING.LENGTH("&clk")
  &clk_itr_length=STRING.LENGTH("mmss_mdss_pclk0_clk")

  if (STRING.SCAN("&clk", "*", 0)==0)
  (
    &wild_head=1
  )
  if (STRING.SCAN("&clk", "*", 1)==(STRING.LENGTH("&clk")-1))
  (
    &wild_tail=1
  )

  if ((&wild_head==1)&&(&wild_tail==1))
  (
    if (STRING.SCAN("mmss_mdss_pclk0_clk", STRING.MID("&clk", 1, &clk_input_length-2), 0)!=-1)
    ( 
      &match=1
    )
  )
  else if (&wild_head==1)
  (
    if (STRING.MID("mmss_mdss_pclk0_clk", &clk_itr_length-&clk_input_length+1, &clk_input_length-1)==STRING.CUT("&clk", 1))
    ( 
      &match=1
    )
  )
  else if (&wild_tail==1)
  (
    if (STRING.MID("mmss_mdss_pclk0_clk", 0, &clk_input_length-1)==STRING.CUT("&clk", -1))
    ( 
      &match=1
    )
  )
  else if ("mmss_mdss_pclk0_clk"=="&clk")
  (
    &match=1
  )
  
  if (&match==1)
  (
    &clk_test=&CLK_TEST_MMSS_MDSS_PCLK0_CLK
    &clk_reg=&HWIO_MMSS_MDSS_PCLK0_CBCR_ADDR
    &clk_reg_name="MMSS_MDSS_PCLK0_CBCR"
    &clk_name="mmss_mdss_pclk0_clk"
    &clk_reg_cbcr_type="sm_cbc"
    &clk_vote_bit=-1.
    &clk_multiplier=12.
    &clk_access_mode="&MMSS_access_mode"

    gosub Print_Clk_Info_Line
  )

  &match=0
  &wild_head=0
  &wild_tail=0
  &clk_input_length=STRING.LENGTH("&clk")
  &clk_itr_length=STRING.LENGTH("mmss_spdm_pclk0_clk")

  if (STRING.SCAN("&clk", "*", 0)==0)
  (
    &wild_head=1
  )
  if (STRING.SCAN("&clk", "*", 1)==(STRING.LENGTH("&clk")-1))
  (
    &wild_tail=1
  )

  if ((&wild_head==1)&&(&wild_tail==1))
  (
    if (STRING.SCAN("mmss_spdm_pclk0_clk", STRING.MID("&clk", 1, &clk_input_length-2), 0)!=-1)
    ( 
      &match=1
    )
  )
  else if (&wild_head==1)
  (
    if (STRING.MID("mmss_spdm_pclk0_clk", &clk_itr_length-&clk_input_length+1, &clk_input_length-1)==STRING.CUT("&clk", 1))
    ( 
      &match=1
    )
  )
  else if (&wild_tail==1)
  (
    if (STRING.MID("mmss_spdm_pclk0_clk", 0, &clk_input_length-1)==STRING.CUT("&clk", -1))
    ( 
      &match=1
    )
  )
  else if ("mmss_spdm_pclk0_clk"=="&clk")
  (
    &match=1
  )
  
  if (&match==1)
  (
    &clk_test=&CLK_TEST_MMSS_SPDM_PCLK0_CLK
    &clk_reg=&HWIO_MMSS_SPDM_PCLK0_CBCR_ADDR
    &clk_reg_name="MMSS_SPDM_PCLK0_CBCR"
    &clk_name="mmss_spdm_pclk0_clk"
    &clk_reg_cbcr_type="sm_cbc"
    &clk_vote_bit=-1.
    &clk_multiplier=12.
    &clk_access_mode="&MMSS_access_mode"

    gosub Print_Clk_Info_Line
  )

  &match=0
  &wild_head=0
  &wild_tail=0
  &clk_input_length=STRING.LENGTH("&clk")
  &clk_itr_length=STRING.LENGTH("mmss_mdss_pclk1_clk")

  if (STRING.SCAN("&clk", "*", 0)==0)
  (
    &wild_head=1
  )
  if (STRING.SCAN("&clk", "*", 1)==(STRING.LENGTH("&clk")-1))
  (
    &wild_tail=1
  )

  if ((&wild_head==1)&&(&wild_tail==1))
  (
    if (STRING.SCAN("mmss_mdss_pclk1_clk", STRING.MID("&clk", 1, &clk_input_length-2), 0)!=-1)
    ( 
      &match=1
    )
  )
  else if (&wild_head==1)
  (
    if (STRING.MID("mmss_mdss_pclk1_clk", &clk_itr_length-&clk_input_length+1, &clk_input_length-1)==STRING.CUT("&clk", 1))
    ( 
      &match=1
    )
  )
  else if (&wild_tail==1)
  (
    if (STRING.MID("mmss_mdss_pclk1_clk", 0, &clk_input_length-1)==STRING.CUT("&clk", -1))
    ( 
      &match=1
    )
  )
  else if ("mmss_mdss_pclk1_clk"=="&clk")
  (
    &match=1
  )
  
  if (&match==1)
  (
    &clk_test=&CLK_TEST_MMSS_MDSS_PCLK1_CLK
    &clk_reg=&HWIO_MMSS_MDSS_PCLK1_CBCR_ADDR
    &clk_reg_name="MMSS_MDSS_PCLK1_CBCR"
    &clk_name="mmss_mdss_pclk1_clk"
    &clk_reg_cbcr_type="sm_cbc"
    &clk_vote_bit=-1.
    &clk_multiplier=12.
    &clk_access_mode="&MMSS_access_mode"

    gosub Print_Clk_Info_Line
  )

  &match=0
  &wild_head=0
  &wild_tail=0
  &clk_input_length=STRING.LENGTH("&clk")
  &clk_itr_length=STRING.LENGTH("mmss_spdm_pclk1_clk")

  if (STRING.SCAN("&clk", "*", 0)==0)
  (
    &wild_head=1
  )
  if (STRING.SCAN("&clk", "*", 1)==(STRING.LENGTH("&clk")-1))
  (
    &wild_tail=1
  )

  if ((&wild_head==1)&&(&wild_tail==1))
  (
    if (STRING.SCAN("mmss_spdm_pclk1_clk", STRING.MID("&clk", 1, &clk_input_length-2), 0)!=-1)
    ( 
      &match=1
    )
  )
  else if (&wild_head==1)
  (
    if (STRING.MID("mmss_spdm_pclk1_clk", &clk_itr_length-&clk_input_length+1, &clk_input_length-1)==STRING.CUT("&clk", 1))
    ( 
      &match=1
    )
  )
  else if (&wild_tail==1)
  (
    if (STRING.MID("mmss_spdm_pclk1_clk", 0, &clk_input_length-1)==STRING.CUT("&clk", -1))
    ( 
      &match=1
    )
  )
  else if ("mmss_spdm_pclk1_clk"=="&clk")
  (
    &match=1
  )
  
  if (&match==1)
  (
    &clk_test=&CLK_TEST_MMSS_SPDM_PCLK1_CLK
    &clk_reg=&HWIO_MMSS_SPDM_PCLK1_CBCR_ADDR
    &clk_reg_name="MMSS_SPDM_PCLK1_CBCR"
    &clk_name="mmss_spdm_pclk1_clk"
    &clk_reg_cbcr_type="sm_cbc"
    &clk_vote_bit=-1.
    &clk_multiplier=12.
    &clk_access_mode="&MMSS_access_mode"

    gosub Print_Clk_Info_Line
  )

  &match=0
  &wild_head=0
  &wild_tail=0
  &clk_input_length=STRING.LENGTH("&clk")
  &clk_itr_length=STRING.LENGTH("mmss_mdss_rot_clk")

  if (STRING.SCAN("&clk", "*", 0)==0)
  (
    &wild_head=1
  )
  if (STRING.SCAN("&clk", "*", 1)==(STRING.LENGTH("&clk")-1))
  (
    &wild_tail=1
  )

  if ((&wild_head==1)&&(&wild_tail==1))
  (
    if (STRING.SCAN("mmss_mdss_rot_clk", STRING.MID("&clk", 1, &clk_input_length-2), 0)!=-1)
    ( 
      &match=1
    )
  )
  else if (&wild_head==1)
  (
    if (STRING.MID("mmss_mdss_rot_clk", &clk_itr_length-&clk_input_length+1, &clk_input_length-1)==STRING.CUT("&clk", 1))
    ( 
      &match=1
    )
  )
  else if (&wild_tail==1)
  (
    if (STRING.MID("mmss_mdss_rot_clk", 0, &clk_input_length-1)==STRING.CUT("&clk", -1))
    ( 
      &match=1
    )
  )
  else if ("mmss_mdss_rot_clk"=="&clk")
  (
    &match=1
  )
  
  if (&match==1)
  (
    &clk_test=&CLK_TEST_MMSS_MDSS_ROT_CLK
    &clk_reg=&HWIO_MMSS_MDSS_ROT_CBCR_ADDR
    &clk_reg_name="MMSS_MDSS_ROT_CBCR"
    &clk_name="mmss_mdss_rot_clk"
    &clk_reg_cbcr_type="sm_sreg_pscbc"
    &clk_vote_bit=-1.
    &clk_multiplier=12.
    &clk_access_mode="&MMSS_access_mode"

    gosub Print_Clk_Info_Line
  )

  &match=0
  &wild_head=0
  &wild_tail=0
  &clk_input_length=STRING.LENGTH("&clk")
  &clk_itr_length=STRING.LENGTH("mmss_spdm_rot_clk")

  if (STRING.SCAN("&clk", "*", 0)==0)
  (
    &wild_head=1
  )
  if (STRING.SCAN("&clk", "*", 1)==(STRING.LENGTH("&clk")-1))
  (
    &wild_tail=1
  )

  if ((&wild_head==1)&&(&wild_tail==1))
  (
    if (STRING.SCAN("mmss_spdm_rot_clk", STRING.MID("&clk", 1, &clk_input_length-2), 0)!=-1)
    ( 
      &match=1
    )
  )
  else if (&wild_head==1)
  (
    if (STRING.MID("mmss_spdm_rot_clk", &clk_itr_length-&clk_input_length+1, &clk_input_length-1)==STRING.CUT("&clk", 1))
    ( 
      &match=1
    )
  )
  else if (&wild_tail==1)
  (
    if (STRING.MID("mmss_spdm_rot_clk", 0, &clk_input_length-1)==STRING.CUT("&clk", -1))
    ( 
      &match=1
    )
  )
  else if ("mmss_spdm_rot_clk"=="&clk")
  (
    &match=1
  )
  
  if (&match==1)
  (
    &clk_test=&CLK_TEST_MMSS_SPDM_ROT_CLK
    &clk_reg=&HWIO_MMSS_SPDM_ROT_CBCR_ADDR
    &clk_reg_name="MMSS_SPDM_ROT_CBCR"
    &clk_name="mmss_spdm_rot_clk"
    &clk_reg_cbcr_type="sm_cbc"
    &clk_vote_bit=-1.
    &clk_multiplier=12.
    &clk_access_mode="&MMSS_access_mode"

    gosub Print_Clk_Info_Line
  )

  &match=0
  &wild_head=0
  &wild_tail=0
  &clk_input_length=STRING.LENGTH("&clk")
  &clk_itr_length=STRING.LENGTH("mmss_camss_csi_vfe0_clk")

  if (STRING.SCAN("&clk", "*", 0)==0)
  (
    &wild_head=1
  )
  if (STRING.SCAN("&clk", "*", 1)==(STRING.LENGTH("&clk")-1))
  (
    &wild_tail=1
  )

  if ((&wild_head==1)&&(&wild_tail==1))
  (
    if (STRING.SCAN("mmss_camss_csi_vfe0_clk", STRING.MID("&clk", 1, &clk_input_length-2), 0)!=-1)
    ( 
      &match=1
    )
  )
  else if (&wild_head==1)
  (
    if (STRING.MID("mmss_camss_csi_vfe0_clk", &clk_itr_length-&clk_input_length+1, &clk_input_length-1)==STRING.CUT("&clk", 1))
    ( 
      &match=1
    )
  )
  else if (&wild_tail==1)
  (
    if (STRING.MID("mmss_camss_csi_vfe0_clk", 0, &clk_input_length-1)==STRING.CUT("&clk", -1))
    ( 
      &match=1
    )
  )
  else if ("mmss_camss_csi_vfe0_clk"=="&clk")
  (
    &match=1
  )
  
  if (&match==1)
  (
    &clk_test=&CLK_TEST_MMSS_CAMSS_CSI_VFE0_CLK
    &clk_reg=&HWIO_MMSS_CAMSS_CSI_VFE0_CBCR_ADDR
    &clk_reg_name="MMSS_CAMSS_CSI_VFE0_CBCR"
    &clk_name="mmss_camss_csi_vfe0_clk"
    &clk_reg_cbcr_type="sm_sreg_pscbc"
    &clk_vote_bit=-1.
    &clk_multiplier=12.
    &clk_access_mode="&MMSS_access_mode"

    gosub Print_Clk_Info_Line
  )

  &match=0
  &wild_head=0
  &wild_tail=0
  &clk_input_length=STRING.LENGTH("&clk")
  &clk_itr_length=STRING.LENGTH("mmss_camss_vfe0_clk")

  if (STRING.SCAN("&clk", "*", 0)==0)
  (
    &wild_head=1
  )
  if (STRING.SCAN("&clk", "*", 1)==(STRING.LENGTH("&clk")-1))
  (
    &wild_tail=1
  )

  if ((&wild_head==1)&&(&wild_tail==1))
  (
    if (STRING.SCAN("mmss_camss_vfe0_clk", STRING.MID("&clk", 1, &clk_input_length-2), 0)!=-1)
    ( 
      &match=1
    )
  )
  else if (&wild_head==1)
  (
    if (STRING.MID("mmss_camss_vfe0_clk", &clk_itr_length-&clk_input_length+1, &clk_input_length-1)==STRING.CUT("&clk", 1))
    ( 
      &match=1
    )
  )
  else if (&wild_tail==1)
  (
    if (STRING.MID("mmss_camss_vfe0_clk", 0, &clk_input_length-1)==STRING.CUT("&clk", -1))
    ( 
      &match=1
    )
  )
  else if ("mmss_camss_vfe0_clk"=="&clk")
  (
    &match=1
  )
  
  if (&match==1)
  (
    &clk_test=&CLK_TEST_MMSS_CAMSS_VFE0_CLK
    &clk_reg=&HWIO_MMSS_CAMSS_VFE0_CBCR_ADDR
    &clk_reg_name="MMSS_CAMSS_VFE0_CBCR"
    &clk_name="mmss_camss_vfe0_clk"
    &clk_reg_cbcr_type="sm_sreg_pscbc"
    &clk_vote_bit=-1.
    &clk_multiplier=12.
    &clk_access_mode="&MMSS_access_mode"

    gosub Print_Clk_Info_Line
  )

  &match=0
  &wild_head=0
  &wild_tail=0
  &clk_input_length=STRING.LENGTH("&clk")
  &clk_itr_length=STRING.LENGTH("mmss_camss_vfe0_stream_clk")

  if (STRING.SCAN("&clk", "*", 0)==0)
  (
    &wild_head=1
  )
  if (STRING.SCAN("&clk", "*", 1)==(STRING.LENGTH("&clk")-1))
  (
    &wild_tail=1
  )

  if ((&wild_head==1)&&(&wild_tail==1))
  (
    if (STRING.SCAN("mmss_camss_vfe0_stream_clk", STRING.MID("&clk", 1, &clk_input_length-2), 0)!=-1)
    ( 
      &match=1
    )
  )
  else if (&wild_head==1)
  (
    if (STRING.MID("mmss_camss_vfe0_stream_clk", &clk_itr_length-&clk_input_length+1, &clk_input_length-1)==STRING.CUT("&clk", 1))
    ( 
      &match=1
    )
  )
  else if (&wild_tail==1)
  (
    if (STRING.MID("mmss_camss_vfe0_stream_clk", 0, &clk_input_length-1)==STRING.CUT("&clk", -1))
    ( 
      &match=1
    )
  )
  else if ("mmss_camss_vfe0_stream_clk"=="&clk")
  (
    &match=1
  )
  
  if (&match==1)
  (
    &clk_test=&CLK_TEST_MMSS_CAMSS_VFE0_STREAM_CLK
    &clk_reg=&HWIO_MMSS_CAMSS_VFE0_STREAM_CBCR_ADDR
    &clk_reg_name="MMSS_CAMSS_VFE0_STREAM_CBCR"
    &clk_name="mmss_camss_vfe0_stream_clk"
    &clk_reg_cbcr_type="sm_cbc"
    &clk_vote_bit=-1.
    &clk_multiplier=12.
    &clk_access_mode="&MMSS_access_mode"

    gosub Print_Clk_Info_Line
  )

  &match=0
  &wild_head=0
  &wild_tail=0
  &clk_input_length=STRING.LENGTH("&clk")
  &clk_itr_length=STRING.LENGTH("mmss_spdm_vfe0_clk")

  if (STRING.SCAN("&clk", "*", 0)==0)
  (
    &wild_head=1
  )
  if (STRING.SCAN("&clk", "*", 1)==(STRING.LENGTH("&clk")-1))
  (
    &wild_tail=1
  )

  if ((&wild_head==1)&&(&wild_tail==1))
  (
    if (STRING.SCAN("mmss_spdm_vfe0_clk", STRING.MID("&clk", 1, &clk_input_length-2), 0)!=-1)
    ( 
      &match=1
    )
  )
  else if (&wild_head==1)
  (
    if (STRING.MID("mmss_spdm_vfe0_clk", &clk_itr_length-&clk_input_length+1, &clk_input_length-1)==STRING.CUT("&clk", 1))
    ( 
      &match=1
    )
  )
  else if (&wild_tail==1)
  (
    if (STRING.MID("mmss_spdm_vfe0_clk", 0, &clk_input_length-1)==STRING.CUT("&clk", -1))
    ( 
      &match=1
    )
  )
  else if ("mmss_spdm_vfe0_clk"=="&clk")
  (
    &match=1
  )
  
  if (&match==1)
  (
    &clk_test=&CLK_TEST_MMSS_SPDM_VFE0_CLK
    &clk_reg=&HWIO_MMSS_SPDM_VFE0_CBCR_ADDR
    &clk_reg_name="MMSS_SPDM_VFE0_CBCR"
    &clk_name="mmss_spdm_vfe0_clk"
    &clk_reg_cbcr_type="sm_cbc"
    &clk_vote_bit=-1.
    &clk_multiplier=12.
    &clk_access_mode="&MMSS_access_mode"

    gosub Print_Clk_Info_Line
  )

  &match=0
  &wild_head=0
  &wild_tail=0
  &clk_input_length=STRING.LENGTH("&clk")
  &clk_itr_length=STRING.LENGTH("mmss_camss_csi_vfe1_clk")

  if (STRING.SCAN("&clk", "*", 0)==0)
  (
    &wild_head=1
  )
  if (STRING.SCAN("&clk", "*", 1)==(STRING.LENGTH("&clk")-1))
  (
    &wild_tail=1
  )

  if ((&wild_head==1)&&(&wild_tail==1))
  (
    if (STRING.SCAN("mmss_camss_csi_vfe1_clk", STRING.MID("&clk", 1, &clk_input_length-2), 0)!=-1)
    ( 
      &match=1
    )
  )
  else if (&wild_head==1)
  (
    if (STRING.MID("mmss_camss_csi_vfe1_clk", &clk_itr_length-&clk_input_length+1, &clk_input_length-1)==STRING.CUT("&clk", 1))
    ( 
      &match=1
    )
  )
  else if (&wild_tail==1)
  (
    if (STRING.MID("mmss_camss_csi_vfe1_clk", 0, &clk_input_length-1)==STRING.CUT("&clk", -1))
    ( 
      &match=1
    )
  )
  else if ("mmss_camss_csi_vfe1_clk"=="&clk")
  (
    &match=1
  )
  
  if (&match==1)
  (
    &clk_test=&CLK_TEST_MMSS_CAMSS_CSI_VFE1_CLK
    &clk_reg=&HWIO_MMSS_CAMSS_CSI_VFE1_CBCR_ADDR
    &clk_reg_name="MMSS_CAMSS_CSI_VFE1_CBCR"
    &clk_name="mmss_camss_csi_vfe1_clk"
    &clk_reg_cbcr_type="sm_sreg_pscbc"
    &clk_vote_bit=-1.
    &clk_multiplier=12.
    &clk_access_mode="&MMSS_access_mode"

    gosub Print_Clk_Info_Line
  )

  &match=0
  &wild_head=0
  &wild_tail=0
  &clk_input_length=STRING.LENGTH("&clk")
  &clk_itr_length=STRING.LENGTH("mmss_camss_vfe1_clk")

  if (STRING.SCAN("&clk", "*", 0)==0)
  (
    &wild_head=1
  )
  if (STRING.SCAN("&clk", "*", 1)==(STRING.LENGTH("&clk")-1))
  (
    &wild_tail=1
  )

  if ((&wild_head==1)&&(&wild_tail==1))
  (
    if (STRING.SCAN("mmss_camss_vfe1_clk", STRING.MID("&clk", 1, &clk_input_length-2), 0)!=-1)
    ( 
      &match=1
    )
  )
  else if (&wild_head==1)
  (
    if (STRING.MID("mmss_camss_vfe1_clk", &clk_itr_length-&clk_input_length+1, &clk_input_length-1)==STRING.CUT("&clk", 1))
    ( 
      &match=1
    )
  )
  else if (&wild_tail==1)
  (
    if (STRING.MID("mmss_camss_vfe1_clk", 0, &clk_input_length-1)==STRING.CUT("&clk", -1))
    ( 
      &match=1
    )
  )
  else if ("mmss_camss_vfe1_clk"=="&clk")
  (
    &match=1
  )
  
  if (&match==1)
  (
    &clk_test=&CLK_TEST_MMSS_CAMSS_VFE1_CLK
    &clk_reg=&HWIO_MMSS_CAMSS_VFE1_CBCR_ADDR
    &clk_reg_name="MMSS_CAMSS_VFE1_CBCR"
    &clk_name="mmss_camss_vfe1_clk"
    &clk_reg_cbcr_type="sm_sreg_pscbc"
    &clk_vote_bit=-1.
    &clk_multiplier=12.
    &clk_access_mode="&MMSS_access_mode"

    gosub Print_Clk_Info_Line
  )

  &match=0
  &wild_head=0
  &wild_tail=0
  &clk_input_length=STRING.LENGTH("&clk")
  &clk_itr_length=STRING.LENGTH("mmss_camss_vfe1_stream_clk")

  if (STRING.SCAN("&clk", "*", 0)==0)
  (
    &wild_head=1
  )
  if (STRING.SCAN("&clk", "*", 1)==(STRING.LENGTH("&clk")-1))
  (
    &wild_tail=1
  )

  if ((&wild_head==1)&&(&wild_tail==1))
  (
    if (STRING.SCAN("mmss_camss_vfe1_stream_clk", STRING.MID("&clk", 1, &clk_input_length-2), 0)!=-1)
    ( 
      &match=1
    )
  )
  else if (&wild_head==1)
  (
    if (STRING.MID("mmss_camss_vfe1_stream_clk", &clk_itr_length-&clk_input_length+1, &clk_input_length-1)==STRING.CUT("&clk", 1))
    ( 
      &match=1
    )
  )
  else if (&wild_tail==1)
  (
    if (STRING.MID("mmss_camss_vfe1_stream_clk", 0, &clk_input_length-1)==STRING.CUT("&clk", -1))
    ( 
      &match=1
    )
  )
  else if ("mmss_camss_vfe1_stream_clk"=="&clk")
  (
    &match=1
  )
  
  if (&match==1)
  (
    &clk_test=&CLK_TEST_MMSS_CAMSS_VFE1_STREAM_CLK
    &clk_reg=&HWIO_MMSS_CAMSS_VFE1_STREAM_CBCR_ADDR
    &clk_reg_name="MMSS_CAMSS_VFE1_STREAM_CBCR"
    &clk_name="mmss_camss_vfe1_stream_clk"
    &clk_reg_cbcr_type="sm_cbc"
    &clk_vote_bit=-1.
    &clk_multiplier=12.
    &clk_access_mode="&MMSS_access_mode"

    gosub Print_Clk_Info_Line
  )

  &match=0
  &wild_head=0
  &wild_tail=0
  &clk_input_length=STRING.LENGTH("&clk")
  &clk_itr_length=STRING.LENGTH("mmss_spdm_vfe1_clk")

  if (STRING.SCAN("&clk", "*", 0)==0)
  (
    &wild_head=1
  )
  if (STRING.SCAN("&clk", "*", 1)==(STRING.LENGTH("&clk")-1))
  (
    &wild_tail=1
  )

  if ((&wild_head==1)&&(&wild_tail==1))
  (
    if (STRING.SCAN("mmss_spdm_vfe1_clk", STRING.MID("&clk", 1, &clk_input_length-2), 0)!=-1)
    ( 
      &match=1
    )
  )
  else if (&wild_head==1)
  (
    if (STRING.MID("mmss_spdm_vfe1_clk", &clk_itr_length-&clk_input_length+1, &clk_input_length-1)==STRING.CUT("&clk", 1))
    ( 
      &match=1
    )
  )
  else if (&wild_tail==1)
  (
    if (STRING.MID("mmss_spdm_vfe1_clk", 0, &clk_input_length-1)==STRING.CUT("&clk", -1))
    ( 
      &match=1
    )
  )
  else if ("mmss_spdm_vfe1_clk"=="&clk")
  (
    &match=1
  )
  
  if (&match==1)
  (
    &clk_test=&CLK_TEST_MMSS_SPDM_VFE1_CLK
    &clk_reg=&HWIO_MMSS_SPDM_VFE1_CBCR_ADDR
    &clk_reg_name="MMSS_SPDM_VFE1_CBCR"
    &clk_name="mmss_spdm_vfe1_clk"
    &clk_reg_cbcr_type="sm_cbc"
    &clk_vote_bit=-1.
    &clk_multiplier=12.
    &clk_access_mode="&MMSS_access_mode"

    gosub Print_Clk_Info_Line
  )

  &match=0
  &wild_head=0
  &wild_tail=0
  &clk_input_length=STRING.LENGTH("&clk")
  &clk_itr_length=STRING.LENGTH("mmss_spdm_video_core_clk")

  if (STRING.SCAN("&clk", "*", 0)==0)
  (
    &wild_head=1
  )
  if (STRING.SCAN("&clk", "*", 1)==(STRING.LENGTH("&clk")-1))
  (
    &wild_tail=1
  )

  if ((&wild_head==1)&&(&wild_tail==1))
  (
    if (STRING.SCAN("mmss_spdm_video_core_clk", STRING.MID("&clk", 1, &clk_input_length-2), 0)!=-1)
    ( 
      &match=1
    )
  )
  else if (&wild_head==1)
  (
    if (STRING.MID("mmss_spdm_video_core_clk", &clk_itr_length-&clk_input_length+1, &clk_input_length-1)==STRING.CUT("&clk", 1))
    ( 
      &match=1
    )
  )
  else if (&wild_tail==1)
  (
    if (STRING.MID("mmss_spdm_video_core_clk", 0, &clk_input_length-1)==STRING.CUT("&clk", -1))
    ( 
      &match=1
    )
  )
  else if ("mmss_spdm_video_core_clk"=="&clk")
  (
    &match=1
  )
  
  if (&match==1)
  (
    &clk_test=&CLK_TEST_MMSS_SPDM_VIDEO_CORE_CLK
    &clk_reg=&HWIO_MMSS_SPDM_VIDEO_CORE_CBCR_ADDR
    &clk_reg_name="MMSS_SPDM_VIDEO_CORE_CBCR"
    &clk_name="mmss_spdm_video_core_clk"
    &clk_reg_cbcr_type="sm_cbc"
    &clk_vote_bit=-1.
    &clk_multiplier=12.
    &clk_access_mode="&MMSS_access_mode"

    gosub Print_Clk_Info_Line
  )

  &match=0
  &wild_head=0
  &wild_tail=0
  &clk_input_length=STRING.LENGTH("&clk")
  &clk_itr_length=STRING.LENGTH("mmss_video_core_clk")

  if (STRING.SCAN("&clk", "*", 0)==0)
  (
    &wild_head=1
  )
  if (STRING.SCAN("&clk", "*", 1)==(STRING.LENGTH("&clk")-1))
  (
    &wild_tail=1
  )

  if ((&wild_head==1)&&(&wild_tail==1))
  (
    if (STRING.SCAN("mmss_video_core_clk", STRING.MID("&clk", 1, &clk_input_length-2), 0)!=-1)
    ( 
      &match=1
    )
  )
  else if (&wild_head==1)
  (
    if (STRING.MID("mmss_video_core_clk", &clk_itr_length-&clk_input_length+1, &clk_input_length-1)==STRING.CUT("&clk", 1))
    ( 
      &match=1
    )
  )
  else if (&wild_tail==1)
  (
    if (STRING.MID("mmss_video_core_clk", 0, &clk_input_length-1)==STRING.CUT("&clk", -1))
    ( 
      &match=1
    )
  )
  else if ("mmss_video_core_clk"=="&clk")
  (
    &match=1
  )
  
  if (&match==1)
  (
    &clk_test=&CLK_TEST_MMSS_VIDEO_CORE_CLK
    &clk_reg=&HWIO_MMSS_VIDEO_CORE_CBCR_ADDR
    &clk_reg_name="MMSS_VIDEO_CORE_CBCR"
    &clk_name="mmss_video_core_clk"
    &clk_reg_cbcr_type="sm_pscbc"
    &clk_vote_bit=-1.
    &clk_multiplier=12.
    &clk_access_mode="&MMSS_access_mode"

    gosub Print_Clk_Info_Line
  )

  &match=0
  &wild_head=0
  &wild_tail=0
  &clk_input_length=STRING.LENGTH("&clk")
  &clk_itr_length=STRING.LENGTH("mmss_video_subcore0_clk")

  if (STRING.SCAN("&clk", "*", 0)==0)
  (
    &wild_head=1
  )
  if (STRING.SCAN("&clk", "*", 1)==(STRING.LENGTH("&clk")-1))
  (
    &wild_tail=1
  )

  if ((&wild_head==1)&&(&wild_tail==1))
  (
    if (STRING.SCAN("mmss_video_subcore0_clk", STRING.MID("&clk", 1, &clk_input_length-2), 0)!=-1)
    ( 
      &match=1
    )
  )
  else if (&wild_head==1)
  (
    if (STRING.MID("mmss_video_subcore0_clk", &clk_itr_length-&clk_input_length+1, &clk_input_length-1)==STRING.CUT("&clk", 1))
    ( 
      &match=1
    )
  )
  else if (&wild_tail==1)
  (
    if (STRING.MID("mmss_video_subcore0_clk", 0, &clk_input_length-1)==STRING.CUT("&clk", -1))
    ( 
      &match=1
    )
  )
  else if ("mmss_video_subcore0_clk"=="&clk")
  (
    &match=1
  )
  
  if (&match==1)
  (
    &clk_test=&CLK_TEST_MMSS_VIDEO_SUBCORE0_CLK
    &clk_reg=&HWIO_MMSS_VIDEO_SUBCORE0_CBCR_ADDR
    &clk_reg_name="MMSS_VIDEO_SUBCORE0_CBCR"
    &clk_name="mmss_video_subcore0_clk"
    &clk_reg_cbcr_type="sm_sreg_pscbc"
    &clk_vote_bit=-1.
    &clk_multiplier=12.
    &clk_access_mode="&MMSS_access_mode"

    gosub Print_Clk_Info_Line
  )

  &match=0
  &wild_head=0
  &wild_tail=0
  &clk_input_length=STRING.LENGTH("&clk")
  &clk_itr_length=STRING.LENGTH("mmss_mdss_vsync_clk")

  if (STRING.SCAN("&clk", "*", 0)==0)
  (
    &wild_head=1
  )
  if (STRING.SCAN("&clk", "*", 1)==(STRING.LENGTH("&clk")-1))
  (
    &wild_tail=1
  )

  if ((&wild_head==1)&&(&wild_tail==1))
  (
    if (STRING.SCAN("mmss_mdss_vsync_clk", STRING.MID("&clk", 1, &clk_input_length-2), 0)!=-1)
    ( 
      &match=1
    )
  )
  else if (&wild_head==1)
  (
    if (STRING.MID("mmss_mdss_vsync_clk", &clk_itr_length-&clk_input_length+1, &clk_input_length-1)==STRING.CUT("&clk", 1))
    ( 
      &match=1
    )
  )
  else if (&wild_tail==1)
  (
    if (STRING.MID("mmss_mdss_vsync_clk", 0, &clk_input_length-1)==STRING.CUT("&clk", -1))
    ( 
      &match=1
    )
  )
  else if ("mmss_mdss_vsync_clk"=="&clk")
  (
    &match=1
  )
  
  if (&match==1)
  (
    &clk_test=&CLK_TEST_MMSS_MDSS_VSYNC_CLK
    &clk_reg=&HWIO_MMSS_MDSS_VSYNC_CBCR_ADDR
    &clk_reg_name="MMSS_MDSS_VSYNC_CBCR"
    &clk_name="mmss_mdss_vsync_clk"
    &clk_reg_cbcr_type="sm_cbc"
    &clk_vote_bit=-1.
    &clk_multiplier=12.
    &clk_access_mode="&MMSS_access_mode"

    gosub Print_Clk_Info_Line
  )


  return



;-----------------------------------------------------------------------------
; Set appropriate mux settings for configurable clocks 
;-----------------------------------------------------------------------------

Set_Clock_Freq_Enter:

  ; Return for now. Need to figure out a way to map source to HW.
  return

  if ("&clk"=="gcc_sec_ctrl_acc_clk")
  (
    gosub PRINT_SET_CLOCK_FREQ_WARNING

    &clk_cmd_rcgr_addr=&HWIO_GCC_ACC_CMD_RCGR_ADDR
    &clk_cfg_rcgr_addr=&HWIO_GCC_ACC_CFG_RCGR_ADDR

    print "Choose frequency (MHz) from list below: " 

    print "19.2           37.5           75.0           " 
    print "150.0          200.0          " 

    print " "
    print "Enter desired frequency (r to return): "
    enter &clk_desired_freq
    print " "

    if ("&clk_desired_freq"=="19.2")
    (
      &clk_src_name="XO"
      &clk_src_sel=SRC_SEL TODO.
      &clk_src_div=2.
      &clk_m_val=0.
      &clk_n_val=0.
      &clk_2d_val=0.
      
      gosub Set_Clock_Freq
      return
    )
    else if ("&clk_desired_freq"=="37.5")
    (
      &clk_src_name="GPLL0_OUT_MAIN"
      &clk_src_sel=SRC_SEL TODO.
      &clk_src_div=32.
      &clk_m_val=0.
      &clk_n_val=0.
      &clk_2d_val=0.
      
      gosub Set_Clock_Freq
      return
    )
    else if ("&clk_desired_freq"=="75.0")
    (
      &clk_src_name="GPLL0_OUT_MAIN"
      &clk_src_sel=SRC_SEL TODO.
      &clk_src_div=16.
      &clk_m_val=0.
      &clk_n_val=0.
      &clk_2d_val=0.
      
      gosub Set_Clock_Freq
      return
    )
    else if ("&clk_desired_freq"=="150.0")
    (
      &clk_src_name="GPLL0_OUT_MAIN"
      &clk_src_sel=SRC_SEL TODO.
      &clk_src_div=8.
      &clk_m_val=0.
      &clk_n_val=0.
      &clk_2d_val=0.
      
      gosub Set_Clock_Freq
      return
    )
    else if ("&clk_desired_freq"=="200.0")
    (
      &clk_src_name="GPLL0_OUT_MAIN"
      &clk_src_sel=SRC_SEL TODO.
      &clk_src_div=6.
      &clk_m_val=0.
      &clk_n_val=0.
      &clk_2d_val=0.
      
      gosub Set_Clock_Freq
      return
    )
    else if ("&clk_desired_freq"=="r")
    (
      return
    )
    else
    (
      print "Invalid selection."
      goto Set_Clock_Freq_Enter
    )
  )

  if ("&clk"=="gcc_apc0_vs_clk")
  (
    gosub PRINT_SET_CLOCK_FREQ_WARNING

    &clk_cmd_rcgr_addr=&HWIO_GCC_APC0_VS_CMD_RCGR_ADDR
    &clk_cfg_rcgr_addr=&HWIO_GCC_APC0_VS_CFG_RCGR_ADDR

    print "Choose frequency (MHz) from list below: " 

    print "19.2           300.0          600.0          " 

    print " "
    print "Enter desired frequency (r to return): "
    enter &clk_desired_freq
    print " "

    if ("&clk_desired_freq"=="19.2")
    (
      &clk_src_name="XO"
      &clk_src_sel=SRC_SEL TODO.
      &clk_src_div=2.
      &clk_m_val=0.
      &clk_n_val=0.
      &clk_2d_val=0.
      
      gosub Set_Clock_Freq
      return
    )
    else if ("&clk_desired_freq"=="300.0")
    (
      &clk_src_name="GPLL0_OUT_MAIN"
      &clk_src_sel=SRC_SEL TODO.
      &clk_src_div=4.
      &clk_m_val=0.
      &clk_n_val=0.
      &clk_2d_val=0.
      
      gosub Set_Clock_Freq
      return
    )
    else if ("&clk_desired_freq"=="600.0")
    (
      &clk_src_name="GPLL0_OUT_MAIN"
      &clk_src_sel=SRC_SEL TODO.
      &clk_src_div=2.
      &clk_m_val=0.
      &clk_n_val=0.
      &clk_2d_val=0.
      
      gosub Set_Clock_Freq
      return
    )
    else if ("&clk_desired_freq"=="r")
    (
      return
    )
    else
    (
      print "Invalid selection."
      goto Set_Clock_Freq_Enter
    )
  )

  if ("&clk"=="gcc_apc1_vs_clk")
  (
    gosub PRINT_SET_CLOCK_FREQ_WARNING

    &clk_cmd_rcgr_addr=&HWIO_GCC_APC1_VS_CMD_RCGR_ADDR
    &clk_cfg_rcgr_addr=&HWIO_GCC_APC1_VS_CFG_RCGR_ADDR

    print "Choose frequency (MHz) from list below: " 

    print "19.2           300.0          600.0          " 

    print " "
    print "Enter desired frequency (r to return): "
    enter &clk_desired_freq
    print " "

    if ("&clk_desired_freq"=="19.2")
    (
      &clk_src_name="XO"
      &clk_src_sel=SRC_SEL TODO.
      &clk_src_div=2.
      &clk_m_val=0.
      &clk_n_val=0.
      &clk_2d_val=0.
      
      gosub Set_Clock_Freq
      return
    )
    else if ("&clk_desired_freq"=="300.0")
    (
      &clk_src_name="GPLL0_OUT_MAIN"
      &clk_src_sel=SRC_SEL TODO.
      &clk_src_div=4.
      &clk_m_val=0.
      &clk_n_val=0.
      &clk_2d_val=0.
      
      gosub Set_Clock_Freq
      return
    )
    else if ("&clk_desired_freq"=="600.0")
    (
      &clk_src_name="GPLL0_OUT_MAIN"
      &clk_src_sel=SRC_SEL TODO.
      &clk_src_div=2.
      &clk_m_val=0.
      &clk_n_val=0.
      &clk_2d_val=0.
      
      gosub Set_Clock_Freq
      return
    )
    else if ("&clk_desired_freq"=="r")
    (
      return
    )
    else
    (
      print "Invalid selection."
      goto Set_Clock_Freq_Enter
    )
  )

  if ("&clk"=="gcc_bimc_clk")||("&clk"=="gcc_spdm_bimc_cy_clk")
  (
    gosub PRINT_SET_CLOCK_FREQ_WARNING

    &clk_cmd_rcgr_addr=&HWIO_GCC_BIMC_CMD_RCGR_ADDR
    &clk_cfg_rcgr_addr=&HWIO_GCC_BIMC_CFG_RCGR_ADDR

    print "Choose frequency (MHz) from list below: " 

    print "19.2           200.0          400.0          " 
    print "633.6          802.0          902.1          " 

    print " "
    print "Enter desired frequency (r to return): "
    enter &clk_desired_freq
    print " "

    if ("&clk_desired_freq"=="19.2")
    (
      &clk_src_name="XO"
      &clk_src_sel=SRC_SEL TODO.
      &clk_src_div=2.
      &clk_m_val=0.
      &clk_n_val=0.
      &clk_2d_val=0.
      
      gosub Set_Clock_Freq
      return
    )
    else if ("&clk_desired_freq"=="200.0")
    (
      &clk_src_name="GPLL0_OUT_MAIN"
      &clk_src_sel=SRC_SEL TODO.
      &clk_src_div=6.
      &clk_m_val=0.
      &clk_n_val=0.
      &clk_2d_val=0.
      
      gosub Set_Clock_Freq
      return
    )
    else if ("&clk_desired_freq"=="400.0")
    (
      &clk_src_name="GPLL0_OUT_MAIN"
      &clk_src_sel=SRC_SEL TODO.
      &clk_src_div=3.
      &clk_m_val=0.
      &clk_n_val=0.
      &clk_2d_val=0.
      
      gosub Set_Clock_Freq
      return
    )
    else if ("&clk_desired_freq"=="633.6")
    (
      &clk_src_name="GPLL2_OUT_MAIN"
      &clk_src_sel=SRC_SEL TODO.
      &clk_src_div=2.
      &clk_m_val=0.
      &clk_n_val=0.
      &clk_2d_val=0.
      
      gosub Set_Clock_Freq
      return
    )
    else if ("&clk_desired_freq"=="802.0")
    (
      &clk_src_name="GPLL1_OUT_MAIN"
      &clk_src_sel=SRC_SEL TODO.
      &clk_src_div=2.
      &clk_m_val=0.
      &clk_n_val=0.
      &clk_2d_val=0.
      
      gosub Set_Clock_Freq
      return
    )
    else if ("&clk_desired_freq"=="902.1")
    (
      &clk_src_name="GPLL2_OUT_MAIN"
      &clk_src_sel=SRC_SEL TODO.
      &clk_src_div=4.
      &clk_m_val=0.
      &clk_n_val=0.
      &clk_2d_val=0.
      
      gosub Set_Clock_Freq
      return
    )
    else if ("&clk_desired_freq"=="r")
    (
      return
    )
    else
    (
      print "Invalid selection."
      goto Set_Clock_Freq_Enter
    )
  )

  if ("&clk"=="gcc_bimc_dtts_xo_clk")||("&clk"=="gcc_bimc_xo_clk")||("&clk"=="gcc_cfg_noc_ddr_cfg_clk")||("&clk"=="gcc_cnoc_bus_timeout5_ahb_clk")||("&clk"=="gcc_ddr_dim_cfg_clk")
  (
    gosub PRINT_SET_CLOCK_FREQ_WARNING

    &clk_cmd_rcgr_addr=&HWIO_GCC_BIMC_DDR_XO_CMD_RCGR_ADDR
    &clk_cfg_rcgr_addr=&HWIO_GCC_BIMC_DDR_XO_CFG_RCGR_ADDR

    print "Choose frequency (MHz) from list below: " 

    print "19.2           " 

    print " "
    print "Enter desired frequency (r to return): "
    enter &clk_desired_freq
    print " "

    if ("&clk_desired_freq"=="19.2")
    (
      &clk_src_name="XO"
      &clk_src_sel=SRC_SEL TODO.
      &clk_src_div=2.
      &clk_m_val=0.
      &clk_n_val=0.
      &clk_2d_val=0.
      
      gosub Set_Clock_Freq
      return
    )
    else if ("&clk_desired_freq"=="r")
    (
      return
    )
    else
    (
      print "Invalid selection."
      goto Set_Clock_Freq_Enter
    )
  )

  if ("&clk"=="gcc_bimc_hmss_axi_clk")
  (
    gosub PRINT_SET_CLOCK_FREQ_WARNING

    &clk_cmd_rcgr_addr=&HWIO_GCC_BIMC_HMSS_AXI_CMD_RCGR_ADDR
    &clk_cfg_rcgr_addr=&HWIO_GCC_BIMC_HMSS_AXI_CFG_RCGR_ADDR

    print "Choose frequency (MHz) from list below: " 

    print "19.2           200.0          401.0          " 
    print "600.0          729.6          854.4          " 

    print " "
    print "Enter desired frequency (r to return): "
    enter &clk_desired_freq
    print " "

    if ("&clk_desired_freq"=="19.2")
    (
      &clk_src_name="XO"
      &clk_src_sel=SRC_SEL TODO.
      &clk_src_div=2.
      &clk_m_val=0.
      &clk_n_val=0.
      &clk_2d_val=0.
      
      gosub Set_Clock_Freq
      return
    )
    else if ("&clk_desired_freq"=="200.0")
    (
      &clk_src_name="GPLL0_OUT_MAIN"
      &clk_src_sel=SRC_SEL TODO.
      &clk_src_div=6.
      &clk_m_val=0.
      &clk_n_val=0.
      &clk_2d_val=0.
      
      gosub Set_Clock_Freq
      return
    )
    else if ("&clk_desired_freq"=="401.0")
    (
      &clk_src_name="GPLL1_OUT_MAIN"
      &clk_src_sel=SRC_SEL TODO.
      &clk_src_div=4.
      &clk_m_val=0.
      &clk_n_val=0.
      &clk_2d_val=0.
      
      gosub Set_Clock_Freq
      return
    )
    else if ("&clk_desired_freq"=="600.0")
    (
      &clk_src_name="GPLL0_OUT_MAIN"
      &clk_src_sel=SRC_SEL TODO.
      &clk_src_div=2.
      &clk_m_val=0.
      &clk_n_val=0.
      &clk_2d_val=0.
      
      gosub Set_Clock_Freq
      return
    )
    else if ("&clk_desired_freq"=="729.6")
    (
      &clk_src_name="GPLL2_OUT_MAIN"
      &clk_src_sel=SRC_SEL TODO.
      &clk_src_div=4.
      &clk_m_val=0.
      &clk_n_val=0.
      &clk_2d_val=0.
      
      gosub Set_Clock_Freq
      return
    )
    else if ("&clk_desired_freq"=="854.4")
    (
      &clk_src_name="GPLL5_OUT_MAIN"
      &clk_src_sel=SRC_SEL TODO.
      &clk_src_div=4.
      &clk_m_val=0.
      &clk_n_val=0.
      &clk_2d_val=0.
      
      gosub Set_Clock_Freq
      return
    )
    else if ("&clk_desired_freq"=="r")
    (
      return
    )
    else
    (
      print "Invalid selection."
      goto Set_Clock_Freq_Enter
    )
  )

  if ("&clk"=="gcc_blsp1_qup1_i2c_apps_clk")
  (
    gosub PRINT_SET_CLOCK_FREQ_WARNING

    &clk_cmd_rcgr_addr=&HWIO_GCC_BLSP1_QUP1_I2C_APPS_CMD_RCGR_ADDR
    &clk_cfg_rcgr_addr=&HWIO_GCC_BLSP1_QUP1_I2C_APPS_CFG_RCGR_ADDR

    print "Choose frequency (MHz) from list below: " 

    print "19.2           50.0           " 

    print " "
    print "Enter desired frequency (r to return): "
    enter &clk_desired_freq
    print " "

    if ("&clk_desired_freq"=="19.2")
    (
      &clk_src_name="XO"
      &clk_src_sel=SRC_SEL TODO.
      &clk_src_div=2.
      &clk_m_val=0.
      &clk_n_val=0.
      &clk_2d_val=0.
      
      gosub Set_Clock_Freq
      return
    )
    else if ("&clk_desired_freq"=="50.0")
    (
      &clk_src_name="GPLL0_OUT_MAIN"
      &clk_src_sel=SRC_SEL TODO.
      &clk_src_div=24.
      &clk_m_val=0.
      &clk_n_val=0.
      &clk_2d_val=0.
      
      gosub Set_Clock_Freq
      return
    )
    else if ("&clk_desired_freq"=="r")
    (
      return
    )
    else
    (
      print "Invalid selection."
      goto Set_Clock_Freq_Enter
    )
  )

  if ("&clk"=="gcc_blsp1_qup1_spi_apps_clk")
  (
    gosub PRINT_SET_CLOCK_FREQ_WARNING

    &clk_cmd_rcgr_addr=&HWIO_GCC_BLSP1_QUP1_SPI_APPS_CMD_RCGR_ADDR
    &clk_cfg_rcgr_addr=&HWIO_GCC_BLSP1_QUP1_SPI_APPS_CFG_RCGR_ADDR

    print "Choose frequency (MHz) from list below: " 

    print "0.96           4.8            9.6            " 
    print "15.0           19.2           25.0           " 
    print "50.0           " 

    print " "
    print "Enter desired frequency (r to return): "
    enter &clk_desired_freq
    print " "

    if ("&clk_desired_freq"=="0.96")
    (
      &clk_src_name="XO"
      &clk_src_sel=SRC_SEL TODO.
      &clk_src_div=20.
      &clk_m_val=1.
      &clk_n_val=2.
      &clk_2d_val=2.
      
      gosub Set_Clock_Freq
      return
    )
    else if ("&clk_desired_freq"=="4.8")
    (
      &clk_src_name="XO"
      &clk_src_sel=SRC_SEL TODO.
      &clk_src_div=8.
      &clk_m_val=0.
      &clk_n_val=0.
      &clk_2d_val=0.
      
      gosub Set_Clock_Freq
      return
    )
    else if ("&clk_desired_freq"=="9.6")
    (
      &clk_src_name="XO"
      &clk_src_sel=SRC_SEL TODO.
      &clk_src_div=4.
      &clk_m_val=0.
      &clk_n_val=0.
      &clk_2d_val=0.
      
      gosub Set_Clock_Freq
      return
    )
    else if ("&clk_desired_freq"=="15.0")
    (
      &clk_src_name="GPLL0_OUT_MAIN"
      &clk_src_sel=SRC_SEL TODO.
      &clk_src_div=20.
      &clk_m_val=1.
      &clk_n_val=4.
      &clk_2d_val=4.
      
      gosub Set_Clock_Freq
      return
    )
    else if ("&clk_desired_freq"=="19.2")
    (
      &clk_src_name="XO"
      &clk_src_sel=SRC_SEL TODO.
      &clk_src_div=2.
      &clk_m_val=0.
      &clk_n_val=0.
      &clk_2d_val=0.
      
      gosub Set_Clock_Freq
      return
    )
    else if ("&clk_desired_freq"=="25.0")
    (
      &clk_src_name="GPLL0_OUT_MAIN"
      &clk_src_sel=SRC_SEL TODO.
      &clk_src_div=24.
      &clk_m_val=1.
      &clk_n_val=2.
      &clk_2d_val=2.
      
      gosub Set_Clock_Freq
      return
    )
    else if ("&clk_desired_freq"=="50.0")
    (
      &clk_src_name="GPLL0_OUT_MAIN"
      &clk_src_sel=SRC_SEL TODO.
      &clk_src_div=24.
      &clk_m_val=0.
      &clk_n_val=0.
      &clk_2d_val=0.
      
      gosub Set_Clock_Freq
      return
    )
    else if ("&clk_desired_freq"=="r")
    (
      return
    )
    else
    (
      print "Invalid selection."
      goto Set_Clock_Freq_Enter
    )
  )

  if ("&clk"=="gcc_blsp1_qup2_i2c_apps_clk")
  (
    gosub PRINT_SET_CLOCK_FREQ_WARNING

    &clk_cmd_rcgr_addr=&HWIO_GCC_BLSP1_QUP2_I2C_APPS_CMD_RCGR_ADDR
    &clk_cfg_rcgr_addr=&HWIO_GCC_BLSP1_QUP2_I2C_APPS_CFG_RCGR_ADDR

    print "Choose frequency (MHz) from list below: " 

    print "19.2           50.0           " 

    print " "
    print "Enter desired frequency (r to return): "
    enter &clk_desired_freq
    print " "

    if ("&clk_desired_freq"=="19.2")
    (
      &clk_src_name="XO"
      &clk_src_sel=SRC_SEL TODO.
      &clk_src_div=2.
      &clk_m_val=0.
      &clk_n_val=0.
      &clk_2d_val=0.
      
      gosub Set_Clock_Freq
      return
    )
    else if ("&clk_desired_freq"=="50.0")
    (
      &clk_src_name="GPLL0_OUT_MAIN"
      &clk_src_sel=SRC_SEL TODO.
      &clk_src_div=24.
      &clk_m_val=0.
      &clk_n_val=0.
      &clk_2d_val=0.
      
      gosub Set_Clock_Freq
      return
    )
    else if ("&clk_desired_freq"=="r")
    (
      return
    )
    else
    (
      print "Invalid selection."
      goto Set_Clock_Freq_Enter
    )
  )

  if ("&clk"=="gcc_blsp1_qup2_spi_apps_clk")
  (
    gosub PRINT_SET_CLOCK_FREQ_WARNING

    &clk_cmd_rcgr_addr=&HWIO_GCC_BLSP1_QUP2_SPI_APPS_CMD_RCGR_ADDR
    &clk_cfg_rcgr_addr=&HWIO_GCC_BLSP1_QUP2_SPI_APPS_CFG_RCGR_ADDR

    print "Choose frequency (MHz) from list below: " 

    print "0.96           4.8            9.6            " 
    print "15.0           19.2           25.0           " 
    print "50.0           " 

    print " "
    print "Enter desired frequency (r to return): "
    enter &clk_desired_freq
    print " "

    if ("&clk_desired_freq"=="0.96")
    (
      &clk_src_name="XO"
      &clk_src_sel=SRC_SEL TODO.
      &clk_src_div=20.
      &clk_m_val=1.
      &clk_n_val=2.
      &clk_2d_val=2.
      
      gosub Set_Clock_Freq
      return
    )
    else if ("&clk_desired_freq"=="4.8")
    (
      &clk_src_name="XO"
      &clk_src_sel=SRC_SEL TODO.
      &clk_src_div=8.
      &clk_m_val=0.
      &clk_n_val=0.
      &clk_2d_val=0.
      
      gosub Set_Clock_Freq
      return
    )
    else if ("&clk_desired_freq"=="9.6")
    (
      &clk_src_name="XO"
      &clk_src_sel=SRC_SEL TODO.
      &clk_src_div=4.
      &clk_m_val=0.
      &clk_n_val=0.
      &clk_2d_val=0.
      
      gosub Set_Clock_Freq
      return
    )
    else if ("&clk_desired_freq"=="15.0")
    (
      &clk_src_name="GPLL0_OUT_MAIN"
      &clk_src_sel=SRC_SEL TODO.
      &clk_src_div=20.
      &clk_m_val=1.
      &clk_n_val=4.
      &clk_2d_val=4.
      
      gosub Set_Clock_Freq
      return
    )
    else if ("&clk_desired_freq"=="19.2")
    (
      &clk_src_name="XO"
      &clk_src_sel=SRC_SEL TODO.
      &clk_src_div=2.
      &clk_m_val=0.
      &clk_n_val=0.
      &clk_2d_val=0.
      
      gosub Set_Clock_Freq
      return
    )
    else if ("&clk_desired_freq"=="25.0")
    (
      &clk_src_name="GPLL0_OUT_MAIN"
      &clk_src_sel=SRC_SEL TODO.
      &clk_src_div=24.
      &clk_m_val=1.
      &clk_n_val=2.
      &clk_2d_val=2.
      
      gosub Set_Clock_Freq
      return
    )
    else if ("&clk_desired_freq"=="50.0")
    (
      &clk_src_name="GPLL0_OUT_MAIN"
      &clk_src_sel=SRC_SEL TODO.
      &clk_src_div=24.
      &clk_m_val=0.
      &clk_n_val=0.
      &clk_2d_val=0.
      
      gosub Set_Clock_Freq
      return
    )
    else if ("&clk_desired_freq"=="r")
    (
      return
    )
    else
    (
      print "Invalid selection."
      goto Set_Clock_Freq_Enter
    )
  )

  if ("&clk"=="gcc_blsp1_qup3_i2c_apps_clk")
  (
    gosub PRINT_SET_CLOCK_FREQ_WARNING

    &clk_cmd_rcgr_addr=&HWIO_GCC_BLSP1_QUP3_I2C_APPS_CMD_RCGR_ADDR
    &clk_cfg_rcgr_addr=&HWIO_GCC_BLSP1_QUP3_I2C_APPS_CFG_RCGR_ADDR

    print "Choose frequency (MHz) from list below: " 

    print "19.2           50.0           " 

    print " "
    print "Enter desired frequency (r to return): "
    enter &clk_desired_freq
    print " "

    if ("&clk_desired_freq"=="19.2")
    (
      &clk_src_name="XO"
      &clk_src_sel=SRC_SEL TODO.
      &clk_src_div=2.
      &clk_m_val=0.
      &clk_n_val=0.
      &clk_2d_val=0.
      
      gosub Set_Clock_Freq
      return
    )
    else if ("&clk_desired_freq"=="50.0")
    (
      &clk_src_name="GPLL0_OUT_MAIN"
      &clk_src_sel=SRC_SEL TODO.
      &clk_src_div=24.
      &clk_m_val=0.
      &clk_n_val=0.
      &clk_2d_val=0.
      
      gosub Set_Clock_Freq
      return
    )
    else if ("&clk_desired_freq"=="r")
    (
      return
    )
    else
    (
      print "Invalid selection."
      goto Set_Clock_Freq_Enter
    )
  )

  if ("&clk"=="gcc_blsp1_qup3_spi_apps_clk")
  (
    gosub PRINT_SET_CLOCK_FREQ_WARNING

    &clk_cmd_rcgr_addr=&HWIO_GCC_BLSP1_QUP3_SPI_APPS_CMD_RCGR_ADDR
    &clk_cfg_rcgr_addr=&HWIO_GCC_BLSP1_QUP3_SPI_APPS_CFG_RCGR_ADDR

    print "Choose frequency (MHz) from list below: " 

    print "0.96           4.8            9.6            " 
    print "15.0           19.2           25.0           " 
    print "50.0           " 

    print " "
    print "Enter desired frequency (r to return): "
    enter &clk_desired_freq
    print " "

    if ("&clk_desired_freq"=="0.96")
    (
      &clk_src_name="XO"
      &clk_src_sel=SRC_SEL TODO.
      &clk_src_div=20.
      &clk_m_val=1.
      &clk_n_val=2.
      &clk_2d_val=2.
      
      gosub Set_Clock_Freq
      return
    )
    else if ("&clk_desired_freq"=="4.8")
    (
      &clk_src_name="XO"
      &clk_src_sel=SRC_SEL TODO.
      &clk_src_div=8.
      &clk_m_val=0.
      &clk_n_val=0.
      &clk_2d_val=0.
      
      gosub Set_Clock_Freq
      return
    )
    else if ("&clk_desired_freq"=="9.6")
    (
      &clk_src_name="XO"
      &clk_src_sel=SRC_SEL TODO.
      &clk_src_div=4.
      &clk_m_val=0.
      &clk_n_val=0.
      &clk_2d_val=0.
      
      gosub Set_Clock_Freq
      return
    )
    else if ("&clk_desired_freq"=="15.0")
    (
      &clk_src_name="GPLL0_OUT_MAIN"
      &clk_src_sel=SRC_SEL TODO.
      &clk_src_div=20.
      &clk_m_val=1.
      &clk_n_val=4.
      &clk_2d_val=4.
      
      gosub Set_Clock_Freq
      return
    )
    else if ("&clk_desired_freq"=="19.2")
    (
      &clk_src_name="XO"
      &clk_src_sel=SRC_SEL TODO.
      &clk_src_div=2.
      &clk_m_val=0.
      &clk_n_val=0.
      &clk_2d_val=0.
      
      gosub Set_Clock_Freq
      return
    )
    else if ("&clk_desired_freq"=="25.0")
    (
      &clk_src_name="GPLL0_OUT_MAIN"
      &clk_src_sel=SRC_SEL TODO.
      &clk_src_div=24.
      &clk_m_val=1.
      &clk_n_val=2.
      &clk_2d_val=2.
      
      gosub Set_Clock_Freq
      return
    )
    else if ("&clk_desired_freq"=="50.0")
    (
      &clk_src_name="GPLL0_OUT_MAIN"
      &clk_src_sel=SRC_SEL TODO.
      &clk_src_div=24.
      &clk_m_val=0.
      &clk_n_val=0.
      &clk_2d_val=0.
      
      gosub Set_Clock_Freq
      return
    )
    else if ("&clk_desired_freq"=="r")
    (
      return
    )
    else
    (
      print "Invalid selection."
      goto Set_Clock_Freq_Enter
    )
  )

  if ("&clk"=="gcc_blsp1_qup4_i2c_apps_clk")
  (
    gosub PRINT_SET_CLOCK_FREQ_WARNING

    &clk_cmd_rcgr_addr=&HWIO_GCC_BLSP1_QUP4_I2C_APPS_CMD_RCGR_ADDR
    &clk_cfg_rcgr_addr=&HWIO_GCC_BLSP1_QUP4_I2C_APPS_CFG_RCGR_ADDR

    print "Choose frequency (MHz) from list below: " 

    print "19.2           50.0           " 

    print " "
    print "Enter desired frequency (r to return): "
    enter &clk_desired_freq
    print " "

    if ("&clk_desired_freq"=="19.2")
    (
      &clk_src_name="XO"
      &clk_src_sel=SRC_SEL TODO.
      &clk_src_div=2.
      &clk_m_val=0.
      &clk_n_val=0.
      &clk_2d_val=0.
      
      gosub Set_Clock_Freq
      return
    )
    else if ("&clk_desired_freq"=="50.0")
    (
      &clk_src_name="GPLL0_OUT_MAIN"
      &clk_src_sel=SRC_SEL TODO.
      &clk_src_div=24.
      &clk_m_val=0.
      &clk_n_val=0.
      &clk_2d_val=0.
      
      gosub Set_Clock_Freq
      return
    )
    else if ("&clk_desired_freq"=="r")
    (
      return
    )
    else
    (
      print "Invalid selection."
      goto Set_Clock_Freq_Enter
    )
  )

  if ("&clk"=="gcc_blsp1_qup4_spi_apps_clk")
  (
    gosub PRINT_SET_CLOCK_FREQ_WARNING

    &clk_cmd_rcgr_addr=&HWIO_GCC_BLSP1_QUP4_SPI_APPS_CMD_RCGR_ADDR
    &clk_cfg_rcgr_addr=&HWIO_GCC_BLSP1_QUP4_SPI_APPS_CFG_RCGR_ADDR

    print "Choose frequency (MHz) from list below: " 

    print "0.96           4.8            9.6            " 
    print "15.0           19.2           25.0           " 
    print "50.0           " 

    print " "
    print "Enter desired frequency (r to return): "
    enter &clk_desired_freq
    print " "

    if ("&clk_desired_freq"=="0.96")
    (
      &clk_src_name="XO"
      &clk_src_sel=SRC_SEL TODO.
      &clk_src_div=20.
      &clk_m_val=1.
      &clk_n_val=2.
      &clk_2d_val=2.
      
      gosub Set_Clock_Freq
      return
    )
    else if ("&clk_desired_freq"=="4.8")
    (
      &clk_src_name="XO"
      &clk_src_sel=SRC_SEL TODO.
      &clk_src_div=8.
      &clk_m_val=0.
      &clk_n_val=0.
      &clk_2d_val=0.
      
      gosub Set_Clock_Freq
      return
    )
    else if ("&clk_desired_freq"=="9.6")
    (
      &clk_src_name="XO"
      &clk_src_sel=SRC_SEL TODO.
      &clk_src_div=4.
      &clk_m_val=0.
      &clk_n_val=0.
      &clk_2d_val=0.
      
      gosub Set_Clock_Freq
      return
    )
    else if ("&clk_desired_freq"=="15.0")
    (
      &clk_src_name="GPLL0_OUT_MAIN"
      &clk_src_sel=SRC_SEL TODO.
      &clk_src_div=20.
      &clk_m_val=1.
      &clk_n_val=4.
      &clk_2d_val=4.
      
      gosub Set_Clock_Freq
      return
    )
    else if ("&clk_desired_freq"=="19.2")
    (
      &clk_src_name="XO"
      &clk_src_sel=SRC_SEL TODO.
      &clk_src_div=2.
      &clk_m_val=0.
      &clk_n_val=0.
      &clk_2d_val=0.
      
      gosub Set_Clock_Freq
      return
    )
    else if ("&clk_desired_freq"=="25.0")
    (
      &clk_src_name="GPLL0_OUT_MAIN"
      &clk_src_sel=SRC_SEL TODO.
      &clk_src_div=24.
      &clk_m_val=1.
      &clk_n_val=2.
      &clk_2d_val=2.
      
      gosub Set_Clock_Freq
      return
    )
    else if ("&clk_desired_freq"=="50.0")
    (
      &clk_src_name="GPLL0_OUT_MAIN"
      &clk_src_sel=SRC_SEL TODO.
      &clk_src_div=24.
      &clk_m_val=0.
      &clk_n_val=0.
      &clk_2d_val=0.
      
      gosub Set_Clock_Freq
      return
    )
    else if ("&clk_desired_freq"=="r")
    (
      return
    )
    else
    (
      print "Invalid selection."
      goto Set_Clock_Freq_Enter
    )
  )

  if ("&clk"=="gcc_blsp1_uart1_apps_clk")
  (
    gosub PRINT_SET_CLOCK_FREQ_WARNING

    &clk_cmd_rcgr_addr=&HWIO_GCC_BLSP1_UART1_APPS_CMD_RCGR_ADDR
    &clk_cfg_rcgr_addr=&HWIO_GCC_BLSP1_UART1_APPS_CFG_RCGR_ADDR

    print "Choose frequency (MHz) from list below: " 

    print "3.6864         7.3728         14.7456        " 
    print "16.0           19.2           24.0           " 
    print "32.0           40.0           46.4           " 
    print "48.0           51.2           56.0           " 
    print "58.9824        60.0           63.157895      " 

    print " "
    print "Enter desired frequency (r to return): "
    enter &clk_desired_freq
    print " "

    if ("&clk_desired_freq"=="3.6864")
    (
      &clk_src_name="GPLL0_OUT_MAIN"
      &clk_src_sel=SRC_SEL TODO.
      &clk_src_div=2.
      &clk_m_val=96.
      &clk_n_val=15625.
      &clk_2d_val=15625.
      
      gosub Set_Clock_Freq
      return
    )
    else if ("&clk_desired_freq"=="7.3728")
    (
      &clk_src_name="GPLL0_OUT_MAIN"
      &clk_src_sel=SRC_SEL TODO.
      &clk_src_div=2.
      &clk_m_val=192.
      &clk_n_val=15625.
      &clk_2d_val=15625.
      
      gosub Set_Clock_Freq
      return
    )
    else if ("&clk_desired_freq"=="14.7456")
    (
      &clk_src_name="GPLL0_OUT_MAIN"
      &clk_src_sel=SRC_SEL TODO.
      &clk_src_div=2.
      &clk_m_val=384.
      &clk_n_val=15625.
      &clk_2d_val=15625.
      
      gosub Set_Clock_Freq
      return
    )
    else if ("&clk_desired_freq"=="16.0")
    (
      &clk_src_name="GPLL0_OUT_MAIN"
      &clk_src_sel=SRC_SEL TODO.
      &clk_src_div=10.
      &clk_m_val=2.
      &clk_n_val=15.
      &clk_2d_val=15.
      
      gosub Set_Clock_Freq
      return
    )
    else if ("&clk_desired_freq"=="19.2")
    (
      &clk_src_name="XO"
      &clk_src_sel=SRC_SEL TODO.
      &clk_src_div=2.
      &clk_m_val=0.
      &clk_n_val=0.
      &clk_2d_val=0.
      
      gosub Set_Clock_Freq
      return
    )
    else if ("&clk_desired_freq"=="24.0")
    (
      &clk_src_name="GPLL0_OUT_MAIN"
      &clk_src_sel=SRC_SEL TODO.
      &clk_src_div=10.
      &clk_m_val=1.
      &clk_n_val=5.
      &clk_2d_val=5.
      
      gosub Set_Clock_Freq
      return
    )
    else if ("&clk_desired_freq"=="32.0")
    (
      &clk_src_name="GPLL0_OUT_MAIN"
      &clk_src_sel=SRC_SEL TODO.
      &clk_src_div=2.
      &clk_m_val=4.
      &clk_n_val=75.
      &clk_2d_val=75.
      
      gosub Set_Clock_Freq
      return
    )
    else if ("&clk_desired_freq"=="40.0")
    (
      &clk_src_name="GPLL0_OUT_MAIN"
      &clk_src_sel=SRC_SEL TODO.
      &clk_src_div=30.
      &clk_m_val=0.
      &clk_n_val=0.
      &clk_2d_val=0.
      
      gosub Set_Clock_Freq
      return
    )
    else if ("&clk_desired_freq"=="46.4")
    (
      &clk_src_name="GPLL0_OUT_MAIN"
      &clk_src_sel=SRC_SEL TODO.
      &clk_src_div=2.
      &clk_m_val=29.
      &clk_n_val=375.
      &clk_2d_val=375.
      
      gosub Set_Clock_Freq
      return
    )
    else if ("&clk_desired_freq"=="48.0")
    (
      &clk_src_name="GPLL0_OUT_MAIN"
      &clk_src_sel=SRC_SEL TODO.
      &clk_src_div=25.
      &clk_m_val=0.
      &clk_n_val=0.
      &clk_2d_val=0.
      
      gosub Set_Clock_Freq
      return
    )
    else if ("&clk_desired_freq"=="51.2")
    (
      &clk_src_name="GPLL0_OUT_MAIN"
      &clk_src_sel=SRC_SEL TODO.
      &clk_src_div=2.
      &clk_m_val=32.
      &clk_n_val=375.
      &clk_2d_val=375.
      
      gosub Set_Clock_Freq
      return
    )
    else if ("&clk_desired_freq"=="56.0")
    (
      &clk_src_name="GPLL0_OUT_MAIN"
      &clk_src_sel=SRC_SEL TODO.
      &clk_src_div=2.
      &clk_m_val=7.
      &clk_n_val=75.
      &clk_2d_val=75.
      
      gosub Set_Clock_Freq
      return
    )
    else if ("&clk_desired_freq"=="58.9824")
    (
      &clk_src_name="GPLL0_OUT_MAIN"
      &clk_src_sel=SRC_SEL TODO.
      &clk_src_div=2.
      &clk_m_val=1536.
      &clk_n_val=15625.
      &clk_2d_val=15625.
      
      gosub Set_Clock_Freq
      return
    )
    else if ("&clk_desired_freq"=="60.0")
    (
      &clk_src_name="GPLL0_OUT_MAIN"
      &clk_src_sel=SRC_SEL TODO.
      &clk_src_div=20.
      &clk_m_val=0.
      &clk_n_val=0.
      &clk_2d_val=0.
      
      gosub Set_Clock_Freq
      return
    )
    else if ("&clk_desired_freq"=="63.157895")
    (
      &clk_src_name="GPLL0_OUT_MAIN"
      &clk_src_sel=SRC_SEL TODO.
      &clk_src_div=19.
      &clk_m_val=0.
      &clk_n_val=0.
      &clk_2d_val=0.
      
      gosub Set_Clock_Freq
      return
    )
    else if ("&clk_desired_freq"=="r")
    (
      return
    )
    else
    (
      print "Invalid selection."
      goto Set_Clock_Freq_Enter
    )
  )

  if ("&clk"=="gcc_blsp1_uart2_apps_clk")
  (
    gosub PRINT_SET_CLOCK_FREQ_WARNING

    &clk_cmd_rcgr_addr=&HWIO_GCC_BLSP1_UART2_APPS_CMD_RCGR_ADDR
    &clk_cfg_rcgr_addr=&HWIO_GCC_BLSP1_UART2_APPS_CFG_RCGR_ADDR

    print "Choose frequency (MHz) from list below: " 

    print "3.6864         7.3728         14.7456        " 
    print "16.0           19.2           24.0           " 
    print "32.0           40.0           46.4           " 
    print "48.0           51.2           56.0           " 
    print "58.9824        60.0           63.157895      " 

    print " "
    print "Enter desired frequency (r to return): "
    enter &clk_desired_freq
    print " "

    if ("&clk_desired_freq"=="3.6864")
    (
      &clk_src_name="GPLL0_OUT_MAIN"
      &clk_src_sel=SRC_SEL TODO.
      &clk_src_div=2.
      &clk_m_val=96.
      &clk_n_val=15625.
      &clk_2d_val=15625.
      
      gosub Set_Clock_Freq
      return
    )
    else if ("&clk_desired_freq"=="7.3728")
    (
      &clk_src_name="GPLL0_OUT_MAIN"
      &clk_src_sel=SRC_SEL TODO.
      &clk_src_div=2.
      &clk_m_val=192.
      &clk_n_val=15625.
      &clk_2d_val=15625.
      
      gosub Set_Clock_Freq
      return
    )
    else if ("&clk_desired_freq"=="14.7456")
    (
      &clk_src_name="GPLL0_OUT_MAIN"
      &clk_src_sel=SRC_SEL TODO.
      &clk_src_div=2.
      &clk_m_val=384.
      &clk_n_val=15625.
      &clk_2d_val=15625.
      
      gosub Set_Clock_Freq
      return
    )
    else if ("&clk_desired_freq"=="16.0")
    (
      &clk_src_name="GPLL0_OUT_MAIN"
      &clk_src_sel=SRC_SEL TODO.
      &clk_src_div=10.
      &clk_m_val=2.
      &clk_n_val=15.
      &clk_2d_val=15.
      
      gosub Set_Clock_Freq
      return
    )
    else if ("&clk_desired_freq"=="19.2")
    (
      &clk_src_name="XO"
      &clk_src_sel=SRC_SEL TODO.
      &clk_src_div=2.
      &clk_m_val=0.
      &clk_n_val=0.
      &clk_2d_val=0.
      
      gosub Set_Clock_Freq
      return
    )
    else if ("&clk_desired_freq"=="24.0")
    (
      &clk_src_name="GPLL0_OUT_MAIN"
      &clk_src_sel=SRC_SEL TODO.
      &clk_src_div=10.
      &clk_m_val=1.
      &clk_n_val=5.
      &clk_2d_val=5.
      
      gosub Set_Clock_Freq
      return
    )
    else if ("&clk_desired_freq"=="32.0")
    (
      &clk_src_name="GPLL0_OUT_MAIN"
      &clk_src_sel=SRC_SEL TODO.
      &clk_src_div=2.
      &clk_m_val=4.
      &clk_n_val=75.
      &clk_2d_val=75.
      
      gosub Set_Clock_Freq
      return
    )
    else if ("&clk_desired_freq"=="40.0")
    (
      &clk_src_name="GPLL0_OUT_MAIN"
      &clk_src_sel=SRC_SEL TODO.
      &clk_src_div=30.
      &clk_m_val=0.
      &clk_n_val=0.
      &clk_2d_val=0.
      
      gosub Set_Clock_Freq
      return
    )
    else if ("&clk_desired_freq"=="46.4")
    (
      &clk_src_name="GPLL0_OUT_MAIN"
      &clk_src_sel=SRC_SEL TODO.
      &clk_src_div=2.
      &clk_m_val=29.
      &clk_n_val=375.
      &clk_2d_val=375.
      
      gosub Set_Clock_Freq
      return
    )
    else if ("&clk_desired_freq"=="48.0")
    (
      &clk_src_name="GPLL0_OUT_MAIN"
      &clk_src_sel=SRC_SEL TODO.
      &clk_src_div=25.
      &clk_m_val=0.
      &clk_n_val=0.
      &clk_2d_val=0.
      
      gosub Set_Clock_Freq
      return
    )
    else if ("&clk_desired_freq"=="51.2")
    (
      &clk_src_name="GPLL0_OUT_MAIN"
      &clk_src_sel=SRC_SEL TODO.
      &clk_src_div=2.
      &clk_m_val=32.
      &clk_n_val=375.
      &clk_2d_val=375.
      
      gosub Set_Clock_Freq
      return
    )
    else if ("&clk_desired_freq"=="56.0")
    (
      &clk_src_name="GPLL0_OUT_MAIN"
      &clk_src_sel=SRC_SEL TODO.
      &clk_src_div=2.
      &clk_m_val=7.
      &clk_n_val=75.
      &clk_2d_val=75.
      
      gosub Set_Clock_Freq
      return
    )
    else if ("&clk_desired_freq"=="58.9824")
    (
      &clk_src_name="GPLL0_OUT_MAIN"
      &clk_src_sel=SRC_SEL TODO.
      &clk_src_div=2.
      &clk_m_val=1536.
      &clk_n_val=15625.
      &clk_2d_val=15625.
      
      gosub Set_Clock_Freq
      return
    )
    else if ("&clk_desired_freq"=="60.0")
    (
      &clk_src_name="GPLL0_OUT_MAIN"
      &clk_src_sel=SRC_SEL TODO.
      &clk_src_div=20.
      &clk_m_val=0.
      &clk_n_val=0.
      &clk_2d_val=0.
      
      gosub Set_Clock_Freq
      return
    )
    else if ("&clk_desired_freq"=="63.157895")
    (
      &clk_src_name="GPLL0_OUT_MAIN"
      &clk_src_sel=SRC_SEL TODO.
      &clk_src_div=19.
      &clk_m_val=0.
      &clk_n_val=0.
      &clk_2d_val=0.
      
      gosub Set_Clock_Freq
      return
    )
    else if ("&clk_desired_freq"=="r")
    (
      return
    )
    else
    (
      print "Invalid selection."
      goto Set_Clock_Freq_Enter
    )
  )

  if ("&clk"=="gcc_blsp2_qup1_i2c_apps_clk")
  (
    gosub PRINT_SET_CLOCK_FREQ_WARNING

    &clk_cmd_rcgr_addr=&HWIO_GCC_BLSP2_QUP1_I2C_APPS_CMD_RCGR_ADDR
    &clk_cfg_rcgr_addr=&HWIO_GCC_BLSP2_QUP1_I2C_APPS_CFG_RCGR_ADDR

    print "Choose frequency (MHz) from list below: " 

    print "19.2           50.0           " 

    print " "
    print "Enter desired frequency (r to return): "
    enter &clk_desired_freq
    print " "

    if ("&clk_desired_freq"=="19.2")
    (
      &clk_src_name="XO"
      &clk_src_sel=SRC_SEL TODO.
      &clk_src_div=2.
      &clk_m_val=0.
      &clk_n_val=0.
      &clk_2d_val=0.
      
      gosub Set_Clock_Freq
      return
    )
    else if ("&clk_desired_freq"=="50.0")
    (
      &clk_src_name="GPLL0_OUT_MAIN"
      &clk_src_sel=SRC_SEL TODO.
      &clk_src_div=24.
      &clk_m_val=0.
      &clk_n_val=0.
      &clk_2d_val=0.
      
      gosub Set_Clock_Freq
      return
    )
    else if ("&clk_desired_freq"=="r")
    (
      return
    )
    else
    (
      print "Invalid selection."
      goto Set_Clock_Freq_Enter
    )
  )

  if ("&clk"=="gcc_blsp2_qup1_spi_apps_clk")
  (
    gosub PRINT_SET_CLOCK_FREQ_WARNING

    &clk_cmd_rcgr_addr=&HWIO_GCC_BLSP2_QUP1_SPI_APPS_CMD_RCGR_ADDR
    &clk_cfg_rcgr_addr=&HWIO_GCC_BLSP2_QUP1_SPI_APPS_CFG_RCGR_ADDR

    print "Choose frequency (MHz) from list below: " 

    print "0.96           4.8            9.6            " 
    print "15.0           19.2           25.0           " 
    print "50.0           " 

    print " "
    print "Enter desired frequency (r to return): "
    enter &clk_desired_freq
    print " "

    if ("&clk_desired_freq"=="0.96")
    (
      &clk_src_name="XO"
      &clk_src_sel=SRC_SEL TODO.
      &clk_src_div=20.
      &clk_m_val=1.
      &clk_n_val=2.
      &clk_2d_val=2.
      
      gosub Set_Clock_Freq
      return
    )
    else if ("&clk_desired_freq"=="4.8")
    (
      &clk_src_name="XO"
      &clk_src_sel=SRC_SEL TODO.
      &clk_src_div=8.
      &clk_m_val=0.
      &clk_n_val=0.
      &clk_2d_val=0.
      
      gosub Set_Clock_Freq
      return
    )
    else if ("&clk_desired_freq"=="9.6")
    (
      &clk_src_name="XO"
      &clk_src_sel=SRC_SEL TODO.
      &clk_src_div=4.
      &clk_m_val=0.
      &clk_n_val=0.
      &clk_2d_val=0.
      
      gosub Set_Clock_Freq
      return
    )
    else if ("&clk_desired_freq"=="15.0")
    (
      &clk_src_name="GPLL0_OUT_MAIN"
      &clk_src_sel=SRC_SEL TODO.
      &clk_src_div=20.
      &clk_m_val=1.
      &clk_n_val=4.
      &clk_2d_val=4.
      
      gosub Set_Clock_Freq
      return
    )
    else if ("&clk_desired_freq"=="19.2")
    (
      &clk_src_name="XO"
      &clk_src_sel=SRC_SEL TODO.
      &clk_src_div=2.
      &clk_m_val=0.
      &clk_n_val=0.
      &clk_2d_val=0.
      
      gosub Set_Clock_Freq
      return
    )
    else if ("&clk_desired_freq"=="25.0")
    (
      &clk_src_name="GPLL0_OUT_MAIN"
      &clk_src_sel=SRC_SEL TODO.
      &clk_src_div=24.
      &clk_m_val=1.
      &clk_n_val=2.
      &clk_2d_val=2.
      
      gosub Set_Clock_Freq
      return
    )
    else if ("&clk_desired_freq"=="50.0")
    (
      &clk_src_name="GPLL0_OUT_MAIN"
      &clk_src_sel=SRC_SEL TODO.
      &clk_src_div=24.
      &clk_m_val=0.
      &clk_n_val=0.
      &clk_2d_val=0.
      
      gosub Set_Clock_Freq
      return
    )
    else if ("&clk_desired_freq"=="r")
    (
      return
    )
    else
    (
      print "Invalid selection."
      goto Set_Clock_Freq_Enter
    )
  )

  if ("&clk"=="gcc_blsp2_qup2_i2c_apps_clk")
  (
    gosub PRINT_SET_CLOCK_FREQ_WARNING

    &clk_cmd_rcgr_addr=&HWIO_GCC_BLSP2_QUP2_I2C_APPS_CMD_RCGR_ADDR
    &clk_cfg_rcgr_addr=&HWIO_GCC_BLSP2_QUP2_I2C_APPS_CFG_RCGR_ADDR

    print "Choose frequency (MHz) from list below: " 

    print "19.2           50.0           " 

    print " "
    print "Enter desired frequency (r to return): "
    enter &clk_desired_freq
    print " "

    if ("&clk_desired_freq"=="19.2")
    (
      &clk_src_name="XO"
      &clk_src_sel=SRC_SEL TODO.
      &clk_src_div=2.
      &clk_m_val=0.
      &clk_n_val=0.
      &clk_2d_val=0.
      
      gosub Set_Clock_Freq
      return
    )
    else if ("&clk_desired_freq"=="50.0")
    (
      &clk_src_name="GPLL0_OUT_MAIN"
      &clk_src_sel=SRC_SEL TODO.
      &clk_src_div=24.
      &clk_m_val=0.
      &clk_n_val=0.
      &clk_2d_val=0.
      
      gosub Set_Clock_Freq
      return
    )
    else if ("&clk_desired_freq"=="r")
    (
      return
    )
    else
    (
      print "Invalid selection."
      goto Set_Clock_Freq_Enter
    )
  )

  if ("&clk"=="gcc_blsp2_qup2_spi_apps_clk")
  (
    gosub PRINT_SET_CLOCK_FREQ_WARNING

    &clk_cmd_rcgr_addr=&HWIO_GCC_BLSP2_QUP2_SPI_APPS_CMD_RCGR_ADDR
    &clk_cfg_rcgr_addr=&HWIO_GCC_BLSP2_QUP2_SPI_APPS_CFG_RCGR_ADDR

    print "Choose frequency (MHz) from list below: " 

    print "0.96           4.8            9.6            " 
    print "15.0           19.2           25.0           " 
    print "50.0           " 

    print " "
    print "Enter desired frequency (r to return): "
    enter &clk_desired_freq
    print " "

    if ("&clk_desired_freq"=="0.96")
    (
      &clk_src_name="XO"
      &clk_src_sel=SRC_SEL TODO.
      &clk_src_div=20.
      &clk_m_val=1.
      &clk_n_val=2.
      &clk_2d_val=2.
      
      gosub Set_Clock_Freq
      return
    )
    else if ("&clk_desired_freq"=="4.8")
    (
      &clk_src_name="XO"
      &clk_src_sel=SRC_SEL TODO.
      &clk_src_div=8.
      &clk_m_val=0.
      &clk_n_val=0.
      &clk_2d_val=0.
      
      gosub Set_Clock_Freq
      return
    )
    else if ("&clk_desired_freq"=="9.6")
    (
      &clk_src_name="XO"
      &clk_src_sel=SRC_SEL TODO.
      &clk_src_div=4.
      &clk_m_val=0.
      &clk_n_val=0.
      &clk_2d_val=0.
      
      gosub Set_Clock_Freq
      return
    )
    else if ("&clk_desired_freq"=="15.0")
    (
      &clk_src_name="GPLL0_OUT_MAIN"
      &clk_src_sel=SRC_SEL TODO.
      &clk_src_div=20.
      &clk_m_val=1.
      &clk_n_val=4.
      &clk_2d_val=4.
      
      gosub Set_Clock_Freq
      return
    )
    else if ("&clk_desired_freq"=="19.2")
    (
      &clk_src_name="XO"
      &clk_src_sel=SRC_SEL TODO.
      &clk_src_div=2.
      &clk_m_val=0.
      &clk_n_val=0.
      &clk_2d_val=0.
      
      gosub Set_Clock_Freq
      return
    )
    else if ("&clk_desired_freq"=="25.0")
    (
      &clk_src_name="GPLL0_OUT_MAIN"
      &clk_src_sel=SRC_SEL TODO.
      &clk_src_div=24.
      &clk_m_val=1.
      &clk_n_val=2.
      &clk_2d_val=2.
      
      gosub Set_Clock_Freq
      return
    )
    else if ("&clk_desired_freq"=="50.0")
    (
      &clk_src_name="GPLL0_OUT_MAIN"
      &clk_src_sel=SRC_SEL TODO.
      &clk_src_div=24.
      &clk_m_val=0.
      &clk_n_val=0.
      &clk_2d_val=0.
      
      gosub Set_Clock_Freq
      return
    )
    else if ("&clk_desired_freq"=="r")
    (
      return
    )
    else
    (
      print "Invalid selection."
      goto Set_Clock_Freq_Enter
    )
  )

  if ("&clk"=="gcc_blsp2_qup3_i2c_apps_clk")
  (
    gosub PRINT_SET_CLOCK_FREQ_WARNING

    &clk_cmd_rcgr_addr=&HWIO_GCC_BLSP2_QUP3_I2C_APPS_CMD_RCGR_ADDR
    &clk_cfg_rcgr_addr=&HWIO_GCC_BLSP2_QUP3_I2C_APPS_CFG_RCGR_ADDR

    print "Choose frequency (MHz) from list below: " 

    print "19.2           50.0           " 

    print " "
    print "Enter desired frequency (r to return): "
    enter &clk_desired_freq
    print " "

    if ("&clk_desired_freq"=="19.2")
    (
      &clk_src_name="XO"
      &clk_src_sel=SRC_SEL TODO.
      &clk_src_div=2.
      &clk_m_val=0.
      &clk_n_val=0.
      &clk_2d_val=0.
      
      gosub Set_Clock_Freq
      return
    )
    else if ("&clk_desired_freq"=="50.0")
    (
      &clk_src_name="GPLL0_OUT_MAIN"
      &clk_src_sel=SRC_SEL TODO.
      &clk_src_div=24.
      &clk_m_val=0.
      &clk_n_val=0.
      &clk_2d_val=0.
      
      gosub Set_Clock_Freq
      return
    )
    else if ("&clk_desired_freq"=="r")
    (
      return
    )
    else
    (
      print "Invalid selection."
      goto Set_Clock_Freq_Enter
    )
  )

  if ("&clk"=="gcc_blsp2_qup3_spi_apps_clk")
  (
    gosub PRINT_SET_CLOCK_FREQ_WARNING

    &clk_cmd_rcgr_addr=&HWIO_GCC_BLSP2_QUP3_SPI_APPS_CMD_RCGR_ADDR
    &clk_cfg_rcgr_addr=&HWIO_GCC_BLSP2_QUP3_SPI_APPS_CFG_RCGR_ADDR

    print "Choose frequency (MHz) from list below: " 

    print "0.96           4.8            9.6            " 
    print "15.0           19.2           25.0           " 
    print "50.0           " 

    print " "
    print "Enter desired frequency (r to return): "
    enter &clk_desired_freq
    print " "

    if ("&clk_desired_freq"=="0.96")
    (
      &clk_src_name="XO"
      &clk_src_sel=SRC_SEL TODO.
      &clk_src_div=20.
      &clk_m_val=1.
      &clk_n_val=2.
      &clk_2d_val=2.
      
      gosub Set_Clock_Freq
      return
    )
    else if ("&clk_desired_freq"=="4.8")
    (
      &clk_src_name="XO"
      &clk_src_sel=SRC_SEL TODO.
      &clk_src_div=8.
      &clk_m_val=0.
      &clk_n_val=0.
      &clk_2d_val=0.
      
      gosub Set_Clock_Freq
      return
    )
    else if ("&clk_desired_freq"=="9.6")
    (
      &clk_src_name="XO"
      &clk_src_sel=SRC_SEL TODO.
      &clk_src_div=4.
      &clk_m_val=0.
      &clk_n_val=0.
      &clk_2d_val=0.
      
      gosub Set_Clock_Freq
      return
    )
    else if ("&clk_desired_freq"=="15.0")
    (
      &clk_src_name="GPLL0_OUT_MAIN"
      &clk_src_sel=SRC_SEL TODO.
      &clk_src_div=20.
      &clk_m_val=1.
      &clk_n_val=4.
      &clk_2d_val=4.
      
      gosub Set_Clock_Freq
      return
    )
    else if ("&clk_desired_freq"=="19.2")
    (
      &clk_src_name="XO"
      &clk_src_sel=SRC_SEL TODO.
      &clk_src_div=2.
      &clk_m_val=0.
      &clk_n_val=0.
      &clk_2d_val=0.
      
      gosub Set_Clock_Freq
      return
    )
    else if ("&clk_desired_freq"=="25.0")
    (
      &clk_src_name="GPLL0_OUT_MAIN"
      &clk_src_sel=SRC_SEL TODO.
      &clk_src_div=24.
      &clk_m_val=1.
      &clk_n_val=2.
      &clk_2d_val=2.
      
      gosub Set_Clock_Freq
      return
    )
    else if ("&clk_desired_freq"=="50.0")
    (
      &clk_src_name="GPLL0_OUT_MAIN"
      &clk_src_sel=SRC_SEL TODO.
      &clk_src_div=24.
      &clk_m_val=0.
      &clk_n_val=0.
      &clk_2d_val=0.
      
      gosub Set_Clock_Freq
      return
    )
    else if ("&clk_desired_freq"=="r")
    (
      return
    )
    else
    (
      print "Invalid selection."
      goto Set_Clock_Freq_Enter
    )
  )

  if ("&clk"=="gcc_blsp2_qup4_i2c_apps_clk")
  (
    gosub PRINT_SET_CLOCK_FREQ_WARNING

    &clk_cmd_rcgr_addr=&HWIO_GCC_BLSP2_QUP4_I2C_APPS_CMD_RCGR_ADDR
    &clk_cfg_rcgr_addr=&HWIO_GCC_BLSP2_QUP4_I2C_APPS_CFG_RCGR_ADDR

    print "Choose frequency (MHz) from list below: " 

    print "19.2           50.0           " 

    print " "
    print "Enter desired frequency (r to return): "
    enter &clk_desired_freq
    print " "

    if ("&clk_desired_freq"=="19.2")
    (
      &clk_src_name="XO"
      &clk_src_sel=SRC_SEL TODO.
      &clk_src_div=2.
      &clk_m_val=0.
      &clk_n_val=0.
      &clk_2d_val=0.
      
      gosub Set_Clock_Freq
      return
    )
    else if ("&clk_desired_freq"=="50.0")
    (
      &clk_src_name="GPLL0_OUT_MAIN"
      &clk_src_sel=SRC_SEL TODO.
      &clk_src_div=24.
      &clk_m_val=0.
      &clk_n_val=0.
      &clk_2d_val=0.
      
      gosub Set_Clock_Freq
      return
    )
    else if ("&clk_desired_freq"=="r")
    (
      return
    )
    else
    (
      print "Invalid selection."
      goto Set_Clock_Freq_Enter
    )
  )

  if ("&clk"=="gcc_blsp2_qup4_spi_apps_clk")
  (
    gosub PRINT_SET_CLOCK_FREQ_WARNING

    &clk_cmd_rcgr_addr=&HWIO_GCC_BLSP2_QUP4_SPI_APPS_CMD_RCGR_ADDR
    &clk_cfg_rcgr_addr=&HWIO_GCC_BLSP2_QUP4_SPI_APPS_CFG_RCGR_ADDR

    print "Choose frequency (MHz) from list below: " 

    print "0.96           4.8            9.6            " 
    print "15.0           19.2           25.0           " 
    print "50.0           " 

    print " "
    print "Enter desired frequency (r to return): "
    enter &clk_desired_freq
    print " "

    if ("&clk_desired_freq"=="0.96")
    (
      &clk_src_name="XO"
      &clk_src_sel=SRC_SEL TODO.
      &clk_src_div=20.
      &clk_m_val=1.
      &clk_n_val=2.
      &clk_2d_val=2.
      
      gosub Set_Clock_Freq
      return
    )
    else if ("&clk_desired_freq"=="4.8")
    (
      &clk_src_name="XO"
      &clk_src_sel=SRC_SEL TODO.
      &clk_src_div=8.
      &clk_m_val=0.
      &clk_n_val=0.
      &clk_2d_val=0.
      
      gosub Set_Clock_Freq
      return
    )
    else if ("&clk_desired_freq"=="9.6")
    (
      &clk_src_name="XO"
      &clk_src_sel=SRC_SEL TODO.
      &clk_src_div=4.
      &clk_m_val=0.
      &clk_n_val=0.
      &clk_2d_val=0.
      
      gosub Set_Clock_Freq
      return
    )
    else if ("&clk_desired_freq"=="15.0")
    (
      &clk_src_name="GPLL0_OUT_MAIN"
      &clk_src_sel=SRC_SEL TODO.
      &clk_src_div=20.
      &clk_m_val=1.
      &clk_n_val=4.
      &clk_2d_val=4.
      
      gosub Set_Clock_Freq
      return
    )
    else if ("&clk_desired_freq"=="19.2")
    (
      &clk_src_name="XO"
      &clk_src_sel=SRC_SEL TODO.
      &clk_src_div=2.
      &clk_m_val=0.
      &clk_n_val=0.
      &clk_2d_val=0.
      
      gosub Set_Clock_Freq
      return
    )
    else if ("&clk_desired_freq"=="25.0")
    (
      &clk_src_name="GPLL0_OUT_MAIN"
      &clk_src_sel=SRC_SEL TODO.
      &clk_src_div=24.
      &clk_m_val=1.
      &clk_n_val=2.
      &clk_2d_val=2.
      
      gosub Set_Clock_Freq
      return
    )
    else if ("&clk_desired_freq"=="50.0")
    (
      &clk_src_name="GPLL0_OUT_MAIN"
      &clk_src_sel=SRC_SEL TODO.
      &clk_src_div=24.
      &clk_m_val=0.
      &clk_n_val=0.
      &clk_2d_val=0.
      
      gosub Set_Clock_Freq
      return
    )
    else if ("&clk_desired_freq"=="r")
    (
      return
    )
    else
    (
      print "Invalid selection."
      goto Set_Clock_Freq_Enter
    )
  )

  if ("&clk"=="gcc_blsp2_uart1_apps_clk")
  (
    gosub PRINT_SET_CLOCK_FREQ_WARNING

    &clk_cmd_rcgr_addr=&HWIO_GCC_BLSP2_UART1_APPS_CMD_RCGR_ADDR
    &clk_cfg_rcgr_addr=&HWIO_GCC_BLSP2_UART1_APPS_CFG_RCGR_ADDR

    print "Choose frequency (MHz) from list below: " 

    print "3.6864         7.3728         14.7456        " 
    print "16.0           19.2           24.0           " 
    print "32.0           40.0           46.4           " 
    print "48.0           51.2           56.0           " 
    print "58.9824        60.0           63.157895      " 

    print " "
    print "Enter desired frequency (r to return): "
    enter &clk_desired_freq
    print " "

    if ("&clk_desired_freq"=="3.6864")
    (
      &clk_src_name="GPLL0_OUT_MAIN"
      &clk_src_sel=SRC_SEL TODO.
      &clk_src_div=2.
      &clk_m_val=96.
      &clk_n_val=15625.
      &clk_2d_val=15625.
      
      gosub Set_Clock_Freq
      return
    )
    else if ("&clk_desired_freq"=="7.3728")
    (
      &clk_src_name="GPLL0_OUT_MAIN"
      &clk_src_sel=SRC_SEL TODO.
      &clk_src_div=2.
      &clk_m_val=192.
      &clk_n_val=15625.
      &clk_2d_val=15625.
      
      gosub Set_Clock_Freq
      return
    )
    else if ("&clk_desired_freq"=="14.7456")
    (
      &clk_src_name="GPLL0_OUT_MAIN"
      &clk_src_sel=SRC_SEL TODO.
      &clk_src_div=2.
      &clk_m_val=384.
      &clk_n_val=15625.
      &clk_2d_val=15625.
      
      gosub Set_Clock_Freq
      return
    )
    else if ("&clk_desired_freq"=="16.0")
    (
      &clk_src_name="GPLL0_OUT_MAIN"
      &clk_src_sel=SRC_SEL TODO.
      &clk_src_div=10.
      &clk_m_val=2.
      &clk_n_val=15.
      &clk_2d_val=15.
      
      gosub Set_Clock_Freq
      return
    )
    else if ("&clk_desired_freq"=="19.2")
    (
      &clk_src_name="XO"
      &clk_src_sel=SRC_SEL TODO.
      &clk_src_div=2.
      &clk_m_val=0.
      &clk_n_val=0.
      &clk_2d_val=0.
      
      gosub Set_Clock_Freq
      return
    )
    else if ("&clk_desired_freq"=="24.0")
    (
      &clk_src_name="GPLL0_OUT_MAIN"
      &clk_src_sel=SRC_SEL TODO.
      &clk_src_div=10.
      &clk_m_val=1.
      &clk_n_val=5.
      &clk_2d_val=5.
      
      gosub Set_Clock_Freq
      return
    )
    else if ("&clk_desired_freq"=="32.0")
    (
      &clk_src_name="GPLL0_OUT_MAIN"
      &clk_src_sel=SRC_SEL TODO.
      &clk_src_div=2.
      &clk_m_val=4.
      &clk_n_val=75.
      &clk_2d_val=75.
      
      gosub Set_Clock_Freq
      return
    )
    else if ("&clk_desired_freq"=="40.0")
    (
      &clk_src_name="GPLL0_OUT_MAIN"
      &clk_src_sel=SRC_SEL TODO.
      &clk_src_div=30.
      &clk_m_val=0.
      &clk_n_val=0.
      &clk_2d_val=0.
      
      gosub Set_Clock_Freq
      return
    )
    else if ("&clk_desired_freq"=="46.4")
    (
      &clk_src_name="GPLL0_OUT_MAIN"
      &clk_src_sel=SRC_SEL TODO.
      &clk_src_div=2.
      &clk_m_val=29.
      &clk_n_val=375.
      &clk_2d_val=375.
      
      gosub Set_Clock_Freq
      return
    )
    else if ("&clk_desired_freq"=="48.0")
    (
      &clk_src_name="GPLL0_OUT_MAIN"
      &clk_src_sel=SRC_SEL TODO.
      &clk_src_div=25.
      &clk_m_val=0.
      &clk_n_val=0.
      &clk_2d_val=0.
      
      gosub Set_Clock_Freq
      return
    )
    else if ("&clk_desired_freq"=="51.2")
    (
      &clk_src_name="GPLL0_OUT_MAIN"
      &clk_src_sel=SRC_SEL TODO.
      &clk_src_div=2.
      &clk_m_val=32.
      &clk_n_val=375.
      &clk_2d_val=375.
      
      gosub Set_Clock_Freq
      return
    )
    else if ("&clk_desired_freq"=="56.0")
    (
      &clk_src_name="GPLL0_OUT_MAIN"
      &clk_src_sel=SRC_SEL TODO.
      &clk_src_div=2.
      &clk_m_val=7.
      &clk_n_val=75.
      &clk_2d_val=75.
      
      gosub Set_Clock_Freq
      return
    )
    else if ("&clk_desired_freq"=="58.9824")
    (
      &clk_src_name="GPLL0_OUT_MAIN"
      &clk_src_sel=SRC_SEL TODO.
      &clk_src_div=2.
      &clk_m_val=1536.
      &clk_n_val=15625.
      &clk_2d_val=15625.
      
      gosub Set_Clock_Freq
      return
    )
    else if ("&clk_desired_freq"=="60.0")
    (
      &clk_src_name="GPLL0_OUT_MAIN"
      &clk_src_sel=SRC_SEL TODO.
      &clk_src_div=20.
      &clk_m_val=0.
      &clk_n_val=0.
      &clk_2d_val=0.
      
      gosub Set_Clock_Freq
      return
    )
    else if ("&clk_desired_freq"=="63.157895")
    (
      &clk_src_name="GPLL0_OUT_MAIN"
      &clk_src_sel=SRC_SEL TODO.
      &clk_src_div=19.
      &clk_m_val=0.
      &clk_n_val=0.
      &clk_2d_val=0.
      
      gosub Set_Clock_Freq
      return
    )
    else if ("&clk_desired_freq"=="r")
    (
      return
    )
    else
    (
      print "Invalid selection."
      goto Set_Clock_Freq_Enter
    )
  )

  if ("&clk"=="gcc_blsp2_uart2_apps_clk")
  (
    gosub PRINT_SET_CLOCK_FREQ_WARNING

    &clk_cmd_rcgr_addr=&HWIO_GCC_BLSP2_UART2_APPS_CMD_RCGR_ADDR
    &clk_cfg_rcgr_addr=&HWIO_GCC_BLSP2_UART2_APPS_CFG_RCGR_ADDR

    print "Choose frequency (MHz) from list below: " 

    print "3.6864         7.3728         14.7456        " 
    print "16.0           19.2           24.0           " 
    print "32.0           40.0           46.4           " 
    print "48.0           51.2           56.0           " 
    print "58.9824        60.0           63.157895      " 

    print " "
    print "Enter desired frequency (r to return): "
    enter &clk_desired_freq
    print " "

    if ("&clk_desired_freq"=="3.6864")
    (
      &clk_src_name="GPLL0_OUT_MAIN"
      &clk_src_sel=SRC_SEL TODO.
      &clk_src_div=2.
      &clk_m_val=96.
      &clk_n_val=15625.
      &clk_2d_val=15625.
      
      gosub Set_Clock_Freq
      return
    )
    else if ("&clk_desired_freq"=="7.3728")
    (
      &clk_src_name="GPLL0_OUT_MAIN"
      &clk_src_sel=SRC_SEL TODO.
      &clk_src_div=2.
      &clk_m_val=192.
      &clk_n_val=15625.
      &clk_2d_val=15625.
      
      gosub Set_Clock_Freq
      return
    )
    else if ("&clk_desired_freq"=="14.7456")
    (
      &clk_src_name="GPLL0_OUT_MAIN"
      &clk_src_sel=SRC_SEL TODO.
      &clk_src_div=2.
      &clk_m_val=384.
      &clk_n_val=15625.
      &clk_2d_val=15625.
      
      gosub Set_Clock_Freq
      return
    )
    else if ("&clk_desired_freq"=="16.0")
    (
      &clk_src_name="GPLL0_OUT_MAIN"
      &clk_src_sel=SRC_SEL TODO.
      &clk_src_div=10.
      &clk_m_val=2.
      &clk_n_val=15.
      &clk_2d_val=15.
      
      gosub Set_Clock_Freq
      return
    )
    else if ("&clk_desired_freq"=="19.2")
    (
      &clk_src_name="XO"
      &clk_src_sel=SRC_SEL TODO.
      &clk_src_div=2.
      &clk_m_val=0.
      &clk_n_val=0.
      &clk_2d_val=0.
      
      gosub Set_Clock_Freq
      return
    )
    else if ("&clk_desired_freq"=="24.0")
    (
      &clk_src_name="GPLL0_OUT_MAIN"
      &clk_src_sel=SRC_SEL TODO.
      &clk_src_div=10.
      &clk_m_val=1.
      &clk_n_val=5.
      &clk_2d_val=5.
      
      gosub Set_Clock_Freq
      return
    )
    else if ("&clk_desired_freq"=="32.0")
    (
      &clk_src_name="GPLL0_OUT_MAIN"
      &clk_src_sel=SRC_SEL TODO.
      &clk_src_div=2.
      &clk_m_val=4.
      &clk_n_val=75.
      &clk_2d_val=75.
      
      gosub Set_Clock_Freq
      return
    )
    else if ("&clk_desired_freq"=="40.0")
    (
      &clk_src_name="GPLL0_OUT_MAIN"
      &clk_src_sel=SRC_SEL TODO.
      &clk_src_div=30.
      &clk_m_val=0.
      &clk_n_val=0.
      &clk_2d_val=0.
      
      gosub Set_Clock_Freq
      return
    )
    else if ("&clk_desired_freq"=="46.4")
    (
      &clk_src_name="GPLL0_OUT_MAIN"
      &clk_src_sel=SRC_SEL TODO.
      &clk_src_div=2.
      &clk_m_val=29.
      &clk_n_val=375.
      &clk_2d_val=375.
      
      gosub Set_Clock_Freq
      return
    )
    else if ("&clk_desired_freq"=="48.0")
    (
      &clk_src_name="GPLL0_OUT_MAIN"
      &clk_src_sel=SRC_SEL TODO.
      &clk_src_div=25.
      &clk_m_val=0.
      &clk_n_val=0.
      &clk_2d_val=0.
      
      gosub Set_Clock_Freq
      return
    )
    else if ("&clk_desired_freq"=="51.2")
    (
      &clk_src_name="GPLL0_OUT_MAIN"
      &clk_src_sel=SRC_SEL TODO.
      &clk_src_div=2.
      &clk_m_val=32.
      &clk_n_val=375.
      &clk_2d_val=375.
      
      gosub Set_Clock_Freq
      return
    )
    else if ("&clk_desired_freq"=="56.0")
    (
      &clk_src_name="GPLL0_OUT_MAIN"
      &clk_src_sel=SRC_SEL TODO.
      &clk_src_div=2.
      &clk_m_val=7.
      &clk_n_val=75.
      &clk_2d_val=75.
      
      gosub Set_Clock_Freq
      return
    )
    else if ("&clk_desired_freq"=="58.9824")
    (
      &clk_src_name="GPLL0_OUT_MAIN"
      &clk_src_sel=SRC_SEL TODO.
      &clk_src_div=2.
      &clk_m_val=1536.
      &clk_n_val=15625.
      &clk_2d_val=15625.
      
      gosub Set_Clock_Freq
      return
    )
    else if ("&clk_desired_freq"=="60.0")
    (
      &clk_src_name="GPLL0_OUT_MAIN"
      &clk_src_sel=SRC_SEL TODO.
      &clk_src_div=20.
      &clk_m_val=0.
      &clk_n_val=0.
      &clk_2d_val=0.
      
      gosub Set_Clock_Freq
      return
    )
    else if ("&clk_desired_freq"=="63.157895")
    (
      &clk_src_name="GPLL0_OUT_MAIN"
      &clk_src_sel=SRC_SEL TODO.
      &clk_src_div=19.
      &clk_m_val=0.
      &clk_n_val=0.
      &clk_2d_val=0.
      
      gosub Set_Clock_Freq
      return
    )
    else if ("&clk_desired_freq"=="r")
    (
      return
    )
    else
    (
      print "Invalid selection."
      goto Set_Clock_Freq_Enter
    )
  )

  if ("&clk"=="gcc_blsp1_uart1_sim_clk")||("&clk"=="gcc_blsp1_uart2_sim_clk")||("&clk"=="gcc_blsp2_uart1_sim_clk")||("&clk"=="gcc_blsp2_uart2_sim_clk")
  (
    gosub PRINT_SET_CLOCK_FREQ_WARNING

    &clk_cmd_rcgr_addr=&HWIO_GCC_BLSP_UART_SIM_CMD_RCGR_ADDR
    &clk_cfg_rcgr_addr=&HWIO_GCC_BLSP_UART_SIM_CFG_RCGR_ADDR

    print "Choose frequency (MHz) from list below: " 

    print "3.84           " 

    print " "
    print "Enter desired frequency (r to return): "
    enter &clk_desired_freq
    print " "

    if ("&clk_desired_freq"=="3.84")
    (
      &clk_src_name="XO"
      &clk_src_sel=SRC_SEL TODO.
      &clk_src_div=10.
      &clk_m_val=0.
      &clk_n_val=0.
      &clk_2d_val=0.
      
      gosub Set_Clock_Freq
      return
    )
    else if ("&clk_desired_freq"=="r")
    (
      return
    )
    else
    (
      print "Invalid selection."
      goto Set_Clock_Freq_Enter
    )
  )

  if ("&clk"=="gcc_cdsp_bimc_clk")||("&clk"=="gcc_sys_noc_cdsp_clk")||("&clk"=="gcc_turing_q6_axi_clk")||("&clk"=="gcc_turing_q6_smmu_axi_clk")||("&clk"=="gcc_turing_q6_smmu_axi_src_clk")
  (
    gosub PRINT_SET_CLOCK_FREQ_WARNING

    &clk_cmd_rcgr_addr=&HWIO_GCC_CDSP_BIMC_CMD_RCGR_ADDR
    &clk_cfg_rcgr_addr=&HWIO_GCC_CDSP_BIMC_CFG_RCGR_ADDR

    print "Choose frequency (MHz) from list below: " 

    print "19.2           120.0          200.0          " 
    print "316.8          401.0          451.05         " 

    print " "
    print "Enter desired frequency (r to return): "
    enter &clk_desired_freq
    print " "

    if ("&clk_desired_freq"=="19.2")
    (
      &clk_src_name="XO"
      &clk_src_sel=SRC_SEL TODO.
      &clk_src_div=2.
      &clk_m_val=0.
      &clk_n_val=0.
      &clk_2d_val=0.
      
      gosub Set_Clock_Freq
      return
    )
    else if ("&clk_desired_freq"=="120.0")
    (
      &clk_src_name="PLL0_EARLY_DIV_CLK_SRC"
      &clk_src_sel=SRC_SEL TODO.
      &clk_src_div=5.
      &clk_m_val=0.
      &clk_n_val=0.
      &clk_2d_val=0.
      
      gosub Set_Clock_Freq
      return
    )
    else if ("&clk_desired_freq"=="200.0")
    (
      &clk_src_name="GPLL0_OUT_MAIN"
      &clk_src_sel=SRC_SEL TODO.
      &clk_src_div=6.
      &clk_m_val=0.
      &clk_n_val=0.
      &clk_2d_val=0.
      
      gosub Set_Clock_Freq
      return
    )
    else if ("&clk_desired_freq"=="316.8")
    (
      &clk_src_name="GPLL2_OUT_MAIN"
      &clk_src_sel=SRC_SEL TODO.
      &clk_src_div=4.
      &clk_m_val=0.
      &clk_n_val=0.
      &clk_2d_val=0.
      
      gosub Set_Clock_Freq
      return
    )
    else if ("&clk_desired_freq"=="401.0")
    (
      &clk_src_name="GPLL1_OUT_MAIN"
      &clk_src_sel=SRC_SEL TODO.
      &clk_src_div=4.
      &clk_m_val=0.
      &clk_n_val=0.
      &clk_2d_val=0.
      
      gosub Set_Clock_Freq
      return
    )
    else if ("&clk_desired_freq"=="451.05")
    (
      &clk_src_name="GPLL2_OUT_MAIN"
      &clk_src_sel=SRC_SEL TODO.
      &clk_src_div=8.
      &clk_m_val=0.
      &clk_n_val=0.
      &clk_2d_val=0.
      
      gosub Set_Clock_Freq
      return
    )
    else if ("&clk_desired_freq"=="r")
    (
      return
    )
    else
    (
      print "Invalid selection."
      goto Set_Clock_Freq_Enter
    )
  )

  if ("&clk"=="gcc_ce1_clk")
  (
    gosub PRINT_SET_CLOCK_FREQ_WARNING

    &clk_cmd_rcgr_addr=&HWIO_GCC_CE1_CMD_RCGR_ADDR
    &clk_cfg_rcgr_addr=&HWIO_GCC_CE1_CFG_RCGR_ADDR

    print "Choose frequency (MHz) from list below: " 

    print "19.2           42.857143      85.714286      " 
    print "171.428571     " 

    print " "
    print "Enter desired frequency (r to return): "
    enter &clk_desired_freq
    print " "

    if ("&clk_desired_freq"=="19.2")
    (
      &clk_src_name="XO"
      &clk_src_sel=SRC_SEL TODO.
      &clk_src_div=2.
      &clk_m_val=0.
      &clk_n_val=0.
      &clk_2d_val=0.
      
      gosub Set_Clock_Freq
      return
    )
    else if ("&clk_desired_freq"=="42.857143")
    (
      &clk_src_name="GPLL0_OUT_MAIN"
      &clk_src_sel=SRC_SEL TODO.
      &clk_src_div=28.
      &clk_m_val=0.
      &clk_n_val=0.
      &clk_2d_val=0.
      
      gosub Set_Clock_Freq
      return
    )
    else if ("&clk_desired_freq"=="85.714286")
    (
      &clk_src_name="GPLL0_OUT_MAIN"
      &clk_src_sel=SRC_SEL TODO.
      &clk_src_div=14.
      &clk_m_val=0.
      &clk_n_val=0.
      &clk_2d_val=0.
      
      gosub Set_Clock_Freq
      return
    )
    else if ("&clk_desired_freq"=="171.428571")
    (
      &clk_src_name="GPLL0_OUT_MAIN"
      &clk_src_sel=SRC_SEL TODO.
      &clk_src_div=7.
      &clk_m_val=0.
      &clk_n_val=0.
      &clk_2d_val=0.
      
      gosub Set_Clock_Freq
      return
    )
    else if ("&clk_desired_freq"=="r")
    (
      return
    )
    else
    (
      print "Invalid selection."
      goto Set_Clock_Freq_Enter
    )
  )

  if ("&clk"=="gcc_aggre2_cnoc_north_periph_ahb_clk")||("&clk"=="gcc_aggre2_cnoc_periph_ahb_clk")||("&clk"=="gcc_aggre2_cnoc_south_periph_ahb_clk")||("&clk"=="gcc_blsp1_ahb_clk")||("&clk"=="gcc_blsp2_ahb_clk")||("&clk"=="gcc_cnoc_bus_timeout0_ahb_clk")||("&clk"=="gcc_cnoc_periph_ahb_clk")||("&clk"=="gcc_cnoc_periph_bus_timeout1_ahb_clk")||("&clk"=="gcc_cnoc_periph_bus_timeout2_ahb_clk")||("&clk"=="gcc_cnoc_periph_north_ahb_clk")||("&clk"=="gcc_cnoc_periph_south_ahb_clk")||("&clk"=="gcc_pdm_ahb_clk")||("&clk"=="gcc_qspi_ahb_clk")||("&clk"=="gcc_sdcc1_ahb_clk")||("&clk"=="gcc_sdcc2_ahb_clk")||("&clk"=="gcc_spdm_pnoc_cy_clk")
  (
    gosub PRINT_SET_CLOCK_FREQ_WARNING

    &clk_cmd_rcgr_addr=&HWIO_GCC_CNOC_PERIPH_CMD_RCGR_ADDR
    &clk_cfg_rcgr_addr=&HWIO_GCC_CNOC_PERIPH_CFG_RCGR_ADDR

    print "Choose frequency (MHz) from list below: " 

    print "19.2           33.333333      50.0           " 
    print "75.0           100.0          " 

    print " "
    print "Enter desired frequency (r to return): "
    enter &clk_desired_freq
    print " "

    if ("&clk_desired_freq"=="19.2")
    (
      &clk_src_name="XO"
      &clk_src_sel=SRC_SEL TODO.
      &clk_src_div=2.
      &clk_m_val=0.
      &clk_n_val=0.
      &clk_2d_val=0.
      
      gosub Set_Clock_Freq
      return
    )
    else if ("&clk_desired_freq"=="33.333333")
    (
      &clk_src_name="PLL0_EARLY_DIV_CLK_SRC"
      &clk_src_sel=SRC_SEL TODO.
      &clk_src_div=18.
      &clk_m_val=0.
      &clk_n_val=0.
      &clk_2d_val=0.
      
      gosub Set_Clock_Freq
      return
    )
    else if ("&clk_desired_freq"=="50.0")
    (
      &clk_src_name="GPLL0_OUT_MAIN"
      &clk_src_sel=SRC_SEL TODO.
      &clk_src_div=24.
      &clk_m_val=0.
      &clk_n_val=0.
      &clk_2d_val=0.
      
      gosub Set_Clock_Freq
      return
    )
    else if ("&clk_desired_freq"=="75.0")
    (
      &clk_src_name="GPLL0_OUT_MAIN"
      &clk_src_sel=SRC_SEL TODO.
      &clk_src_div=16.
      &clk_m_val=0.
      &clk_n_val=0.
      &clk_2d_val=0.
      
      gosub Set_Clock_Freq
      return
    )
    else if ("&clk_desired_freq"=="100.0")
    (
      &clk_src_name="GPLL0_OUT_MAIN"
      &clk_src_sel=SRC_SEL TODO.
      &clk_src_div=12.
      &clk_m_val=0.
      &clk_n_val=0.
      &clk_2d_val=0.
      
      gosub Set_Clock_Freq
      return
    )
    else if ("&clk_desired_freq"=="r")
    (
      return
    )
    else
    (
      print "Invalid selection."
      goto Set_Clock_Freq_Enter
    )
  )

  if ("&clk"=="gcc_a2noc_throttle_cfg_clk")||("&clk"=="gcc_aggre2_cnoc_ahb_clk")||("&clk"=="gcc_aggre2_noc_msmpu_cfg_ahb_clk")||("&clk"=="gcc_ahb_clk")||("&clk"=="gcc_bimc_cfg_ahb_clk")||("&clk"=="gcc_bimc_nius_cfg_ahb_clk")||("&clk"=="gcc_boot_rom_ahb_clk")||("&clk"=="gcc_ce1_ahb_clk")||("&clk"=="gcc_cfg_noc_ahb_clk")||("&clk"=="gcc_cfg_noc_lpass_aon_ahb_clk")||("&clk"=="gcc_cfg_noc_north_ahb_clk")||("&clk"=="gcc_cfg_noc_south_ahb_clk")||("&clk"=="gcc_cfg_noc_turing_aon_ahb_clk")||("&clk"=="gcc_cnoc_bus_timeout10_ahb_clk")||("&clk"=="gcc_cnoc_bus_timeout11_ahb_clk")||("&clk"=="gcc_cnoc_bus_timeout2_ahb_clk")||("&clk"=="gcc_cnoc_bus_timeout3_ahb_clk")||("&clk"=="gcc_cnoc_bus_timeout4_ahb_clk")||("&clk"=="gcc_cnoc_bus_timeout6_ahb_clk")||("&clk"=="gcc_cnoc_bus_timeout7_ahb_clk")||("&clk"=="gcc_cnoc_bus_timeout8_ahb_clk")||("&clk"=="gcc_cnoc_bus_timeout9_ahb_clk")||("&clk"=="gcc_cnoc_mst_rpm_ahb_clk")||("&clk"=="gcc_dcc_ahb_clk")||("&clk"=="gcc_glm_ahb_clk")||("&clk"=="gcc_gpu_cfg_ahb_clk")||("&clk"=="gcc_imem_cfg_ahb_clk")||("&clk"=="gcc_ipa_ahb_clk")||("&clk"=="gcc_lpass_cnoc_cfg_clk")||("&clk"=="gcc_lpass_q6_smmu_ahb_clk")||("&clk"=="gcc_lpass_q6_smmu_gds_cfg_clk")||("&clk"=="gcc_mccc_cfg_ahb_clk")||("&clk"=="gcc_mmss_noc_cfg_ahb_clk")||("&clk"=="gcc_mmss_qm_ahb_clk")||("&clk"=="gcc_mpm_ahb_clk")||("&clk"=="gcc_msg_ram_ahb_clk")||("&clk"=="gcc_mss_cfg_ahb_clk")||("&clk"=="gcc_mss_msmpu_cfg_ahb_clk")||("&clk"=="gcc_mss_q6_msmpu_cfg_ahb_clk")||("&clk"=="gcc_pimem_ahb_clk")||("&clk"=="gcc_prng_ahb_clk")||("&clk"=="gcc_qdss_cfg_ahb_clk")||("&clk"=="gcc_qdss_dap_ahb_clk")||("&clk"=="gcc_rbcpr_cx_ahb_clk")||("&clk"=="gcc_rbcpr_mx_ahb_clk")||("&clk"=="gcc_rpm_mst_m2_cnoc_ahb_clk")||("&clk"=="gcc_sec_ctrl_ahb_clk")||("&clk"=="gcc_sec_ctrl_boot_rom_patch_clk")||("&clk"=="gcc_smmu_aggre2_ahb_clk")||("&clk"=="gcc_snoc_bus_timeout4_ahb_clk")||("&clk"=="gcc_snoc_cnoc_ahb_clk")||("&clk"=="gcc_spdm_cfg_ahb_clk")||("&clk"=="gcc_spdm_mstr_ahb_clk")||("&clk"=="gcc_spmi_cnoc_ahb_clk")||("&clk"=="gcc_tcsr_ahb_clk")||("&clk"=="gcc_tic_cfg_ahb_clk")||("&clk"=="gcc_tlmm_centre_ahb_clk")||("&clk"=="gcc_tlmm_clk")||("&clk"=="gcc_tlmm_north_ahb_clk")||("&clk"=="gcc_tlmm_south_ahb_clk")||("&clk"=="gcc_turing_q6_smmu_ahb_clk")||("&clk"=="gcc_ufs_ahb_clk")||("&clk"=="gcc_usb_phy_cfg_ahb2phy_clk")
  (
    gosub PRINT_SET_CLOCK_FREQ_WARNING

    &clk_cmd_rcgr_addr=&HWIO_GCC_CONFIG_NOC_CMD_RCGR_ADDR
    &clk_cfg_rcgr_addr=&HWIO_GCC_CONFIG_NOC_CFG_RCGR_ADDR

    print "Choose frequency (MHz) from list below: " 

    print "19.2           33.333333      37.5           " 
    print "75.0           " 

    print " "
    print "Enter desired frequency (r to return): "
    enter &clk_desired_freq
    print " "

    if ("&clk_desired_freq"=="19.2")
    (
      &clk_src_name="XO"
      &clk_src_sel=SRC_SEL TODO.
      &clk_src_div=2.
      &clk_m_val=0.
      &clk_n_val=0.
      &clk_2d_val=0.
      
      gosub Set_Clock_Freq
      return
    )
    else if ("&clk_desired_freq"=="33.333333")
    (
      &clk_src_name="PLL0_EARLY_DIV_CLK_SRC"
      &clk_src_sel=SRC_SEL TODO.
      &clk_src_div=18.
      &clk_m_val=0.
      &clk_n_val=0.
      &clk_2d_val=0.
      
      gosub Set_Clock_Freq
      return
    )
    else if ("&clk_desired_freq"=="37.5")
    (
      &clk_src_name="GPLL0_OUT_MAIN"
      &clk_src_sel=SRC_SEL TODO.
      &clk_src_div=32.
      &clk_m_val=0.
      &clk_n_val=0.
      &clk_2d_val=0.
      
      gosub Set_Clock_Freq
      return
    )
    else if ("&clk_desired_freq"=="75.0")
    (
      &clk_src_name="GPLL0_OUT_MAIN"
      &clk_src_sel=SRC_SEL TODO.
      &clk_src_div=16.
      &clk_m_val=0.
      &clk_n_val=0.
      &clk_2d_val=0.
      
      gosub Set_Clock_Freq
      return
    )
    else if ("&clk_desired_freq"=="r")
    (
      return
    )
    else
    (
      print "Invalid selection."
      goto Set_Clock_Freq_Enter
    )
  )

  if ("&clk"=="gcc_glm_clk")
  (
    gosub PRINT_SET_CLOCK_FREQ_WARNING

    &clk_cmd_rcgr_addr=&HWIO_GCC_GLM_CMD_RCGR_ADDR
    &clk_cfg_rcgr_addr=&HWIO_GCC_GLM_CFG_RCGR_ADDR

    print "Choose frequency (MHz) from list below: " 

    print "100.0          " 

    print " "
    print "Enter desired frequency (r to return): "
    enter &clk_desired_freq
    print " "

    if ("&clk_desired_freq"=="100.0")
    (
      &clk_src_name="PLL0_EARLY_DIV_CLK_SRC"
      &clk_src_sel=SRC_SEL TODO.
      &clk_src_div=6.
      &clk_m_val=0.
      &clk_n_val=0.
      &clk_2d_val=0.
      
      gosub Set_Clock_Freq
      return
    )
    else if ("&clk_desired_freq"=="r")
    (
      return
    )
    else
    (
      print "Invalid selection."
      goto Set_Clock_Freq_Enter
    )
  )

  if ("&clk"=="gcc_gp1_clk")
  (
    gosub PRINT_SET_CLOCK_FREQ_WARNING

    &clk_cmd_rcgr_addr=&HWIO_GCC_GP1_CMD_RCGR_ADDR
    &clk_cfg_rcgr_addr=&HWIO_GCC_GP1_CFG_RCGR_ADDR

    print "Choose frequency (MHz) from list below: " 

    print "19.2           100.0          200.0          " 

    print " "
    print "Enter desired frequency (r to return): "
    enter &clk_desired_freq
    print " "

    if ("&clk_desired_freq"=="19.2")
    (
      &clk_src_name="XO"
      &clk_src_sel=SRC_SEL TODO.
      &clk_src_div=2.
      &clk_m_val=0.
      &clk_n_val=0.
      &clk_2d_val=0.
      
      gosub Set_Clock_Freq
      return
    )
    else if ("&clk_desired_freq"=="100.0")
    (
      &clk_src_name="GPLL0_OUT_MAIN"
      &clk_src_sel=SRC_SEL TODO.
      &clk_src_div=12.
      &clk_m_val=0.
      &clk_n_val=0.
      &clk_2d_val=0.
      
      gosub Set_Clock_Freq
      return
    )
    else if ("&clk_desired_freq"=="200.0")
    (
      &clk_src_name="GPLL0_OUT_MAIN"
      &clk_src_sel=SRC_SEL TODO.
      &clk_src_div=6.
      &clk_m_val=0.
      &clk_n_val=0.
      &clk_2d_val=0.
      
      gosub Set_Clock_Freq
      return
    )
    else if ("&clk_desired_freq"=="r")
    (
      return
    )
    else
    (
      print "Invalid selection."
      goto Set_Clock_Freq_Enter
    )
  )

  if ("&clk"=="gcc_gp2_clk")
  (
    gosub PRINT_SET_CLOCK_FREQ_WARNING

    &clk_cmd_rcgr_addr=&HWIO_GCC_GP2_CMD_RCGR_ADDR
    &clk_cfg_rcgr_addr=&HWIO_GCC_GP2_CFG_RCGR_ADDR

    print "Choose frequency (MHz) from list below: " 

    print "19.2           100.0          200.0          " 

    print " "
    print "Enter desired frequency (r to return): "
    enter &clk_desired_freq
    print " "

    if ("&clk_desired_freq"=="19.2")
    (
      &clk_src_name="XO"
      &clk_src_sel=SRC_SEL TODO.
      &clk_src_div=2.
      &clk_m_val=0.
      &clk_n_val=0.
      &clk_2d_val=0.
      
      gosub Set_Clock_Freq
      return
    )
    else if ("&clk_desired_freq"=="100.0")
    (
      &clk_src_name="GPLL0_OUT_MAIN"
      &clk_src_sel=SRC_SEL TODO.
      &clk_src_div=12.
      &clk_m_val=0.
      &clk_n_val=0.
      &clk_2d_val=0.
      
      gosub Set_Clock_Freq
      return
    )
    else if ("&clk_desired_freq"=="200.0")
    (
      &clk_src_name="GPLL0_OUT_MAIN"
      &clk_src_sel=SRC_SEL TODO.
      &clk_src_div=6.
      &clk_m_val=0.
      &clk_n_val=0.
      &clk_2d_val=0.
      
      gosub Set_Clock_Freq
      return
    )
    else if ("&clk_desired_freq"=="r")
    (
      return
    )
    else
    (
      print "Invalid selection."
      goto Set_Clock_Freq_Enter
    )
  )

  if ("&clk"=="gcc_gp3_clk")
  (
    gosub PRINT_SET_CLOCK_FREQ_WARNING

    &clk_cmd_rcgr_addr=&HWIO_GCC_GP3_CMD_RCGR_ADDR
    &clk_cfg_rcgr_addr=&HWIO_GCC_GP3_CFG_RCGR_ADDR

    print "Choose frequency (MHz) from list below: " 

    print "19.2           100.0          200.0          " 

    print " "
    print "Enter desired frequency (r to return): "
    enter &clk_desired_freq
    print " "

    if ("&clk_desired_freq"=="19.2")
    (
      &clk_src_name="XO"
      &clk_src_sel=SRC_SEL TODO.
      &clk_src_div=2.
      &clk_m_val=0.
      &clk_n_val=0.
      &clk_2d_val=0.
      
      gosub Set_Clock_Freq
      return
    )
    else if ("&clk_desired_freq"=="100.0")
    (
      &clk_src_name="GPLL0_OUT_MAIN"
      &clk_src_sel=SRC_SEL TODO.
      &clk_src_div=12.
      &clk_m_val=0.
      &clk_n_val=0.
      &clk_2d_val=0.
      
      gosub Set_Clock_Freq
      return
    )
    else if ("&clk_desired_freq"=="200.0")
    (
      &clk_src_name="GPLL0_OUT_MAIN"
      &clk_src_sel=SRC_SEL TODO.
      &clk_src_div=6.
      &clk_m_val=0.
      &clk_n_val=0.
      &clk_2d_val=0.
      
      gosub Set_Clock_Freq
      return
    )
    else if ("&clk_desired_freq"=="r")
    (
      return
    )
    else
    (
      print "Invalid selection."
      goto Set_Clock_Freq_Enter
    )
  )

  if ("&clk"=="gcc_bimc_gfx_clk")||("&clk"=="gcc_gpu_bimc_gfx_clk")||("&clk"=="gcc_gpu_bimc_gfx_src_clk")||("&clk"=="gcc_gpu_snoc_dvm_gfx_clk")
  (
    gosub PRINT_SET_CLOCK_FREQ_WARNING

    &clk_cmd_rcgr_addr=&HWIO_GCC_GPU_BIMC_GFX_CMD_RCGR_ADDR
    &clk_cfg_rcgr_addr=&HWIO_GCC_GPU_BIMC_GFX_CFG_RCGR_ADDR

    print "Choose frequency (MHz) from list below: " 

    print "19.2           120.0          200.0          " 
    print "316.8          401.0          451.05         " 

    print " "
    print "Enter desired frequency (r to return): "
    enter &clk_desired_freq
    print " "

    if ("&clk_desired_freq"=="19.2")
    (
      &clk_src_name="XO"
      &clk_src_sel=SRC_SEL TODO.
      &clk_src_div=2.
      &clk_m_val=0.
      &clk_n_val=0.
      &clk_2d_val=0.
      
      gosub Set_Clock_Freq
      return
    )
    else if ("&clk_desired_freq"=="120.0")
    (
      &clk_src_name="PLL0_EARLY_DIV_CLK_SRC"
      &clk_src_sel=SRC_SEL TODO.
      &clk_src_div=5.
      &clk_m_val=0.
      &clk_n_val=0.
      &clk_2d_val=0.
      
      gosub Set_Clock_Freq
      return
    )
    else if ("&clk_desired_freq"=="200.0")
    (
      &clk_src_name="GPLL0_OUT_MAIN"
      &clk_src_sel=SRC_SEL TODO.
      &clk_src_div=6.
      &clk_m_val=0.
      &clk_n_val=0.
      &clk_2d_val=0.
      
      gosub Set_Clock_Freq
      return
    )
    else if ("&clk_desired_freq"=="316.8")
    (
      &clk_src_name="GPLL2_OUT_MAIN"
      &clk_src_sel=SRC_SEL TODO.
      &clk_src_div=4.
      &clk_m_val=0.
      &clk_n_val=0.
      &clk_2d_val=0.
      
      gosub Set_Clock_Freq
      return
    )
    else if ("&clk_desired_freq"=="401.0")
    (
      &clk_src_name="GPLL1_OUT_MAIN"
      &clk_src_sel=SRC_SEL TODO.
      &clk_src_div=4.
      &clk_m_val=0.
      &clk_n_val=0.
      &clk_2d_val=0.
      
      gosub Set_Clock_Freq
      return
    )
    else if ("&clk_desired_freq"=="451.05")
    (
      &clk_src_name="GPLL2_OUT_MAIN"
      &clk_src_sel=SRC_SEL TODO.
      &clk_src_div=8.
      &clk_m_val=0.
      &clk_n_val=0.
      &clk_2d_val=0.
      
      gosub Set_Clock_Freq
      return
    )
    else if ("&clk_desired_freq"=="r")
    (
      return
    )
    else
    (
      print "Invalid selection."
      goto Set_Clock_Freq_Enter
    )
  )

  if ("&clk"=="gcc_hmss_ahb_clk")||("&clk"=="gcc_sys_noc_hmss_ahb_clk")
  (
    gosub PRINT_SET_CLOCK_FREQ_WARNING

    &clk_cmd_rcgr_addr=&HWIO_GCC_HMSS_AHB_CMD_RCGR_ADDR
    &clk_cfg_rcgr_addr=&HWIO_GCC_HMSS_AHB_CFG_RCGR_ADDR

    print "Choose frequency (MHz) from list below: " 

    print "19.2           37.5           50.0           " 
    print "100.0          " 

    print " "
    print "Enter desired frequency (r to return): "
    enter &clk_desired_freq
    print " "

    if ("&clk_desired_freq"=="19.2")
    (
      &clk_src_name="XO"
      &clk_src_sel=SRC_SEL TODO.
      &clk_src_div=2.
      &clk_m_val=0.
      &clk_n_val=0.
      &clk_2d_val=0.
      
      gosub Set_Clock_Freq
      return
    )
    else if ("&clk_desired_freq"=="37.5")
    (
      &clk_src_name="GPLL0_OUT_MAIN"
      &clk_src_sel=SRC_SEL TODO.
      &clk_src_div=32.
      &clk_m_val=0.
      &clk_n_val=0.
      &clk_2d_val=0.
      
      gosub Set_Clock_Freq
      return
    )
    else if ("&clk_desired_freq"=="50.0")
    (
      &clk_src_name="GPLL0_OUT_MAIN"
      &clk_src_sel=SRC_SEL TODO.
      &clk_src_div=24.
      &clk_m_val=0.
      &clk_n_val=0.
      &clk_2d_val=0.
      
      gosub Set_Clock_Freq
      return
    )
    else if ("&clk_desired_freq"=="100.0")
    (
      &clk_src_name="GPLL0_OUT_MAIN"
      &clk_src_sel=SRC_SEL TODO.
      &clk_src_div=12.
      &clk_m_val=0.
      &clk_n_val=0.
      &clk_2d_val=0.
      
      gosub Set_Clock_Freq
      return
    )
    else if ("&clk_desired_freq"=="r")
    (
      return
    )
    else
    (
      print "Invalid selection."
      goto Set_Clock_Freq_Enter
    )
  )

  if ("&clk"=="gcc_hmss_rbcpr_clk")
  (
    gosub PRINT_SET_CLOCK_FREQ_WARNING

    &clk_cmd_rcgr_addr=&HWIO_GCC_HMSS_RBCPR_CMD_RCGR_ADDR
    &clk_cfg_rcgr_addr=&HWIO_GCC_HMSS_RBCPR_CFG_RCGR_ADDR

    print "Choose frequency (MHz) from list below: " 

    print "19.2           " 

    print " "
    print "Enter desired frequency (r to return): "
    enter &clk_desired_freq
    print " "

    if ("&clk_desired_freq"=="19.2")
    (
      &clk_src_name="XO"
      &clk_src_sel=SRC_SEL TODO.
      &clk_src_div=2.
      &clk_m_val=0.
      &clk_n_val=0.
      &clk_2d_val=0.
      
      gosub Set_Clock_Freq
      return
    )
    else if ("&clk_desired_freq"=="r")
    (
      return
    )
    else
    (
      print "Invalid selection."
      goto Set_Clock_Freq_Enter
    )
  )

  if ("&clk"=="gcc_mmss_qm_core_clk")
  (
    gosub PRINT_SET_CLOCK_FREQ_WARNING

    &clk_cmd_rcgr_addr=&HWIO_GCC_MMSS_QM_CORE_CMD_RCGR_ADDR
    &clk_cfg_rcgr_addr=&HWIO_GCC_MMSS_QM_CORE_CFG_RCGR_ADDR

    print "Choose frequency (MHz) from list below: " 

    print "150.0          300.0          " 

    print " "
    print "Enter desired frequency (r to return): "
    enter &clk_desired_freq
    print " "

    if ("&clk_desired_freq"=="150.0")
    (
      &clk_src_name="PLL0_EARLY_DIV_CLK_SRC"
      &clk_src_sel=SRC_SEL TODO.
      &clk_src_div=4.
      &clk_m_val=0.
      &clk_n_val=0.
      &clk_2d_val=0.
      
      gosub Set_Clock_Freq
      return
    )
    else if ("&clk_desired_freq"=="300.0")
    (
      &clk_src_name="GPLL0_OUT_MAIN"
      &clk_src_sel=SRC_SEL TODO.
      &clk_src_div=4.
      &clk_m_val=0.
      &clk_n_val=0.
      &clk_2d_val=0.
      
      gosub Set_Clock_Freq
      return
    )
    else if ("&clk_desired_freq"=="r")
    (
      return
    )
    else
    (
      print "Invalid selection."
      goto Set_Clock_Freq_Enter
    )
  )

  if ("&clk"=="gcc_bimc_mss_q6_axi_clk")||("&clk"=="gcc_mss_q6_bimc_axi_clk")||("&clk"=="gcc_mss_q6_msmpu_client_axi_clk")
  (
    gosub PRINT_SET_CLOCK_FREQ_WARNING

    &clk_cmd_rcgr_addr=&HWIO_GCC_MSS_Q6_BIMC_AXI_CMD_RCGR_ADDR
    &clk_cfg_rcgr_addr=&HWIO_GCC_MSS_Q6_BIMC_AXI_CFG_RCGR_ADDR

    print "Choose frequency (MHz) from list below: " 

    print "200.0          401.0          422.4          " 
    print "600.0          " 

    print " "
    print "Enter desired frequency (r to return): "
    enter &clk_desired_freq
    print " "

    if ("&clk_desired_freq"=="200.0")
    (
      &clk_src_name="GPLL0_OUT_MAIN"
      &clk_src_sel=SRC_SEL TODO.
      &clk_src_div=6.
      &clk_m_val=0.
      &clk_n_val=0.
      &clk_2d_val=0.
      
      gosub Set_Clock_Freq
      return
    )
    else if ("&clk_desired_freq"=="401.0")
    (
      &clk_src_name="GPLL1_OUT_MAIN"
      &clk_src_sel=SRC_SEL TODO.
      &clk_src_div=4.
      &clk_m_val=0.
      &clk_n_val=0.
      &clk_2d_val=0.
      
      gosub Set_Clock_Freq
      return
    )
    else if ("&clk_desired_freq"=="422.4")
    (
      &clk_src_name="GPLL2_OUT_MAIN"
      &clk_src_sel=SRC_SEL TODO.
      &clk_src_div=3.
      &clk_m_val=0.
      &clk_n_val=0.
      &clk_2d_val=0.
      
      gosub Set_Clock_Freq
      return
    )
    else if ("&clk_desired_freq"=="600.0")
    (
      &clk_src_name="GPLL0_OUT_MAIN"
      &clk_src_sel=SRC_SEL TODO.
      &clk_src_div=2.
      &clk_m_val=0.
      &clk_n_val=0.
      &clk_2d_val=0.
      
      gosub Set_Clock_Freq
      return
    )
    else if ("&clk_desired_freq"=="r")
    (
      return
    )
    else
    (
      print "Invalid selection."
      goto Set_Clock_Freq_Enter
    )
  )

  if ("&clk"=="gcc_mss_vs_clk")
  (
    gosub PRINT_SET_CLOCK_FREQ_WARNING

    &clk_cmd_rcgr_addr=&HWIO_GCC_MSS_VS_CMD_RCGR_ADDR
    &clk_cfg_rcgr_addr=&HWIO_GCC_MSS_VS_CFG_RCGR_ADDR

    print "Choose frequency (MHz) from list below: " 

    print "19.2           300.0          600.0          " 

    print " "
    print "Enter desired frequency (r to return): "
    enter &clk_desired_freq
    print " "

    if ("&clk_desired_freq"=="19.2")
    (
      &clk_src_name="XO"
      &clk_src_sel=SRC_SEL TODO.
      &clk_src_div=2.
      &clk_m_val=0.
      &clk_n_val=0.
      &clk_2d_val=0.
      
      gosub Set_Clock_Freq
      return
    )
    else if ("&clk_desired_freq"=="300.0")
    (
      &clk_src_name="GPLL0_OUT_MAIN"
      &clk_src_sel=SRC_SEL TODO.
      &clk_src_div=4.
      &clk_m_val=0.
      &clk_n_val=0.
      &clk_2d_val=0.
      
      gosub Set_Clock_Freq
      return
    )
    else if ("&clk_desired_freq"=="600.0")
    (
      &clk_src_name="GPLL0_OUT_MAIN"
      &clk_src_sel=SRC_SEL TODO.
      &clk_src_div=2.
      &clk_m_val=0.
      &clk_n_val=0.
      &clk_2d_val=0.
      
      gosub Set_Clock_Freq
      return
    )
    else if ("&clk_desired_freq"=="r")
    (
      return
    )
    else
    (
      print "Invalid selection."
      goto Set_Clock_Freq_Enter
    )
  )

  if ("&clk"=="gcc_pdm2_clk")
  (
    gosub PRINT_SET_CLOCK_FREQ_WARNING

    &clk_cmd_rcgr_addr=&HWIO_GCC_PDM2_CMD_RCGR_ADDR
    &clk_cfg_rcgr_addr=&HWIO_GCC_PDM2_CFG_RCGR_ADDR

    print "Choose frequency (MHz) from list below: " 

    print "60.0           " 

    print " "
    print "Enter desired frequency (r to return): "
    enter &clk_desired_freq
    print " "

    if ("&clk_desired_freq"=="60.0")
    (
      &clk_src_name="GPLL0_OUT_MAIN"
      &clk_src_sel=SRC_SEL TODO.
      &clk_src_div=20.
      &clk_m_val=0.
      &clk_n_val=0.
      &clk_2d_val=0.
      
      gosub Set_Clock_Freq
      return
    )
    else if ("&clk_desired_freq"=="r")
    (
      return
    )
    else
    (
      print "Invalid selection."
      goto Set_Clock_Freq_Enter
    )
  )

  if ("&clk"=="gcc_bimc_pimem_axi_clk")||("&clk"=="gcc_pimem_axi_clk")||("&clk"=="gcc_sys_noc_pimem_axi_clk")
  (
    gosub PRINT_SET_CLOCK_FREQ_WARNING

    &clk_cmd_rcgr_addr=&HWIO_GCC_PIMEM_AXI_CMD_RCGR_ADDR
    &clk_cfg_rcgr_addr=&HWIO_GCC_PIMEM_AXI_CFG_RCGR_ADDR

    print "Choose frequency (MHz) from list below: " 

    print "19.2           50.0           75.0           " 
    print "100.0          150.0          200.0          " 
    print "240.0          300.0          341.76         " 

    print " "
    print "Enter desired frequency (r to return): "
    enter &clk_desired_freq
    print " "

    if ("&clk_desired_freq"=="19.2")
    (
      &clk_src_name="XO"
      &clk_src_sel=SRC_SEL TODO.
      &clk_src_div=2.
      &clk_m_val=0.
      &clk_n_val=0.
      &clk_2d_val=0.
      
      gosub Set_Clock_Freq
      return
    )
    else if ("&clk_desired_freq"=="50.0")
    (
      &clk_src_name="PLL0_EARLY_DIV_CLK_SRC"
      &clk_src_sel=SRC_SEL TODO.
      &clk_src_div=12.
      &clk_m_val=0.
      &clk_n_val=0.
      &clk_2d_val=0.
      
      gosub Set_Clock_Freq
      return
    )
    else if ("&clk_desired_freq"=="75.0")
    (
      &clk_src_name="PLL0_EARLY_DIV_CLK_SRC"
      &clk_src_sel=SRC_SEL TODO.
      &clk_src_div=8.
      &clk_m_val=0.
      &clk_n_val=0.
      &clk_2d_val=0.
      
      gosub Set_Clock_Freq
      return
    )
    else if ("&clk_desired_freq"=="100.0")
    (
      &clk_src_name="GPLL0_OUT_MAIN"
      &clk_src_sel=SRC_SEL TODO.
      &clk_src_div=12.
      &clk_m_val=0.
      &clk_n_val=0.
      &clk_2d_val=0.
      
      gosub Set_Clock_Freq
      return
    )
    else if ("&clk_desired_freq"=="150.0")
    (
      &clk_src_name="GPLL0_OUT_MAIN"
      &clk_src_sel=SRC_SEL TODO.
      &clk_src_div=8.
      &clk_m_val=0.
      &clk_n_val=0.
      &clk_2d_val=0.
      
      gosub Set_Clock_Freq
      return
    )
    else if ("&clk_desired_freq"=="200.0")
    (
      &clk_src_name="GPLL0_OUT_MAIN"
      &clk_src_sel=SRC_SEL TODO.
      &clk_src_div=6.
      &clk_m_val=0.
      &clk_n_val=0.
      &clk_2d_val=0.
      
      gosub Set_Clock_Freq
      return
    )
    else if ("&clk_desired_freq"=="240.0")
    (
      &clk_src_name="GPLL0_OUT_MAIN"
      &clk_src_sel=SRC_SEL TODO.
      &clk_src_div=5.
      &clk_m_val=0.
      &clk_n_val=0.
      &clk_2d_val=0.
      
      gosub Set_Clock_Freq
      return
    )
    else if ("&clk_desired_freq"=="300.0")
    (
      &clk_src_name="GPLL0_OUT_MAIN"
      &clk_src_sel=SRC_SEL TODO.
      &clk_src_div=4.
      &clk_m_val=0.
      &clk_n_val=0.
      &clk_2d_val=0.
      
      gosub Set_Clock_Freq
      return
    )
    else if ("&clk_desired_freq"=="341.76")
    (
      &clk_src_name="GPLL5_OUT_MAIN"
      &clk_src_sel=SRC_SEL TODO.
      &clk_src_div=10.
      &clk_m_val=0.
      &clk_n_val=0.
      &clk_2d_val=0.
      
      gosub Set_Clock_Freq
      return
    )
    else if ("&clk_desired_freq"=="r")
    (
      return
    )
    else
    (
      print "Invalid selection."
      goto Set_Clock_Freq_Enter
    )
  )

  if ("&clk"=="gcc_center_apb_clk")||("&clk"=="gcc_gpu_trig_clk")||("&clk"=="gcc_hmss_trig_clk")||("&clk"=="gcc_lpass_trig_clk")||("&clk"=="gcc_mmss_trig_clk")||("&clk"=="gcc_mss_trig_clk")||("&clk"=="gcc_north_apb_clk")||("&clk"=="gcc_qdss_apb2jtag_clk")||("&clk"=="gcc_qdss_dap_clk")||("&clk"=="gcc_qdss_trig_clk")||("&clk"=="gcc_south_apb_clk")||("&clk"=="gcc_turing_trig_clk")||("&clk"=="gcc_wcss_apb_clk")
  (
    gosub PRINT_SET_CLOCK_FREQ_WARNING

    &clk_cmd_rcgr_addr=&HWIO_GCC_QDSS_APB_TRIG_CMD_RCGR_ADDR
    &clk_cfg_rcgr_addr=&HWIO_GCC_QDSS_APB_TRIG_CFG_RCGR_ADDR

    print "Choose frequency (MHz) from list below: " 

    print "37.5           75.0           150.0          " 

    print " "
    print "Enter desired frequency (r to return): "
    enter &clk_desired_freq
    print " "

    if ("&clk_desired_freq"=="37.5")
    (
      &clk_src_name="PLL0_EARLY_DIV_CLK_SRC"
      &clk_src_sel=SRC_SEL TODO.
      &clk_src_div=16.
      &clk_m_val=0.
      &clk_n_val=0.
      &clk_2d_val=0.
      
      gosub Set_Clock_Freq
      return
    )
    else if ("&clk_desired_freq"=="75.0")
    (
      &clk_src_name="PLL0_EARLY_DIV_CLK_SRC"
      &clk_src_sel=SRC_SEL TODO.
      &clk_src_div=8.
      &clk_m_val=0.
      &clk_n_val=0.
      &clk_2d_val=0.
      
      gosub Set_Clock_Freq
      return
    )
    else if ("&clk_desired_freq"=="150.0")
    (
      &clk_src_name="GPLL0_OUT_MAIN"
      &clk_src_sel=SRC_SEL TODO.
      &clk_src_div=8.
      &clk_m_val=0.
      &clk_n_val=0.
      &clk_2d_val=0.
      
      gosub Set_Clock_Freq
      return
    )
    else if ("&clk_desired_freq"=="r")
    (
      return
    )
    else
    (
      print "Invalid selection."
      goto Set_Clock_Freq_Enter
    )
  )

  if ("&clk"=="gcc_aggre2_noc_at_clk")||("&clk"=="gcc_gpu_at_clk")||("&clk"=="gcc_hmss_at_clk")||("&clk"=="gcc_mmss_at_clk")||("&clk"=="gcc_mmss_noc_at_clk")||("&clk"=="gcc_north_at_clk")||("&clk"=="gcc_qdss_center_at_clk")||("&clk"=="gcc_south_at_clk")||("&clk"=="gcc_sys_noc_at_clk")||("&clk"=="gcc_wcss_at_clk")
  (
    gosub PRINT_SET_CLOCK_FREQ_WARNING

    &clk_cmd_rcgr_addr=&HWIO_GCC_QDSS_ATB_A_CMD_RCGR_ADDR
    &clk_cfg_rcgr_addr=&HWIO_GCC_QDSS_ATB_A_CFG_RCGR_ADDR

    print "Choose frequency (MHz) from list below: " 

    print "60.0           120.0          240.0          " 

    print " "
    print "Enter desired frequency (r to return): "
    enter &clk_desired_freq
    print " "

    if ("&clk_desired_freq"=="60.0")
    (
      &clk_src_name="PLL0_EARLY_DIV_CLK_SRC"
      &clk_src_sel=SRC_SEL TODO.
      &clk_src_div=10.
      &clk_m_val=0.
      &clk_n_val=0.
      &clk_2d_val=0.
      
      gosub Set_Clock_Freq
      return
    )
    else if ("&clk_desired_freq"=="120.0")
    (
      &clk_src_name="GPLL0_OUT_MAIN"
      &clk_src_sel=SRC_SEL TODO.
      &clk_src_div=10.
      &clk_m_val=0.
      &clk_n_val=0.
      &clk_2d_val=0.
      
      gosub Set_Clock_Freq
      return
    )
    else if ("&clk_desired_freq"=="240.0")
    (
      &clk_src_name="GPLL0_OUT_MAIN"
      &clk_src_sel=SRC_SEL TODO.
      &clk_src_div=5.
      &clk_m_val=0.
      &clk_n_val=0.
      &clk_2d_val=0.
      
      gosub Set_Clock_Freq
      return
    )
    else if ("&clk_desired_freq"=="r")
    (
      return
    )
    else
    (
      print "Invalid selection."
      goto Set_Clock_Freq_Enter
    )
  )

  if ("&clk"=="gcc_qdss_stm_clk")||("&clk"=="gcc_sys_noc_qdss_stm_axi_clk")
  (
    gosub PRINT_SET_CLOCK_FREQ_WARNING

    &clk_cmd_rcgr_addr=&HWIO_GCC_QDSS_STM_CMD_RCGR_ADDR
    &clk_cfg_rcgr_addr=&HWIO_GCC_QDSS_STM_CFG_RCGR_ADDR

    print "Choose frequency (MHz) from list below: " 

    print "50.0           100.0          200.0          " 

    print " "
    print "Enter desired frequency (r to return): "
    enter &clk_desired_freq
    print " "

    if ("&clk_desired_freq"=="50.0")
    (
      &clk_src_name="PLL0_EARLY_DIV_CLK_SRC"
      &clk_src_sel=SRC_SEL TODO.
      &clk_src_div=12.
      &clk_m_val=0.
      &clk_n_val=0.
      &clk_2d_val=0.
      
      gosub Set_Clock_Freq
      return
    )
    else if ("&clk_desired_freq"=="100.0")
    (
      &clk_src_name="GPLL0_OUT_MAIN"
      &clk_src_sel=SRC_SEL TODO.
      &clk_src_div=12.
      &clk_m_val=0.
      &clk_n_val=0.
      &clk_2d_val=0.
      
      gosub Set_Clock_Freq
      return
    )
    else if ("&clk_desired_freq"=="200.0")
    (
      &clk_src_name="GPLL0_OUT_MAIN"
      &clk_src_sel=SRC_SEL TODO.
      &clk_src_div=6.
      &clk_m_val=0.
      &clk_n_val=0.
      &clk_2d_val=0.
      
      gosub Set_Clock_Freq
      return
    )
    else if ("&clk_desired_freq"=="r")
    (
      return
    )
    else
    (
      print "Invalid selection."
      goto Set_Clock_Freq_Enter
    )
  )

  if ("&clk"=="gcc_qdss_traceclkin_clk")
  (
    gosub PRINT_SET_CLOCK_FREQ_WARNING

    &clk_cmd_rcgr_addr=&HWIO_GCC_QDSS_TRACECLKIN_CMD_RCGR_ADDR
    &clk_cfg_rcgr_addr=&HWIO_GCC_QDSS_TRACECLKIN_CFG_RCGR_ADDR

    print "Choose frequency (MHz) from list below: " 

    print "75.0           150.0          267.333333     " 

    print " "
    print "Enter desired frequency (r to return): "
    enter &clk_desired_freq
    print " "

    if ("&clk_desired_freq"=="75.0")
    (
      &clk_src_name="PLL0_EARLY_DIV_CLK_SRC"
      &clk_src_sel=SRC_SEL TODO.
      &clk_src_div=8.
      &clk_m_val=0.
      &clk_n_val=0.
      &clk_2d_val=0.
      
      gosub Set_Clock_Freq
      return
    )
    else if ("&clk_desired_freq"=="150.0")
    (
      &clk_src_name="GPLL0_OUT_MAIN"
      &clk_src_sel=SRC_SEL TODO.
      &clk_src_div=8.
      &clk_m_val=0.
      &clk_n_val=0.
      &clk_2d_val=0.
      
      gosub Set_Clock_Freq
      return
    )
    else if ("&clk_desired_freq"=="267.333333")
    (
      &clk_src_name="GPLL1_OUT_MAIN"
      &clk_src_sel=SRC_SEL TODO.
      &clk_src_div=6.
      &clk_m_val=0.
      &clk_n_val=0.
      &clk_2d_val=0.
      
      gosub Set_Clock_Freq
      return
    )
    else if ("&clk_desired_freq"=="r")
    (
      return
    )
    else
    (
      print "Invalid selection."
      goto Set_Clock_Freq_Enter
    )
  )

  if ("&clk"=="gcc_apss_qdss_tsctr_div2_clk")||("&clk"=="gcc_apss_qdss_tsctr_div8_clk")||("&clk"=="gcc_qdss_tsctr_div16_clk")||("&clk"=="gcc_qdss_tsctr_div2_clk")||("&clk"=="gcc_qdss_tsctr_div3_clk")||("&clk"=="gcc_qdss_tsctr_div4_clk")||("&clk"=="gcc_qdss_tsctr_div8_clk")||("&clk"=="gcc_wcss_tsctr_div2_clk")
  (
    gosub PRINT_SET_CLOCK_FREQ_WARNING

    &clk_cmd_rcgr_addr=&HWIO_GCC_QDSS_TSCTR_CMD_RCGR_ADDR
    &clk_cfg_rcgr_addr=&HWIO_GCC_QDSS_TSCTR_CFG_RCGR_ADDR

    print "Choose frequency (MHz) from list below: " 

    print "150.0          300.0          600.0          " 

    print " "
    print "Enter desired frequency (r to return): "
    enter &clk_desired_freq
    print " "

    if ("&clk_desired_freq"=="150.0")
    (
      &clk_src_name="PLL0_EARLY_DIV_CLK_SRC"
      &clk_src_sel=SRC_SEL TODO.
      &clk_src_div=4.
      &clk_m_val=0.
      &clk_n_val=0.
      &clk_2d_val=0.
      
      gosub Set_Clock_Freq
      return
    )
    else if ("&clk_desired_freq"=="300.0")
    (
      &clk_src_name="GPLL0_OUT_MAIN"
      &clk_src_sel=SRC_SEL TODO.
      &clk_src_div=4.
      &clk_m_val=0.
      &clk_n_val=0.
      &clk_2d_val=0.
      
      gosub Set_Clock_Freq
      return
    )
    else if ("&clk_desired_freq"=="600.0")
    (
      &clk_src_name="GPLL0_OUT_MAIN"
      &clk_src_sel=SRC_SEL TODO.
      &clk_src_div=2.
      &clk_m_val=0.
      &clk_n_val=0.
      &clk_2d_val=0.
      
      gosub Set_Clock_Freq
      return
    )
    else if ("&clk_desired_freq"=="r")
    (
      return
    )
    else
    (
      print "Invalid selection."
      goto Set_Clock_Freq_Enter
    )
  )

  if ("&clk"=="gcc_qspi_ser_clk")
  (
    gosub PRINT_SET_CLOCK_FREQ_WARNING

    &clk_cmd_rcgr_addr=&HWIO_GCC_QSPI_SER_CMD_RCGR_ADDR
    &clk_cfg_rcgr_addr=&HWIO_GCC_QSPI_SER_CFG_RCGR_ADDR

    print "Choose frequency (MHz) from list below: " 

    print "19.2           80.2           160.4          " 
    print "267.333333     " 

    print " "
    print "Enter desired frequency (r to return): "
    enter &clk_desired_freq
    print " "

    if ("&clk_desired_freq"=="19.2")
    (
      &clk_src_name="XO"
      &clk_src_sel=SRC_SEL TODO.
      &clk_src_div=2.
      &clk_m_val=0.
      &clk_n_val=0.
      &clk_2d_val=0.
      
      gosub Set_Clock_Freq
      return
    )
    else if ("&clk_desired_freq"=="80.2")
    (
      &clk_src_name="PLL1_EARLY_DIV_CLK_SRC"
      &clk_src_sel=SRC_SEL TODO.
      &clk_src_div=10.
      &clk_m_val=0.
      &clk_n_val=0.
      &clk_2d_val=0.
      
      gosub Set_Clock_Freq
      return
    )
    else if ("&clk_desired_freq"=="160.4")
    (
      &clk_src_name="GPLL1_OUT_MAIN"
      &clk_src_sel=SRC_SEL TODO.
      &clk_src_div=10.
      &clk_m_val=0.
      &clk_n_val=0.
      &clk_2d_val=0.
      
      gosub Set_Clock_Freq
      return
    )
    else if ("&clk_desired_freq"=="267.333333")
    (
      &clk_src_name="GPLL1_OUT_MAIN"
      &clk_src_sel=SRC_SEL TODO.
      &clk_src_div=6.
      &clk_m_val=0.
      &clk_n_val=0.
      &clk_2d_val=0.
      
      gosub Set_Clock_Freq
      return
    )
    else if ("&clk_desired_freq"=="r")
    (
      return
    )
    else
    (
      print "Invalid selection."
      goto Set_Clock_Freq_Enter
    )
  )

  if ("&clk"=="gcc_rbcpr_cx_clk")
  (
    gosub PRINT_SET_CLOCK_FREQ_WARNING

    &clk_cmd_rcgr_addr=&HWIO_GCC_RBCPR_CX_CMD_RCGR_ADDR
    &clk_cfg_rcgr_addr=&HWIO_GCC_RBCPR_CX_CFG_RCGR_ADDR

    print "Choose frequency (MHz) from list below: " 

    print "19.2           " 

    print " "
    print "Enter desired frequency (r to return): "
    enter &clk_desired_freq
    print " "

    if ("&clk_desired_freq"=="19.2")
    (
      &clk_src_name="XO"
      &clk_src_sel=SRC_SEL TODO.
      &clk_src_div=2.
      &clk_m_val=0.
      &clk_n_val=0.
      &clk_2d_val=0.
      
      gosub Set_Clock_Freq
      return
    )
    else if ("&clk_desired_freq"=="r")
    (
      return
    )
    else
    (
      print "Invalid selection."
      goto Set_Clock_Freq_Enter
    )
  )

  if ("&clk"=="gcc_rbcpr_mx_clk")
  (
    gosub PRINT_SET_CLOCK_FREQ_WARNING

    &clk_cmd_rcgr_addr=&HWIO_GCC_RBCPR_MX_CMD_RCGR_ADDR
    &clk_cfg_rcgr_addr=&HWIO_GCC_RBCPR_MX_CFG_RCGR_ADDR

    print "Choose frequency (MHz) from list below: " 

    print "19.2           " 

    print " "
    print "Enter desired frequency (r to return): "
    enter &clk_desired_freq
    print " "

    if ("&clk_desired_freq"=="19.2")
    (
      &clk_src_name="XO"
      &clk_src_sel=SRC_SEL TODO.
      &clk_src_div=2.
      &clk_m_val=0.
      &clk_n_val=0.
      &clk_2d_val=0.
      
      gosub Set_Clock_Freq
      return
    )
    else if ("&clk_desired_freq"=="r")
    (
      return
    )
    else
    (
      print "Invalid selection."
      goto Set_Clock_Freq_Enter
    )
  )

  if ("&clk"=="gcc_rpm_bus_ahb_clk")||("&clk"=="gcc_rpm_proc_fclk")||("&clk"=="gcc_rpm_proc_hclk")||("&clk"=="gcc_spdm_rpm_cy_clk")
  (
    gosub PRINT_SET_CLOCK_FREQ_WARNING

    &clk_cmd_rcgr_addr=&HWIO_GCC_RPM_CMD_RCGR_ADDR
    &clk_cfg_rcgr_addr=&HWIO_GCC_RPM_CFG_RCGR_ADDR

    print "Choose frequency (MHz) from list below: " 

    print "19.2           300.0          400.0          " 
    print "600.0          " 

    print " "
    print "Enter desired frequency (r to return): "
    enter &clk_desired_freq
    print " "

    if ("&clk_desired_freq"=="19.2")
    (
      &clk_src_name="XO"
      &clk_src_sel=SRC_SEL TODO.
      &clk_src_div=2.
      &clk_m_val=0.
      &clk_n_val=0.
      &clk_2d_val=0.
      
      gosub Set_Clock_Freq
      return
    )
    else if ("&clk_desired_freq"=="300.0")
    (
      &clk_src_name="PLL0_EARLY_DIV_CLK_SRC"
      &clk_src_sel=SRC_SEL TODO.
      &clk_src_div=2.
      &clk_m_val=0.
      &clk_n_val=0.
      &clk_2d_val=0.
      
      gosub Set_Clock_Freq
      return
    )
    else if ("&clk_desired_freq"=="400.0")
    (
      &clk_src_name="GPLL0_OUT_MAIN"
      &clk_src_sel=SRC_SEL TODO.
      &clk_src_div=3.
      &clk_m_val=0.
      &clk_n_val=0.
      &clk_2d_val=0.
      
      gosub Set_Clock_Freq
      return
    )
    else if ("&clk_desired_freq"=="600.0")
    (
      &clk_src_name="GPLL0_OUT_MAIN"
      &clk_src_sel=SRC_SEL TODO.
      &clk_src_div=2.
      &clk_m_val=0.
      &clk_n_val=0.
      &clk_2d_val=0.
      
      gosub Set_Clock_Freq
      return
    )
    else if ("&clk_desired_freq"=="r")
    (
      return
    )
    else
    (
      print "Invalid selection."
      goto Set_Clock_Freq_Enter
    )
  )

  if ("&clk"=="gcc_sdcc1_apps_clk")
  (
    gosub PRINT_SET_CLOCK_FREQ_WARNING

    &clk_cmd_rcgr_addr=&HWIO_GCC_SDCC1_APPS_CMD_RCGR_ADDR
    &clk_cfg_rcgr_addr=&HWIO_GCC_SDCC1_APPS_CFG_RCGR_ADDR

    print "Choose frequency (MHz) from list below: " 

    print "0.144          0.4            20.0           " 
    print "25.0           50.0           100.0          " 
    print "192.0          384.0          " 

    print " "
    print "Enter desired frequency (r to return): "
    enter &clk_desired_freq
    print " "

    if ("&clk_desired_freq"=="0.144")
    (
      &clk_src_name="XO"
      &clk_src_sel=SRC_SEL TODO.
      &clk_src_div=32.
      &clk_m_val=3.
      &clk_n_val=25.
      &clk_2d_val=25.
      
      gosub Set_Clock_Freq
      return
    )
    else if ("&clk_desired_freq"=="0.4")
    (
      &clk_src_name="XO"
      &clk_src_sel=SRC_SEL TODO.
      &clk_src_div=24.
      &clk_m_val=1.
      &clk_n_val=4.
      &clk_2d_val=4.
      
      gosub Set_Clock_Freq
      return
    )
    else if ("&clk_desired_freq"=="20.0")
    (
      &clk_src_name="PLL0_EARLY_DIV_CLK_SRC"
      &clk_src_sel=SRC_SEL TODO.
      &clk_src_div=10.
      &clk_m_val=1.
      &clk_n_val=3.
      &clk_2d_val=3.
      
      gosub Set_Clock_Freq
      return
    )
    else if ("&clk_desired_freq"=="25.0")
    (
      &clk_src_name="PLL0_EARLY_DIV_CLK_SRC"
      &clk_src_sel=SRC_SEL TODO.
      &clk_src_div=12.
      &clk_m_val=1.
      &clk_n_val=2.
      &clk_2d_val=2.
      
      gosub Set_Clock_Freq
      return
    )
    else if ("&clk_desired_freq"=="50.0")
    (
      &clk_src_name="PLL0_EARLY_DIV_CLK_SRC"
      &clk_src_sel=SRC_SEL TODO.
      &clk_src_div=12.
      &clk_m_val=0.
      &clk_n_val=0.
      &clk_2d_val=0.
      
      gosub Set_Clock_Freq
      return
    )
    else if ("&clk_desired_freq"=="100.0")
    (
      &clk_src_name="GPLL0_OUT_MAIN"
      &clk_src_sel=SRC_SEL TODO.
      &clk_src_div=12.
      &clk_m_val=0.
      &clk_n_val=0.
      &clk_2d_val=0.
      
      gosub Set_Clock_Freq
      return
    )
    else if ("&clk_desired_freq"=="192.0")
    (
      &clk_src_name="GPLL4_OUT_MAIN"
      &clk_src_sel=SRC_SEL TODO.
      &clk_src_div=16.
      &clk_m_val=0.
      &clk_n_val=0.
      &clk_2d_val=0.
      
      gosub Set_Clock_Freq
      return
    )
    else if ("&clk_desired_freq"=="384.0")
    (
      &clk_src_name="GPLL4_OUT_MAIN"
      &clk_src_sel=SRC_SEL TODO.
      &clk_src_div=8.
      &clk_m_val=0.
      &clk_n_val=0.
      &clk_2d_val=0.
      
      gosub Set_Clock_Freq
      return
    )
    else if ("&clk_desired_freq"=="r")
    (
      return
    )
    else
    (
      print "Invalid selection."
      goto Set_Clock_Freq_Enter
    )
  )

  if ("&clk"=="gcc_sdcc1_ice_core_clk")
  (
    gosub PRINT_SET_CLOCK_FREQ_WARNING

    &clk_cmd_rcgr_addr=&HWIO_GCC_SDCC1_ICE_CORE_CMD_RCGR_ADDR
    &clk_cfg_rcgr_addr=&HWIO_GCC_SDCC1_ICE_CORE_CFG_RCGR_ADDR

    print "Choose frequency (MHz) from list below: " 

    print "75.0           150.0          200.0          " 
    print "300.0          " 

    print " "
    print "Enter desired frequency (r to return): "
    enter &clk_desired_freq
    print " "

    if ("&clk_desired_freq"=="75.0")
    (
      &clk_src_name="PLL0_EARLY_DIV_CLK_SRC"
      &clk_src_sel=SRC_SEL TODO.
      &clk_src_div=8.
      &clk_m_val=0.
      &clk_n_val=0.
      &clk_2d_val=0.
      
      gosub Set_Clock_Freq
      return
    )
    else if ("&clk_desired_freq"=="150.0")
    (
      &clk_src_name="GPLL0_OUT_MAIN"
      &clk_src_sel=SRC_SEL TODO.
      &clk_src_div=8.
      &clk_m_val=0.
      &clk_n_val=0.
      &clk_2d_val=0.
      
      gosub Set_Clock_Freq
      return
    )
    else if ("&clk_desired_freq"=="200.0")
    (
      &clk_src_name="GPLL0_OUT_MAIN"
      &clk_src_sel=SRC_SEL TODO.
      &clk_src_div=6.
      &clk_m_val=0.
      &clk_n_val=0.
      &clk_2d_val=0.
      
      gosub Set_Clock_Freq
      return
    )
    else if ("&clk_desired_freq"=="300.0")
    (
      &clk_src_name="GPLL0_OUT_MAIN"
      &clk_src_sel=SRC_SEL TODO.
      &clk_src_div=4.
      &clk_m_val=0.
      &clk_n_val=0.
      &clk_2d_val=0.
      
      gosub Set_Clock_Freq
      return
    )
    else if ("&clk_desired_freq"=="r")
    (
      return
    )
    else
    (
      print "Invalid selection."
      goto Set_Clock_Freq_Enter
    )
  )

  if ("&clk"=="gcc_sdcc2_apps_clk")
  (
    gosub PRINT_SET_CLOCK_FREQ_WARNING

    &clk_cmd_rcgr_addr=&HWIO_GCC_SDCC2_APPS_CMD_RCGR_ADDR
    &clk_cfg_rcgr_addr=&HWIO_GCC_SDCC2_APPS_CFG_RCGR_ADDR

    print "Choose frequency (MHz) from list below: " 

    print "0.144          0.4            20.0           " 
    print "25.0           50.0           100.0          " 
    print "192.0          " 

    print " "
    print "Enter desired frequency (r to return): "
    enter &clk_desired_freq
    print " "

    if ("&clk_desired_freq"=="0.144")
    (
      &clk_src_name="XO"
      &clk_src_sel=SRC_SEL TODO.
      &clk_src_div=32.
      &clk_m_val=3.
      &clk_n_val=25.
      &clk_2d_val=25.
      
      gosub Set_Clock_Freq
      return
    )
    else if ("&clk_desired_freq"=="0.4")
    (
      &clk_src_name="XO"
      &clk_src_sel=SRC_SEL TODO.
      &clk_src_div=24.
      &clk_m_val=1.
      &clk_n_val=4.
      &clk_2d_val=4.
      
      gosub Set_Clock_Freq
      return
    )
    else if ("&clk_desired_freq"=="20.0")
    (
      &clk_src_name="GPLL0_OUT_MAIN"
      &clk_src_sel=SRC_SEL TODO.
      &clk_src_div=30.
      &clk_m_val=1.
      &clk_n_val=2.
      &clk_2d_val=2.
      
      gosub Set_Clock_Freq
      return
    )
    else if ("&clk_desired_freq"=="25.0")
    (
      &clk_src_name="GPLL0_OUT_MAIN"
      &clk_src_sel=SRC_SEL TODO.
      &clk_src_div=24.
      &clk_m_val=1.
      &clk_n_val=2.
      &clk_2d_val=2.
      
      gosub Set_Clock_Freq
      return
    )
    else if ("&clk_desired_freq"=="50.0")
    (
      &clk_src_name="GPLL0_OUT_MAIN"
      &clk_src_sel=SRC_SEL TODO.
      &clk_src_div=24.
      &clk_m_val=0.
      &clk_n_val=0.
      &clk_2d_val=0.
      
      gosub Set_Clock_Freq
      return
    )
    else if ("&clk_desired_freq"=="100.0")
    (
      &clk_src_name="GPLL0_OUT_MAIN"
      &clk_src_sel=SRC_SEL TODO.
      &clk_src_div=12.
      &clk_m_val=0.
      &clk_n_val=0.
      &clk_2d_val=0.
      
      gosub Set_Clock_Freq
      return
    )
    else if ("&clk_desired_freq"=="192.0")
    (
      &clk_src_name="GPLL4_OUT_MAIN"
      &clk_src_sel=SRC_SEL TODO.
      &clk_src_div=16.
      &clk_m_val=0.
      &clk_n_val=0.
      &clk_2d_val=0.
      
      gosub Set_Clock_Freq
      return
    )
    else if ("&clk_desired_freq"=="r")
    (
      return
    )
    else
    (
      print "Invalid selection."
      goto Set_Clock_Freq_Enter
    )
  )

  if ("&clk"=="gcc_sec_ctrl_clk")||("&clk"=="gcc_sec_ctrl_sense_clk")
  (
    gosub PRINT_SET_CLOCK_FREQ_WARNING

    &clk_cmd_rcgr_addr=&HWIO_GCC_SEC_CTRL_CMD_RCGR_ADDR
    &clk_cfg_rcgr_addr=&HWIO_GCC_SEC_CTRL_CFG_RCGR_ADDR

    print "Choose frequency (MHz) from list below: " 

    print "4.8            19.2           " 

    print " "
    print "Enter desired frequency (r to return): "
    enter &clk_desired_freq
    print " "

    if ("&clk_desired_freq"=="4.8")
    (
      &clk_src_name="XO"
      &clk_src_sel=SRC_SEL TODO.
      &clk_src_div=8.
      &clk_m_val=0.
      &clk_n_val=0.
      &clk_2d_val=0.
      
      gosub Set_Clock_Freq
      return
    )
    else if ("&clk_desired_freq"=="19.2")
    (
      &clk_src_name="XO"
      &clk_src_sel=SRC_SEL TODO.
      &clk_src_div=2.
      &clk_m_val=0.
      &clk_n_val=0.
      &clk_2d_val=0.
      
      gosub Set_Clock_Freq
      return
    )
    else if ("&clk_desired_freq"=="r")
    (
      return
    )
    else
    (
      print "Invalid selection."
      goto Set_Clock_Freq_Enter
    )
  )

  if ("&clk"=="gcc_spmi_ahb_clk")
  (
    gosub PRINT_SET_CLOCK_FREQ_WARNING

    &clk_cmd_rcgr_addr=&HWIO_GCC_SPMI_AHB_CMD_RCGR_ADDR
    &clk_cfg_rcgr_addr=&HWIO_GCC_SPMI_AHB_CFG_RCGR_ADDR

    print "Choose frequency (MHz) from list below: " 

    print "19.2           37.5           " 

    print " "
    print "Enter desired frequency (r to return): "
    enter &clk_desired_freq
    print " "

    if ("&clk_desired_freq"=="19.2")
    (
      &clk_src_name="XO"
      &clk_src_sel=SRC_SEL TODO.
      &clk_src_div=2.
      &clk_m_val=0.
      &clk_n_val=0.
      &clk_2d_val=0.
      
      gosub Set_Clock_Freq
      return
    )
    else if ("&clk_desired_freq"=="37.5")
    (
      &clk_src_name="GPLL0_OUT_MAIN"
      &clk_src_sel=SRC_SEL TODO.
      &clk_src_div=32.
      &clk_m_val=0.
      &clk_n_val=0.
      &clk_2d_val=0.
      
      gosub Set_Clock_Freq
      return
    )
    else if ("&clk_desired_freq"=="r")
    (
      return
    )
    else
    (
      print "Invalid selection."
      goto Set_Clock_Freq_Enter
    )
  )

  if ("&clk"=="gcc_spmi_ser_clk")
  (
    gosub PRINT_SET_CLOCK_FREQ_WARNING

    &clk_cmd_rcgr_addr=&HWIO_GCC_SPMI_SER_CMD_RCGR_ADDR
    &clk_cfg_rcgr_addr=&HWIO_GCC_SPMI_SER_CFG_RCGR_ADDR

    print "Choose frequency (MHz) from list below: " 

    print "19.2           " 

    print " "
    print "Enter desired frequency (r to return): "
    enter &clk_desired_freq
    print " "

    if ("&clk_desired_freq"=="19.2")
    (
      &clk_src_name="XO"
      &clk_src_sel=SRC_SEL TODO.
      &clk_src_div=2.
      &clk_m_val=0.
      &clk_n_val=0.
      &clk_2d_val=0.
      
      gosub Set_Clock_Freq
      return
    )
    else if ("&clk_desired_freq"=="r")
    (
      return
    )
    else
    (
      print "Invalid selection."
      goto Set_Clock_Freq_Enter
    )
  )

  if ("&clk"=="gcc_bimc_nius_hs_axi_clk")||("&clk"=="gcc_bimc_sysnoc_hs_axi_clk")||("&clk"=="gcc_lpass_q6_axi_clk")||("&clk"=="gcc_lpass_q6_smmu_axi_clk")||("&clk"=="gcc_lpass_q6_smmu_axi_src_clk")||("&clk"=="gcc_mss_mnoc_bimc_axi_clk")||("&clk"=="gcc_mss_msmpu_client_axi_clk")||("&clk"=="gcc_sys_noc_hs_axi_clk")
  (
    gosub PRINT_SET_CLOCK_FREQ_WARNING

    &clk_cmd_rcgr_addr=&HWIO_GCC_SYS_NOC_HS_AXI_CMD_RCGR_ADDR
    &clk_cfg_rcgr_addr=&HWIO_GCC_SYS_NOC_HS_AXI_CFG_RCGR_ADDR

    print "Choose frequency (MHz) from list below: " 

    print "19.2           37.5           50.0           " 
    print "75.0           100.0          150.0          " 
    print "200.0          240.0          267.333333     " 
    print "300.0          " 

    print " "
    print "Enter desired frequency (r to return): "
    enter &clk_desired_freq
    print " "

    if ("&clk_desired_freq"=="19.2")
    (
      &clk_src_name="XO"
      &clk_src_sel=SRC_SEL TODO.
      &clk_src_div=2.
      &clk_m_val=0.
      &clk_n_val=0.
      &clk_2d_val=0.
      
      gosub Set_Clock_Freq
      return
    )
    else if ("&clk_desired_freq"=="37.5")
    (
      &clk_src_name="PLL0_EARLY_DIV_CLK_SRC"
      &clk_src_sel=SRC_SEL TODO.
      &clk_src_div=16.
      &clk_m_val=0.
      &clk_n_val=0.
      &clk_2d_val=0.
      
      gosub Set_Clock_Freq
      return
    )
    else if ("&clk_desired_freq"=="50.0")
    (
      &clk_src_name="PLL0_EARLY_DIV_CLK_SRC"
      &clk_src_sel=SRC_SEL TODO.
      &clk_src_div=12.
      &clk_m_val=0.
      &clk_n_val=0.
      &clk_2d_val=0.
      
      gosub Set_Clock_Freq
      return
    )
    else if ("&clk_desired_freq"=="75.0")
    (
      &clk_src_name="PLL0_EARLY_DIV_CLK_SRC"
      &clk_src_sel=SRC_SEL TODO.
      &clk_src_div=8.
      &clk_m_val=0.
      &clk_n_val=0.
      &clk_2d_val=0.
      
      gosub Set_Clock_Freq
      return
    )
    else if ("&clk_desired_freq"=="100.0")
    (
      &clk_src_name="GPLL0_OUT_MAIN"
      &clk_src_sel=SRC_SEL TODO.
      &clk_src_div=12.
      &clk_m_val=0.
      &clk_n_val=0.
      &clk_2d_val=0.
      
      gosub Set_Clock_Freq
      return
    )
    else if ("&clk_desired_freq"=="150.0")
    (
      &clk_src_name="GPLL0_OUT_MAIN"
      &clk_src_sel=SRC_SEL TODO.
      &clk_src_div=8.
      &clk_m_val=0.
      &clk_n_val=0.
      &clk_2d_val=0.
      
      gosub Set_Clock_Freq
      return
    )
    else if ("&clk_desired_freq"=="200.0")
    (
      &clk_src_name="GPLL0_OUT_MAIN"
      &clk_src_sel=SRC_SEL TODO.
      &clk_src_div=6.
      &clk_m_val=0.
      &clk_n_val=0.
      &clk_2d_val=0.
      
      gosub Set_Clock_Freq
      return
    )
    else if ("&clk_desired_freq"=="240.0")
    (
      &clk_src_name="GPLL0_OUT_MAIN"
      &clk_src_sel=SRC_SEL TODO.
      &clk_src_div=5.
      &clk_m_val=0.
      &clk_n_val=0.
      &clk_2d_val=0.
      
      gosub Set_Clock_Freq
      return
    )
    else if ("&clk_desired_freq"=="267.333333")
    (
      &clk_src_name="GPLL1_OUT_MAIN"
      &clk_src_sel=SRC_SEL TODO.
      &clk_src_div=6.
      &clk_m_val=0.
      &clk_n_val=0.
      &clk_2d_val=0.
      
      gosub Set_Clock_Freq
      return
    )
    else if ("&clk_desired_freq"=="300.0")
    (
      &clk_src_name="GPLL0_OUT_MAIN"
      &clk_src_sel=SRC_SEL TODO.
      &clk_src_div=4.
      &clk_m_val=0.
      &clk_n_val=0.
      &clk_2d_val=0.
      
      gosub Set_Clock_Freq
      return
    )
    else if ("&clk_desired_freq"=="r")
    (
      return
    )
    else
    (
      print "Invalid selection."
      goto Set_Clock_Freq_Enter
    )
  )

  if ("&clk"=="gcc_a2noc_throttle_core_axi_clk")||("&clk"=="gcc_aggre2_snoc_axi_clk")||("&clk"=="gcc_aggre2_snoc_msmpu_client_axi_clk")||("&clk"=="gcc_aggre2_snoc_north_axi_clk")||("&clk"=="gcc_aggre2_snoc_south_axi_clk")||("&clk"=="gcc_bimc_nius_axi_clk")||("&clk"=="gcc_bimc_sysnoc_axi_clk")||("&clk"=="gcc_ce1_axi_clk")||("&clk"=="gcc_hmss_dvm_bus_clk")||("&clk"=="gcc_imem_axi_clk")||("&clk"=="gcc_lpass_mport_clk")||("&clk"=="gcc_lpass_sway_clk")||("&clk"=="gcc_lpass_sway_mpu_clk")||("&clk"=="gcc_mmss_sys_noc_axi_clk")||("&clk"=="gcc_mss_snoc_axi_clk")||("&clk"=="gcc_qdss_etr_usb_clk")||("&clk"=="gcc_smmu_aggre2_axi_clk")||("&clk"=="gcc_smmu_aggre2_axi_src_clk")||("&clk"=="gcc_snoc_bus_timeout0_ahb_clk")||("&clk"=="gcc_snoc_bus_timeout1_ahb_clk")||("&clk"=="gcc_snoc_bus_timeout3_ahb_clk")||("&clk"=="gcc_snoc_lpass_q6_axis_clk")||("&clk"=="gcc_spdm_snoc_cy_clk")||("&clk"=="gcc_sys_noc_axi_clk")||("&clk"=="gcc_sys_noc_north_axi_clk")||("&clk"=="gcc_sys_noc_south_axi_clk")||("&clk"=="gcc_turing_sway_clk")||("&clk"=="gcc_wcss_ahb_s0_clk")||("&clk"=="gcc_wcss_axi_m_clk")||("&clk"=="gcc_wcss_ecahb_clk")||("&clk"=="gcc_wcss_shdreg_ahb_clk")
  (
    gosub PRINT_SET_CLOCK_FREQ_WARNING

    &clk_cmd_rcgr_addr=&HWIO_GCC_SYSTEM_NOC_CMD_RCGR_ADDR
    &clk_cfg_rcgr_addr=&HWIO_GCC_SYSTEM_NOC_CFG_RCGR_ADDR

    print "Choose frequency (MHz) from list below: " 

    print "19.2           50.0           75.0           " 
    print "120.0          160.4          200.0          " 
    print "236.307692     " 

    print " "
    print "Enter desired frequency (r to return): "
    enter &clk_desired_freq
    print " "

    if ("&clk_desired_freq"=="19.2")
    (
      &clk_src_name="XO"
      &clk_src_sel=SRC_SEL TODO.
      &clk_src_div=2.
      &clk_m_val=0.
      &clk_n_val=0.
      &clk_2d_val=0.
      
      gosub Set_Clock_Freq
      return
    )
    else if ("&clk_desired_freq"=="50.0")
    (
      &clk_src_name="PLL0_EARLY_DIV_CLK_SRC"
      &clk_src_sel=SRC_SEL TODO.
      &clk_src_div=12.
      &clk_m_val=0.
      &clk_n_val=0.
      &clk_2d_val=0.
      
      gosub Set_Clock_Freq
      return
    )
    else if ("&clk_desired_freq"=="75.0")
    (
      &clk_src_name="PLL0_EARLY_DIV_CLK_SRC"
      &clk_src_sel=SRC_SEL TODO.
      &clk_src_div=8.
      &clk_m_val=0.
      &clk_n_val=0.
      &clk_2d_val=0.
      
      gosub Set_Clock_Freq
      return
    )
    else if ("&clk_desired_freq"=="120.0")
    (
      &clk_src_name="GPLL0_OUT_MAIN"
      &clk_src_sel=SRC_SEL TODO.
      &clk_src_div=10.
      &clk_m_val=0.
      &clk_n_val=0.
      &clk_2d_val=0.
      
      gosub Set_Clock_Freq
      return
    )
    else if ("&clk_desired_freq"=="160.4")
    (
      &clk_src_name="GPLL1_OUT_MAIN"
      &clk_src_sel=SRC_SEL TODO.
      &clk_src_div=10.
      &clk_m_val=0.
      &clk_n_val=0.
      &clk_2d_val=0.
      
      gosub Set_Clock_Freq
      return
    )
    else if ("&clk_desired_freq"=="200.0")
    (
      &clk_src_name="GPLL0_OUT_MAIN"
      &clk_src_sel=SRC_SEL TODO.
      &clk_src_div=6.
      &clk_m_val=0.
      &clk_n_val=0.
      &clk_2d_val=0.
      
      gosub Set_Clock_Freq
      return
    )
    else if ("&clk_desired_freq"=="236.307692")
    (
      &clk_src_name="GPLL4_OUT_MAIN"
      &clk_src_sel=SRC_SEL TODO.
      &clk_src_div=13.
      &clk_m_val=0.
      &clk_n_val=0.
      &clk_2d_val=0.
      
      gosub Set_Clock_Freq
      return
    )
    else if ("&clk_desired_freq"=="r")
    (
      return
    )
    else
    (
      print "Invalid selection."
      goto Set_Clock_Freq_Enter
    )
  )

  if ("&clk"=="gcc_aggre2_ufs_axi_clk")||("&clk"=="gcc_ufs_axi_clk")
  (
    gosub PRINT_SET_CLOCK_FREQ_WARNING

    &clk_cmd_rcgr_addr=&HWIO_GCC_UFS_AXI_CMD_RCGR_ADDR
    &clk_cfg_rcgr_addr=&HWIO_GCC_UFS_AXI_CFG_RCGR_ADDR

    print "Choose frequency (MHz) from list below: " 

    print "50.0           100.0          150.0          " 
    print "200.0          240.0          " 

    print " "
    print "Enter desired frequency (r to return): "
    enter &clk_desired_freq
    print " "

    if ("&clk_desired_freq"=="50.0")
    (
      &clk_src_name="PLL0_EARLY_DIV_CLK_SRC"
      &clk_src_sel=SRC_SEL TODO.
      &clk_src_div=12.
      &clk_m_val=0.
      &clk_n_val=0.
      &clk_2d_val=0.
      
      gosub Set_Clock_Freq
      return
    )
    else if ("&clk_desired_freq"=="100.0")
    (
      &clk_src_name="GPLL0_OUT_MAIN"
      &clk_src_sel=SRC_SEL TODO.
      &clk_src_div=12.
      &clk_m_val=0.
      &clk_n_val=0.
      &clk_2d_val=0.
      
      gosub Set_Clock_Freq
      return
    )
    else if ("&clk_desired_freq"=="150.0")
    (
      &clk_src_name="GPLL0_OUT_MAIN"
      &clk_src_sel=SRC_SEL TODO.
      &clk_src_div=8.
      &clk_m_val=0.
      &clk_n_val=0.
      &clk_2d_val=0.
      
      gosub Set_Clock_Freq
      return
    )
    else if ("&clk_desired_freq"=="200.0")
    (
      &clk_src_name="GPLL0_OUT_MAIN"
      &clk_src_sel=SRC_SEL TODO.
      &clk_src_div=6.
      &clk_m_val=0.
      &clk_n_val=0.
      &clk_2d_val=0.
      
      gosub Set_Clock_Freq
      return
    )
    else if ("&clk_desired_freq"=="240.0")
    (
      &clk_src_name="GPLL0_OUT_MAIN"
      &clk_src_sel=SRC_SEL TODO.
      &clk_src_div=5.
      &clk_m_val=0.
      &clk_n_val=0.
      &clk_2d_val=0.
      
      gosub Set_Clock_Freq
      return
    )
    else if ("&clk_desired_freq"=="r")
    (
      return
    )
    else
    (
      print "Invalid selection."
      goto Set_Clock_Freq_Enter
    )
  )

  if ("&clk"=="gcc_ufs_ice_core_clk")
  (
    gosub PRINT_SET_CLOCK_FREQ_WARNING

    &clk_cmd_rcgr_addr=&HWIO_GCC_UFS_ICE_CORE_CMD_RCGR_ADDR
    &clk_cfg_rcgr_addr=&HWIO_GCC_UFS_ICE_CORE_CFG_RCGR_ADDR

    print "Choose frequency (MHz) from list below: " 

    print "75.0           150.0          300.0          " 

    print " "
    print "Enter desired frequency (r to return): "
    enter &clk_desired_freq
    print " "

    if ("&clk_desired_freq"=="75.0")
    (
      &clk_src_name="PLL0_EARLY_DIV_CLK_SRC"
      &clk_src_sel=SRC_SEL TODO.
      &clk_src_div=8.
      &clk_m_val=0.
      &clk_n_val=0.
      &clk_2d_val=0.
      
      gosub Set_Clock_Freq
      return
    )
    else if ("&clk_desired_freq"=="150.0")
    (
      &clk_src_name="GPLL0_OUT_MAIN"
      &clk_src_sel=SRC_SEL TODO.
      &clk_src_div=8.
      &clk_m_val=0.
      &clk_n_val=0.
      &clk_2d_val=0.
      
      gosub Set_Clock_Freq
      return
    )
    else if ("&clk_desired_freq"=="300.0")
    (
      &clk_src_name="GPLL0_OUT_MAIN"
      &clk_src_sel=SRC_SEL TODO.
      &clk_src_div=4.
      &clk_m_val=0.
      &clk_n_val=0.
      &clk_2d_val=0.
      
      gosub Set_Clock_Freq
      return
    )
    else if ("&clk_desired_freq"=="r")
    (
      return
    )
    else
    (
      print "Invalid selection."
      goto Set_Clock_Freq_Enter
    )
  )

  if ("&clk"=="gcc_ufs_phy_aux_clk")
  (
    gosub PRINT_SET_CLOCK_FREQ_WARNING

    &clk_cmd_rcgr_addr=&HWIO_GCC_UFS_PHY_AUX_CMD_RCGR_ADDR
    &clk_cfg_rcgr_addr=&HWIO_GCC_UFS_PHY_AUX_CFG_RCGR_ADDR

    print "Choose frequency (MHz) from list below: " 

    print "19.2           " 

    print " "
    print "Enter desired frequency (r to return): "
    enter &clk_desired_freq
    print " "

    if ("&clk_desired_freq"=="19.2")
    (
      &clk_src_name="XO"
      &clk_src_sel=SRC_SEL TODO.
      &clk_src_div=2.
      &clk_m_val=0.
      &clk_n_val=0.
      &clk_2d_val=0.
      
      gosub Set_Clock_Freq
      return
    )
    else if ("&clk_desired_freq"=="r")
    (
      return
    )
    else
    (
      print "Invalid selection."
      goto Set_Clock_Freq_Enter
    )
  )

  if ("&clk"=="gcc_ufs_unipro_core_clk")
  (
    gosub PRINT_SET_CLOCK_FREQ_WARNING

    &clk_cmd_rcgr_addr=&HWIO_GCC_UFS_UNIPRO_CORE_CMD_RCGR_ADDR
    &clk_cfg_rcgr_addr=&HWIO_GCC_UFS_UNIPRO_CORE_CFG_RCGR_ADDR

    print "Choose frequency (MHz) from list below: " 

    print "37.5           75.0           150.0          " 

    print " "
    print "Enter desired frequency (r to return): "
    enter &clk_desired_freq
    print " "

    if ("&clk_desired_freq"=="37.5")
    (
      &clk_src_name="PLL0_EARLY_DIV_CLK_SRC"
      &clk_src_sel=SRC_SEL TODO.
      &clk_src_div=16.
      &clk_m_val=0.
      &clk_n_val=0.
      &clk_2d_val=0.
      
      gosub Set_Clock_Freq
      return
    )
    else if ("&clk_desired_freq"=="75.0")
    (
      &clk_src_name="GPLL0_OUT_MAIN"
      &clk_src_sel=SRC_SEL TODO.
      &clk_src_div=16.
      &clk_m_val=0.
      &clk_n_val=0.
      &clk_2d_val=0.
      
      gosub Set_Clock_Freq
      return
    )
    else if ("&clk_desired_freq"=="150.0")
    (
      &clk_src_name="GPLL0_OUT_MAIN"
      &clk_src_sel=SRC_SEL TODO.
      &clk_src_div=8.
      &clk_m_val=0.
      &clk_n_val=0.
      &clk_2d_val=0.
      
      gosub Set_Clock_Freq
      return
    )
    else if ("&clk_desired_freq"=="r")
    (
      return
    )
    else
    (
      print "Invalid selection."
      goto Set_Clock_Freq_Enter
    )
  )

  if ("&clk"=="gcc_cfg_noc_usb2_axi_clk")||("&clk"=="gcc_cnoc_bus_timeout12_ahb_clk")||("&clk"=="gcc_usb20_master_clk")
  (
    gosub PRINT_SET_CLOCK_FREQ_WARNING

    &clk_cmd_rcgr_addr=&HWIO_GCC_USB20_MASTER_CMD_RCGR_ADDR
    &clk_cfg_rcgr_addr=&HWIO_GCC_USB20_MASTER_CFG_RCGR_ADDR

    print "Choose frequency (MHz) from list below: " 

    print "19.2           60.0           120.0          " 

    print " "
    print "Enter desired frequency (r to return): "
    enter &clk_desired_freq
    print " "

    if ("&clk_desired_freq"=="19.2")
    (
      &clk_src_name="XO"
      &clk_src_sel=SRC_SEL TODO.
      &clk_src_div=2.
      &clk_m_val=0.
      &clk_n_val=0.
      &clk_2d_val=0.
      
      gosub Set_Clock_Freq
      return
    )
    else if ("&clk_desired_freq"=="60.0")
    (
      &clk_src_name="GPLL0_OUT_MAIN"
      &clk_src_sel=SRC_SEL TODO.
      &clk_src_div=20.
      &clk_m_val=0.
      &clk_n_val=0.
      &clk_2d_val=0.
      
      gosub Set_Clock_Freq
      return
    )
    else if ("&clk_desired_freq"=="120.0")
    (
      &clk_src_name="GPLL0_OUT_MAIN"
      &clk_src_sel=SRC_SEL TODO.
      &clk_src_div=10.
      &clk_m_val=0.
      &clk_n_val=0.
      &clk_2d_val=0.
      
      gosub Set_Clock_Freq
      return
    )
    else if ("&clk_desired_freq"=="r")
    (
      return
    )
    else
    (
      print "Invalid selection."
      goto Set_Clock_Freq_Enter
    )
  )

  if ("&clk"=="gcc_usb20_mock_utmi_clk")
  (
    gosub PRINT_SET_CLOCK_FREQ_WARNING

    &clk_cmd_rcgr_addr=&HWIO_GCC_USB20_MOCK_UTMI_CMD_RCGR_ADDR
    &clk_cfg_rcgr_addr=&HWIO_GCC_USB20_MOCK_UTMI_CFG_RCGR_ADDR

    print "Choose frequency (MHz) from list below: " 

    print "19.2           " 

    print " "
    print "Enter desired frequency (r to return): "
    enter &clk_desired_freq
    print " "

    if ("&clk_desired_freq"=="19.2")
    (
      &clk_src_name="XO"
      &clk_src_sel=SRC_SEL TODO.
      &clk_src_div=2.
      &clk_m_val=0.
      &clk_n_val=0.
      &clk_2d_val=0.
      
      gosub Set_Clock_Freq
      return
    )
    else if ("&clk_desired_freq"=="r")
    (
      return
    )
    else
    (
      print "Invalid selection."
      goto Set_Clock_Freq_Enter
    )
  )

  if ("&clk"=="gcc_aggre2_usb3_axi_clk")||("&clk"=="gcc_cfg_noc_usb3_axi_clk")||("&clk"=="gcc_cnoc_bus_timeout14_ahb_clk")||("&clk"=="gcc_usb30_master_clk")
  (
    gosub PRINT_SET_CLOCK_FREQ_WARNING

    &clk_cmd_rcgr_addr=&HWIO_GCC_USB30_MASTER_CMD_RCGR_ADDR
    &clk_cfg_rcgr_addr=&HWIO_GCC_USB30_MASTER_CFG_RCGR_ADDR

    print "Choose frequency (MHz) from list below: " 

    print "19.2           66.666667      120.0          " 
    print "133.333333     150.0          200.0          " 
    print "240.0          " 

    print " "
    print "Enter desired frequency (r to return): "
    enter &clk_desired_freq
    print " "

    if ("&clk_desired_freq"=="19.2")
    (
      &clk_src_name="XO"
      &clk_src_sel=SRC_SEL TODO.
      &clk_src_div=2.
      &clk_m_val=0.
      &clk_n_val=0.
      &clk_2d_val=0.
      
      gosub Set_Clock_Freq
      return
    )
    else if ("&clk_desired_freq"=="66.666667")
    (
      &clk_src_name="PLL0_EARLY_DIV_CLK_SRC"
      &clk_src_sel=SRC_SEL TODO.
      &clk_src_div=9.
      &clk_m_val=0.
      &clk_n_val=0.
      &clk_2d_val=0.
      
      gosub Set_Clock_Freq
      return
    )
    else if ("&clk_desired_freq"=="120.0")
    (
      &clk_src_name="GPLL0_OUT_MAIN"
      &clk_src_sel=SRC_SEL TODO.
      &clk_src_div=10.
      &clk_m_val=0.
      &clk_n_val=0.
      &clk_2d_val=0.
      
      gosub Set_Clock_Freq
      return
    )
    else if ("&clk_desired_freq"=="133.333333")
    (
      &clk_src_name="GPLL0_OUT_MAIN"
      &clk_src_sel=SRC_SEL TODO.
      &clk_src_div=9.
      &clk_m_val=0.
      &clk_n_val=0.
      &clk_2d_val=0.
      
      gosub Set_Clock_Freq
      return
    )
    else if ("&clk_desired_freq"=="150.0")
    (
      &clk_src_name="GPLL0_OUT_MAIN"
      &clk_src_sel=SRC_SEL TODO.
      &clk_src_div=8.
      &clk_m_val=0.
      &clk_n_val=0.
      &clk_2d_val=0.
      
      gosub Set_Clock_Freq
      return
    )
    else if ("&clk_desired_freq"=="200.0")
    (
      &clk_src_name="GPLL0_OUT_MAIN"
      &clk_src_sel=SRC_SEL TODO.
      &clk_src_div=6.
      &clk_m_val=0.
      &clk_n_val=0.
      &clk_2d_val=0.
      
      gosub Set_Clock_Freq
      return
    )
    else if ("&clk_desired_freq"=="240.0")
    (
      &clk_src_name="GPLL0_OUT_MAIN"
      &clk_src_sel=SRC_SEL TODO.
      &clk_src_div=5.
      &clk_m_val=0.
      &clk_n_val=0.
      &clk_2d_val=0.
      
      gosub Set_Clock_Freq
      return
    )
    else if ("&clk_desired_freq"=="r")
    (
      return
    )
    else
    (
      print "Invalid selection."
      goto Set_Clock_Freq_Enter
    )
  )

  if ("&clk"=="gcc_usb30_mock_utmi_clk")
  (
    gosub PRINT_SET_CLOCK_FREQ_WARNING

    &clk_cmd_rcgr_addr=&HWIO_GCC_USB30_MOCK_UTMI_CMD_RCGR_ADDR
    &clk_cfg_rcgr_addr=&HWIO_GCC_USB30_MOCK_UTMI_CFG_RCGR_ADDR

    print "Choose frequency (MHz) from list below: " 

    print "40.0           60.0           " 

    print " "
    print "Enter desired frequency (r to return): "
    enter &clk_desired_freq
    print " "

    if ("&clk_desired_freq"=="40.0")
    (
      &clk_src_name="PLL0_EARLY_DIV_CLK_SRC"
      &clk_src_sel=SRC_SEL TODO.
      &clk_src_div=15.
      &clk_m_val=0.
      &clk_n_val=0.
      &clk_2d_val=0.
      
      gosub Set_Clock_Freq
      return
    )
    else if ("&clk_desired_freq"=="60.0")
    (
      &clk_src_name="GPLL0_OUT_MAIN"
      &clk_src_sel=SRC_SEL TODO.
      &clk_src_div=20.
      &clk_m_val=0.
      &clk_n_val=0.
      &clk_2d_val=0.
      
      gosub Set_Clock_Freq
      return
    )
    else if ("&clk_desired_freq"=="r")
    (
      return
    )
    else
    (
      print "Invalid selection."
      goto Set_Clock_Freq_Enter
    )
  )

  if ("&clk"=="gcc_usb3_phy_aux_clk")
  (
    gosub PRINT_SET_CLOCK_FREQ_WARNING

    &clk_cmd_rcgr_addr=&HWIO_GCC_USB3_PHY_AUX_CMD_RCGR_ADDR
    &clk_cfg_rcgr_addr=&HWIO_GCC_USB3_PHY_AUX_CFG_RCGR_ADDR

    print "Choose frequency (MHz) from list below: " 

    print "1.2            19.2           " 

    print " "
    print "Enter desired frequency (r to return): "
    enter &clk_desired_freq
    print " "

    if ("&clk_desired_freq"=="1.2")
    (
      &clk_src_name="XO"
      &clk_src_sel=SRC_SEL TODO.
      &clk_src_div=32.
      &clk_m_val=0.
      &clk_n_val=0.
      &clk_2d_val=0.
      
      gosub Set_Clock_Freq
      return
    )
    else if ("&clk_desired_freq"=="19.2")
    (
      &clk_src_name="XO"
      &clk_src_sel=SRC_SEL TODO.
      &clk_src_div=2.
      &clk_m_val=0.
      &clk_n_val=0.
      &clk_2d_val=0.
      
      gosub Set_Clock_Freq
      return
    )
    else if ("&clk_desired_freq"=="r")
    (
      return
    )
    else
    (
      print "Invalid selection."
      goto Set_Clock_Freq_Enter
    )
  )

  if ("&clk"=="gcc_vdda_vs_clk")
  (
    gosub PRINT_SET_CLOCK_FREQ_WARNING

    &clk_cmd_rcgr_addr=&HWIO_GCC_VDDA_VS_CMD_RCGR_ADDR
    &clk_cfg_rcgr_addr=&HWIO_GCC_VDDA_VS_CFG_RCGR_ADDR

    print "Choose frequency (MHz) from list below: " 

    print "19.2           300.0          600.0          " 

    print " "
    print "Enter desired frequency (r to return): "
    enter &clk_desired_freq
    print " "

    if ("&clk_desired_freq"=="19.2")
    (
      &clk_src_name="XO"
      &clk_src_sel=SRC_SEL TODO.
      &clk_src_div=2.
      &clk_m_val=0.
      &clk_n_val=0.
      &clk_2d_val=0.
      
      gosub Set_Clock_Freq
      return
    )
    else if ("&clk_desired_freq"=="300.0")
    (
      &clk_src_name="GPLL0_OUT_MAIN"
      &clk_src_sel=SRC_SEL TODO.
      &clk_src_div=4.
      &clk_m_val=0.
      &clk_n_val=0.
      &clk_2d_val=0.
      
      gosub Set_Clock_Freq
      return
    )
    else if ("&clk_desired_freq"=="600.0")
    (
      &clk_src_name="GPLL0_OUT_MAIN"
      &clk_src_sel=SRC_SEL TODO.
      &clk_src_div=2.
      &clk_m_val=0.
      &clk_n_val=0.
      &clk_2d_val=0.
      
      gosub Set_Clock_Freq
      return
    )
    else if ("&clk_desired_freq"=="r")
    (
      return
    )
    else
    (
      print "Invalid selection."
      goto Set_Clock_Freq_Enter
    )
  )

  if ("&clk"=="gcc_vddcx_vs_clk")
  (
    gosub PRINT_SET_CLOCK_FREQ_WARNING

    &clk_cmd_rcgr_addr=&HWIO_GCC_VDDCX_VS_CMD_RCGR_ADDR
    &clk_cfg_rcgr_addr=&HWIO_GCC_VDDCX_VS_CFG_RCGR_ADDR

    print "Choose frequency (MHz) from list below: " 

    print "19.2           300.0          600.0          " 

    print " "
    print "Enter desired frequency (r to return): "
    enter &clk_desired_freq
    print " "

    if ("&clk_desired_freq"=="19.2")
    (
      &clk_src_name="XO"
      &clk_src_sel=SRC_SEL TODO.
      &clk_src_div=2.
      &clk_m_val=0.
      &clk_n_val=0.
      &clk_2d_val=0.
      
      gosub Set_Clock_Freq
      return
    )
    else if ("&clk_desired_freq"=="300.0")
    (
      &clk_src_name="GPLL0_OUT_MAIN"
      &clk_src_sel=SRC_SEL TODO.
      &clk_src_div=4.
      &clk_m_val=0.
      &clk_n_val=0.
      &clk_2d_val=0.
      
      gosub Set_Clock_Freq
      return
    )
    else if ("&clk_desired_freq"=="600.0")
    (
      &clk_src_name="GPLL0_OUT_MAIN"
      &clk_src_sel=SRC_SEL TODO.
      &clk_src_div=2.
      &clk_m_val=0.
      &clk_n_val=0.
      &clk_2d_val=0.
      
      gosub Set_Clock_Freq
      return
    )
    else if ("&clk_desired_freq"=="r")
    (
      return
    )
    else
    (
      print "Invalid selection."
      goto Set_Clock_Freq_Enter
    )
  )

  if ("&clk"=="gcc_vddmx_vs_clk")
  (
    gosub PRINT_SET_CLOCK_FREQ_WARNING

    &clk_cmd_rcgr_addr=&HWIO_GCC_VDDMX_VS_CMD_RCGR_ADDR
    &clk_cfg_rcgr_addr=&HWIO_GCC_VDDMX_VS_CFG_RCGR_ADDR

    print "Choose frequency (MHz) from list below: " 

    print "19.2           300.0          600.0          " 

    print " "
    print "Enter desired frequency (r to return): "
    enter &clk_desired_freq
    print " "

    if ("&clk_desired_freq"=="19.2")
    (
      &clk_src_name="XO"
      &clk_src_sel=SRC_SEL TODO.
      &clk_src_div=2.
      &clk_m_val=0.
      &clk_n_val=0.
      &clk_2d_val=0.
      
      gosub Set_Clock_Freq
      return
    )
    else if ("&clk_desired_freq"=="300.0")
    (
      &clk_src_name="GPLL0_OUT_MAIN"
      &clk_src_sel=SRC_SEL TODO.
      &clk_src_div=4.
      &clk_m_val=0.
      &clk_n_val=0.
      &clk_2d_val=0.
      
      gosub Set_Clock_Freq
      return
    )
    else if ("&clk_desired_freq"=="600.0")
    (
      &clk_src_name="GPLL0_OUT_MAIN"
      &clk_src_sel=SRC_SEL TODO.
      &clk_src_div=2.
      &clk_m_val=0.
      &clk_n_val=0.
      &clk_2d_val=0.
      
      gosub Set_Clock_Freq
      return
    )
    else if ("&clk_desired_freq"=="r")
    (
      return
    )
    else
    (
      print "Invalid selection."
      goto Set_Clock_Freq_Enter
    )
  )

  if ("&clk"=="gcc_vs_ctrl_clk")
  (
    gosub PRINT_SET_CLOCK_FREQ_WARNING

    &clk_cmd_rcgr_addr=&HWIO_GCC_VS_CTRL_CMD_RCGR_ADDR
    &clk_cfg_rcgr_addr=&HWIO_GCC_VS_CTRL_CFG_RCGR_ADDR

    print "Choose frequency (MHz) from list below: " 

    print "19.2           " 

    print " "
    print "Enter desired frequency (r to return): "
    enter &clk_desired_freq
    print " "

    if ("&clk_desired_freq"=="19.2")
    (
      &clk_src_name="XO"
      &clk_src_sel=SRC_SEL TODO.
      &clk_src_div=2.
      &clk_m_val=0.
      &clk_n_val=0.
      &clk_2d_val=0.
      
      gosub Set_Clock_Freq
      return
    )
    else if ("&clk_desired_freq"=="r")
    (
      return
    )
    else
    (
      print "Invalid selection."
      goto Set_Clock_Freq_Enter
    )
  )

  if ("&clk"=="gcc_wcss_vs_clk")
  (
    gosub PRINT_SET_CLOCK_FREQ_WARNING

    &clk_cmd_rcgr_addr=&HWIO_GCC_WCSS_VS_CMD_RCGR_ADDR
    &clk_cfg_rcgr_addr=&HWIO_GCC_WCSS_VS_CFG_RCGR_ADDR

    print "Choose frequency (MHz) from list below: " 

    print "19.2           300.0          600.0          " 

    print " "
    print "Enter desired frequency (r to return): "
    enter &clk_desired_freq
    print " "

    if ("&clk_desired_freq"=="19.2")
    (
      &clk_src_name="XO"
      &clk_src_sel=SRC_SEL TODO.
      &clk_src_div=2.
      &clk_m_val=0.
      &clk_n_val=0.
      &clk_2d_val=0.
      
      gosub Set_Clock_Freq
      return
    )
    else if ("&clk_desired_freq"=="300.0")
    (
      &clk_src_name="GPLL0_OUT_MAIN"
      &clk_src_sel=SRC_SEL TODO.
      &clk_src_div=4.
      &clk_m_val=0.
      &clk_n_val=0.
      &clk_2d_val=0.
      
      gosub Set_Clock_Freq
      return
    )
    else if ("&clk_desired_freq"=="600.0")
    (
      &clk_src_name="GPLL0_OUT_MAIN"
      &clk_src_sel=SRC_SEL TODO.
      &clk_src_div=2.
      &clk_m_val=0.
      &clk_n_val=0.
      &clk_2d_val=0.
      
      gosub Set_Clock_Freq
      return
    )
    else if ("&clk_desired_freq"=="r")
    (
      return
    )
    else
    (
      print "Invalid selection."
      goto Set_Clock_Freq_Enter
    )
  )

  if ("&clk"=="gpucc_gfx3d_clk")||("&clk"=="gpucc_spdm_gfx3d_clk")
  (
    gosub PRINT_SET_CLOCK_FREQ_WARNING

    &clk_cmd_rcgr_addr=&HWIO_GPUCC_GFX3D_CMD_RCGR_ADDR
    &clk_cfg_rcgr_addr=&HWIO_GPUCC_GFX3D_CFG_RCGR_ADDR

    print "Choose frequency (MHz) from list below: " 

    print "160.0          266.0          370.0          " 
    print "465.0          588.0          647.0          " 
    print "700.0          750.0          " 

    print " "
    print "Enter desired frequency (r to return): "
    enter &clk_desired_freq
    print " "

    if ("&clk_desired_freq"=="160.0")
    (
      &clk_src_name="GPU_PLL0_PLL_OUT_MAIN"
      &clk_src_sel=SRC_SEL TODO.
      &clk_src_div=4.
      &clk_m_val=0.
      &clk_n_val=0.
      &clk_2d_val=0.
      
      gosub Set_Clock_Freq
      return
    )
    else if ("&clk_desired_freq"=="266.0")
    (
      &clk_src_name="GPU_PLL0_PLL_OUT_MAIN"
      &clk_src_sel=SRC_SEL TODO.
      &clk_src_div=4.
      &clk_m_val=0.
      &clk_n_val=0.
      &clk_2d_val=0.
      
      gosub Set_Clock_Freq
      return
    )
    else if ("&clk_desired_freq"=="370.0")
    (
      &clk_src_name="GPU_PLL0_PLL_OUT_MAIN"
      &clk_src_sel=SRC_SEL TODO.
      &clk_src_div=4.
      &clk_m_val=0.
      &clk_n_val=0.
      &clk_2d_val=0.
      
      gosub Set_Clock_Freq
      return
    )
    else if ("&clk_desired_freq"=="465.0")
    (
      &clk_src_name="GPU_PLL0_PLL_OUT_MAIN"
      &clk_src_sel=SRC_SEL TODO.
      &clk_src_div=4.
      &clk_m_val=0.
      &clk_n_val=0.
      &clk_2d_val=0.
      
      gosub Set_Clock_Freq
      return
    )
    else if ("&clk_desired_freq"=="588.0")
    (
      &clk_src_name="GPU_PLL0_PLL_OUT_MAIN"
      &clk_src_sel=SRC_SEL TODO.
      &clk_src_div=4.
      &clk_m_val=0.
      &clk_n_val=0.
      &clk_2d_val=0.
      
      gosub Set_Clock_Freq
      return
    )
    else if ("&clk_desired_freq"=="647.0")
    (
      &clk_src_name="GPU_PLL0_PLL_OUT_MAIN"
      &clk_src_sel=SRC_SEL TODO.
      &clk_src_div=4.
      &clk_m_val=0.
      &clk_n_val=0.
      &clk_2d_val=0.
      
      gosub Set_Clock_Freq
      return
    )
    else if ("&clk_desired_freq"=="700.0")
    (
      &clk_src_name="GPU_PLL0_PLL_OUT_MAIN"
      &clk_src_sel=SRC_SEL TODO.
      &clk_src_div=4.
      &clk_m_val=0.
      &clk_n_val=0.
      &clk_2d_val=0.
      
      gosub Set_Clock_Freq
      return
    )
    else if ("&clk_desired_freq"=="750.0")
    (
      &clk_src_name="GPU_PLL0_PLL_OUT_MAIN"
      &clk_src_sel=SRC_SEL TODO.
      &clk_src_div=4.
      &clk_m_val=0.
      &clk_n_val=0.
      &clk_2d_val=0.
      
      gosub Set_Clock_Freq
      return
    )
    else if ("&clk_desired_freq"=="r")
    (
      return
    )
    else
    (
      print "Invalid selection."
      goto Set_Clock_Freq_Enter
    )
  )

  if ("&clk"=="gpucc_rbbmtimer_clk")
  (
    gosub PRINT_SET_CLOCK_FREQ_WARNING

    &clk_cmd_rcgr_addr=&HWIO_GPUCC_RBBMTIMER_CMD_RCGR_ADDR
    &clk_cfg_rcgr_addr=&HWIO_GPUCC_RBBMTIMER_CFG_RCGR_ADDR

    print "Choose frequency (MHz) from list below: " 

    print "19.2           " 

    print " "
    print "Enter desired frequency (r to return): "
    enter &clk_desired_freq
    print " "

    if ("&clk_desired_freq"=="19.2")
    (
      &clk_src_name="XO"
      &clk_src_sel=SRC_SEL TODO.
      &clk_src_div=2.
      &clk_m_val=0.
      &clk_n_val=0.
      &clk_2d_val=0.
      
      gosub Set_Clock_Freq
      return
    )
    else if ("&clk_desired_freq"=="r")
    (
      return
    )
    else
    (
      print "Invalid selection."
      goto Set_Clock_Freq_Enter
    )
  )

  if ("&clk"=="gpucc_rbcpr_clk")
  (
    gosub PRINT_SET_CLOCK_FREQ_WARNING

    &clk_cmd_rcgr_addr=&HWIO_GPUCC_RBCPR_CMD_RCGR_ADDR
    &clk_cfg_rcgr_addr=&HWIO_GPUCC_RBCPR_CFG_RCGR_ADDR

    print "Choose frequency (MHz) from list below: " 

    print "19.2           50.0           " 

    print " "
    print "Enter desired frequency (r to return): "
    enter &clk_desired_freq
    print " "

    if ("&clk_desired_freq"=="19.2")
    (
      &clk_src_name="XO"
      &clk_src_sel=SRC_SEL TODO.
      &clk_src_div=2.
      &clk_m_val=0.
      &clk_n_val=0.
      &clk_2d_val=0.
      
      gosub Set_Clock_Freq
      return
    )
    else if ("&clk_desired_freq"=="50.0")
    (
      &clk_src_name="GPLL0_OUT_MAIN_DIV"
      &clk_src_sel=SRC_SEL TODO.
      &clk_src_div=12.
      &clk_m_val=0.
      &clk_n_val=0.
      &clk_2d_val=0.
      
      gosub Set_Clock_Freq
      return
    )
    else if ("&clk_desired_freq"=="r")
    (
      return
    )
    else
    (
      print "Invalid selection."
      goto Set_Clock_Freq_Enter
    )
  )

  if ("&clk"=="aon_clk_src")||("&clk"=="audio_core_qdsp_sway_aon_clk")||("&clk"=="audio_wrapper_aon_clk")||("&clk"=="audio_wrapper_bus_timeout_aon_clk")||("&clk"=="audio_wrapper_mpu_cfg_aon_clk")||("&clk"=="audio_wrapper_q6_ahbm_mpu_aon_clk")||("&clk"=="audio_wrapper_qos_ahbs_aon_clk")||("&clk"=="audio_wrapper_sysnoc_sway_aon_clk")||("&clk"=="island_scc_cfg_ahb_aon_clk")||("&clk"=="island_scc_crif_aon_clk")||("&clk"=="island_scc_csr_h_aon_clk")||("&clk"=="island_scc_data_h_aon_clk")||("&clk"=="island_scc_qdsp_sway_aon_clk")||("&clk"=="q6ss_ahbm_aon_clk")||("&clk"=="q6ss_ahbs_aon_clk")
  (
    gosub PRINT_SET_CLOCK_FREQ_WARNING

    &clk_cmd_rcgr_addr=&HWIO_LPASS_AON_CMD_RCGR_ADDR
    &clk_cfg_rcgr_addr=&HWIO_LPASS_AON_CFG_RCGR_ADDR

    print "Choose frequency (MHz) from list below: " 

    print "19.2           49.918771      99.837542      " 
    print "153.6          204.8          " 

    print " "
    print "Enter desired frequency (r to return): "
    enter &clk_desired_freq
    print " "

    if ("&clk_desired_freq"=="19.2")
    (
      &clk_src_name="XO"
      &clk_src_sel=SRC_SEL TODO.
      &clk_src_div=2.
      &clk_m_val=0.
      &clk_n_val=0.
      &clk_2d_val=0.
      
      gosub Set_Clock_Freq
      return
    )
    else if ("&clk_desired_freq"=="49.918771")
    (
      &clk_src_name="SCC_PLL_OUT_MAIN"
      &clk_src_sel=SRC_SEL TODO.
      &clk_src_div=10.
      &clk_m_val=0.
      &clk_n_val=0.
      &clk_2d_val=0.
      
      gosub Set_Clock_Freq
      return
    )
    else if ("&clk_desired_freq"=="99.837542")
    (
      &clk_src_name="SCC_PLL_OUT_MAIN"
      &clk_src_sel=SRC_SEL TODO.
      &clk_src_div=5.
      &clk_m_val=0.
      &clk_n_val=0.
      &clk_2d_val=0.
      
      gosub Set_Clock_Freq
      return
    )
    else if ("&clk_desired_freq"=="153.6")
    (
      &clk_src_name="LPAAUDIO_DIG_PLL_CLK_DIV_CDIV"
      &clk_src_sel=SRC_SEL TODO.
      &clk_src_div=4.
      &clk_m_val=0.
      &clk_n_val=0.
      &clk_2d_val=0.
      
      gosub Set_Clock_Freq
      return
    )
    else if ("&clk_desired_freq"=="204.8")
    (
      &clk_src_name="LPAAUDIO_DIG_PLL_OUT_EARLY"
      &clk_src_sel=SRC_SEL TODO.
      &clk_src_div=6.
      &clk_m_val=0.
      &clk_n_val=0.
      &clk_2d_val=0.
      
      gosub Set_Clock_Freq
      return
    )
    else if ("&clk_desired_freq"=="r")
    (
      return
    )
    else
    (
      print "Invalid selection."
      goto Set_Clock_Freq_Enter
    )
  )

  if ("&clk"=="atime_clk_src")||("&clk"=="audio_core_avsync_atime_clk")
  (
    gosub PRINT_SET_CLOCK_FREQ_WARNING

    &clk_cmd_rcgr_addr=&HWIO_LPASS_ATIME_CMD_RCGR_ADDR
    &clk_cfg_rcgr_addr=&HWIO_LPASS_ATIME_CFG_RCGR_ADDR

    print "Choose frequency (MHz) from list below: " 

    print "15.36          30.72          61.44          " 
    print "122.88         " 

    print " "
    print "Enter desired frequency (r to return): "
    enter &clk_desired_freq
    print " "

    if ("&clk_desired_freq"=="15.36")
    (
      &clk_src_name="LPAAUDIO_DIG_PLL_OUT_AUX"
      &clk_src_sel=SRC_SEL TODO.
      &clk_src_div=16.
      &clk_m_val=0.
      &clk_n_val=0.
      &clk_2d_val=0.
      
      gosub Set_Clock_Freq
      return
    )
    else if ("&clk_desired_freq"=="30.72")
    (
      &clk_src_name="LPAAUDIO_DIG_PLL_OUT_AUX"
      &clk_src_sel=SRC_SEL TODO.
      &clk_src_div=8.
      &clk_m_val=0.
      &clk_n_val=0.
      &clk_2d_val=0.
      
      gosub Set_Clock_Freq
      return
    )
    else if ("&clk_desired_freq"=="61.44")
    (
      &clk_src_name="LPAAUDIO_DIG_PLL_OUT_AUX"
      &clk_src_sel=SRC_SEL TODO.
      &clk_src_div=4.
      &clk_m_val=0.
      &clk_n_val=0.
      &clk_2d_val=0.
      
      gosub Set_Clock_Freq
      return
    )
    else if ("&clk_desired_freq"=="122.88")
    (
      &clk_src_name="LPAAUDIO_DIG_PLL_OUT_AUX"
      &clk_src_sel=SRC_SEL TODO.
      &clk_src_div=2.
      &clk_m_val=0.
      &clk_n_val=0.
      &clk_2d_val=0.
      
      gosub Set_Clock_Freq
      return
    )
    else if ("&clk_desired_freq"=="r")
    (
      return
    )
    else
    (
      print "Invalid selection."
      goto Set_Clock_Freq_Enter
    )
  )

  if ("&clk"=="aud_slimbus_clk_src")||("&clk"=="audio_core_aud_slimbus_clk")
  (
    gosub PRINT_SET_CLOCK_FREQ_WARNING

    &clk_cmd_rcgr_addr=&HWIO_LPASS_AUD_SLIMBUS_CMD_RCGR_ADDR
    &clk_cfg_rcgr_addr=&HWIO_LPASS_AUD_SLIMBUS_CFG_RCGR_ADDR

    print "Choose frequency (MHz) from list below: " 

    print "3.072          6.144          12.288         " 
    print "24.576         " 

    print " "
    print "Enter desired frequency (r to return): "
    enter &clk_desired_freq
    print " "

    if ("&clk_desired_freq"=="3.072")
    (
      &clk_src_name="LPAAUDIO_DIG_PLL_OUT_AUX"
      &clk_src_sel=SRC_SEL TODO.
      &clk_src_div=20.
      &clk_m_val=1.
      &clk_n_val=4.
      &clk_2d_val=4.
      
      gosub Set_Clock_Freq
      return
    )
    else if ("&clk_desired_freq"=="6.144")
    (
      &clk_src_name="LPAAUDIO_DIG_PLL_OUT_AUX"
      &clk_src_sel=SRC_SEL TODO.
      &clk_src_div=20.
      &clk_m_val=1.
      &clk_n_val=2.
      &clk_2d_val=2.
      
      gosub Set_Clock_Freq
      return
    )
    else if ("&clk_desired_freq"=="12.288")
    (
      &clk_src_name="LPAAUDIO_DIG_PLL_OUT_AUX"
      &clk_src_sel=SRC_SEL TODO.
      &clk_src_div=20.
      &clk_m_val=0.
      &clk_n_val=0.
      &clk_2d_val=0.
      
      gosub Set_Clock_Freq
      return
    )
    else if ("&clk_desired_freq"=="24.576")
    (
      &clk_src_name="LPAAUDIO_DIG_PLL_OUT_AUX"
      &clk_src_sel=SRC_SEL TODO.
      &clk_src_div=10.
      &clk_m_val=0.
      &clk_n_val=0.
      &clk_2d_val=0.
      
      gosub Set_Clock_Freq
      return
    )
    else if ("&clk_desired_freq"=="r")
    (
      return
    )
    else
    (
      print "Invalid selection."
      goto Set_Clock_Freq_Enter
    )
  )

  if ("&clk"=="core_clk_src")||("&clk"=="audio_core_aud_slimbus_core_clk")||("&clk"=="audio_core_bus_timeout_core_clk")||("&clk"=="audio_core_core_clk")||("&clk"=="audio_core_lpm_core_clk")||("&clk"=="audio_core_qca_slimbus_core_clk")||("&clk"=="audio_core_sysnoc_mport_core_clk")||("&clk"=="island_scc_ahb_timeout_core_clk")||("&clk"=="island_scc_blsp_h_core_clk")||("&clk"=="island_scc_sensor_core_core_clk")||("&clk"=="island_scc_smem_core_clk")
  (
    gosub PRINT_SET_CLOCK_FREQ_WARNING

    &clk_cmd_rcgr_addr=&HWIO_LPASS_CORE_CMD_RCGR_ADDR
    &clk_cfg_rcgr_addr=&HWIO_LPASS_CORE_CFG_RCGR_ADDR

    print "Choose frequency (MHz) from list below: " 

    print "19.2           49.918771      99.837542      " 
    print "153.6          204.8          " 

    print " "
    print "Enter desired frequency (r to return): "
    enter &clk_desired_freq
    print " "

    if ("&clk_desired_freq"=="19.2")
    (
      &clk_src_name="XO"
      &clk_src_sel=SRC_SEL TODO.
      &clk_src_div=2.
      &clk_m_val=0.
      &clk_n_val=0.
      &clk_2d_val=0.
      
      gosub Set_Clock_Freq
      return
    )
    else if ("&clk_desired_freq"=="49.918771")
    (
      &clk_src_name="SCC_PLL_OUT_MAIN"
      &clk_src_sel=SRC_SEL TODO.
      &clk_src_div=10.
      &clk_m_val=0.
      &clk_n_val=0.
      &clk_2d_val=0.
      
      gosub Set_Clock_Freq
      return
    )
    else if ("&clk_desired_freq"=="99.837542")
    (
      &clk_src_name="SCC_PLL_OUT_MAIN"
      &clk_src_sel=SRC_SEL TODO.
      &clk_src_div=5.
      &clk_m_val=0.
      &clk_n_val=0.
      &clk_2d_val=0.
      
      gosub Set_Clock_Freq
      return
    )
    else if ("&clk_desired_freq"=="153.6")
    (
      &clk_src_name="LPAAUDIO_DIG_PLL_CLK_DIV_CDIV"
      &clk_src_sel=SRC_SEL TODO.
      &clk_src_div=4.
      &clk_m_val=0.
      &clk_n_val=0.
      &clk_2d_val=0.
      
      gosub Set_Clock_Freq
      return
    )
    else if ("&clk_desired_freq"=="204.8")
    (
      &clk_src_name="LPAAUDIO_DIG_PLL_OUT_EARLY"
      &clk_src_sel=SRC_SEL TODO.
      &clk_src_div=6.
      &clk_m_val=0.
      &clk_n_val=0.
      &clk_2d_val=0.
      
      gosub Set_Clock_Freq
      return
    )
    else if ("&clk_desired_freq"=="r")
    (
      return
    )
    else
    (
      print "Invalid selection."
      goto Set_Clock_Freq_Enter
    )
  )

  if ("&clk"=="ext_mclk0_clk_src")||("&clk"=="audio_wrapper_ext_mclk0_clk")
  (
    gosub PRINT_SET_CLOCK_FREQ_WARNING

    &clk_cmd_rcgr_addr=&HWIO_LPASS_EXT_MCLK0_CMD_RCGR_ADDR
    &clk_cfg_rcgr_addr=&HWIO_LPASS_EXT_MCLK0_CFG_RCGR_ADDR

    print "Choose frequency (MHz) from list below: " 

    print "0.3528         0.512          0.7056         " 
    print "0.768          1.024          1.4112         " 
    print "1.536          2.048          2.8224         " 
    print "3.072          4.096          5.6448         " 
    print "6.144          8.192          9.6            " 
    print "11.2896        12.288         15.36          " 
    print "24.576         " 

    print " "
    print "Enter desired frequency (r to return): "
    enter &clk_desired_freq
    print " "

    if ("&clk_desired_freq"=="0.3528")
    (
      &clk_src_name="LPAAUDIO_PLL_CLK_DIV_CDIV"
      &clk_src_sel=SRC_SEL TODO.
      &clk_src_div=32.
      &clk_m_val=1.
      &clk_n_val=50.
      &clk_2d_val=50.
      
      gosub Set_Clock_Freq
      return
    )
    else if ("&clk_desired_freq"=="0.512")
    (
      &clk_src_name="LPAAUDIO_DIG_PLL_OUT_AUX"
      &clk_src_sel=SRC_SEL TODO.
      &clk_src_div=32.
      &clk_m_val=1.
      &clk_n_val=15.
      &clk_2d_val=15.
      
      gosub Set_Clock_Freq
      return
    )
    else if ("&clk_desired_freq"=="0.7056")
    (
      &clk_src_name="LPAAUDIO_PLL_CLK_DIV_CDIV"
      &clk_src_sel=SRC_SEL TODO.
      &clk_src_div=32.
      &clk_m_val=1.
      &clk_n_val=25.
      &clk_2d_val=25.
      
      gosub Set_Clock_Freq
      return
    )
    else if ("&clk_desired_freq"=="0.768")
    (
      &clk_src_name="LPAAUDIO_DIG_PLL_OUT_AUX"
      &clk_src_sel=SRC_SEL TODO.
      &clk_src_div=32.
      &clk_m_val=1.
      &clk_n_val=10.
      &clk_2d_val=10.
      
      gosub Set_Clock_Freq
      return
    )
    else if ("&clk_desired_freq"=="1.024")
    (
      &clk_src_name="LPAAUDIO_DIG_PLL_OUT_AUX"
      &clk_src_sel=SRC_SEL TODO.
      &clk_src_div=30.
      &clk_m_val=1.
      &clk_n_val=8.
      &clk_2d_val=8.
      
      gosub Set_Clock_Freq
      return
    )
    else if ("&clk_desired_freq"=="1.4112")
    (
      &clk_src_name="LPAAUDIO_PLL_CLK_DIV_CDIV"
      &clk_src_sel=SRC_SEL TODO.
      &clk_src_div=20.
      &clk_m_val=1.
      &clk_n_val=20.
      &clk_2d_val=20.
      
      gosub Set_Clock_Freq
      return
    )
    else if ("&clk_desired_freq"=="1.536")
    (
      &clk_src_name="LPAAUDIO_DIG_PLL_OUT_AUX"
      &clk_src_sel=SRC_SEL TODO.
      &clk_src_div=32.
      &clk_m_val=1.
      &clk_n_val=5.
      &clk_2d_val=5.
      
      gosub Set_Clock_Freq
      return
    )
    else if ("&clk_desired_freq"=="2.048")
    (
      &clk_src_name="LPAAUDIO_DIG_PLL_OUT_AUX"
      &clk_src_sel=SRC_SEL TODO.
      &clk_src_div=30.
      &clk_m_val=1.
      &clk_n_val=4.
      &clk_2d_val=4.
      
      gosub Set_Clock_Freq
      return
    )
    else if ("&clk_desired_freq"=="2.8224")
    (
      &clk_src_name="LPAAUDIO_PLL_CLK_DIV_CDIV"
      &clk_src_sel=SRC_SEL TODO.
      &clk_src_div=20.
      &clk_m_val=1.
      &clk_n_val=10.
      &clk_2d_val=10.
      
      gosub Set_Clock_Freq
      return
    )
    else if ("&clk_desired_freq"=="3.072")
    (
      &clk_src_name="LPAAUDIO_DIG_PLL_OUT_AUX"
      &clk_src_sel=SRC_SEL TODO.
      &clk_src_div=20.
      &clk_m_val=1.
      &clk_n_val=4.
      &clk_2d_val=4.
      
      gosub Set_Clock_Freq
      return
    )
    else if ("&clk_desired_freq"=="4.096")
    (
      &clk_src_name="LPAAUDIO_DIG_PLL_OUT_AUX"
      &clk_src_sel=SRC_SEL TODO.
      &clk_src_div=30.
      &clk_m_val=1.
      &clk_n_val=2.
      &clk_2d_val=2.
      
      gosub Set_Clock_Freq
      return
    )
    else if ("&clk_desired_freq"=="5.6448")
    (
      &clk_src_name="LPAAUDIO_PLL_CLK_DIV_CDIV"
      &clk_src_sel=SRC_SEL TODO.
      &clk_src_div=20.
      &clk_m_val=1.
      &clk_n_val=5.
      &clk_2d_val=5.
      
      gosub Set_Clock_Freq
      return
    )
    else if ("&clk_desired_freq"=="6.144")
    (
      &clk_src_name="LPAAUDIO_DIG_PLL_OUT_AUX"
      &clk_src_sel=SRC_SEL TODO.
      &clk_src_div=20.
      &clk_m_val=1.
      &clk_n_val=2.
      &clk_2d_val=2.
      
      gosub Set_Clock_Freq
      return
    )
    else if ("&clk_desired_freq"=="8.192")
    (
      &clk_src_name="LPAAUDIO_DIG_PLL_OUT_AUX"
      &clk_src_sel=SRC_SEL TODO.
      &clk_src_div=30.
      &clk_m_val=0.
      &clk_n_val=0.
      &clk_2d_val=0.
      
      gosub Set_Clock_Freq
      return
    )
    else if ("&clk_desired_freq"=="9.6")
    (
      &clk_src_name="XO"
      &clk_src_sel=SRC_SEL TODO.
      &clk_src_div=4.
      &clk_m_val=0.
      &clk_n_val=0.
      &clk_2d_val=0.
      
      gosub Set_Clock_Freq
      return
    )
    else if ("&clk_desired_freq"=="11.2896")
    (
      &clk_src_name="LPAAUDIO_PLL_CLK_DIV_CDIV"
      &clk_src_sel=SRC_SEL TODO.
      &clk_src_div=10.
      &clk_m_val=1.
      &clk_n_val=5.
      &clk_2d_val=5.
      
      gosub Set_Clock_Freq
      return
    )
    else if ("&clk_desired_freq"=="12.288")
    (
      &clk_src_name="LPAAUDIO_DIG_PLL_OUT_AUX"
      &clk_src_sel=SRC_SEL TODO.
      &clk_src_div=20.
      &clk_m_val=0.
      &clk_n_val=0.
      &clk_2d_val=0.
      
      gosub Set_Clock_Freq
      return
    )
    else if ("&clk_desired_freq"=="15.36")
    (
      &clk_src_name="LPAAUDIO_DIG_PLL_OUT_AUX"
      &clk_src_sel=SRC_SEL TODO.
      &clk_src_div=16.
      &clk_m_val=0.
      &clk_n_val=0.
      &clk_2d_val=0.
      
      gosub Set_Clock_Freq
      return
    )
    else if ("&clk_desired_freq"=="24.576")
    (
      &clk_src_name="LPAAUDIO_DIG_PLL_OUT_AUX"
      &clk_src_sel=SRC_SEL TODO.
      &clk_src_div=10.
      &clk_m_val=0.
      &clk_n_val=0.
      &clk_2d_val=0.
      
      gosub Set_Clock_Freq
      return
    )
    else if ("&clk_desired_freq"=="r")
    (
      return
    )
    else
    (
      print "Invalid selection."
      goto Set_Clock_Freq_Enter
    )
  )

  if ("&clk"=="ext_mclk1_clk_src")||("&clk"=="audio_wrapper_ext_mclk1_clk")
  (
    gosub PRINT_SET_CLOCK_FREQ_WARNING

    &clk_cmd_rcgr_addr=&HWIO_LPASS_EXT_MCLK1_CMD_RCGR_ADDR
    &clk_cfg_rcgr_addr=&HWIO_LPASS_EXT_MCLK1_CFG_RCGR_ADDR

    print "Choose frequency (MHz) from list below: " 

    print "0.3528         0.512          0.7056         " 
    print "0.768          1.024          1.4112         " 
    print "1.536          2.048          2.8224         " 
    print "3.072          4.096          5.6448         " 
    print "6.144          8.192          9.6            " 
    print "11.2896        12.288         15.36          " 
    print "24.576         " 

    print " "
    print "Enter desired frequency (r to return): "
    enter &clk_desired_freq
    print " "

    if ("&clk_desired_freq"=="0.3528")
    (
      &clk_src_name="LPAAUDIO_PLL_CLK_DIV_CDIV"
      &clk_src_sel=SRC_SEL TODO.
      &clk_src_div=32.
      &clk_m_val=1.
      &clk_n_val=50.
      &clk_2d_val=50.
      
      gosub Set_Clock_Freq
      return
    )
    else if ("&clk_desired_freq"=="0.512")
    (
      &clk_src_name="LPAAUDIO_DIG_PLL_OUT_AUX"
      &clk_src_sel=SRC_SEL TODO.
      &clk_src_div=32.
      &clk_m_val=1.
      &clk_n_val=15.
      &clk_2d_val=15.
      
      gosub Set_Clock_Freq
      return
    )
    else if ("&clk_desired_freq"=="0.7056")
    (
      &clk_src_name="LPAAUDIO_PLL_CLK_DIV_CDIV"
      &clk_src_sel=SRC_SEL TODO.
      &clk_src_div=32.
      &clk_m_val=1.
      &clk_n_val=25.
      &clk_2d_val=25.
      
      gosub Set_Clock_Freq
      return
    )
    else if ("&clk_desired_freq"=="0.768")
    (
      &clk_src_name="LPAAUDIO_DIG_PLL_OUT_AUX"
      &clk_src_sel=SRC_SEL TODO.
      &clk_src_div=32.
      &clk_m_val=1.
      &clk_n_val=10.
      &clk_2d_val=10.
      
      gosub Set_Clock_Freq
      return
    )
    else if ("&clk_desired_freq"=="1.024")
    (
      &clk_src_name="LPAAUDIO_DIG_PLL_OUT_AUX"
      &clk_src_sel=SRC_SEL TODO.
      &clk_src_div=30.
      &clk_m_val=1.
      &clk_n_val=8.
      &clk_2d_val=8.
      
      gosub Set_Clock_Freq
      return
    )
    else if ("&clk_desired_freq"=="1.4112")
    (
      &clk_src_name="LPAAUDIO_PLL_CLK_DIV_CDIV"
      &clk_src_sel=SRC_SEL TODO.
      &clk_src_div=20.
      &clk_m_val=1.
      &clk_n_val=20.
      &clk_2d_val=20.
      
      gosub Set_Clock_Freq
      return
    )
    else if ("&clk_desired_freq"=="1.536")
    (
      &clk_src_name="LPAAUDIO_DIG_PLL_OUT_AUX"
      &clk_src_sel=SRC_SEL TODO.
      &clk_src_div=32.
      &clk_m_val=1.
      &clk_n_val=5.
      &clk_2d_val=5.
      
      gosub Set_Clock_Freq
      return
    )
    else if ("&clk_desired_freq"=="2.048")
    (
      &clk_src_name="LPAAUDIO_DIG_PLL_OUT_AUX"
      &clk_src_sel=SRC_SEL TODO.
      &clk_src_div=30.
      &clk_m_val=1.
      &clk_n_val=4.
      &clk_2d_val=4.
      
      gosub Set_Clock_Freq
      return
    )
    else if ("&clk_desired_freq"=="2.8224")
    (
      &clk_src_name="LPAAUDIO_PLL_CLK_DIV_CDIV"
      &clk_src_sel=SRC_SEL TODO.
      &clk_src_div=20.
      &clk_m_val=1.
      &clk_n_val=10.
      &clk_2d_val=10.
      
      gosub Set_Clock_Freq
      return
    )
    else if ("&clk_desired_freq"=="3.072")
    (
      &clk_src_name="LPAAUDIO_DIG_PLL_OUT_AUX"
      &clk_src_sel=SRC_SEL TODO.
      &clk_src_div=20.
      &clk_m_val=1.
      &clk_n_val=4.
      &clk_2d_val=4.
      
      gosub Set_Clock_Freq
      return
    )
    else if ("&clk_desired_freq"=="4.096")
    (
      &clk_src_name="LPAAUDIO_DIG_PLL_OUT_AUX"
      &clk_src_sel=SRC_SEL TODO.
      &clk_src_div=30.
      &clk_m_val=1.
      &clk_n_val=2.
      &clk_2d_val=2.
      
      gosub Set_Clock_Freq
      return
    )
    else if ("&clk_desired_freq"=="5.6448")
    (
      &clk_src_name="LPAAUDIO_PLL_CLK_DIV_CDIV"
      &clk_src_sel=SRC_SEL TODO.
      &clk_src_div=20.
      &clk_m_val=1.
      &clk_n_val=5.
      &clk_2d_val=5.
      
      gosub Set_Clock_Freq
      return
    )
    else if ("&clk_desired_freq"=="6.144")
    (
      &clk_src_name="LPAAUDIO_DIG_PLL_OUT_AUX"
      &clk_src_sel=SRC_SEL TODO.
      &clk_src_div=20.
      &clk_m_val=1.
      &clk_n_val=2.
      &clk_2d_val=2.
      
      gosub Set_Clock_Freq
      return
    )
    else if ("&clk_desired_freq"=="8.192")
    (
      &clk_src_name="LPAAUDIO_DIG_PLL_OUT_AUX"
      &clk_src_sel=SRC_SEL TODO.
      &clk_src_div=30.
      &clk_m_val=0.
      &clk_n_val=0.
      &clk_2d_val=0.
      
      gosub Set_Clock_Freq
      return
    )
    else if ("&clk_desired_freq"=="9.6")
    (
      &clk_src_name="XO"
      &clk_src_sel=SRC_SEL TODO.
      &clk_src_div=4.
      &clk_m_val=0.
      &clk_n_val=0.
      &clk_2d_val=0.
      
      gosub Set_Clock_Freq
      return
    )
    else if ("&clk_desired_freq"=="11.2896")
    (
      &clk_src_name="LPAAUDIO_PLL_CLK_DIV_CDIV"
      &clk_src_sel=SRC_SEL TODO.
      &clk_src_div=10.
      &clk_m_val=1.
      &clk_n_val=5.
      &clk_2d_val=5.
      
      gosub Set_Clock_Freq
      return
    )
    else if ("&clk_desired_freq"=="12.288")
    (
      &clk_src_name="LPAAUDIO_DIG_PLL_OUT_AUX"
      &clk_src_sel=SRC_SEL TODO.
      &clk_src_div=20.
      &clk_m_val=0.
      &clk_n_val=0.
      &clk_2d_val=0.
      
      gosub Set_Clock_Freq
      return
    )
    else if ("&clk_desired_freq"=="15.36")
    (
      &clk_src_name="LPAAUDIO_DIG_PLL_OUT_AUX"
      &clk_src_sel=SRC_SEL TODO.
      &clk_src_div=16.
      &clk_m_val=0.
      &clk_n_val=0.
      &clk_2d_val=0.
      
      gosub Set_Clock_Freq
      return
    )
    else if ("&clk_desired_freq"=="24.576")
    (
      &clk_src_name="LPAAUDIO_DIG_PLL_OUT_AUX"
      &clk_src_sel=SRC_SEL TODO.
      &clk_src_div=10.
      &clk_m_val=0.
      &clk_n_val=0.
      &clk_2d_val=0.
      
      gosub Set_Clock_Freq
      return
    )
    else if ("&clk_desired_freq"=="r")
    (
      return
    )
    else
    (
      print "Invalid selection."
      goto Set_Clock_Freq_Enter
    )
  )

  if ("&clk"=="ext_mclk2_clk_src")||("&clk"=="audio_wrapper_ext_mclk2_clk")
  (
    gosub PRINT_SET_CLOCK_FREQ_WARNING

    &clk_cmd_rcgr_addr=&HWIO_LPASS_EXT_MCLK2_CMD_RCGR_ADDR
    &clk_cfg_rcgr_addr=&HWIO_LPASS_EXT_MCLK2_CFG_RCGR_ADDR

    print "Choose frequency (MHz) from list below: " 

    print "0.3528         0.512          0.7056         " 
    print "0.768          1.024          1.4112         " 
    print "1.536          2.048          2.8224         " 
    print "3.072          4.096          5.6448         " 
    print "6.144          8.192          9.6            " 
    print "11.2896        12.288         15.36          " 
    print "24.576         " 

    print " "
    print "Enter desired frequency (r to return): "
    enter &clk_desired_freq
    print " "

    if ("&clk_desired_freq"=="0.3528")
    (
      &clk_src_name="LPAAUDIO_PLL_CLK_DIV_CDIV"
      &clk_src_sel=SRC_SEL TODO.
      &clk_src_div=32.
      &clk_m_val=1.
      &clk_n_val=50.
      &clk_2d_val=50.
      
      gosub Set_Clock_Freq
      return
    )
    else if ("&clk_desired_freq"=="0.512")
    (
      &clk_src_name="LPAAUDIO_DIG_PLL_OUT_AUX"
      &clk_src_sel=SRC_SEL TODO.
      &clk_src_div=32.
      &clk_m_val=1.
      &clk_n_val=15.
      &clk_2d_val=15.
      
      gosub Set_Clock_Freq
      return
    )
    else if ("&clk_desired_freq"=="0.7056")
    (
      &clk_src_name="LPAAUDIO_PLL_CLK_DIV_CDIV"
      &clk_src_sel=SRC_SEL TODO.
      &clk_src_div=32.
      &clk_m_val=1.
      &clk_n_val=25.
      &clk_2d_val=25.
      
      gosub Set_Clock_Freq
      return
    )
    else if ("&clk_desired_freq"=="0.768")
    (
      &clk_src_name="LPAAUDIO_DIG_PLL_OUT_AUX"
      &clk_src_sel=SRC_SEL TODO.
      &clk_src_div=32.
      &clk_m_val=1.
      &clk_n_val=10.
      &clk_2d_val=10.
      
      gosub Set_Clock_Freq
      return
    )
    else if ("&clk_desired_freq"=="1.024")
    (
      &clk_src_name="LPAAUDIO_DIG_PLL_OUT_AUX"
      &clk_src_sel=SRC_SEL TODO.
      &clk_src_div=30.
      &clk_m_val=1.
      &clk_n_val=8.
      &clk_2d_val=8.
      
      gosub Set_Clock_Freq
      return
    )
    else if ("&clk_desired_freq"=="1.4112")
    (
      &clk_src_name="LPAAUDIO_PLL_CLK_DIV_CDIV"
      &clk_src_sel=SRC_SEL TODO.
      &clk_src_div=20.
      &clk_m_val=1.
      &clk_n_val=20.
      &clk_2d_val=20.
      
      gosub Set_Clock_Freq
      return
    )
    else if ("&clk_desired_freq"=="1.536")
    (
      &clk_src_name="LPAAUDIO_DIG_PLL_OUT_AUX"
      &clk_src_sel=SRC_SEL TODO.
      &clk_src_div=32.
      &clk_m_val=1.
      &clk_n_val=5.
      &clk_2d_val=5.
      
      gosub Set_Clock_Freq
      return
    )
    else if ("&clk_desired_freq"=="2.048")
    (
      &clk_src_name="LPAAUDIO_DIG_PLL_OUT_AUX"
      &clk_src_sel=SRC_SEL TODO.
      &clk_src_div=30.
      &clk_m_val=1.
      &clk_n_val=4.
      &clk_2d_val=4.
      
      gosub Set_Clock_Freq
      return
    )
    else if ("&clk_desired_freq"=="2.8224")
    (
      &clk_src_name="LPAAUDIO_PLL_CLK_DIV_CDIV"
      &clk_src_sel=SRC_SEL TODO.
      &clk_src_div=20.
      &clk_m_val=1.
      &clk_n_val=10.
      &clk_2d_val=10.
      
      gosub Set_Clock_Freq
      return
    )
    else if ("&clk_desired_freq"=="3.072")
    (
      &clk_src_name="LPAAUDIO_DIG_PLL_OUT_AUX"
      &clk_src_sel=SRC_SEL TODO.
      &clk_src_div=20.
      &clk_m_val=1.
      &clk_n_val=4.
      &clk_2d_val=4.
      
      gosub Set_Clock_Freq
      return
    )
    else if ("&clk_desired_freq"=="4.096")
    (
      &clk_src_name="LPAAUDIO_DIG_PLL_OUT_AUX"
      &clk_src_sel=SRC_SEL TODO.
      &clk_src_div=30.
      &clk_m_val=1.
      &clk_n_val=2.
      &clk_2d_val=2.
      
      gosub Set_Clock_Freq
      return
    )
    else if ("&clk_desired_freq"=="5.6448")
    (
      &clk_src_name="LPAAUDIO_PLL_CLK_DIV_CDIV"
      &clk_src_sel=SRC_SEL TODO.
      &clk_src_div=20.
      &clk_m_val=1.
      &clk_n_val=5.
      &clk_2d_val=5.
      
      gosub Set_Clock_Freq
      return
    )
    else if ("&clk_desired_freq"=="6.144")
    (
      &clk_src_name="LPAAUDIO_DIG_PLL_OUT_AUX"
      &clk_src_sel=SRC_SEL TODO.
      &clk_src_div=20.
      &clk_m_val=1.
      &clk_n_val=2.
      &clk_2d_val=2.
      
      gosub Set_Clock_Freq
      return
    )
    else if ("&clk_desired_freq"=="8.192")
    (
      &clk_src_name="LPAAUDIO_DIG_PLL_OUT_AUX"
      &clk_src_sel=SRC_SEL TODO.
      &clk_src_div=30.
      &clk_m_val=0.
      &clk_n_val=0.
      &clk_2d_val=0.
      
      gosub Set_Clock_Freq
      return
    )
    else if ("&clk_desired_freq"=="9.6")
    (
      &clk_src_name="XO"
      &clk_src_sel=SRC_SEL TODO.
      &clk_src_div=4.
      &clk_m_val=0.
      &clk_n_val=0.
      &clk_2d_val=0.
      
      gosub Set_Clock_Freq
      return
    )
    else if ("&clk_desired_freq"=="11.2896")
    (
      &clk_src_name="LPAAUDIO_PLL_CLK_DIV_CDIV"
      &clk_src_sel=SRC_SEL TODO.
      &clk_src_div=10.
      &clk_m_val=1.
      &clk_n_val=5.
      &clk_2d_val=5.
      
      gosub Set_Clock_Freq
      return
    )
    else if ("&clk_desired_freq"=="12.288")
    (
      &clk_src_name="LPAAUDIO_DIG_PLL_OUT_AUX"
      &clk_src_sel=SRC_SEL TODO.
      &clk_src_div=20.
      &clk_m_val=0.
      &clk_n_val=0.
      &clk_2d_val=0.
      
      gosub Set_Clock_Freq
      return
    )
    else if ("&clk_desired_freq"=="15.36")
    (
      &clk_src_name="LPAAUDIO_DIG_PLL_OUT_AUX"
      &clk_src_sel=SRC_SEL TODO.
      &clk_src_div=16.
      &clk_m_val=0.
      &clk_n_val=0.
      &clk_2d_val=0.
      
      gosub Set_Clock_Freq
      return
    )
    else if ("&clk_desired_freq"=="24.576")
    (
      &clk_src_name="LPAAUDIO_DIG_PLL_OUT_AUX"
      &clk_src_sel=SRC_SEL TODO.
      &clk_src_div=10.
      &clk_m_val=0.
      &clk_n_val=0.
      &clk_2d_val=0.
      
      gosub Set_Clock_Freq
      return
    )
    else if ("&clk_desired_freq"=="r")
    (
      return
    )
    else
    (
      print "Invalid selection."
      goto Set_Clock_Freq_Enter
    )
  )

  if ("&clk"=="audio_wrapper_ext_mclk3_clk")
  (
    gosub PRINT_SET_CLOCK_FREQ_WARNING

    &clk_cmd_rcgr_addr=&HWIO_LPASS_EXT_MCLK3_CMD_RCGR_ADDR
    &clk_cfg_rcgr_addr=&HWIO_LPASS_EXT_MCLK3_CFG_RCGR_ADDR

    print "Choose frequency (MHz) from list below: " 

    print "0.3528         0.512          0.7056         " 
    print "0.768          1.024          1.4112         " 
    print "1.536          2.048          2.8224         " 
    print "3.072          4.096          5.6448         " 
    print "6.144          8.192          9.6            " 
    print "11.2896        12.288         15.36          " 
    print "24.576         " 

    print " "
    print "Enter desired frequency (r to return): "
    enter &clk_desired_freq
    print " "

    if ("&clk_desired_freq"=="0.3528")
    (
      &clk_src_name="LPAAUDIO_PLL_CLK_DIV_CDIV"
      &clk_src_sel=SRC_SEL TODO.
      &clk_src_div=32.
      &clk_m_val=1.
      &clk_n_val=50.
      &clk_2d_val=50.
      
      gosub Set_Clock_Freq
      return
    )
    else if ("&clk_desired_freq"=="0.512")
    (
      &clk_src_name="LPAAUDIO_DIG_PLL_OUT_AUX"
      &clk_src_sel=SRC_SEL TODO.
      &clk_src_div=32.
      &clk_m_val=1.
      &clk_n_val=15.
      &clk_2d_val=15.
      
      gosub Set_Clock_Freq
      return
    )
    else if ("&clk_desired_freq"=="0.7056")
    (
      &clk_src_name="LPAAUDIO_PLL_CLK_DIV_CDIV"
      &clk_src_sel=SRC_SEL TODO.
      &clk_src_div=32.
      &clk_m_val=1.
      &clk_n_val=25.
      &clk_2d_val=25.
      
      gosub Set_Clock_Freq
      return
    )
    else if ("&clk_desired_freq"=="0.768")
    (
      &clk_src_name="LPAAUDIO_DIG_PLL_OUT_AUX"
      &clk_src_sel=SRC_SEL TODO.
      &clk_src_div=32.
      &clk_m_val=1.
      &clk_n_val=10.
      &clk_2d_val=10.
      
      gosub Set_Clock_Freq
      return
    )
    else if ("&clk_desired_freq"=="1.024")
    (
      &clk_src_name="LPAAUDIO_DIG_PLL_OUT_AUX"
      &clk_src_sel=SRC_SEL TODO.
      &clk_src_div=30.
      &clk_m_val=1.
      &clk_n_val=8.
      &clk_2d_val=8.
      
      gosub Set_Clock_Freq
      return
    )
    else if ("&clk_desired_freq"=="1.4112")
    (
      &clk_src_name="LPAAUDIO_PLL_CLK_DIV_CDIV"
      &clk_src_sel=SRC_SEL TODO.
      &clk_src_div=20.
      &clk_m_val=1.
      &clk_n_val=20.
      &clk_2d_val=20.
      
      gosub Set_Clock_Freq
      return
    )
    else if ("&clk_desired_freq"=="1.536")
    (
      &clk_src_name="LPAAUDIO_DIG_PLL_OUT_AUX"
      &clk_src_sel=SRC_SEL TODO.
      &clk_src_div=32.
      &clk_m_val=1.
      &clk_n_val=5.
      &clk_2d_val=5.
      
      gosub Set_Clock_Freq
      return
    )
    else if ("&clk_desired_freq"=="2.048")
    (
      &clk_src_name="LPAAUDIO_DIG_PLL_OUT_AUX"
      &clk_src_sel=SRC_SEL TODO.
      &clk_src_div=30.
      &clk_m_val=1.
      &clk_n_val=4.
      &clk_2d_val=4.
      
      gosub Set_Clock_Freq
      return
    )
    else if ("&clk_desired_freq"=="2.8224")
    (
      &clk_src_name="LPAAUDIO_PLL_CLK_DIV_CDIV"
      &clk_src_sel=SRC_SEL TODO.
      &clk_src_div=20.
      &clk_m_val=1.
      &clk_n_val=10.
      &clk_2d_val=10.
      
      gosub Set_Clock_Freq
      return
    )
    else if ("&clk_desired_freq"=="3.072")
    (
      &clk_src_name="LPAAUDIO_DIG_PLL_OUT_AUX"
      &clk_src_sel=SRC_SEL TODO.
      &clk_src_div=20.
      &clk_m_val=1.
      &clk_n_val=4.
      &clk_2d_val=4.
      
      gosub Set_Clock_Freq
      return
    )
    else if ("&clk_desired_freq"=="4.096")
    (
      &clk_src_name="LPAAUDIO_DIG_PLL_OUT_AUX"
      &clk_src_sel=SRC_SEL TODO.
      &clk_src_div=30.
      &clk_m_val=1.
      &clk_n_val=2.
      &clk_2d_val=2.
      
      gosub Set_Clock_Freq
      return
    )
    else if ("&clk_desired_freq"=="5.6448")
    (
      &clk_src_name="LPAAUDIO_PLL_CLK_DIV_CDIV"
      &clk_src_sel=SRC_SEL TODO.
      &clk_src_div=20.
      &clk_m_val=1.
      &clk_n_val=5.
      &clk_2d_val=5.
      
      gosub Set_Clock_Freq
      return
    )
    else if ("&clk_desired_freq"=="6.144")
    (
      &clk_src_name="LPAAUDIO_DIG_PLL_OUT_AUX"
      &clk_src_sel=SRC_SEL TODO.
      &clk_src_div=20.
      &clk_m_val=1.
      &clk_n_val=2.
      &clk_2d_val=2.
      
      gosub Set_Clock_Freq
      return
    )
    else if ("&clk_desired_freq"=="8.192")
    (
      &clk_src_name="LPAAUDIO_DIG_PLL_OUT_AUX"
      &clk_src_sel=SRC_SEL TODO.
      &clk_src_div=30.
      &clk_m_val=0.
      &clk_n_val=0.
      &clk_2d_val=0.
      
      gosub Set_Clock_Freq
      return
    )
    else if ("&clk_desired_freq"=="9.6")
    (
      &clk_src_name="XO"
      &clk_src_sel=SRC_SEL TODO.
      &clk_src_div=4.
      &clk_m_val=0.
      &clk_n_val=0.
      &clk_2d_val=0.
      
      gosub Set_Clock_Freq
      return
    )
    else if ("&clk_desired_freq"=="11.2896")
    (
      &clk_src_name="LPAAUDIO_PLL_CLK_DIV_CDIV"
      &clk_src_sel=SRC_SEL TODO.
      &clk_src_div=10.
      &clk_m_val=1.
      &clk_n_val=5.
      &clk_2d_val=5.
      
      gosub Set_Clock_Freq
      return
    )
    else if ("&clk_desired_freq"=="12.288")
    (
      &clk_src_name="LPAAUDIO_DIG_PLL_OUT_AUX"
      &clk_src_sel=SRC_SEL TODO.
      &clk_src_div=20.
      &clk_m_val=0.
      &clk_n_val=0.
      &clk_2d_val=0.
      
      gosub Set_Clock_Freq
      return
    )
    else if ("&clk_desired_freq"=="15.36")
    (
      &clk_src_name="LPAAUDIO_DIG_PLL_OUT_AUX"
      &clk_src_sel=SRC_SEL TODO.
      &clk_src_div=16.
      &clk_m_val=0.
      &clk_n_val=0.
      &clk_2d_val=0.
      
      gosub Set_Clock_Freq
      return
    )
    else if ("&clk_desired_freq"=="24.576")
    (
      &clk_src_name="LPAAUDIO_DIG_PLL_OUT_AUX"
      &clk_src_sel=SRC_SEL TODO.
      &clk_src_div=10.
      &clk_m_val=0.
      &clk_n_val=0.
      &clk_2d_val=0.
      
      gosub Set_Clock_Freq
      return
    )
    else if ("&clk_desired_freq"=="r")
    (
      return
    )
    else
    (
      print "Invalid selection."
      goto Set_Clock_Freq_Enter
    )
  )

  if ("&clk"=="audio_core_int_i2s0_1_ibit_clk")
  (
    gosub PRINT_SET_CLOCK_FREQ_WARNING

    &clk_cmd_rcgr_addr=&HWIO_LPASS_INT_I2S0_1_CMD_RCGR_ADDR
    &clk_cfg_rcgr_addr=&HWIO_LPASS_INT_I2S0_1_CFG_RCGR_ADDR

    print "Choose frequency (MHz) from list below: " 

    print "0.3528         0.512          0.7056         " 
    print "0.768          1.024          1.4112         " 
    print "1.536          2.048          2.8224         " 
    print "3.072          4.096          5.6448         " 
    print "6.144          8.192          9.6            " 
    print "11.2896        12.288         15.36          " 
    print "24.576         " 

    print " "
    print "Enter desired frequency (r to return): "
    enter &clk_desired_freq
    print " "

    if ("&clk_desired_freq"=="0.3528")
    (
      &clk_src_name="LPAAUDIO_PLL_CLK_DIV_CDIV"
      &clk_src_sel=SRC_SEL TODO.
      &clk_src_div=32.
      &clk_m_val=1.
      &clk_n_val=50.
      &clk_2d_val=50.
      
      gosub Set_Clock_Freq
      return
    )
    else if ("&clk_desired_freq"=="0.512")
    (
      &clk_src_name="LPAAUDIO_DIG_PLL_OUT_AUX"
      &clk_src_sel=SRC_SEL TODO.
      &clk_src_div=32.
      &clk_m_val=1.
      &clk_n_val=15.
      &clk_2d_val=15.
      
      gosub Set_Clock_Freq
      return
    )
    else if ("&clk_desired_freq"=="0.7056")
    (
      &clk_src_name="LPAAUDIO_PLL_CLK_DIV_CDIV"
      &clk_src_sel=SRC_SEL TODO.
      &clk_src_div=32.
      &clk_m_val=1.
      &clk_n_val=25.
      &clk_2d_val=25.
      
      gosub Set_Clock_Freq
      return
    )
    else if ("&clk_desired_freq"=="0.768")
    (
      &clk_src_name="LPAAUDIO_DIG_PLL_OUT_AUX"
      &clk_src_sel=SRC_SEL TODO.
      &clk_src_div=32.
      &clk_m_val=1.
      &clk_n_val=10.
      &clk_2d_val=10.
      
      gosub Set_Clock_Freq
      return
    )
    else if ("&clk_desired_freq"=="1.024")
    (
      &clk_src_name="LPAAUDIO_DIG_PLL_OUT_AUX"
      &clk_src_sel=SRC_SEL TODO.
      &clk_src_div=30.
      &clk_m_val=1.
      &clk_n_val=8.
      &clk_2d_val=8.
      
      gosub Set_Clock_Freq
      return
    )
    else if ("&clk_desired_freq"=="1.4112")
    (
      &clk_src_name="LPAAUDIO_PLL_CLK_DIV_CDIV"
      &clk_src_sel=SRC_SEL TODO.
      &clk_src_div=20.
      &clk_m_val=1.
      &clk_n_val=20.
      &clk_2d_val=20.
      
      gosub Set_Clock_Freq
      return
    )
    else if ("&clk_desired_freq"=="1.536")
    (
      &clk_src_name="LPAAUDIO_DIG_PLL_OUT_AUX"
      &clk_src_sel=SRC_SEL TODO.
      &clk_src_div=32.
      &clk_m_val=1.
      &clk_n_val=5.
      &clk_2d_val=5.
      
      gosub Set_Clock_Freq
      return
    )
    else if ("&clk_desired_freq"=="2.048")
    (
      &clk_src_name="LPAAUDIO_DIG_PLL_OUT_AUX"
      &clk_src_sel=SRC_SEL TODO.
      &clk_src_div=30.
      &clk_m_val=1.
      &clk_n_val=4.
      &clk_2d_val=4.
      
      gosub Set_Clock_Freq
      return
    )
    else if ("&clk_desired_freq"=="2.8224")
    (
      &clk_src_name="LPAAUDIO_PLL_CLK_DIV_CDIV"
      &clk_src_sel=SRC_SEL TODO.
      &clk_src_div=20.
      &clk_m_val=1.
      &clk_n_val=10.
      &clk_2d_val=10.
      
      gosub Set_Clock_Freq
      return
    )
    else if ("&clk_desired_freq"=="3.072")
    (
      &clk_src_name="LPAAUDIO_DIG_PLL_OUT_AUX"
      &clk_src_sel=SRC_SEL TODO.
      &clk_src_div=20.
      &clk_m_val=1.
      &clk_n_val=4.
      &clk_2d_val=4.
      
      gosub Set_Clock_Freq
      return
    )
    else if ("&clk_desired_freq"=="4.096")
    (
      &clk_src_name="LPAAUDIO_DIG_PLL_OUT_AUX"
      &clk_src_sel=SRC_SEL TODO.
      &clk_src_div=30.
      &clk_m_val=1.
      &clk_n_val=2.
      &clk_2d_val=2.
      
      gosub Set_Clock_Freq
      return
    )
    else if ("&clk_desired_freq"=="5.6448")
    (
      &clk_src_name="LPAAUDIO_PLL_CLK_DIV_CDIV"
      &clk_src_sel=SRC_SEL TODO.
      &clk_src_div=20.
      &clk_m_val=1.
      &clk_n_val=5.
      &clk_2d_val=5.
      
      gosub Set_Clock_Freq
      return
    )
    else if ("&clk_desired_freq"=="6.144")
    (
      &clk_src_name="LPAAUDIO_DIG_PLL_OUT_AUX"
      &clk_src_sel=SRC_SEL TODO.
      &clk_src_div=20.
      &clk_m_val=1.
      &clk_n_val=2.
      &clk_2d_val=2.
      
      gosub Set_Clock_Freq
      return
    )
    else if ("&clk_desired_freq"=="8.192")
    (
      &clk_src_name="LPAAUDIO_DIG_PLL_OUT_AUX"
      &clk_src_sel=SRC_SEL TODO.
      &clk_src_div=30.
      &clk_m_val=0.
      &clk_n_val=0.
      &clk_2d_val=0.
      
      gosub Set_Clock_Freq
      return
    )
    else if ("&clk_desired_freq"=="9.6")
    (
      &clk_src_name="XO"
      &clk_src_sel=SRC_SEL TODO.
      &clk_src_div=4.
      &clk_m_val=0.
      &clk_n_val=0.
      &clk_2d_val=0.
      
      gosub Set_Clock_Freq
      return
    )
    else if ("&clk_desired_freq"=="11.2896")
    (
      &clk_src_name="LPAAUDIO_PLL_CLK_DIV_CDIV"
      &clk_src_sel=SRC_SEL TODO.
      &clk_src_div=10.
      &clk_m_val=1.
      &clk_n_val=5.
      &clk_2d_val=5.
      
      gosub Set_Clock_Freq
      return
    )
    else if ("&clk_desired_freq"=="12.288")
    (
      &clk_src_name="LPAAUDIO_DIG_PLL_OUT_AUX"
      &clk_src_sel=SRC_SEL TODO.
      &clk_src_div=20.
      &clk_m_val=0.
      &clk_n_val=0.
      &clk_2d_val=0.
      
      gosub Set_Clock_Freq
      return
    )
    else if ("&clk_desired_freq"=="15.36")
    (
      &clk_src_name="LPAAUDIO_DIG_PLL_OUT_AUX"
      &clk_src_sel=SRC_SEL TODO.
      &clk_src_div=16.
      &clk_m_val=0.
      &clk_n_val=0.
      &clk_2d_val=0.
      
      gosub Set_Clock_Freq
      return
    )
    else if ("&clk_desired_freq"=="24.576")
    (
      &clk_src_name="LPAAUDIO_DIG_PLL_OUT_AUX"
      &clk_src_sel=SRC_SEL TODO.
      &clk_src_div=10.
      &clk_m_val=0.
      &clk_n_val=0.
      &clk_2d_val=0.
      
      gosub Set_Clock_Freq
      return
    )
    else if ("&clk_desired_freq"=="r")
    (
      return
    )
    else
    (
      print "Invalid selection."
      goto Set_Clock_Freq_Enter
    )
  )

  if ("&clk"=="audio_core_int_i2s2_ibit_clk")
  (
    gosub PRINT_SET_CLOCK_FREQ_WARNING

    &clk_cmd_rcgr_addr=&HWIO_LPASS_INT_I2S2_CMD_RCGR_ADDR
    &clk_cfg_rcgr_addr=&HWIO_LPASS_INT_I2S2_CFG_RCGR_ADDR

    print "Choose frequency (MHz) from list below: " 

    print "0.3528         0.512          0.7056         " 
    print "0.768          1.024          1.4112         " 
    print "1.536          2.048          2.8224         " 
    print "3.072          4.096          5.6448         " 
    print "6.144          8.192          9.6            " 
    print "11.2896        12.288         15.36          " 
    print "24.576         " 

    print " "
    print "Enter desired frequency (r to return): "
    enter &clk_desired_freq
    print " "

    if ("&clk_desired_freq"=="0.3528")
    (
      &clk_src_name="LPAAUDIO_PLL_CLK_DIV_CDIV"
      &clk_src_sel=SRC_SEL TODO.
      &clk_src_div=32.
      &clk_m_val=1.
      &clk_n_val=50.
      &clk_2d_val=50.
      
      gosub Set_Clock_Freq
      return
    )
    else if ("&clk_desired_freq"=="0.512")
    (
      &clk_src_name="LPAAUDIO_DIG_PLL_OUT_AUX"
      &clk_src_sel=SRC_SEL TODO.
      &clk_src_div=32.
      &clk_m_val=1.
      &clk_n_val=15.
      &clk_2d_val=15.
      
      gosub Set_Clock_Freq
      return
    )
    else if ("&clk_desired_freq"=="0.7056")
    (
      &clk_src_name="LPAAUDIO_PLL_CLK_DIV_CDIV"
      &clk_src_sel=SRC_SEL TODO.
      &clk_src_div=32.
      &clk_m_val=1.
      &clk_n_val=25.
      &clk_2d_val=25.
      
      gosub Set_Clock_Freq
      return
    )
    else if ("&clk_desired_freq"=="0.768")
    (
      &clk_src_name="LPAAUDIO_DIG_PLL_OUT_AUX"
      &clk_src_sel=SRC_SEL TODO.
      &clk_src_div=32.
      &clk_m_val=1.
      &clk_n_val=10.
      &clk_2d_val=10.
      
      gosub Set_Clock_Freq
      return
    )
    else if ("&clk_desired_freq"=="1.024")
    (
      &clk_src_name="LPAAUDIO_DIG_PLL_OUT_AUX"
      &clk_src_sel=SRC_SEL TODO.
      &clk_src_div=30.
      &clk_m_val=1.
      &clk_n_val=8.
      &clk_2d_val=8.
      
      gosub Set_Clock_Freq
      return
    )
    else if ("&clk_desired_freq"=="1.4112")
    (
      &clk_src_name="LPAAUDIO_PLL_CLK_DIV_CDIV"
      &clk_src_sel=SRC_SEL TODO.
      &clk_src_div=20.
      &clk_m_val=1.
      &clk_n_val=20.
      &clk_2d_val=20.
      
      gosub Set_Clock_Freq
      return
    )
    else if ("&clk_desired_freq"=="1.536")
    (
      &clk_src_name="LPAAUDIO_DIG_PLL_OUT_AUX"
      &clk_src_sel=SRC_SEL TODO.
      &clk_src_div=32.
      &clk_m_val=1.
      &clk_n_val=5.
      &clk_2d_val=5.
      
      gosub Set_Clock_Freq
      return
    )
    else if ("&clk_desired_freq"=="2.048")
    (
      &clk_src_name="LPAAUDIO_DIG_PLL_OUT_AUX"
      &clk_src_sel=SRC_SEL TODO.
      &clk_src_div=30.
      &clk_m_val=1.
      &clk_n_val=4.
      &clk_2d_val=4.
      
      gosub Set_Clock_Freq
      return
    )
    else if ("&clk_desired_freq"=="2.8224")
    (
      &clk_src_name="LPAAUDIO_PLL_CLK_DIV_CDIV"
      &clk_src_sel=SRC_SEL TODO.
      &clk_src_div=20.
      &clk_m_val=1.
      &clk_n_val=10.
      &clk_2d_val=10.
      
      gosub Set_Clock_Freq
      return
    )
    else if ("&clk_desired_freq"=="3.072")
    (
      &clk_src_name="LPAAUDIO_DIG_PLL_OUT_AUX"
      &clk_src_sel=SRC_SEL TODO.
      &clk_src_div=20.
      &clk_m_val=1.
      &clk_n_val=4.
      &clk_2d_val=4.
      
      gosub Set_Clock_Freq
      return
    )
    else if ("&clk_desired_freq"=="4.096")
    (
      &clk_src_name="LPAAUDIO_DIG_PLL_OUT_AUX"
      &clk_src_sel=SRC_SEL TODO.
      &clk_src_div=30.
      &clk_m_val=1.
      &clk_n_val=2.
      &clk_2d_val=2.
      
      gosub Set_Clock_Freq
      return
    )
    else if ("&clk_desired_freq"=="5.6448")
    (
      &clk_src_name="LPAAUDIO_PLL_CLK_DIV_CDIV"
      &clk_src_sel=SRC_SEL TODO.
      &clk_src_div=20.
      &clk_m_val=1.
      &clk_n_val=5.
      &clk_2d_val=5.
      
      gosub Set_Clock_Freq
      return
    )
    else if ("&clk_desired_freq"=="6.144")
    (
      &clk_src_name="LPAAUDIO_DIG_PLL_OUT_AUX"
      &clk_src_sel=SRC_SEL TODO.
      &clk_src_div=20.
      &clk_m_val=1.
      &clk_n_val=2.
      &clk_2d_val=2.
      
      gosub Set_Clock_Freq
      return
    )
    else if ("&clk_desired_freq"=="8.192")
    (
      &clk_src_name="LPAAUDIO_DIG_PLL_OUT_AUX"
      &clk_src_sel=SRC_SEL TODO.
      &clk_src_div=30.
      &clk_m_val=0.
      &clk_n_val=0.
      &clk_2d_val=0.
      
      gosub Set_Clock_Freq
      return
    )
    else if ("&clk_desired_freq"=="9.6")
    (
      &clk_src_name="XO"
      &clk_src_sel=SRC_SEL TODO.
      &clk_src_div=4.
      &clk_m_val=0.
      &clk_n_val=0.
      &clk_2d_val=0.
      
      gosub Set_Clock_Freq
      return
    )
    else if ("&clk_desired_freq"=="11.2896")
    (
      &clk_src_name="LPAAUDIO_PLL_CLK_DIV_CDIV"
      &clk_src_sel=SRC_SEL TODO.
      &clk_src_div=10.
      &clk_m_val=1.
      &clk_n_val=5.
      &clk_2d_val=5.
      
      gosub Set_Clock_Freq
      return
    )
    else if ("&clk_desired_freq"=="12.288")
    (
      &clk_src_name="LPAAUDIO_DIG_PLL_OUT_AUX"
      &clk_src_sel=SRC_SEL TODO.
      &clk_src_div=20.
      &clk_m_val=0.
      &clk_n_val=0.
      &clk_2d_val=0.
      
      gosub Set_Clock_Freq
      return
    )
    else if ("&clk_desired_freq"=="15.36")
    (
      &clk_src_name="LPAAUDIO_DIG_PLL_OUT_AUX"
      &clk_src_sel=SRC_SEL TODO.
      &clk_src_div=16.
      &clk_m_val=0.
      &clk_n_val=0.
      &clk_2d_val=0.
      
      gosub Set_Clock_Freq
      return
    )
    else if ("&clk_desired_freq"=="24.576")
    (
      &clk_src_name="LPAAUDIO_DIG_PLL_OUT_AUX"
      &clk_src_sel=SRC_SEL TODO.
      &clk_src_div=10.
      &clk_m_val=0.
      &clk_n_val=0.
      &clk_2d_val=0.
      
      gosub Set_Clock_Freq
      return
    )
    else if ("&clk_desired_freq"=="r")
    (
      return
    )
    else
    (
      print "Invalid selection."
      goto Set_Clock_Freq_Enter
    )
  )

  if ("&clk"=="audio_core_int_i2s3_ibit_clk")
  (
    gosub PRINT_SET_CLOCK_FREQ_WARNING

    &clk_cmd_rcgr_addr=&HWIO_LPASS_INT_I2S3_CMD_RCGR_ADDR
    &clk_cfg_rcgr_addr=&HWIO_LPASS_INT_I2S3_CFG_RCGR_ADDR

    print "Choose frequency (MHz) from list below: " 

    print "0.3528         0.512          0.7056         " 
    print "0.768          1.024          1.4112         " 
    print "1.536          2.048          2.8224         " 
    print "3.072          4.096          5.6448         " 
    print "6.144          8.192          9.6            " 
    print "11.2896        12.288         15.36          " 
    print "24.576         " 

    print " "
    print "Enter desired frequency (r to return): "
    enter &clk_desired_freq
    print " "

    if ("&clk_desired_freq"=="0.3528")
    (
      &clk_src_name="LPAAUDIO_PLL_CLK_DIV_CDIV"
      &clk_src_sel=SRC_SEL TODO.
      &clk_src_div=32.
      &clk_m_val=1.
      &clk_n_val=50.
      &clk_2d_val=50.
      
      gosub Set_Clock_Freq
      return
    )
    else if ("&clk_desired_freq"=="0.512")
    (
      &clk_src_name="LPAAUDIO_DIG_PLL_OUT_AUX"
      &clk_src_sel=SRC_SEL TODO.
      &clk_src_div=32.
      &clk_m_val=1.
      &clk_n_val=15.
      &clk_2d_val=15.
      
      gosub Set_Clock_Freq
      return
    )
    else if ("&clk_desired_freq"=="0.7056")
    (
      &clk_src_name="LPAAUDIO_PLL_CLK_DIV_CDIV"
      &clk_src_sel=SRC_SEL TODO.
      &clk_src_div=32.
      &clk_m_val=1.
      &clk_n_val=25.
      &clk_2d_val=25.
      
      gosub Set_Clock_Freq
      return
    )
    else if ("&clk_desired_freq"=="0.768")
    (
      &clk_src_name="LPAAUDIO_DIG_PLL_OUT_AUX"
      &clk_src_sel=SRC_SEL TODO.
      &clk_src_div=32.
      &clk_m_val=1.
      &clk_n_val=10.
      &clk_2d_val=10.
      
      gosub Set_Clock_Freq
      return
    )
    else if ("&clk_desired_freq"=="1.024")
    (
      &clk_src_name="LPAAUDIO_DIG_PLL_OUT_AUX"
      &clk_src_sel=SRC_SEL TODO.
      &clk_src_div=30.
      &clk_m_val=1.
      &clk_n_val=8.
      &clk_2d_val=8.
      
      gosub Set_Clock_Freq
      return
    )
    else if ("&clk_desired_freq"=="1.4112")
    (
      &clk_src_name="LPAAUDIO_PLL_CLK_DIV_CDIV"
      &clk_src_sel=SRC_SEL TODO.
      &clk_src_div=20.
      &clk_m_val=1.
      &clk_n_val=20.
      &clk_2d_val=20.
      
      gosub Set_Clock_Freq
      return
    )
    else if ("&clk_desired_freq"=="1.536")
    (
      &clk_src_name="LPAAUDIO_DIG_PLL_OUT_AUX"
      &clk_src_sel=SRC_SEL TODO.
      &clk_src_div=32.
      &clk_m_val=1.
      &clk_n_val=5.
      &clk_2d_val=5.
      
      gosub Set_Clock_Freq
      return
    )
    else if ("&clk_desired_freq"=="2.048")
    (
      &clk_src_name="LPAAUDIO_DIG_PLL_OUT_AUX"
      &clk_src_sel=SRC_SEL TODO.
      &clk_src_div=30.
      &clk_m_val=1.
      &clk_n_val=4.
      &clk_2d_val=4.
      
      gosub Set_Clock_Freq
      return
    )
    else if ("&clk_desired_freq"=="2.8224")
    (
      &clk_src_name="LPAAUDIO_PLL_CLK_DIV_CDIV"
      &clk_src_sel=SRC_SEL TODO.
      &clk_src_div=20.
      &clk_m_val=1.
      &clk_n_val=10.
      &clk_2d_val=10.
      
      gosub Set_Clock_Freq
      return
    )
    else if ("&clk_desired_freq"=="3.072")
    (
      &clk_src_name="LPAAUDIO_DIG_PLL_OUT_AUX"
      &clk_src_sel=SRC_SEL TODO.
      &clk_src_div=20.
      &clk_m_val=1.
      &clk_n_val=4.
      &clk_2d_val=4.
      
      gosub Set_Clock_Freq
      return
    )
    else if ("&clk_desired_freq"=="4.096")
    (
      &clk_src_name="LPAAUDIO_DIG_PLL_OUT_AUX"
      &clk_src_sel=SRC_SEL TODO.
      &clk_src_div=30.
      &clk_m_val=1.
      &clk_n_val=2.
      &clk_2d_val=2.
      
      gosub Set_Clock_Freq
      return
    )
    else if ("&clk_desired_freq"=="5.6448")
    (
      &clk_src_name="LPAAUDIO_PLL_CLK_DIV_CDIV"
      &clk_src_sel=SRC_SEL TODO.
      &clk_src_div=20.
      &clk_m_val=1.
      &clk_n_val=5.
      &clk_2d_val=5.
      
      gosub Set_Clock_Freq
      return
    )
    else if ("&clk_desired_freq"=="6.144")
    (
      &clk_src_name="LPAAUDIO_DIG_PLL_OUT_AUX"
      &clk_src_sel=SRC_SEL TODO.
      &clk_src_div=20.
      &clk_m_val=1.
      &clk_n_val=2.
      &clk_2d_val=2.
      
      gosub Set_Clock_Freq
      return
    )
    else if ("&clk_desired_freq"=="8.192")
    (
      &clk_src_name="LPAAUDIO_DIG_PLL_OUT_AUX"
      &clk_src_sel=SRC_SEL TODO.
      &clk_src_div=30.
      &clk_m_val=0.
      &clk_n_val=0.
      &clk_2d_val=0.
      
      gosub Set_Clock_Freq
      return
    )
    else if ("&clk_desired_freq"=="9.6")
    (
      &clk_src_name="XO"
      &clk_src_sel=SRC_SEL TODO.
      &clk_src_div=4.
      &clk_m_val=0.
      &clk_n_val=0.
      &clk_2d_val=0.
      
      gosub Set_Clock_Freq
      return
    )
    else if ("&clk_desired_freq"=="11.2896")
    (
      &clk_src_name="LPAAUDIO_PLL_CLK_DIV_CDIV"
      &clk_src_sel=SRC_SEL TODO.
      &clk_src_div=10.
      &clk_m_val=1.
      &clk_n_val=5.
      &clk_2d_val=5.
      
      gosub Set_Clock_Freq
      return
    )
    else if ("&clk_desired_freq"=="12.288")
    (
      &clk_src_name="LPAAUDIO_DIG_PLL_OUT_AUX"
      &clk_src_sel=SRC_SEL TODO.
      &clk_src_div=20.
      &clk_m_val=0.
      &clk_n_val=0.
      &clk_2d_val=0.
      
      gosub Set_Clock_Freq
      return
    )
    else if ("&clk_desired_freq"=="15.36")
    (
      &clk_src_name="LPAAUDIO_DIG_PLL_OUT_AUX"
      &clk_src_sel=SRC_SEL TODO.
      &clk_src_div=16.
      &clk_m_val=0.
      &clk_n_val=0.
      &clk_2d_val=0.
      
      gosub Set_Clock_Freq
      return
    )
    else if ("&clk_desired_freq"=="24.576")
    (
      &clk_src_name="LPAAUDIO_DIG_PLL_OUT_AUX"
      &clk_src_sel=SRC_SEL TODO.
      &clk_src_div=10.
      &clk_m_val=0.
      &clk_n_val=0.
      &clk_2d_val=0.
      
      gosub Set_Clock_Freq
      return
    )
    else if ("&clk_desired_freq"=="r")
    (
      return
    )
    else
    (
      print "Invalid selection."
      goto Set_Clock_Freq_Enter
    )
  )

  if ("&clk"=="audio_core_int_i2s4_ibit_clk")
  (
    gosub PRINT_SET_CLOCK_FREQ_WARNING

    &clk_cmd_rcgr_addr=&HWIO_LPASS_INT_I2S4_CMD_RCGR_ADDR
    &clk_cfg_rcgr_addr=&HWIO_LPASS_INT_I2S4_CFG_RCGR_ADDR

    print "Choose frequency (MHz) from list below: " 

    print "0.3528         0.512          0.7056         " 
    print "0.768          1.024          1.4112         " 
    print "1.536          2.048          2.8224         " 
    print "3.072          4.096          5.6448         " 
    print "6.144          8.192          9.6            " 
    print "11.2896        12.288         15.36          " 
    print "24.576         " 

    print " "
    print "Enter desired frequency (r to return): "
    enter &clk_desired_freq
    print " "

    if ("&clk_desired_freq"=="0.3528")
    (
      &clk_src_name="LPAAUDIO_PLL_CLK_DIV_CDIV"
      &clk_src_sel=SRC_SEL TODO.
      &clk_src_div=32.
      &clk_m_val=1.
      &clk_n_val=50.
      &clk_2d_val=50.
      
      gosub Set_Clock_Freq
      return
    )
    else if ("&clk_desired_freq"=="0.512")
    (
      &clk_src_name="LPAAUDIO_DIG_PLL_OUT_AUX"
      &clk_src_sel=SRC_SEL TODO.
      &clk_src_div=32.
      &clk_m_val=1.
      &clk_n_val=15.
      &clk_2d_val=15.
      
      gosub Set_Clock_Freq
      return
    )
    else if ("&clk_desired_freq"=="0.7056")
    (
      &clk_src_name="LPAAUDIO_PLL_CLK_DIV_CDIV"
      &clk_src_sel=SRC_SEL TODO.
      &clk_src_div=32.
      &clk_m_val=1.
      &clk_n_val=25.
      &clk_2d_val=25.
      
      gosub Set_Clock_Freq
      return
    )
    else if ("&clk_desired_freq"=="0.768")
    (
      &clk_src_name="LPAAUDIO_DIG_PLL_OUT_AUX"
      &clk_src_sel=SRC_SEL TODO.
      &clk_src_div=32.
      &clk_m_val=1.
      &clk_n_val=10.
      &clk_2d_val=10.
      
      gosub Set_Clock_Freq
      return
    )
    else if ("&clk_desired_freq"=="1.024")
    (
      &clk_src_name="LPAAUDIO_DIG_PLL_OUT_AUX"
      &clk_src_sel=SRC_SEL TODO.
      &clk_src_div=30.
      &clk_m_val=1.
      &clk_n_val=8.
      &clk_2d_val=8.
      
      gosub Set_Clock_Freq
      return
    )
    else if ("&clk_desired_freq"=="1.4112")
    (
      &clk_src_name="LPAAUDIO_PLL_CLK_DIV_CDIV"
      &clk_src_sel=SRC_SEL TODO.
      &clk_src_div=20.
      &clk_m_val=1.
      &clk_n_val=20.
      &clk_2d_val=20.
      
      gosub Set_Clock_Freq
      return
    )
    else if ("&clk_desired_freq"=="1.536")
    (
      &clk_src_name="LPAAUDIO_DIG_PLL_OUT_AUX"
      &clk_src_sel=SRC_SEL TODO.
      &clk_src_div=32.
      &clk_m_val=1.
      &clk_n_val=5.
      &clk_2d_val=5.
      
      gosub Set_Clock_Freq
      return
    )
    else if ("&clk_desired_freq"=="2.048")
    (
      &clk_src_name="LPAAUDIO_DIG_PLL_OUT_AUX"
      &clk_src_sel=SRC_SEL TODO.
      &clk_src_div=30.
      &clk_m_val=1.
      &clk_n_val=4.
      &clk_2d_val=4.
      
      gosub Set_Clock_Freq
      return
    )
    else if ("&clk_desired_freq"=="2.8224")
    (
      &clk_src_name="LPAAUDIO_PLL_CLK_DIV_CDIV"
      &clk_src_sel=SRC_SEL TODO.
      &clk_src_div=20.
      &clk_m_val=1.
      &clk_n_val=10.
      &clk_2d_val=10.
      
      gosub Set_Clock_Freq
      return
    )
    else if ("&clk_desired_freq"=="3.072")
    (
      &clk_src_name="LPAAUDIO_DIG_PLL_OUT_AUX"
      &clk_src_sel=SRC_SEL TODO.
      &clk_src_div=20.
      &clk_m_val=1.
      &clk_n_val=4.
      &clk_2d_val=4.
      
      gosub Set_Clock_Freq
      return
    )
    else if ("&clk_desired_freq"=="4.096")
    (
      &clk_src_name="LPAAUDIO_DIG_PLL_OUT_AUX"
      &clk_src_sel=SRC_SEL TODO.
      &clk_src_div=30.
      &clk_m_val=1.
      &clk_n_val=2.
      &clk_2d_val=2.
      
      gosub Set_Clock_Freq
      return
    )
    else if ("&clk_desired_freq"=="5.6448")
    (
      &clk_src_name="LPAAUDIO_PLL_CLK_DIV_CDIV"
      &clk_src_sel=SRC_SEL TODO.
      &clk_src_div=20.
      &clk_m_val=1.
      &clk_n_val=5.
      &clk_2d_val=5.
      
      gosub Set_Clock_Freq
      return
    )
    else if ("&clk_desired_freq"=="6.144")
    (
      &clk_src_name="LPAAUDIO_DIG_PLL_OUT_AUX"
      &clk_src_sel=SRC_SEL TODO.
      &clk_src_div=20.
      &clk_m_val=1.
      &clk_n_val=2.
      &clk_2d_val=2.
      
      gosub Set_Clock_Freq
      return
    )
    else if ("&clk_desired_freq"=="8.192")
    (
      &clk_src_name="LPAAUDIO_DIG_PLL_OUT_AUX"
      &clk_src_sel=SRC_SEL TODO.
      &clk_src_div=30.
      &clk_m_val=0.
      &clk_n_val=0.
      &clk_2d_val=0.
      
      gosub Set_Clock_Freq
      return
    )
    else if ("&clk_desired_freq"=="9.6")
    (
      &clk_src_name="XO"
      &clk_src_sel=SRC_SEL TODO.
      &clk_src_div=4.
      &clk_m_val=0.
      &clk_n_val=0.
      &clk_2d_val=0.
      
      gosub Set_Clock_Freq
      return
    )
    else if ("&clk_desired_freq"=="11.2896")
    (
      &clk_src_name="LPAAUDIO_PLL_CLK_DIV_CDIV"
      &clk_src_sel=SRC_SEL TODO.
      &clk_src_div=10.
      &clk_m_val=1.
      &clk_n_val=5.
      &clk_2d_val=5.
      
      gosub Set_Clock_Freq
      return
    )
    else if ("&clk_desired_freq"=="12.288")
    (
      &clk_src_name="LPAAUDIO_DIG_PLL_OUT_AUX"
      &clk_src_sel=SRC_SEL TODO.
      &clk_src_div=20.
      &clk_m_val=0.
      &clk_n_val=0.
      &clk_2d_val=0.
      
      gosub Set_Clock_Freq
      return
    )
    else if ("&clk_desired_freq"=="15.36")
    (
      &clk_src_name="LPAAUDIO_DIG_PLL_OUT_AUX"
      &clk_src_sel=SRC_SEL TODO.
      &clk_src_div=16.
      &clk_m_val=0.
      &clk_n_val=0.
      &clk_2d_val=0.
      
      gosub Set_Clock_Freq
      return
    )
    else if ("&clk_desired_freq"=="24.576")
    (
      &clk_src_name="LPAAUDIO_DIG_PLL_OUT_AUX"
      &clk_src_sel=SRC_SEL TODO.
      &clk_src_div=10.
      &clk_m_val=0.
      &clk_n_val=0.
      &clk_2d_val=0.
      
      gosub Set_Clock_Freq
      return
    )
    else if ("&clk_desired_freq"=="r")
    (
      return
    )
    else
    (
      print "Invalid selection."
      goto Set_Clock_Freq_Enter
    )
  )

  if ("&clk"=="audio_core_int_i2s5_6_ibit_clk")
  (
    gosub PRINT_SET_CLOCK_FREQ_WARNING

    &clk_cmd_rcgr_addr=&HWIO_LPASS_INT_I2S5_6_CMD_RCGR_ADDR
    &clk_cfg_rcgr_addr=&HWIO_LPASS_INT_I2S5_6_CFG_RCGR_ADDR

    print "Choose frequency (MHz) from list below: " 

    print "0.3528         0.512          0.7056         " 
    print "0.768          1.024          1.4112         " 
    print "1.536          2.048          2.8224         " 
    print "3.072          4.096          5.6448         " 
    print "6.144          8.192          9.6            " 
    print "11.2896        12.288         15.36          " 
    print "24.576         " 

    print " "
    print "Enter desired frequency (r to return): "
    enter &clk_desired_freq
    print " "

    if ("&clk_desired_freq"=="0.3528")
    (
      &clk_src_name="LPAAUDIO_PLL_CLK_DIV_CDIV"
      &clk_src_sel=SRC_SEL TODO.
      &clk_src_div=32.
      &clk_m_val=1.
      &clk_n_val=50.
      &clk_2d_val=50.
      
      gosub Set_Clock_Freq
      return
    )
    else if ("&clk_desired_freq"=="0.512")
    (
      &clk_src_name="LPAAUDIO_DIG_PLL_OUT_AUX"
      &clk_src_sel=SRC_SEL TODO.
      &clk_src_div=32.
      &clk_m_val=1.
      &clk_n_val=15.
      &clk_2d_val=15.
      
      gosub Set_Clock_Freq
      return
    )
    else if ("&clk_desired_freq"=="0.7056")
    (
      &clk_src_name="LPAAUDIO_PLL_CLK_DIV_CDIV"
      &clk_src_sel=SRC_SEL TODO.
      &clk_src_div=32.
      &clk_m_val=1.
      &clk_n_val=25.
      &clk_2d_val=25.
      
      gosub Set_Clock_Freq
      return
    )
    else if ("&clk_desired_freq"=="0.768")
    (
      &clk_src_name="LPAAUDIO_DIG_PLL_OUT_AUX"
      &clk_src_sel=SRC_SEL TODO.
      &clk_src_div=32.
      &clk_m_val=1.
      &clk_n_val=10.
      &clk_2d_val=10.
      
      gosub Set_Clock_Freq
      return
    )
    else if ("&clk_desired_freq"=="1.024")
    (
      &clk_src_name="LPAAUDIO_DIG_PLL_OUT_AUX"
      &clk_src_sel=SRC_SEL TODO.
      &clk_src_div=30.
      &clk_m_val=1.
      &clk_n_val=8.
      &clk_2d_val=8.
      
      gosub Set_Clock_Freq
      return
    )
    else if ("&clk_desired_freq"=="1.4112")
    (
      &clk_src_name="LPAAUDIO_PLL_CLK_DIV_CDIV"
      &clk_src_sel=SRC_SEL TODO.
      &clk_src_div=20.
      &clk_m_val=1.
      &clk_n_val=20.
      &clk_2d_val=20.
      
      gosub Set_Clock_Freq
      return
    )
    else if ("&clk_desired_freq"=="1.536")
    (
      &clk_src_name="LPAAUDIO_DIG_PLL_OUT_AUX"
      &clk_src_sel=SRC_SEL TODO.
      &clk_src_div=32.
      &clk_m_val=1.
      &clk_n_val=5.
      &clk_2d_val=5.
      
      gosub Set_Clock_Freq
      return
    )
    else if ("&clk_desired_freq"=="2.048")
    (
      &clk_src_name="LPAAUDIO_DIG_PLL_OUT_AUX"
      &clk_src_sel=SRC_SEL TODO.
      &clk_src_div=30.
      &clk_m_val=1.
      &clk_n_val=4.
      &clk_2d_val=4.
      
      gosub Set_Clock_Freq
      return
    )
    else if ("&clk_desired_freq"=="2.8224")
    (
      &clk_src_name="LPAAUDIO_PLL_CLK_DIV_CDIV"
      &clk_src_sel=SRC_SEL TODO.
      &clk_src_div=20.
      &clk_m_val=1.
      &clk_n_val=10.
      &clk_2d_val=10.
      
      gosub Set_Clock_Freq
      return
    )
    else if ("&clk_desired_freq"=="3.072")
    (
      &clk_src_name="LPAAUDIO_DIG_PLL_OUT_AUX"
      &clk_src_sel=SRC_SEL TODO.
      &clk_src_div=20.
      &clk_m_val=1.
      &clk_n_val=4.
      &clk_2d_val=4.
      
      gosub Set_Clock_Freq
      return
    )
    else if ("&clk_desired_freq"=="4.096")
    (
      &clk_src_name="LPAAUDIO_DIG_PLL_OUT_AUX"
      &clk_src_sel=SRC_SEL TODO.
      &clk_src_div=30.
      &clk_m_val=1.
      &clk_n_val=2.
      &clk_2d_val=2.
      
      gosub Set_Clock_Freq
      return
    )
    else if ("&clk_desired_freq"=="5.6448")
    (
      &clk_src_name="LPAAUDIO_PLL_CLK_DIV_CDIV"
      &clk_src_sel=SRC_SEL TODO.
      &clk_src_div=20.
      &clk_m_val=1.
      &clk_n_val=5.
      &clk_2d_val=5.
      
      gosub Set_Clock_Freq
      return
    )
    else if ("&clk_desired_freq"=="6.144")
    (
      &clk_src_name="LPAAUDIO_DIG_PLL_OUT_AUX"
      &clk_src_sel=SRC_SEL TODO.
      &clk_src_div=20.
      &clk_m_val=1.
      &clk_n_val=2.
      &clk_2d_val=2.
      
      gosub Set_Clock_Freq
      return
    )
    else if ("&clk_desired_freq"=="8.192")
    (
      &clk_src_name="LPAAUDIO_DIG_PLL_OUT_AUX"
      &clk_src_sel=SRC_SEL TODO.
      &clk_src_div=30.
      &clk_m_val=0.
      &clk_n_val=0.
      &clk_2d_val=0.
      
      gosub Set_Clock_Freq
      return
    )
    else if ("&clk_desired_freq"=="9.6")
    (
      &clk_src_name="XO"
      &clk_src_sel=SRC_SEL TODO.
      &clk_src_div=4.
      &clk_m_val=0.
      &clk_n_val=0.
      &clk_2d_val=0.
      
      gosub Set_Clock_Freq
      return
    )
    else if ("&clk_desired_freq"=="11.2896")
    (
      &clk_src_name="LPAAUDIO_PLL_CLK_DIV_CDIV"
      &clk_src_sel=SRC_SEL TODO.
      &clk_src_div=10.
      &clk_m_val=1.
      &clk_n_val=5.
      &clk_2d_val=5.
      
      gosub Set_Clock_Freq
      return
    )
    else if ("&clk_desired_freq"=="12.288")
    (
      &clk_src_name="LPAAUDIO_DIG_PLL_OUT_AUX"
      &clk_src_sel=SRC_SEL TODO.
      &clk_src_div=20.
      &clk_m_val=0.
      &clk_n_val=0.
      &clk_2d_val=0.
      
      gosub Set_Clock_Freq
      return
    )
    else if ("&clk_desired_freq"=="15.36")
    (
      &clk_src_name="LPAAUDIO_DIG_PLL_OUT_AUX"
      &clk_src_sel=SRC_SEL TODO.
      &clk_src_div=16.
      &clk_m_val=0.
      &clk_n_val=0.
      &clk_2d_val=0.
      
      gosub Set_Clock_Freq
      return
    )
    else if ("&clk_desired_freq"=="24.576")
    (
      &clk_src_name="LPAAUDIO_DIG_PLL_OUT_AUX"
      &clk_src_sel=SRC_SEL TODO.
      &clk_src_div=10.
      &clk_m_val=0.
      &clk_n_val=0.
      &clk_2d_val=0.
      
      gosub Set_Clock_Freq
      return
    )
    else if ("&clk_desired_freq"=="r")
    (
      return
    )
    else
    (
      print "Invalid selection."
      goto Set_Clock_Freq_Enter
    )
  )

  if ("&clk"=="audio_core_int_mclk0_clk")
  (
    gosub PRINT_SET_CLOCK_FREQ_WARNING

    &clk_cmd_rcgr_addr=&HWIO_LPASS_INT_MCLK0_CMD_RCGR_ADDR
    &clk_cfg_rcgr_addr=&HWIO_LPASS_INT_MCLK0_CFG_RCGR_ADDR

    print "Choose frequency (MHz) from list below: " 

    print "0.3528         0.512          0.7056         " 
    print "0.768          1.024          1.4112         " 
    print "1.536          2.048          2.8224         " 
    print "3.072          4.096          5.6448         " 
    print "6.144          8.192          9.6            " 
    print "11.2896        12.288         15.36          " 
    print "24.576         " 

    print " "
    print "Enter desired frequency (r to return): "
    enter &clk_desired_freq
    print " "

    if ("&clk_desired_freq"=="0.3528")
    (
      &clk_src_name="LPAAUDIO_PLL_CLK_DIV_CDIV"
      &clk_src_sel=SRC_SEL TODO.
      &clk_src_div=32.
      &clk_m_val=1.
      &clk_n_val=50.
      &clk_2d_val=50.
      
      gosub Set_Clock_Freq
      return
    )
    else if ("&clk_desired_freq"=="0.512")
    (
      &clk_src_name="LPAAUDIO_DIG_PLL_OUT_AUX"
      &clk_src_sel=SRC_SEL TODO.
      &clk_src_div=32.
      &clk_m_val=1.
      &clk_n_val=15.
      &clk_2d_val=15.
      
      gosub Set_Clock_Freq
      return
    )
    else if ("&clk_desired_freq"=="0.7056")
    (
      &clk_src_name="LPAAUDIO_PLL_CLK_DIV_CDIV"
      &clk_src_sel=SRC_SEL TODO.
      &clk_src_div=32.
      &clk_m_val=1.
      &clk_n_val=25.
      &clk_2d_val=25.
      
      gosub Set_Clock_Freq
      return
    )
    else if ("&clk_desired_freq"=="0.768")
    (
      &clk_src_name="LPAAUDIO_DIG_PLL_OUT_AUX"
      &clk_src_sel=SRC_SEL TODO.
      &clk_src_div=32.
      &clk_m_val=1.
      &clk_n_val=10.
      &clk_2d_val=10.
      
      gosub Set_Clock_Freq
      return
    )
    else if ("&clk_desired_freq"=="1.024")
    (
      &clk_src_name="LPAAUDIO_DIG_PLL_OUT_AUX"
      &clk_src_sel=SRC_SEL TODO.
      &clk_src_div=30.
      &clk_m_val=1.
      &clk_n_val=8.
      &clk_2d_val=8.
      
      gosub Set_Clock_Freq
      return
    )
    else if ("&clk_desired_freq"=="1.4112")
    (
      &clk_src_name="LPAAUDIO_PLL_CLK_DIV_CDIV"
      &clk_src_sel=SRC_SEL TODO.
      &clk_src_div=20.
      &clk_m_val=1.
      &clk_n_val=20.
      &clk_2d_val=20.
      
      gosub Set_Clock_Freq
      return
    )
    else if ("&clk_desired_freq"=="1.536")
    (
      &clk_src_name="LPAAUDIO_DIG_PLL_OUT_AUX"
      &clk_src_sel=SRC_SEL TODO.
      &clk_src_div=32.
      &clk_m_val=1.
      &clk_n_val=5.
      &clk_2d_val=5.
      
      gosub Set_Clock_Freq
      return
    )
    else if ("&clk_desired_freq"=="2.048")
    (
      &clk_src_name="LPAAUDIO_DIG_PLL_OUT_AUX"
      &clk_src_sel=SRC_SEL TODO.
      &clk_src_div=30.
      &clk_m_val=1.
      &clk_n_val=4.
      &clk_2d_val=4.
      
      gosub Set_Clock_Freq
      return
    )
    else if ("&clk_desired_freq"=="2.8224")
    (
      &clk_src_name="LPAAUDIO_PLL_CLK_DIV_CDIV"
      &clk_src_sel=SRC_SEL TODO.
      &clk_src_div=20.
      &clk_m_val=1.
      &clk_n_val=10.
      &clk_2d_val=10.
      
      gosub Set_Clock_Freq
      return
    )
    else if ("&clk_desired_freq"=="3.072")
    (
      &clk_src_name="LPAAUDIO_DIG_PLL_OUT_AUX"
      &clk_src_sel=SRC_SEL TODO.
      &clk_src_div=20.
      &clk_m_val=1.
      &clk_n_val=4.
      &clk_2d_val=4.
      
      gosub Set_Clock_Freq
      return
    )
    else if ("&clk_desired_freq"=="4.096")
    (
      &clk_src_name="LPAAUDIO_DIG_PLL_OUT_AUX"
      &clk_src_sel=SRC_SEL TODO.
      &clk_src_div=30.
      &clk_m_val=1.
      &clk_n_val=2.
      &clk_2d_val=2.
      
      gosub Set_Clock_Freq
      return
    )
    else if ("&clk_desired_freq"=="5.6448")
    (
      &clk_src_name="LPAAUDIO_PLL_CLK_DIV_CDIV"
      &clk_src_sel=SRC_SEL TODO.
      &clk_src_div=20.
      &clk_m_val=1.
      &clk_n_val=5.
      &clk_2d_val=5.
      
      gosub Set_Clock_Freq
      return
    )
    else if ("&clk_desired_freq"=="6.144")
    (
      &clk_src_name="LPAAUDIO_DIG_PLL_OUT_AUX"
      &clk_src_sel=SRC_SEL TODO.
      &clk_src_div=20.
      &clk_m_val=1.
      &clk_n_val=2.
      &clk_2d_val=2.
      
      gosub Set_Clock_Freq
      return
    )
    else if ("&clk_desired_freq"=="8.192")
    (
      &clk_src_name="LPAAUDIO_DIG_PLL_OUT_AUX"
      &clk_src_sel=SRC_SEL TODO.
      &clk_src_div=30.
      &clk_m_val=0.
      &clk_n_val=0.
      &clk_2d_val=0.
      
      gosub Set_Clock_Freq
      return
    )
    else if ("&clk_desired_freq"=="9.6")
    (
      &clk_src_name="XO"
      &clk_src_sel=SRC_SEL TODO.
      &clk_src_div=4.
      &clk_m_val=0.
      &clk_n_val=0.
      &clk_2d_val=0.
      
      gosub Set_Clock_Freq
      return
    )
    else if ("&clk_desired_freq"=="11.2896")
    (
      &clk_src_name="LPAAUDIO_PLL_CLK_DIV_CDIV"
      &clk_src_sel=SRC_SEL TODO.
      &clk_src_div=10.
      &clk_m_val=1.
      &clk_n_val=5.
      &clk_2d_val=5.
      
      gosub Set_Clock_Freq
      return
    )
    else if ("&clk_desired_freq"=="12.288")
    (
      &clk_src_name="LPAAUDIO_DIG_PLL_OUT_AUX"
      &clk_src_sel=SRC_SEL TODO.
      &clk_src_div=20.
      &clk_m_val=0.
      &clk_n_val=0.
      &clk_2d_val=0.
      
      gosub Set_Clock_Freq
      return
    )
    else if ("&clk_desired_freq"=="15.36")
    (
      &clk_src_name="LPAAUDIO_DIG_PLL_OUT_AUX"
      &clk_src_sel=SRC_SEL TODO.
      &clk_src_div=16.
      &clk_m_val=0.
      &clk_n_val=0.
      &clk_2d_val=0.
      
      gosub Set_Clock_Freq
      return
    )
    else if ("&clk_desired_freq"=="24.576")
    (
      &clk_src_name="LPAAUDIO_DIG_PLL_OUT_AUX"
      &clk_src_sel=SRC_SEL TODO.
      &clk_src_div=10.
      &clk_m_val=0.
      &clk_n_val=0.
      &clk_2d_val=0.
      
      gosub Set_Clock_Freq
      return
    )
    else if ("&clk_desired_freq"=="r")
    (
      return
    )
    else
    (
      print "Invalid selection."
      goto Set_Clock_Freq_Enter
    )
  )

  if ("&clk"=="audio_core_int_mclk1_clk")
  (
    gosub PRINT_SET_CLOCK_FREQ_WARNING

    &clk_cmd_rcgr_addr=&HWIO_LPASS_INT_MCLK1_CMD_RCGR_ADDR
    &clk_cfg_rcgr_addr=&HWIO_LPASS_INT_MCLK1_CFG_RCGR_ADDR

    print "Choose frequency (MHz) from list below: " 

    print "0.3528         0.512          0.7056         " 
    print "0.768          1.024          1.4112         " 
    print "1.536          2.048          2.8224         " 
    print "3.072          4.096          5.6448         " 
    print "6.144          8.192          9.6            " 
    print "11.2896        12.288         15.36          " 
    print "24.576         " 

    print " "
    print "Enter desired frequency (r to return): "
    enter &clk_desired_freq
    print " "

    if ("&clk_desired_freq"=="0.3528")
    (
      &clk_src_name="LPAAUDIO_PLL_CLK_DIV_CDIV"
      &clk_src_sel=SRC_SEL TODO.
      &clk_src_div=32.
      &clk_m_val=1.
      &clk_n_val=50.
      &clk_2d_val=50.
      
      gosub Set_Clock_Freq
      return
    )
    else if ("&clk_desired_freq"=="0.512")
    (
      &clk_src_name="LPAAUDIO_DIG_PLL_OUT_AUX"
      &clk_src_sel=SRC_SEL TODO.
      &clk_src_div=32.
      &clk_m_val=1.
      &clk_n_val=15.
      &clk_2d_val=15.
      
      gosub Set_Clock_Freq
      return
    )
    else if ("&clk_desired_freq"=="0.7056")
    (
      &clk_src_name="LPAAUDIO_PLL_CLK_DIV_CDIV"
      &clk_src_sel=SRC_SEL TODO.
      &clk_src_div=32.
      &clk_m_val=1.
      &clk_n_val=25.
      &clk_2d_val=25.
      
      gosub Set_Clock_Freq
      return
    )
    else if ("&clk_desired_freq"=="0.768")
    (
      &clk_src_name="LPAAUDIO_DIG_PLL_OUT_AUX"
      &clk_src_sel=SRC_SEL TODO.
      &clk_src_div=32.
      &clk_m_val=1.
      &clk_n_val=10.
      &clk_2d_val=10.
      
      gosub Set_Clock_Freq
      return
    )
    else if ("&clk_desired_freq"=="1.024")
    (
      &clk_src_name="LPAAUDIO_DIG_PLL_OUT_AUX"
      &clk_src_sel=SRC_SEL TODO.
      &clk_src_div=30.
      &clk_m_val=1.
      &clk_n_val=8.
      &clk_2d_val=8.
      
      gosub Set_Clock_Freq
      return
    )
    else if ("&clk_desired_freq"=="1.4112")
    (
      &clk_src_name="LPAAUDIO_PLL_CLK_DIV_CDIV"
      &clk_src_sel=SRC_SEL TODO.
      &clk_src_div=20.
      &clk_m_val=1.
      &clk_n_val=20.
      &clk_2d_val=20.
      
      gosub Set_Clock_Freq
      return
    )
    else if ("&clk_desired_freq"=="1.536")
    (
      &clk_src_name="LPAAUDIO_DIG_PLL_OUT_AUX"
      &clk_src_sel=SRC_SEL TODO.
      &clk_src_div=32.
      &clk_m_val=1.
      &clk_n_val=5.
      &clk_2d_val=5.
      
      gosub Set_Clock_Freq
      return
    )
    else if ("&clk_desired_freq"=="2.048")
    (
      &clk_src_name="LPAAUDIO_DIG_PLL_OUT_AUX"
      &clk_src_sel=SRC_SEL TODO.
      &clk_src_div=30.
      &clk_m_val=1.
      &clk_n_val=4.
      &clk_2d_val=4.
      
      gosub Set_Clock_Freq
      return
    )
    else if ("&clk_desired_freq"=="2.8224")
    (
      &clk_src_name="LPAAUDIO_PLL_CLK_DIV_CDIV"
      &clk_src_sel=SRC_SEL TODO.
      &clk_src_div=20.
      &clk_m_val=1.
      &clk_n_val=10.
      &clk_2d_val=10.
      
      gosub Set_Clock_Freq
      return
    )
    else if ("&clk_desired_freq"=="3.072")
    (
      &clk_src_name="LPAAUDIO_DIG_PLL_OUT_AUX"
      &clk_src_sel=SRC_SEL TODO.
      &clk_src_div=20.
      &clk_m_val=1.
      &clk_n_val=4.
      &clk_2d_val=4.
      
      gosub Set_Clock_Freq
      return
    )
    else if ("&clk_desired_freq"=="4.096")
    (
      &clk_src_name="LPAAUDIO_DIG_PLL_OUT_AUX"
      &clk_src_sel=SRC_SEL TODO.
      &clk_src_div=30.
      &clk_m_val=1.
      &clk_n_val=2.
      &clk_2d_val=2.
      
      gosub Set_Clock_Freq
      return
    )
    else if ("&clk_desired_freq"=="5.6448")
    (
      &clk_src_name="LPAAUDIO_PLL_CLK_DIV_CDIV"
      &clk_src_sel=SRC_SEL TODO.
      &clk_src_div=20.
      &clk_m_val=1.
      &clk_n_val=5.
      &clk_2d_val=5.
      
      gosub Set_Clock_Freq
      return
    )
    else if ("&clk_desired_freq"=="6.144")
    (
      &clk_src_name="LPAAUDIO_DIG_PLL_OUT_AUX"
      &clk_src_sel=SRC_SEL TODO.
      &clk_src_div=20.
      &clk_m_val=1.
      &clk_n_val=2.
      &clk_2d_val=2.
      
      gosub Set_Clock_Freq
      return
    )
    else if ("&clk_desired_freq"=="8.192")
    (
      &clk_src_name="LPAAUDIO_DIG_PLL_OUT_AUX"
      &clk_src_sel=SRC_SEL TODO.
      &clk_src_div=30.
      &clk_m_val=0.
      &clk_n_val=0.
      &clk_2d_val=0.
      
      gosub Set_Clock_Freq
      return
    )
    else if ("&clk_desired_freq"=="9.6")
    (
      &clk_src_name="XO"
      &clk_src_sel=SRC_SEL TODO.
      &clk_src_div=4.
      &clk_m_val=0.
      &clk_n_val=0.
      &clk_2d_val=0.
      
      gosub Set_Clock_Freq
      return
    )
    else if ("&clk_desired_freq"=="11.2896")
    (
      &clk_src_name="LPAAUDIO_PLL_CLK_DIV_CDIV"
      &clk_src_sel=SRC_SEL TODO.
      &clk_src_div=10.
      &clk_m_val=1.
      &clk_n_val=5.
      &clk_2d_val=5.
      
      gosub Set_Clock_Freq
      return
    )
    else if ("&clk_desired_freq"=="12.288")
    (
      &clk_src_name="LPAAUDIO_DIG_PLL_OUT_AUX"
      &clk_src_sel=SRC_SEL TODO.
      &clk_src_div=20.
      &clk_m_val=0.
      &clk_n_val=0.
      &clk_2d_val=0.
      
      gosub Set_Clock_Freq
      return
    )
    else if ("&clk_desired_freq"=="15.36")
    (
      &clk_src_name="LPAAUDIO_DIG_PLL_OUT_AUX"
      &clk_src_sel=SRC_SEL TODO.
      &clk_src_div=16.
      &clk_m_val=0.
      &clk_n_val=0.
      &clk_2d_val=0.
      
      gosub Set_Clock_Freq
      return
    )
    else if ("&clk_desired_freq"=="24.576")
    (
      &clk_src_name="LPAAUDIO_DIG_PLL_OUT_AUX"
      &clk_src_sel=SRC_SEL TODO.
      &clk_src_div=10.
      &clk_m_val=0.
      &clk_n_val=0.
      &clk_2d_val=0.
      
      gosub Set_Clock_Freq
      return
    )
    else if ("&clk_desired_freq"=="r")
    (
      return
    )
    else
    (
      print "Invalid selection."
      goto Set_Clock_Freq_Enter
    )
  )

  if ("&clk"=="lpaif_pcmoe_clk_src")||("&clk"=="audio_core_lpaif_pcm_data_oe_clk")
  (
    gosub PRINT_SET_CLOCK_FREQ_WARNING

    &clk_cmd_rcgr_addr=&HWIO_LPASS_LPAIF_PCMOE_CMD_RCGR_ADDR
    &clk_cfg_rcgr_addr=&HWIO_LPASS_LPAIF_PCMOE_CFG_RCGR_ADDR

    print "Choose frequency (MHz) from list below: " 

    print "0.3528         0.512          0.7056         " 
    print "0.768          1.024          1.4112         " 
    print "1.536          2.048          2.8224         " 
    print "3.072          4.096          5.6448         " 
    print "6.144          8.192          9.6            " 
    print "11.2896        12.288         15.36          " 
    print "24.576         " 

    print " "
    print "Enter desired frequency (r to return): "
    enter &clk_desired_freq
    print " "

    if ("&clk_desired_freq"=="0.3528")
    (
      &clk_src_name="LPAAUDIO_PLL_CLK_DIV_CDIV"
      &clk_src_sel=SRC_SEL TODO.
      &clk_src_div=32.
      &clk_m_val=1.
      &clk_n_val=50.
      &clk_2d_val=50.
      
      gosub Set_Clock_Freq
      return
    )
    else if ("&clk_desired_freq"=="0.512")
    (
      &clk_src_name="LPAAUDIO_DIG_PLL_OUT_AUX"
      &clk_src_sel=SRC_SEL TODO.
      &clk_src_div=32.
      &clk_m_val=1.
      &clk_n_val=15.
      &clk_2d_val=15.
      
      gosub Set_Clock_Freq
      return
    )
    else if ("&clk_desired_freq"=="0.7056")
    (
      &clk_src_name="LPAAUDIO_PLL_CLK_DIV_CDIV"
      &clk_src_sel=SRC_SEL TODO.
      &clk_src_div=32.
      &clk_m_val=1.
      &clk_n_val=25.
      &clk_2d_val=25.
      
      gosub Set_Clock_Freq
      return
    )
    else if ("&clk_desired_freq"=="0.768")
    (
      &clk_src_name="LPAAUDIO_DIG_PLL_OUT_AUX"
      &clk_src_sel=SRC_SEL TODO.
      &clk_src_div=32.
      &clk_m_val=1.
      &clk_n_val=10.
      &clk_2d_val=10.
      
      gosub Set_Clock_Freq
      return
    )
    else if ("&clk_desired_freq"=="1.024")
    (
      &clk_src_name="LPAAUDIO_DIG_PLL_OUT_AUX"
      &clk_src_sel=SRC_SEL TODO.
      &clk_src_div=30.
      &clk_m_val=1.
      &clk_n_val=8.
      &clk_2d_val=8.
      
      gosub Set_Clock_Freq
      return
    )
    else if ("&clk_desired_freq"=="1.4112")
    (
      &clk_src_name="LPAAUDIO_PLL_CLK_DIV_CDIV"
      &clk_src_sel=SRC_SEL TODO.
      &clk_src_div=20.
      &clk_m_val=1.
      &clk_n_val=20.
      &clk_2d_val=20.
      
      gosub Set_Clock_Freq
      return
    )
    else if ("&clk_desired_freq"=="1.536")
    (
      &clk_src_name="LPAAUDIO_DIG_PLL_OUT_AUX"
      &clk_src_sel=SRC_SEL TODO.
      &clk_src_div=32.
      &clk_m_val=1.
      &clk_n_val=5.
      &clk_2d_val=5.
      
      gosub Set_Clock_Freq
      return
    )
    else if ("&clk_desired_freq"=="2.048")
    (
      &clk_src_name="LPAAUDIO_DIG_PLL_OUT_AUX"
      &clk_src_sel=SRC_SEL TODO.
      &clk_src_div=30.
      &clk_m_val=1.
      &clk_n_val=4.
      &clk_2d_val=4.
      
      gosub Set_Clock_Freq
      return
    )
    else if ("&clk_desired_freq"=="2.8224")
    (
      &clk_src_name="LPAAUDIO_PLL_CLK_DIV_CDIV"
      &clk_src_sel=SRC_SEL TODO.
      &clk_src_div=20.
      &clk_m_val=1.
      &clk_n_val=10.
      &clk_2d_val=10.
      
      gosub Set_Clock_Freq
      return
    )
    else if ("&clk_desired_freq"=="3.072")
    (
      &clk_src_name="LPAAUDIO_DIG_PLL_OUT_AUX"
      &clk_src_sel=SRC_SEL TODO.
      &clk_src_div=20.
      &clk_m_val=1.
      &clk_n_val=4.
      &clk_2d_val=4.
      
      gosub Set_Clock_Freq
      return
    )
    else if ("&clk_desired_freq"=="4.096")
    (
      &clk_src_name="LPAAUDIO_DIG_PLL_OUT_AUX"
      &clk_src_sel=SRC_SEL TODO.
      &clk_src_div=30.
      &clk_m_val=1.
      &clk_n_val=2.
      &clk_2d_val=2.
      
      gosub Set_Clock_Freq
      return
    )
    else if ("&clk_desired_freq"=="5.6448")
    (
      &clk_src_name="LPAAUDIO_PLL_CLK_DIV_CDIV"
      &clk_src_sel=SRC_SEL TODO.
      &clk_src_div=20.
      &clk_m_val=1.
      &clk_n_val=5.
      &clk_2d_val=5.
      
      gosub Set_Clock_Freq
      return
    )
    else if ("&clk_desired_freq"=="6.144")
    (
      &clk_src_name="LPAAUDIO_DIG_PLL_OUT_AUX"
      &clk_src_sel=SRC_SEL TODO.
      &clk_src_div=20.
      &clk_m_val=1.
      &clk_n_val=2.
      &clk_2d_val=2.
      
      gosub Set_Clock_Freq
      return
    )
    else if ("&clk_desired_freq"=="8.192")
    (
      &clk_src_name="LPAAUDIO_DIG_PLL_OUT_AUX"
      &clk_src_sel=SRC_SEL TODO.
      &clk_src_div=30.
      &clk_m_val=0.
      &clk_n_val=0.
      &clk_2d_val=0.
      
      gosub Set_Clock_Freq
      return
    )
    else if ("&clk_desired_freq"=="9.6")
    (
      &clk_src_name="XO"
      &clk_src_sel=SRC_SEL TODO.
      &clk_src_div=4.
      &clk_m_val=0.
      &clk_n_val=0.
      &clk_2d_val=0.
      
      gosub Set_Clock_Freq
      return
    )
    else if ("&clk_desired_freq"=="11.2896")
    (
      &clk_src_name="LPAAUDIO_PLL_CLK_DIV_CDIV"
      &clk_src_sel=SRC_SEL TODO.
      &clk_src_div=10.
      &clk_m_val=1.
      &clk_n_val=5.
      &clk_2d_val=5.
      
      gosub Set_Clock_Freq
      return
    )
    else if ("&clk_desired_freq"=="12.288")
    (
      &clk_src_name="LPAAUDIO_DIG_PLL_OUT_AUX"
      &clk_src_sel=SRC_SEL TODO.
      &clk_src_div=20.
      &clk_m_val=0.
      &clk_n_val=0.
      &clk_2d_val=0.
      
      gosub Set_Clock_Freq
      return
    )
    else if ("&clk_desired_freq"=="15.36")
    (
      &clk_src_name="LPAAUDIO_DIG_PLL_OUT_AUX"
      &clk_src_sel=SRC_SEL TODO.
      &clk_src_div=16.
      &clk_m_val=0.
      &clk_n_val=0.
      &clk_2d_val=0.
      
      gosub Set_Clock_Freq
      return
    )
    else if ("&clk_desired_freq"=="24.576")
    (
      &clk_src_name="LPAAUDIO_DIG_PLL_OUT_AUX"
      &clk_src_sel=SRC_SEL TODO.
      &clk_src_div=10.
      &clk_m_val=0.
      &clk_n_val=0.
      &clk_2d_val=0.
      
      gosub Set_Clock_Freq
      return
    )
    else if ("&clk_desired_freq"=="r")
    (
      return
    )
    else
    (
      print "Invalid selection."
      goto Set_Clock_Freq_Enter
    )
  )

  if ("&clk"=="lpaif_pri_clk_src")||("&clk"=="audio_core_lpaif_pri_ibit_clk")
  (
    gosub PRINT_SET_CLOCK_FREQ_WARNING

    &clk_cmd_rcgr_addr=&HWIO_LPASS_LPAIF_PRI_CMD_RCGR_ADDR
    &clk_cfg_rcgr_addr=&HWIO_LPASS_LPAIF_PRI_CFG_RCGR_ADDR

    print "Choose frequency (MHz) from list below: " 

    print "0.3528         0.512          0.7056         " 
    print "0.768          1.024          1.4112         " 
    print "1.536          2.048          2.8224         " 
    print "3.072          4.096          5.6448         " 
    print "6.144          8.192          9.6            " 
    print "11.2896        12.288         15.36          " 
    print "24.576         " 

    print " "
    print "Enter desired frequency (r to return): "
    enter &clk_desired_freq
    print " "

    if ("&clk_desired_freq"=="0.3528")
    (
      &clk_src_name="LPAAUDIO_PLL_CLK_DIV_CDIV"
      &clk_src_sel=SRC_SEL TODO.
      &clk_src_div=32.
      &clk_m_val=1.
      &clk_n_val=50.
      &clk_2d_val=50.
      
      gosub Set_Clock_Freq
      return
    )
    else if ("&clk_desired_freq"=="0.512")
    (
      &clk_src_name="LPAAUDIO_DIG_PLL_OUT_AUX"
      &clk_src_sel=SRC_SEL TODO.
      &clk_src_div=32.
      &clk_m_val=1.
      &clk_n_val=15.
      &clk_2d_val=15.
      
      gosub Set_Clock_Freq
      return
    )
    else if ("&clk_desired_freq"=="0.7056")
    (
      &clk_src_name="LPAAUDIO_PLL_CLK_DIV_CDIV"
      &clk_src_sel=SRC_SEL TODO.
      &clk_src_div=32.
      &clk_m_val=1.
      &clk_n_val=25.
      &clk_2d_val=25.
      
      gosub Set_Clock_Freq
      return
    )
    else if ("&clk_desired_freq"=="0.768")
    (
      &clk_src_name="LPAAUDIO_DIG_PLL_OUT_AUX"
      &clk_src_sel=SRC_SEL TODO.
      &clk_src_div=32.
      &clk_m_val=1.
      &clk_n_val=10.
      &clk_2d_val=10.
      
      gosub Set_Clock_Freq
      return
    )
    else if ("&clk_desired_freq"=="1.024")
    (
      &clk_src_name="LPAAUDIO_DIG_PLL_OUT_AUX"
      &clk_src_sel=SRC_SEL TODO.
      &clk_src_div=30.
      &clk_m_val=1.
      &clk_n_val=8.
      &clk_2d_val=8.
      
      gosub Set_Clock_Freq
      return
    )
    else if ("&clk_desired_freq"=="1.4112")
    (
      &clk_src_name="LPAAUDIO_PLL_CLK_DIV_CDIV"
      &clk_src_sel=SRC_SEL TODO.
      &clk_src_div=20.
      &clk_m_val=1.
      &clk_n_val=20.
      &clk_2d_val=20.
      
      gosub Set_Clock_Freq
      return
    )
    else if ("&clk_desired_freq"=="1.536")
    (
      &clk_src_name="LPAAUDIO_DIG_PLL_OUT_AUX"
      &clk_src_sel=SRC_SEL TODO.
      &clk_src_div=32.
      &clk_m_val=1.
      &clk_n_val=5.
      &clk_2d_val=5.
      
      gosub Set_Clock_Freq
      return
    )
    else if ("&clk_desired_freq"=="2.048")
    (
      &clk_src_name="LPAAUDIO_DIG_PLL_OUT_AUX"
      &clk_src_sel=SRC_SEL TODO.
      &clk_src_div=30.
      &clk_m_val=1.
      &clk_n_val=4.
      &clk_2d_val=4.
      
      gosub Set_Clock_Freq
      return
    )
    else if ("&clk_desired_freq"=="2.8224")
    (
      &clk_src_name="LPAAUDIO_PLL_CLK_DIV_CDIV"
      &clk_src_sel=SRC_SEL TODO.
      &clk_src_div=20.
      &clk_m_val=1.
      &clk_n_val=10.
      &clk_2d_val=10.
      
      gosub Set_Clock_Freq
      return
    )
    else if ("&clk_desired_freq"=="3.072")
    (
      &clk_src_name="LPAAUDIO_DIG_PLL_OUT_AUX"
      &clk_src_sel=SRC_SEL TODO.
      &clk_src_div=20.
      &clk_m_val=1.
      &clk_n_val=4.
      &clk_2d_val=4.
      
      gosub Set_Clock_Freq
      return
    )
    else if ("&clk_desired_freq"=="4.096")
    (
      &clk_src_name="LPAAUDIO_DIG_PLL_OUT_AUX"
      &clk_src_sel=SRC_SEL TODO.
      &clk_src_div=30.
      &clk_m_val=1.
      &clk_n_val=2.
      &clk_2d_val=2.
      
      gosub Set_Clock_Freq
      return
    )
    else if ("&clk_desired_freq"=="5.6448")
    (
      &clk_src_name="LPAAUDIO_PLL_CLK_DIV_CDIV"
      &clk_src_sel=SRC_SEL TODO.
      &clk_src_div=20.
      &clk_m_val=1.
      &clk_n_val=5.
      &clk_2d_val=5.
      
      gosub Set_Clock_Freq
      return
    )
    else if ("&clk_desired_freq"=="6.144")
    (
      &clk_src_name="LPAAUDIO_DIG_PLL_OUT_AUX"
      &clk_src_sel=SRC_SEL TODO.
      &clk_src_div=20.
      &clk_m_val=1.
      &clk_n_val=2.
      &clk_2d_val=2.
      
      gosub Set_Clock_Freq
      return
    )
    else if ("&clk_desired_freq"=="8.192")
    (
      &clk_src_name="LPAAUDIO_DIG_PLL_OUT_AUX"
      &clk_src_sel=SRC_SEL TODO.
      &clk_src_div=30.
      &clk_m_val=0.
      &clk_n_val=0.
      &clk_2d_val=0.
      
      gosub Set_Clock_Freq
      return
    )
    else if ("&clk_desired_freq"=="9.6")
    (
      &clk_src_name="XO"
      &clk_src_sel=SRC_SEL TODO.
      &clk_src_div=4.
      &clk_m_val=0.
      &clk_n_val=0.
      &clk_2d_val=0.
      
      gosub Set_Clock_Freq
      return
    )
    else if ("&clk_desired_freq"=="11.2896")
    (
      &clk_src_name="LPAAUDIO_PLL_CLK_DIV_CDIV"
      &clk_src_sel=SRC_SEL TODO.
      &clk_src_div=10.
      &clk_m_val=1.
      &clk_n_val=5.
      &clk_2d_val=5.
      
      gosub Set_Clock_Freq
      return
    )
    else if ("&clk_desired_freq"=="12.288")
    (
      &clk_src_name="LPAAUDIO_DIG_PLL_OUT_AUX"
      &clk_src_sel=SRC_SEL TODO.
      &clk_src_div=20.
      &clk_m_val=0.
      &clk_n_val=0.
      &clk_2d_val=0.
      
      gosub Set_Clock_Freq
      return
    )
    else if ("&clk_desired_freq"=="15.36")
    (
      &clk_src_name="LPAAUDIO_DIG_PLL_OUT_AUX"
      &clk_src_sel=SRC_SEL TODO.
      &clk_src_div=16.
      &clk_m_val=0.
      &clk_n_val=0.
      &clk_2d_val=0.
      
      gosub Set_Clock_Freq
      return
    )
    else if ("&clk_desired_freq"=="24.576")
    (
      &clk_src_name="LPAAUDIO_DIG_PLL_OUT_AUX"
      &clk_src_sel=SRC_SEL TODO.
      &clk_src_div=10.
      &clk_m_val=0.
      &clk_n_val=0.
      &clk_2d_val=0.
      
      gosub Set_Clock_Freq
      return
    )
    else if ("&clk_desired_freq"=="r")
    (
      return
    )
    else
    (
      print "Invalid selection."
      goto Set_Clock_Freq_Enter
    )
  )

  if ("&clk"=="lpaif_quad_clk_src")||("&clk"=="audio_core_lpaif_quad_ibit_clk")
  (
    gosub PRINT_SET_CLOCK_FREQ_WARNING

    &clk_cmd_rcgr_addr=&HWIO_LPASS_LPAIF_QUAD_CMD_RCGR_ADDR
    &clk_cfg_rcgr_addr=&HWIO_LPASS_LPAIF_QUAD_CFG_RCGR_ADDR

    print "Choose frequency (MHz) from list below: " 

    print "0.3528         0.512          0.7056         " 
    print "0.768          1.024          1.4112         " 
    print "1.536          2.048          2.8224         " 
    print "3.072          4.096          5.6448         " 
    print "6.144          8.192          9.6            " 
    print "11.2896        12.288         15.36          " 
    print "24.576         " 

    print " "
    print "Enter desired frequency (r to return): "
    enter &clk_desired_freq
    print " "

    if ("&clk_desired_freq"=="0.3528")
    (
      &clk_src_name="LPAAUDIO_PLL_CLK_DIV_CDIV"
      &clk_src_sel=SRC_SEL TODO.
      &clk_src_div=32.
      &clk_m_val=1.
      &clk_n_val=50.
      &clk_2d_val=50.
      
      gosub Set_Clock_Freq
      return
    )
    else if ("&clk_desired_freq"=="0.512")
    (
      &clk_src_name="LPAAUDIO_DIG_PLL_OUT_AUX"
      &clk_src_sel=SRC_SEL TODO.
      &clk_src_div=32.
      &clk_m_val=1.
      &clk_n_val=15.
      &clk_2d_val=15.
      
      gosub Set_Clock_Freq
      return
    )
    else if ("&clk_desired_freq"=="0.7056")
    (
      &clk_src_name="LPAAUDIO_PLL_CLK_DIV_CDIV"
      &clk_src_sel=SRC_SEL TODO.
      &clk_src_div=32.
      &clk_m_val=1.
      &clk_n_val=25.
      &clk_2d_val=25.
      
      gosub Set_Clock_Freq
      return
    )
    else if ("&clk_desired_freq"=="0.768")
    (
      &clk_src_name="LPAAUDIO_DIG_PLL_OUT_AUX"
      &clk_src_sel=SRC_SEL TODO.
      &clk_src_div=32.
      &clk_m_val=1.
      &clk_n_val=10.
      &clk_2d_val=10.
      
      gosub Set_Clock_Freq
      return
    )
    else if ("&clk_desired_freq"=="1.024")
    (
      &clk_src_name="LPAAUDIO_DIG_PLL_OUT_AUX"
      &clk_src_sel=SRC_SEL TODO.
      &clk_src_div=30.
      &clk_m_val=1.
      &clk_n_val=8.
      &clk_2d_val=8.
      
      gosub Set_Clock_Freq
      return
    )
    else if ("&clk_desired_freq"=="1.4112")
    (
      &clk_src_name="LPAAUDIO_PLL_CLK_DIV_CDIV"
      &clk_src_sel=SRC_SEL TODO.
      &clk_src_div=20.
      &clk_m_val=1.
      &clk_n_val=20.
      &clk_2d_val=20.
      
      gosub Set_Clock_Freq
      return
    )
    else if ("&clk_desired_freq"=="1.536")
    (
      &clk_src_name="LPAAUDIO_DIG_PLL_OUT_AUX"
      &clk_src_sel=SRC_SEL TODO.
      &clk_src_div=32.
      &clk_m_val=1.
      &clk_n_val=5.
      &clk_2d_val=5.
      
      gosub Set_Clock_Freq
      return
    )
    else if ("&clk_desired_freq"=="2.048")
    (
      &clk_src_name="LPAAUDIO_DIG_PLL_OUT_AUX"
      &clk_src_sel=SRC_SEL TODO.
      &clk_src_div=30.
      &clk_m_val=1.
      &clk_n_val=4.
      &clk_2d_val=4.
      
      gosub Set_Clock_Freq
      return
    )
    else if ("&clk_desired_freq"=="2.8224")
    (
      &clk_src_name="LPAAUDIO_PLL_CLK_DIV_CDIV"
      &clk_src_sel=SRC_SEL TODO.
      &clk_src_div=20.
      &clk_m_val=1.
      &clk_n_val=10.
      &clk_2d_val=10.
      
      gosub Set_Clock_Freq
      return
    )
    else if ("&clk_desired_freq"=="3.072")
    (
      &clk_src_name="LPAAUDIO_DIG_PLL_OUT_AUX"
      &clk_src_sel=SRC_SEL TODO.
      &clk_src_div=20.
      &clk_m_val=1.
      &clk_n_val=4.
      &clk_2d_val=4.
      
      gosub Set_Clock_Freq
      return
    )
    else if ("&clk_desired_freq"=="4.096")
    (
      &clk_src_name="LPAAUDIO_DIG_PLL_OUT_AUX"
      &clk_src_sel=SRC_SEL TODO.
      &clk_src_div=30.
      &clk_m_val=1.
      &clk_n_val=2.
      &clk_2d_val=2.
      
      gosub Set_Clock_Freq
      return
    )
    else if ("&clk_desired_freq"=="5.6448")
    (
      &clk_src_name="LPAAUDIO_PLL_CLK_DIV_CDIV"
      &clk_src_sel=SRC_SEL TODO.
      &clk_src_div=20.
      &clk_m_val=1.
      &clk_n_val=5.
      &clk_2d_val=5.
      
      gosub Set_Clock_Freq
      return
    )
    else if ("&clk_desired_freq"=="6.144")
    (
      &clk_src_name="LPAAUDIO_DIG_PLL_OUT_AUX"
      &clk_src_sel=SRC_SEL TODO.
      &clk_src_div=20.
      &clk_m_val=1.
      &clk_n_val=2.
      &clk_2d_val=2.
      
      gosub Set_Clock_Freq
      return
    )
    else if ("&clk_desired_freq"=="8.192")
    (
      &clk_src_name="LPAAUDIO_DIG_PLL_OUT_AUX"
      &clk_src_sel=SRC_SEL TODO.
      &clk_src_div=30.
      &clk_m_val=0.
      &clk_n_val=0.
      &clk_2d_val=0.
      
      gosub Set_Clock_Freq
      return
    )
    else if ("&clk_desired_freq"=="9.6")
    (
      &clk_src_name="XO"
      &clk_src_sel=SRC_SEL TODO.
      &clk_src_div=4.
      &clk_m_val=0.
      &clk_n_val=0.
      &clk_2d_val=0.
      
      gosub Set_Clock_Freq
      return
    )
    else if ("&clk_desired_freq"=="11.2896")
    (
      &clk_src_name="LPAAUDIO_PLL_CLK_DIV_CDIV"
      &clk_src_sel=SRC_SEL TODO.
      &clk_src_div=10.
      &clk_m_val=1.
      &clk_n_val=5.
      &clk_2d_val=5.
      
      gosub Set_Clock_Freq
      return
    )
    else if ("&clk_desired_freq"=="12.288")
    (
      &clk_src_name="LPAAUDIO_DIG_PLL_OUT_AUX"
      &clk_src_sel=SRC_SEL TODO.
      &clk_src_div=20.
      &clk_m_val=0.
      &clk_n_val=0.
      &clk_2d_val=0.
      
      gosub Set_Clock_Freq
      return
    )
    else if ("&clk_desired_freq"=="15.36")
    (
      &clk_src_name="LPAAUDIO_DIG_PLL_OUT_AUX"
      &clk_src_sel=SRC_SEL TODO.
      &clk_src_div=16.
      &clk_m_val=0.
      &clk_n_val=0.
      &clk_2d_val=0.
      
      gosub Set_Clock_Freq
      return
    )
    else if ("&clk_desired_freq"=="24.576")
    (
      &clk_src_name="LPAAUDIO_DIG_PLL_OUT_AUX"
      &clk_src_sel=SRC_SEL TODO.
      &clk_src_div=10.
      &clk_m_val=0.
      &clk_n_val=0.
      &clk_2d_val=0.
      
      gosub Set_Clock_Freq
      return
    )
    else if ("&clk_desired_freq"=="r")
    (
      return
    )
    else
    (
      print "Invalid selection."
      goto Set_Clock_Freq_Enter
    )
  )

  if ("&clk"=="lpaif_sec_clk_src")||("&clk"=="audio_core_lpaif_sec_ibit_clk")
  (
    gosub PRINT_SET_CLOCK_FREQ_WARNING

    &clk_cmd_rcgr_addr=&HWIO_LPASS_LPAIF_SEC_CMD_RCGR_ADDR
    &clk_cfg_rcgr_addr=&HWIO_LPASS_LPAIF_SEC_CFG_RCGR_ADDR

    print "Choose frequency (MHz) from list below: " 

    print "0.3528         0.512          0.7056         " 
    print "0.768          1.024          1.4112         " 
    print "1.536          2.048          2.8224         " 
    print "3.072          4.096          5.6448         " 
    print "6.144          8.192          9.6            " 
    print "11.2896        12.288         15.36          " 
    print "24.576         " 

    print " "
    print "Enter desired frequency (r to return): "
    enter &clk_desired_freq
    print " "

    if ("&clk_desired_freq"=="0.3528")
    (
      &clk_src_name="LPAAUDIO_PLL_CLK_DIV_CDIV"
      &clk_src_sel=SRC_SEL TODO.
      &clk_src_div=32.
      &clk_m_val=1.
      &clk_n_val=50.
      &clk_2d_val=50.
      
      gosub Set_Clock_Freq
      return
    )
    else if ("&clk_desired_freq"=="0.512")
    (
      &clk_src_name="LPAAUDIO_DIG_PLL_OUT_AUX"
      &clk_src_sel=SRC_SEL TODO.
      &clk_src_div=32.
      &clk_m_val=1.
      &clk_n_val=15.
      &clk_2d_val=15.
      
      gosub Set_Clock_Freq
      return
    )
    else if ("&clk_desired_freq"=="0.7056")
    (
      &clk_src_name="LPAAUDIO_PLL_CLK_DIV_CDIV"
      &clk_src_sel=SRC_SEL TODO.
      &clk_src_div=32.
      &clk_m_val=1.
      &clk_n_val=25.
      &clk_2d_val=25.
      
      gosub Set_Clock_Freq
      return
    )
    else if ("&clk_desired_freq"=="0.768")
    (
      &clk_src_name="LPAAUDIO_DIG_PLL_OUT_AUX"
      &clk_src_sel=SRC_SEL TODO.
      &clk_src_div=32.
      &clk_m_val=1.
      &clk_n_val=10.
      &clk_2d_val=10.
      
      gosub Set_Clock_Freq
      return
    )
    else if ("&clk_desired_freq"=="1.024")
    (
      &clk_src_name="LPAAUDIO_DIG_PLL_OUT_AUX"
      &clk_src_sel=SRC_SEL TODO.
      &clk_src_div=30.
      &clk_m_val=1.
      &clk_n_val=8.
      &clk_2d_val=8.
      
      gosub Set_Clock_Freq
      return
    )
    else if ("&clk_desired_freq"=="1.4112")
    (
      &clk_src_name="LPAAUDIO_PLL_CLK_DIV_CDIV"
      &clk_src_sel=SRC_SEL TODO.
      &clk_src_div=20.
      &clk_m_val=1.
      &clk_n_val=20.
      &clk_2d_val=20.
      
      gosub Set_Clock_Freq
      return
    )
    else if ("&clk_desired_freq"=="1.536")
    (
      &clk_src_name="LPAAUDIO_DIG_PLL_OUT_AUX"
      &clk_src_sel=SRC_SEL TODO.
      &clk_src_div=32.
      &clk_m_val=1.
      &clk_n_val=5.
      &clk_2d_val=5.
      
      gosub Set_Clock_Freq
      return
    )
    else if ("&clk_desired_freq"=="2.048")
    (
      &clk_src_name="LPAAUDIO_DIG_PLL_OUT_AUX"
      &clk_src_sel=SRC_SEL TODO.
      &clk_src_div=30.
      &clk_m_val=1.
      &clk_n_val=4.
      &clk_2d_val=4.
      
      gosub Set_Clock_Freq
      return
    )
    else if ("&clk_desired_freq"=="2.8224")
    (
      &clk_src_name="LPAAUDIO_PLL_CLK_DIV_CDIV"
      &clk_src_sel=SRC_SEL TODO.
      &clk_src_div=20.
      &clk_m_val=1.
      &clk_n_val=10.
      &clk_2d_val=10.
      
      gosub Set_Clock_Freq
      return
    )
    else if ("&clk_desired_freq"=="3.072")
    (
      &clk_src_name="LPAAUDIO_DIG_PLL_OUT_AUX"
      &clk_src_sel=SRC_SEL TODO.
      &clk_src_div=20.
      &clk_m_val=1.
      &clk_n_val=4.
      &clk_2d_val=4.
      
      gosub Set_Clock_Freq
      return
    )
    else if ("&clk_desired_freq"=="4.096")
    (
      &clk_src_name="LPAAUDIO_DIG_PLL_OUT_AUX"
      &clk_src_sel=SRC_SEL TODO.
      &clk_src_div=30.
      &clk_m_val=1.
      &clk_n_val=2.
      &clk_2d_val=2.
      
      gosub Set_Clock_Freq
      return
    )
    else if ("&clk_desired_freq"=="5.6448")
    (
      &clk_src_name="LPAAUDIO_PLL_CLK_DIV_CDIV"
      &clk_src_sel=SRC_SEL TODO.
      &clk_src_div=20.
      &clk_m_val=1.
      &clk_n_val=5.
      &clk_2d_val=5.
      
      gosub Set_Clock_Freq
      return
    )
    else if ("&clk_desired_freq"=="6.144")
    (
      &clk_src_name="LPAAUDIO_DIG_PLL_OUT_AUX"
      &clk_src_sel=SRC_SEL TODO.
      &clk_src_div=20.
      &clk_m_val=1.
      &clk_n_val=2.
      &clk_2d_val=2.
      
      gosub Set_Clock_Freq
      return
    )
    else if ("&clk_desired_freq"=="8.192")
    (
      &clk_src_name="LPAAUDIO_DIG_PLL_OUT_AUX"
      &clk_src_sel=SRC_SEL TODO.
      &clk_src_div=30.
      &clk_m_val=0.
      &clk_n_val=0.
      &clk_2d_val=0.
      
      gosub Set_Clock_Freq
      return
    )
    else if ("&clk_desired_freq"=="9.6")
    (
      &clk_src_name="XO"
      &clk_src_sel=SRC_SEL TODO.
      &clk_src_div=4.
      &clk_m_val=0.
      &clk_n_val=0.
      &clk_2d_val=0.
      
      gosub Set_Clock_Freq
      return
    )
    else if ("&clk_desired_freq"=="11.2896")
    (
      &clk_src_name="LPAAUDIO_PLL_CLK_DIV_CDIV"
      &clk_src_sel=SRC_SEL TODO.
      &clk_src_div=10.
      &clk_m_val=1.
      &clk_n_val=5.
      &clk_2d_val=5.
      
      gosub Set_Clock_Freq
      return
    )
    else if ("&clk_desired_freq"=="12.288")
    (
      &clk_src_name="LPAAUDIO_DIG_PLL_OUT_AUX"
      &clk_src_sel=SRC_SEL TODO.
      &clk_src_div=20.
      &clk_m_val=0.
      &clk_n_val=0.
      &clk_2d_val=0.
      
      gosub Set_Clock_Freq
      return
    )
    else if ("&clk_desired_freq"=="15.36")
    (
      &clk_src_name="LPAAUDIO_DIG_PLL_OUT_AUX"
      &clk_src_sel=SRC_SEL TODO.
      &clk_src_div=16.
      &clk_m_val=0.
      &clk_n_val=0.
      &clk_2d_val=0.
      
      gosub Set_Clock_Freq
      return
    )
    else if ("&clk_desired_freq"=="24.576")
    (
      &clk_src_name="LPAAUDIO_DIG_PLL_OUT_AUX"
      &clk_src_sel=SRC_SEL TODO.
      &clk_src_div=10.
      &clk_m_val=0.
      &clk_n_val=0.
      &clk_2d_val=0.
      
      gosub Set_Clock_Freq
      return
    )
    else if ("&clk_desired_freq"=="r")
    (
      return
    )
    else
    (
      print "Invalid selection."
      goto Set_Clock_Freq_Enter
    )
  )

  if ("&clk"=="lpaif_ter_clk_src")||("&clk"=="audio_core_lpaif_ter_ibit_clk")
  (
    gosub PRINT_SET_CLOCK_FREQ_WARNING

    &clk_cmd_rcgr_addr=&HWIO_LPASS_LPAIF_TER_CMD_RCGR_ADDR
    &clk_cfg_rcgr_addr=&HWIO_LPASS_LPAIF_TER_CFG_RCGR_ADDR

    print "Choose frequency (MHz) from list below: " 

    print "0.3528         0.512          0.7056         " 
    print "0.768          1.024          1.4112         " 
    print "1.536          2.048          2.8224         " 
    print "3.072          4.096          5.6448         " 
    print "6.144          8.192          9.6            " 
    print "11.2896        12.288         15.36          " 
    print "24.576         " 

    print " "
    print "Enter desired frequency (r to return): "
    enter &clk_desired_freq
    print " "

    if ("&clk_desired_freq"=="0.3528")
    (
      &clk_src_name="LPAAUDIO_PLL_CLK_DIV_CDIV"
      &clk_src_sel=SRC_SEL TODO.
      &clk_src_div=32.
      &clk_m_val=1.
      &clk_n_val=50.
      &clk_2d_val=50.
      
      gosub Set_Clock_Freq
      return
    )
    else if ("&clk_desired_freq"=="0.512")
    (
      &clk_src_name="LPAAUDIO_DIG_PLL_OUT_AUX"
      &clk_src_sel=SRC_SEL TODO.
      &clk_src_div=32.
      &clk_m_val=1.
      &clk_n_val=15.
      &clk_2d_val=15.
      
      gosub Set_Clock_Freq
      return
    )
    else if ("&clk_desired_freq"=="0.7056")
    (
      &clk_src_name="LPAAUDIO_PLL_CLK_DIV_CDIV"
      &clk_src_sel=SRC_SEL TODO.
      &clk_src_div=32.
      &clk_m_val=1.
      &clk_n_val=25.
      &clk_2d_val=25.
      
      gosub Set_Clock_Freq
      return
    )
    else if ("&clk_desired_freq"=="0.768")
    (
      &clk_src_name="LPAAUDIO_DIG_PLL_OUT_AUX"
      &clk_src_sel=SRC_SEL TODO.
      &clk_src_div=32.
      &clk_m_val=1.
      &clk_n_val=10.
      &clk_2d_val=10.
      
      gosub Set_Clock_Freq
      return
    )
    else if ("&clk_desired_freq"=="1.024")
    (
      &clk_src_name="LPAAUDIO_DIG_PLL_OUT_AUX"
      &clk_src_sel=SRC_SEL TODO.
      &clk_src_div=30.
      &clk_m_val=1.
      &clk_n_val=8.
      &clk_2d_val=8.
      
      gosub Set_Clock_Freq
      return
    )
    else if ("&clk_desired_freq"=="1.4112")
    (
      &clk_src_name="LPAAUDIO_PLL_CLK_DIV_CDIV"
      &clk_src_sel=SRC_SEL TODO.
      &clk_src_div=20.
      &clk_m_val=1.
      &clk_n_val=20.
      &clk_2d_val=20.
      
      gosub Set_Clock_Freq
      return
    )
    else if ("&clk_desired_freq"=="1.536")
    (
      &clk_src_name="LPAAUDIO_DIG_PLL_OUT_AUX"
      &clk_src_sel=SRC_SEL TODO.
      &clk_src_div=32.
      &clk_m_val=1.
      &clk_n_val=5.
      &clk_2d_val=5.
      
      gosub Set_Clock_Freq
      return
    )
    else if ("&clk_desired_freq"=="2.048")
    (
      &clk_src_name="LPAAUDIO_DIG_PLL_OUT_AUX"
      &clk_src_sel=SRC_SEL TODO.
      &clk_src_div=30.
      &clk_m_val=1.
      &clk_n_val=4.
      &clk_2d_val=4.
      
      gosub Set_Clock_Freq
      return
    )
    else if ("&clk_desired_freq"=="2.8224")
    (
      &clk_src_name="LPAAUDIO_PLL_CLK_DIV_CDIV"
      &clk_src_sel=SRC_SEL TODO.
      &clk_src_div=20.
      &clk_m_val=1.
      &clk_n_val=10.
      &clk_2d_val=10.
      
      gosub Set_Clock_Freq
      return
    )
    else if ("&clk_desired_freq"=="3.072")
    (
      &clk_src_name="LPAAUDIO_DIG_PLL_OUT_AUX"
      &clk_src_sel=SRC_SEL TODO.
      &clk_src_div=20.
      &clk_m_val=1.
      &clk_n_val=4.
      &clk_2d_val=4.
      
      gosub Set_Clock_Freq
      return
    )
    else if ("&clk_desired_freq"=="4.096")
    (
      &clk_src_name="LPAAUDIO_DIG_PLL_OUT_AUX"
      &clk_src_sel=SRC_SEL TODO.
      &clk_src_div=30.
      &clk_m_val=1.
      &clk_n_val=2.
      &clk_2d_val=2.
      
      gosub Set_Clock_Freq
      return
    )
    else if ("&clk_desired_freq"=="5.6448")
    (
      &clk_src_name="LPAAUDIO_PLL_CLK_DIV_CDIV"
      &clk_src_sel=SRC_SEL TODO.
      &clk_src_div=20.
      &clk_m_val=1.
      &clk_n_val=5.
      &clk_2d_val=5.
      
      gosub Set_Clock_Freq
      return
    )
    else if ("&clk_desired_freq"=="6.144")
    (
      &clk_src_name="LPAAUDIO_DIG_PLL_OUT_AUX"
      &clk_src_sel=SRC_SEL TODO.
      &clk_src_div=20.
      &clk_m_val=1.
      &clk_n_val=2.
      &clk_2d_val=2.
      
      gosub Set_Clock_Freq
      return
    )
    else if ("&clk_desired_freq"=="8.192")
    (
      &clk_src_name="LPAAUDIO_DIG_PLL_OUT_AUX"
      &clk_src_sel=SRC_SEL TODO.
      &clk_src_div=30.
      &clk_m_val=0.
      &clk_n_val=0.
      &clk_2d_val=0.
      
      gosub Set_Clock_Freq
      return
    )
    else if ("&clk_desired_freq"=="9.6")
    (
      &clk_src_name="XO"
      &clk_src_sel=SRC_SEL TODO.
      &clk_src_div=4.
      &clk_m_val=0.
      &clk_n_val=0.
      &clk_2d_val=0.
      
      gosub Set_Clock_Freq
      return
    )
    else if ("&clk_desired_freq"=="11.2896")
    (
      &clk_src_name="LPAAUDIO_PLL_CLK_DIV_CDIV"
      &clk_src_sel=SRC_SEL TODO.
      &clk_src_div=10.
      &clk_m_val=1.
      &clk_n_val=5.
      &clk_2d_val=5.
      
      gosub Set_Clock_Freq
      return
    )
    else if ("&clk_desired_freq"=="12.288")
    (
      &clk_src_name="LPAAUDIO_DIG_PLL_OUT_AUX"
      &clk_src_sel=SRC_SEL TODO.
      &clk_src_div=20.
      &clk_m_val=0.
      &clk_n_val=0.
      &clk_2d_val=0.
      
      gosub Set_Clock_Freq
      return
    )
    else if ("&clk_desired_freq"=="15.36")
    (
      &clk_src_name="LPAAUDIO_DIG_PLL_OUT_AUX"
      &clk_src_sel=SRC_SEL TODO.
      &clk_src_div=16.
      &clk_m_val=0.
      &clk_n_val=0.
      &clk_2d_val=0.
      
      gosub Set_Clock_Freq
      return
    )
    else if ("&clk_desired_freq"=="24.576")
    (
      &clk_src_name="LPAAUDIO_DIG_PLL_OUT_AUX"
      &clk_src_sel=SRC_SEL TODO.
      &clk_src_div=10.
      &clk_m_val=0.
      &clk_n_val=0.
      &clk_2d_val=0.
      
      gosub Set_Clock_Freq
      return
    )
    else if ("&clk_desired_freq"=="r")
    (
      return
    )
    else
    (
      print "Invalid selection."
      goto Set_Clock_Freq_Enter
    )
  )

  if ("&clk"=="island_scc_q6_spm_clk")||("&clk"=="island_scc_sensor_core_bcr_xo_clk")
  (
    gosub PRINT_SET_CLOCK_FREQ_WARNING

    &clk_cmd_rcgr_addr=&HWIO_LPASS_Q6_SPM_CMD_RCGR_ADDR
    &clk_cfg_rcgr_addr=&HWIO_LPASS_Q6_SPM_CFG_RCGR_ADDR

    print "Choose frequency (MHz) from list below: " 

    print "19.199527      " 

    print " "
    print "Enter desired frequency (r to return): "
    enter &clk_desired_freq
    print " "

    if ("&clk_desired_freq"=="19.199527")
    (
      &clk_src_name="SCC_PLL_OUT_MAIN"
      &clk_src_sel=SRC_SEL TODO.
      &clk_src_div=26.
      &clk_m_val=0.
      &clk_n_val=0.
      &clk_2d_val=0.
      
      gosub Set_Clock_Freq
      return
    )
    else if ("&clk_desired_freq"=="r")
    (
      return
    )
    else
    (
      print "Invalid selection."
      goto Set_Clock_Freq_Enter
    )
  )

  if ("&clk"=="qca_slimbus_clk_src")||("&clk"=="audio_core_qca_slimbus_clk")
  (
    gosub PRINT_SET_CLOCK_FREQ_WARNING

    &clk_cmd_rcgr_addr=&HWIO_LPASS_QCA_SLIMBUS_CMD_RCGR_ADDR
    &clk_cfg_rcgr_addr=&HWIO_LPASS_QCA_SLIMBUS_CFG_RCGR_ADDR

    print "Choose frequency (MHz) from list below: " 

    print "3.072          6.144          12.288         " 
    print "24.576         " 

    print " "
    print "Enter desired frequency (r to return): "
    enter &clk_desired_freq
    print " "

    if ("&clk_desired_freq"=="3.072")
    (
      &clk_src_name="LPAAUDIO_DIG_PLL_OUT_AUX"
      &clk_src_sel=SRC_SEL TODO.
      &clk_src_div=20.
      &clk_m_val=1.
      &clk_n_val=4.
      &clk_2d_val=4.
      
      gosub Set_Clock_Freq
      return
    )
    else if ("&clk_desired_freq"=="6.144")
    (
      &clk_src_name="LPAAUDIO_DIG_PLL_OUT_AUX"
      &clk_src_sel=SRC_SEL TODO.
      &clk_src_div=20.
      &clk_m_val=1.
      &clk_n_val=2.
      &clk_2d_val=2.
      
      gosub Set_Clock_Freq
      return
    )
    else if ("&clk_desired_freq"=="12.288")
    (
      &clk_src_name="LPAAUDIO_DIG_PLL_OUT_AUX"
      &clk_src_sel=SRC_SEL TODO.
      &clk_src_div=20.
      &clk_m_val=0.
      &clk_n_val=0.
      &clk_2d_val=0.
      
      gosub Set_Clock_Freq
      return
    )
    else if ("&clk_desired_freq"=="24.576")
    (
      &clk_src_name="LPAAUDIO_DIG_PLL_OUT_AUX"
      &clk_src_sel=SRC_SEL TODO.
      &clk_src_div=10.
      &clk_m_val=0.
      &clk_n_val=0.
      &clk_2d_val=0.
      
      gosub Set_Clock_Freq
      return
    )
    else if ("&clk_desired_freq"=="r")
    (
      return
    )
    else
    (
      print "Invalid selection."
      goto Set_Clock_Freq_Enter
    )
  )

  if ("&clk"=="qos_fixed_lat_counter_clk_src")||("&clk"=="audio_core_qos_dmonitor_fixed_lat_counter_clk")||("&clk"=="audio_wrapper_qos_danger_fixed_lat_counter_clk")||("&clk"=="audio_wrapper_qos_dmonitor_fixed_lat_counter_clk")
  (
    gosub PRINT_SET_CLOCK_FREQ_WARNING

    &clk_cmd_rcgr_addr=&HWIO_LPASS_QOS_FIXED_LAT_COUNTER_CMD_RCGR_ADDR
    &clk_cfg_rcgr_addr=&HWIO_LPASS_QOS_FIXED_LAT_COUNTER_CFG_RCGR_ADDR

    print "Choose frequency (MHz) from list below: " 

    print "122.88         " 

    print " "
    print "Enter desired frequency (r to return): "
    enter &clk_desired_freq
    print " "

    if ("&clk_desired_freq"=="122.88")
    (
      &clk_src_name="LPAAUDIO_DIG_PLL_OUT_AUX"
      &clk_src_sel=SRC_SEL TODO.
      &clk_src_div=2.
      &clk_m_val=0.
      &clk_n_val=0.
      &clk_2d_val=0.
      
      gosub Set_Clock_Freq
      return
    )
    else if ("&clk_desired_freq"=="r")
    (
      return
    )
    else
    (
      print "Invalid selection."
      goto Set_Clock_Freq_Enter
    )
  )

  if ("&clk"=="resampler_clk_src")||("&clk"=="audio_core_resampler_clk")
  (
    gosub PRINT_SET_CLOCK_FREQ_WARNING

    &clk_cmd_rcgr_addr=&HWIO_LPASS_RESAMPLER_CMD_RCGR_ADDR
    &clk_cfg_rcgr_addr=&HWIO_LPASS_RESAMPLER_CFG_RCGR_ADDR

    print "Choose frequency (MHz) from list below: " 

    print "38.4           76.8           153.6          " 
    print "307.2          " 

    print " "
    print "Enter desired frequency (r to return): "
    enter &clk_desired_freq
    print " "

    if ("&clk_desired_freq"=="38.4")
    (
      &clk_src_name="LPAAUDIO_DIG_PLL_CLK_DIV_CDIV"
      &clk_src_sel=SRC_SEL TODO.
      &clk_src_div=16.
      &clk_m_val=0.
      &clk_n_val=0.
      &clk_2d_val=0.
      
      gosub Set_Clock_Freq
      return
    )
    else if ("&clk_desired_freq"=="76.8")
    (
      &clk_src_name="LPAAUDIO_DIG_PLL_CLK_DIV_CDIV"
      &clk_src_sel=SRC_SEL TODO.
      &clk_src_div=8.
      &clk_m_val=0.
      &clk_n_val=0.
      &clk_2d_val=0.
      
      gosub Set_Clock_Freq
      return
    )
    else if ("&clk_desired_freq"=="153.6")
    (
      &clk_src_name="LPAAUDIO_DIG_PLL_CLK_DIV_CDIV"
      &clk_src_sel=SRC_SEL TODO.
      &clk_src_div=4.
      &clk_m_val=0.
      &clk_n_val=0.
      &clk_2d_val=0.
      
      gosub Set_Clock_Freq
      return
    )
    else if ("&clk_desired_freq"=="307.2")
    (
      &clk_src_name="LPAAUDIO_DIG_PLL_OUT_EARLY"
      &clk_src_sel=SRC_SEL TODO.
      &clk_src_div=4.
      &clk_m_val=0.
      &clk_n_val=0.
      &clk_2d_val=0.
      
      gosub Set_Clock_Freq
      return
    )
    else if ("&clk_desired_freq"=="r")
    (
      return
    )
    else
    (
      print "Invalid selection."
      goto Set_Clock_Freq_Enter
    )
  )

  if ("&clk"=="island_scc_qup_i2c1_clk")||("&clk"=="island_scc_qup_i2c2_clk")||("&clk"=="island_scc_qup_i2c3_clk")||("&clk"=="island_scc_qup_spi1_clk")||("&clk"=="island_scc_qup_spi2_clk")||("&clk"=="island_scc_qup_spi3_clk")
  (
    gosub PRINT_SET_CLOCK_FREQ_WARNING

    &clk_cmd_rcgr_addr=&HWIO_LPASS_SCC_100M_CMD_RCGR_ADDR
    &clk_cfg_rcgr_addr=&HWIO_LPASS_SCC_100M_CFG_RCGR_ADDR

    print "Choose frequency (MHz) from list below: " 

    print "99.837542      " 

    print " "
    print "Enter desired frequency (r to return): "
    enter &clk_desired_freq
    print " "

    if ("&clk_desired_freq"=="99.837542")
    (
      &clk_src_name="SCC_PLL_OUT_MAIN"
      &clk_src_sel=SRC_SEL TODO.
      &clk_src_div=5.
      &clk_m_val=0.
      &clk_n_val=0.
      &clk_2d_val=0.
      
      gosub Set_Clock_Freq
      return
    )
    else if ("&clk_desired_freq"=="r")
    (
      return
    )
    else
    (
      print "Invalid selection."
      goto Set_Clock_Freq_Enter
    )
  )

  if ("&clk"=="island_scc_at_clk")||("&clk"=="island_scc_pclkdbg_clk")||("&clk"=="island_scc_q6_atbm_clk")
  (
    gosub PRINT_SET_CLOCK_FREQ_WARNING

    &clk_cmd_rcgr_addr=&HWIO_LPASS_SCC_AON_DBG_CMD_RCGR_ADDR
    &clk_cfg_rcgr_addr=&HWIO_LPASS_SCC_AON_DBG_CFG_RCGR_ADDR

    print "Choose frequency (MHz) from list below: " 

    print "62.398464      124.796928     249.593856     " 

    print " "
    print "Enter desired frequency (r to return): "
    enter &clk_desired_freq
    print " "

    if ("&clk_desired_freq"=="62.398464")
    (
      &clk_src_name="SCC_PLL_OUT_MAIN"
      &clk_src_sel=SRC_SEL TODO.
      &clk_src_div=8.
      &clk_m_val=0.
      &clk_n_val=0.
      &clk_2d_val=0.
      
      gosub Set_Clock_Freq
      return
    )
    else if ("&clk_desired_freq"=="124.796928")
    (
      &clk_src_name="SCC_PLL_OUT_MAIN"
      &clk_src_sel=SRC_SEL TODO.
      &clk_src_div=4.
      &clk_m_val=0.
      &clk_n_val=0.
      &clk_2d_val=0.
      
      gosub Set_Clock_Freq
      return
    )
    else if ("&clk_desired_freq"=="249.593856")
    (
      &clk_src_name="SCC_PLL_OUT_MAIN"
      &clk_src_sel=SRC_SEL TODO.
      &clk_src_div=2.
      &clk_m_val=0.
      &clk_n_val=0.
      &clk_2d_val=0.
      
      gosub Set_Clock_Freq
      return
    )
    else if ("&clk_desired_freq"=="r")
    (
      return
    )
    else
    (
      print "Invalid selection."
      goto Set_Clock_Freq_Enter
    )
  )

  if ("&clk"=="island_scc_dbg_tsctr_clk")
  (
    gosub PRINT_SET_CLOCK_FREQ_WARNING

    &clk_cmd_rcgr_addr=&HWIO_LPASS_SCC_AON_DBG_TSCTR_CMD_RCGR_ADDR
    &clk_cfg_rcgr_addr=&HWIO_LPASS_SCC_AON_DBG_TSCTR_CFG_RCGR_ADDR

    print "Choose frequency (MHz) from list below: " 

    print "31.199232      62.398464      124.796928     " 

    print " "
    print "Enter desired frequency (r to return): "
    enter &clk_desired_freq
    print " "

    if ("&clk_desired_freq"=="31.199232")
    (
      &clk_src_name="SCC_PLL_OUT_MAIN"
      &clk_src_sel=SRC_SEL TODO.
      &clk_src_div=16.
      &clk_m_val=0.
      &clk_n_val=0.
      &clk_2d_val=0.
      
      gosub Set_Clock_Freq
      return
    )
    else if ("&clk_desired_freq"=="62.398464")
    (
      &clk_src_name="SCC_PLL_OUT_MAIN"
      &clk_src_sel=SRC_SEL TODO.
      &clk_src_div=8.
      &clk_m_val=0.
      &clk_n_val=0.
      &clk_2d_val=0.
      
      gosub Set_Clock_Freq
      return
    )
    else if ("&clk_desired_freq"=="124.796928")
    (
      &clk_src_name="SCC_PLL_OUT_MAIN"
      &clk_src_sel=SRC_SEL TODO.
      &clk_src_div=4.
      &clk_m_val=0.
      &clk_n_val=0.
      &clk_2d_val=0.
      
      gosub Set_Clock_Freq
      return
    )
    else if ("&clk_desired_freq"=="r")
    (
      return
    )
    else
    (
      print "Invalid selection."
      goto Set_Clock_Freq_Enter
    )
  )

  if ("&clk"=="scc_uart1_clk_src")||("&clk"=="island_scc_uart_dm_uart1_clk")
  (
    gosub PRINT_SET_CLOCK_FREQ_WARNING

    &clk_cmd_rcgr_addr=&HWIO_LPASS_SCC_UART1_CMD_RCGR_ADDR
    &clk_cfg_rcgr_addr=&HWIO_LPASS_SCC_UART1_CFG_RCGR_ADDR

    print "Choose frequency (MHz) from list below: " 

    print "49.918771      62.398464      " 

    print " "
    print "Enter desired frequency (r to return): "
    enter &clk_desired_freq
    print " "

    if ("&clk_desired_freq"=="49.918771")
    (
      &clk_src_name="SCC_PLL_OUT_MAIN"
      &clk_src_sel=SRC_SEL TODO.
      &clk_src_div=10.
      &clk_m_val=0.
      &clk_n_val=0.
      &clk_2d_val=0.
      
      gosub Set_Clock_Freq
      return
    )
    else if ("&clk_desired_freq"=="62.398464")
    (
      &clk_src_name="SCC_PLL_OUT_MAIN"
      &clk_src_sel=SRC_SEL TODO.
      &clk_src_div=8.
      &clk_m_val=0.
      &clk_n_val=0.
      &clk_2d_val=0.
      
      gosub Set_Clock_Freq
      return
    )
    else if ("&clk_desired_freq"=="r")
    (
      return
    )
    else
    (
      print "Invalid selection."
      goto Set_Clock_Freq_Enter
    )
  )

  if ("&clk"=="scc_uart2_clk_src")||("&clk"=="island_scc_uart_dm_uart2_clk")
  (
    gosub PRINT_SET_CLOCK_FREQ_WARNING

    &clk_cmd_rcgr_addr=&HWIO_LPASS_SCC_UART2_CMD_RCGR_ADDR
    &clk_cfg_rcgr_addr=&HWIO_LPASS_SCC_UART2_CFG_RCGR_ADDR

    print "Choose frequency (MHz) from list below: " 

    print "49.918771      62.398464      " 

    print " "
    print "Enter desired frequency (r to return): "
    enter &clk_desired_freq
    print " "

    if ("&clk_desired_freq"=="49.918771")
    (
      &clk_src_name="SCC_PLL_OUT_MAIN"
      &clk_src_sel=SRC_SEL TODO.
      &clk_src_div=10.
      &clk_m_val=0.
      &clk_n_val=0.
      &clk_2d_val=0.
      
      gosub Set_Clock_Freq
      return
    )
    else if ("&clk_desired_freq"=="62.398464")
    (
      &clk_src_name="SCC_PLL_OUT_MAIN"
      &clk_src_sel=SRC_SEL TODO.
      &clk_src_div=8.
      &clk_m_val=0.
      &clk_n_val=0.
      &clk_2d_val=0.
      
      gosub Set_Clock_Freq
      return
    )
    else if ("&clk_desired_freq"=="r")
    (
      return
    )
    else
    (
      print "Invalid selection."
      goto Set_Clock_Freq_Enter
    )
  )

  if ("&clk"=="scc_uart3_clk_src")||("&clk"=="island_scc_uart_dm_uart3_clk")
  (
    gosub PRINT_SET_CLOCK_FREQ_WARNING

    &clk_cmd_rcgr_addr=&HWIO_LPASS_SCC_UART3_CMD_RCGR_ADDR
    &clk_cfg_rcgr_addr=&HWIO_LPASS_SCC_UART3_CFG_RCGR_ADDR

    print "Choose frequency (MHz) from list below: " 

    print "49.918771      62.398464      " 

    print " "
    print "Enter desired frequency (r to return): "
    enter &clk_desired_freq
    print " "

    if ("&clk_desired_freq"=="49.918771")
    (
      &clk_src_name="SCC_PLL_OUT_MAIN"
      &clk_src_sel=SRC_SEL TODO.
      &clk_src_div=10.
      &clk_m_val=0.
      &clk_n_val=0.
      &clk_2d_val=0.
      
      gosub Set_Clock_Freq
      return
    )
    else if ("&clk_desired_freq"=="62.398464")
    (
      &clk_src_name="SCC_PLL_OUT_MAIN"
      &clk_src_sel=SRC_SEL TODO.
      &clk_src_div=8.
      &clk_m_val=0.
      &clk_n_val=0.
      &clk_2d_val=0.
      
      gosub Set_Clock_Freq
      return
    )
    else if ("&clk_desired_freq"=="r")
    (
      return
    )
    else
    (
      print "Invalid selection."
      goto Set_Clock_Freq_Enter
    )
  )

  if ("&clk"=="scc_uart4_clk_src")||("&clk"=="island_scc_uart_dm_uart4_clk")
  (
    gosub PRINT_SET_CLOCK_FREQ_WARNING

    &clk_cmd_rcgr_addr=&HWIO_LPASS_SCC_UART4_CMD_RCGR_ADDR
    &clk_cfg_rcgr_addr=&HWIO_LPASS_SCC_UART4_CFG_RCGR_ADDR

    print "Choose frequency (MHz) from list below: " 

    print "49.918771      62.398464      " 

    print " "
    print "Enter desired frequency (r to return): "
    enter &clk_desired_freq
    print " "

    if ("&clk_desired_freq"=="49.918771")
    (
      &clk_src_name="SCC_PLL_OUT_MAIN"
      &clk_src_sel=SRC_SEL TODO.
      &clk_src_div=10.
      &clk_m_val=0.
      &clk_n_val=0.
      &clk_2d_val=0.
      
      gosub Set_Clock_Freq
      return
    )
    else if ("&clk_desired_freq"=="62.398464")
    (
      &clk_src_name="SCC_PLL_OUT_MAIN"
      &clk_src_sel=SRC_SEL TODO.
      &clk_src_div=8.
      &clk_m_val=0.
      &clk_n_val=0.
      &clk_2d_val=0.
      
      gosub Set_Clock_Freq
      return
    )
    else if ("&clk_desired_freq"=="r")
    (
      return
    )
    else
    (
      print "Invalid selection."
      goto Set_Clock_Freq_Enter
    )
  )

  if ("&clk"=="island_scc_vs_vddcx_clk")
  (
    gosub PRINT_SET_CLOCK_FREQ_WARNING

    &clk_cmd_rcgr_addr=&HWIO_LPASS_SCC_VS_VDDCX_CMD_RCGR_ADDR
    &clk_cfg_rcgr_addr=&HWIO_LPASS_SCC_VS_VDDCX_CFG_RCGR_ADDR

    print "Choose frequency (MHz) from list below: " 

    print "307.2          614.4          " 

    print " "
    print "Enter desired frequency (r to return): "
    enter &clk_desired_freq
    print " "

    if ("&clk_desired_freq"=="307.2")
    (
      &clk_src_name="LPAAUDIO_DIG_PLL_CLK_DIV_CDIV"
      &clk_src_sel=SRC_SEL TODO.
      &clk_src_div=2.
      &clk_m_val=0.
      &clk_n_val=0.
      &clk_2d_val=0.
      
      gosub Set_Clock_Freq
      return
    )
    else if ("&clk_desired_freq"=="614.4")
    (
      &clk_src_name="LPAAUDIO_DIG_PLL_OUT_EARLY"
      &clk_src_sel=SRC_SEL TODO.
      &clk_src_div=2.
      &clk_m_val=0.
      &clk_n_val=0.
      &clk_2d_val=0.
      
      gosub Set_Clock_Freq
      return
    )
    else if ("&clk_desired_freq"=="r")
    (
      return
    )
    else
    (
      print "Invalid selection."
      goto Set_Clock_Freq_Enter
    )
  )

  if ("&clk"=="island_scc_vs_vddmx_clk")
  (
    gosub PRINT_SET_CLOCK_FREQ_WARNING

    &clk_cmd_rcgr_addr=&HWIO_LPASS_SCC_VS_VDDMX_CMD_RCGR_ADDR
    &clk_cfg_rcgr_addr=&HWIO_LPASS_SCC_VS_VDDMX_CFG_RCGR_ADDR

    print "Choose frequency (MHz) from list below: " 

    print "307.2          614.4          " 

    print " "
    print "Enter desired frequency (r to return): "
    enter &clk_desired_freq
    print " "

    if ("&clk_desired_freq"=="307.2")
    (
      &clk_src_name="LPAAUDIO_DIG_PLL_CLK_DIV_CDIV"
      &clk_src_sel=SRC_SEL TODO.
      &clk_src_div=2.
      &clk_m_val=0.
      &clk_n_val=0.
      &clk_2d_val=0.
      
      gosub Set_Clock_Freq
      return
    )
    else if ("&clk_desired_freq"=="614.4")
    (
      &clk_src_name="LPAAUDIO_DIG_PLL_OUT_EARLY"
      &clk_src_sel=SRC_SEL TODO.
      &clk_src_div=2.
      &clk_m_val=0.
      &clk_n_val=0.
      &clk_2d_val=0.
      
      gosub Set_Clock_Freq
      return
    )
    else if ("&clk_desired_freq"=="r")
    (
      return
    )
    else
    (
      print "Invalid selection."
      goto Set_Clock_Freq_Enter
    )
  )

  if ("&clk"=="sleep_clk_src")||("&clk"=="audio_core_bcr_slp_clk")||("&clk"=="island_scc_sensor_core_bcr_slp_clk")||("&clk"=="q6ss_bcr_slp_clk")||("&clk"=="q6ss_slp_clk")
  (
    gosub PRINT_SET_CLOCK_FREQ_WARNING

    &clk_cmd_rcgr_addr=&HWIO_LPASS_SLEEP_CMD_RCGR_ADDR
    &clk_cfg_rcgr_addr=&HWIO_LPASS_SLEEP_CFG_RCGR_ADDR

    print "Choose frequency (MHz) from list below: " 

    print "0.032768       " 

    print " "
    print "Enter desired frequency (r to return): "
    enter &clk_desired_freq
    print " "

    if ("&clk_desired_freq"=="0.032768")
    (
      &clk_src_name="SLEEP_CLK"
      &clk_src_sel=SRC_SEL TODO.
      &clk_src_div=2.
      &clk_m_val=0.
      &clk_n_val=0.
      &clk_2d_val=0.
      
      gosub Set_Clock_Freq
      return
    )
    else if ("&clk_desired_freq"=="r")
    (
      return
    )
    else
    (
      print "Invalid selection."
      goto Set_Clock_Freq_Enter
    )
  )

  if ("&clk"=="audio_wrapper_sw_npl_clk")
  (
    gosub PRINT_SET_CLOCK_FREQ_WARNING

    &clk_cmd_rcgr_addr=&HWIO_LPASS_SW_NPL_CMD_RCGR_ADDR
    &clk_cfg_rcgr_addr=&HWIO_LPASS_SW_NPL_CFG_RCGR_ADDR

    print "Choose frequency (MHz) from list below: " 

    print "76.8           153.6          " 

    print " "
    print "Enter desired frequency (r to return): "
    enter &clk_desired_freq
    print " "

    if ("&clk_desired_freq"=="76.8")
    (
      &clk_src_name="LPAAUDIO_DIG_PLL_CLK_DIV_CDIV"
      &clk_src_sel=SRC_SEL TODO.
      &clk_src_div=8.
      &clk_m_val=0.
      &clk_n_val=0.
      &clk_2d_val=0.
      
      gosub Set_Clock_Freq
      return
    )
    else if ("&clk_desired_freq"=="153.6")
    (
      &clk_src_name="LPAAUDIO_DIG_PLL_OUT_EARLY"
      &clk_src_sel=SRC_SEL TODO.
      &clk_src_div=8.
      &clk_m_val=0.
      &clk_n_val=0.
      &clk_2d_val=0.
      
      gosub Set_Clock_Freq
      return
    )
    else if ("&clk_desired_freq"=="r")
    (
      return
    )
    else
    (
      print "Invalid selection."
      goto Set_Clock_Freq_Enter
    )
  )

  if ("&clk"=="xo_clk_src")||("&clk"=="audio_core_avsync_stc_clk")||("&clk"=="audio_core_gdsc_xo_clk")||("&clk"=="audio_wrapper_qos_xo_lat_counter_clk")||("&clk"=="q6ss_xo_clk")
  (
    gosub PRINT_SET_CLOCK_FREQ_WARNING

    &clk_cmd_rcgr_addr=&HWIO_LPASS_XO_CMD_RCGR_ADDR
    &clk_cfg_rcgr_addr=&HWIO_LPASS_XO_CFG_RCGR_ADDR

    print "Choose frequency (MHz) from list below: " 

    print "19.2           " 

    print " "
    print "Enter desired frequency (r to return): "
    enter &clk_desired_freq
    print " "

    if ("&clk_desired_freq"=="19.2")
    (
      &clk_src_name="XO"
      &clk_src_sel=SRC_SEL TODO.
      &clk_src_div=2.
      &clk_m_val=0.
      &clk_n_val=0.
      &clk_2d_val=0.
      
      gosub Set_Clock_Freq
      return
    )
    else if ("&clk_desired_freq"=="r")
    (
      return
    )
    else
    (
      print "Invalid selection."
      goto Set_Clock_Freq_Enter
    )
  )

  if ("&clk"=="mmss_bimc_smmu_ahb_clk")||("&clk"=="mmss_bto_ahb_clk")||("&clk"=="mmss_camss_ahb_clk")||("&clk"=="mmss_camss_cci_ahb_clk")||("&clk"=="mmss_camss_cpp_ahb_clk")||("&clk"=="mmss_camss_cpp_vbif_ahb_clk")||("&clk"=="mmss_camss_csi0_ahb_clk")||("&clk"=="mmss_camss_csi1_ahb_clk")||("&clk"=="mmss_camss_csi2_ahb_clk")||("&clk"=="mmss_camss_csi3_ahb_clk")||("&clk"=="mmss_camss_ispif_ahb_clk")||("&clk"=="mmss_camss_jpeg_ahb_clk")||("&clk"=="mmss_camss_micro_ahb_clk")||("&clk"=="mmss_camss_top_ahb_clk")||("&clk"=="mmss_camss_vfe0_ahb_clk")||("&clk"=="mmss_camss_vfe1_ahb_clk")||("&clk"=="mmss_camss_vfe_vbif_ahb_clk")||("&clk"=="mmss_csiphy_ahb2crif_clk")||("&clk"=="mmss_mdss_ahb_clk")||("&clk"=="mmss_mdss_hdmi_dp_ahb_clk")||("&clk"=="mmss_misc_ahb_clk")||("&clk"=="mmss_mnoc_ahb_clk")||("&clk"=="mmss_spdm_ahb_clk")||("&clk"=="mmss_throttle_camss_ahb_clk")||("&clk"=="mmss_throttle_mdss_ahb_clk")||("&clk"=="mmss_throttle_video_ahb_clk")||("&clk"=="mmss_video_ahb_clk")
  (
    gosub PRINT_SET_CLOCK_FREQ_WARNING

    &clk_cmd_rcgr_addr=&HWIO_MMSS_AHB_CMD_RCGR_ADDR
    &clk_cfg_rcgr_addr=&HWIO_MMSS_AHB_CFG_RCGR_ADDR

    print "Choose frequency (MHz) from list below: " 

    print "19.2           40.0           80.8           " 

    print " "
    print "Enter desired frequency (r to return): "
    enter &clk_desired_freq
    print " "

    if ("&clk_desired_freq"=="19.2")
    (
      &clk_src_name="CXO"
      &clk_src_sel=SRC_SEL TODO.
      &clk_src_div=2.
      &clk_m_val=0.
      &clk_n_val=0.
      &clk_2d_val=0.
      
      gosub Set_Clock_Freq
      return
    )
    else if ("&clk_desired_freq"=="40.0")
    (
      &clk_src_name="GPLL0_OUT_MAIN_DIV"
      &clk_src_sel=SRC_SEL TODO.
      &clk_src_div=15.
      &clk_m_val=0.
      &clk_n_val=0.
      &clk_2d_val=0.
      
      gosub Set_Clock_Freq
      return
    )
    else if ("&clk_desired_freq"=="80.8")
    (
      &clk_src_name="MMPLL0_PLL_OUT_MAIN"
      &clk_src_sel=SRC_SEL TODO.
      &clk_src_div=20.
      &clk_m_val=0.
      &clk_n_val=0.
      &clk_2d_val=0.
      
      gosub Set_Clock_Freq
      return
    )
    else if ("&clk_desired_freq"=="r")
    (
      return
    )
    else
    (
      print "Invalid selection."
      goto Set_Clock_Freq_Enter
    )
  )

  if ("&clk"=="mmss_bimc_smmu_axi_clk")||("&clk"=="mmss_camss_cpp_axi_clk")||("&clk"=="mmss_camss_jpeg_axi_clk")||("&clk"=="mmss_camss_vfe_vbif_axi_clk")||("&clk"=="mmss_mdss_axi_clk")||("&clk"=="mmss_mnoc_axi_clk")||("&clk"=="mmss_s0_axi_clk")||("&clk"=="mmss_snoc_dvm_axi_clk")||("&clk"=="mmss_spdm_axi_clk")||("&clk"=="mmss_spdm_rm_axi_clk")||("&clk"=="mmss_throttle_camss_axi_clk")||("&clk"=="mmss_throttle_mdss_axi_clk")||("&clk"=="mmss_throttle_video_axi_clk")||("&clk"=="mmss_video_axi_clk")
  (
    gosub PRINT_SET_CLOCK_FREQ_WARNING

    &clk_cmd_rcgr_addr=&HWIO_MMSS_AXI_CMD_RCGR_ADDR
    &clk_cfg_rcgr_addr=&HWIO_MMSS_AXI_CFG_RCGR_ADDR

    print "Choose frequency (MHz) from list below: " 

    print "75.0           171.428571     240.0          " 
    print "323.2          360.0          406.0          " 

    print " "
    print "Enter desired frequency (r to return): "
    enter &clk_desired_freq
    print " "

    if ("&clk_desired_freq"=="75.0")
    (
      &clk_src_name="GPLL0_OUT_MAIN_DIV"
      &clk_src_sel=SRC_SEL TODO.
      &clk_src_div=8.
      &clk_m_val=0.
      &clk_n_val=0.
      &clk_2d_val=0.
      
      gosub Set_Clock_Freq
      return
    )
    else if ("&clk_desired_freq"=="171.428571")
    (
      &clk_src_name="GPLL0_OUT_MAIN"
      &clk_src_sel=SRC_SEL TODO.
      &clk_src_div=7.
      &clk_m_val=0.
      &clk_n_val=0.
      &clk_2d_val=0.
      
      gosub Set_Clock_Freq
      return
    )
    else if ("&clk_desired_freq"=="240.0")
    (
      &clk_src_name="GPLL0_OUT_MAIN"
      &clk_src_sel=SRC_SEL TODO.
      &clk_src_div=5.
      &clk_m_val=0.
      &clk_n_val=0.
      &clk_2d_val=0.
      
      gosub Set_Clock_Freq
      return
    )
    else if ("&clk_desired_freq"=="323.2")
    (
      &clk_src_name="MMPLL0_PLL_OUT_MAIN"
      &clk_src_sel=SRC_SEL TODO.
      &clk_src_div=5.
      &clk_m_val=0.
      &clk_n_val=0.
      &clk_2d_val=0.
      
      gosub Set_Clock_Freq
      return
    )
    else if ("&clk_desired_freq"=="360.0")
    (
      &clk_src_name="MMPLL6_PLL_OUT_MAIN"
      &clk_src_sel=SRC_SEL TODO.
      &clk_src_div=6.
      &clk_m_val=0.
      &clk_n_val=0.
      &clk_2d_val=0.
      
      gosub Set_Clock_Freq
      return
    )
    else if ("&clk_desired_freq"=="406.0")
    (
      &clk_src_name="MMPLL1_PLL_OUT_MAIN"
      &clk_src_sel=SRC_SEL TODO.
      &clk_src_div=4.
      &clk_m_val=0.
      &clk_n_val=0.
      &clk_2d_val=0.
      
      gosub Set_Clock_Freq
      return
    )
    else if ("&clk_desired_freq"=="r")
    (
      return
    )
    else
    (
      print "Invalid selection."
      goto Set_Clock_Freq_Enter
    )
  )

  if ("&clk"=="mmss_mdss_byte0_clk")||("&clk"=="mmss_mdss_byte0_intf_clk")
  (
    gosub PRINT_SET_CLOCK_FREQ_WARNING

    &clk_cmd_rcgr_addr=&HWIO_MMSS_BYTE0_CMD_RCGR_ADDR
    &clk_cfg_rcgr_addr=&HWIO_MMSS_BYTE0_CFG_RCGR_ADDR

    print "Choose frequency (MHz) from list below: " 

    print "131.25         210.0          262.5          " 

    print " "
    print "Enter desired frequency (r to return): "
    enter &clk_desired_freq
    print " "

    if ("&clk_desired_freq"=="131.25")
    (
      &clk_src_name="EXTERNAL"
      &clk_src_sel=SRC_SEL TODO.
      &clk_src_div=2.
      &clk_m_val=0.
      &clk_n_val=0.
      &clk_2d_val=0.
      
      gosub Set_Clock_Freq
      return
    )
    else if ("&clk_desired_freq"=="210.0")
    (
      &clk_src_name="EXTERNAL"
      &clk_src_sel=SRC_SEL TODO.
      &clk_src_div=2.
      &clk_m_val=0.
      &clk_n_val=0.
      &clk_2d_val=0.
      
      gosub Set_Clock_Freq
      return
    )
    else if ("&clk_desired_freq"=="262.5")
    (
      &clk_src_name="EXTERNAL"
      &clk_src_sel=SRC_SEL TODO.
      &clk_src_div=2.
      &clk_m_val=0.
      &clk_n_val=0.
      &clk_2d_val=0.
      
      gosub Set_Clock_Freq
      return
    )
    else if ("&clk_desired_freq"=="r")
    (
      return
    )
    else
    (
      print "Invalid selection."
      goto Set_Clock_Freq_Enter
    )
  )

  if ("&clk"=="mmss_mdss_byte1_clk")||("&clk"=="mmss_mdss_byte1_intf_clk")
  (
    gosub PRINT_SET_CLOCK_FREQ_WARNING

    &clk_cmd_rcgr_addr=&HWIO_MMSS_BYTE1_CMD_RCGR_ADDR
    &clk_cfg_rcgr_addr=&HWIO_MMSS_BYTE1_CFG_RCGR_ADDR

    print "Choose frequency (MHz) from list below: " 

    print "131.25         210.0          262.5          " 

    print " "
    print "Enter desired frequency (r to return): "
    enter &clk_desired_freq
    print " "

    if ("&clk_desired_freq"=="131.25")
    (
      &clk_src_name="EXTERNAL"
      &clk_src_sel=SRC_SEL TODO.
      &clk_src_div=2.
      &clk_m_val=0.
      &clk_n_val=0.
      &clk_2d_val=0.
      
      gosub Set_Clock_Freq
      return
    )
    else if ("&clk_desired_freq"=="210.0")
    (
      &clk_src_name="EXTERNAL"
      &clk_src_sel=SRC_SEL TODO.
      &clk_src_div=2.
      &clk_m_val=0.
      &clk_n_val=0.
      &clk_2d_val=0.
      
      gosub Set_Clock_Freq
      return
    )
    else if ("&clk_desired_freq"=="262.5")
    (
      &clk_src_name="EXTERNAL"
      &clk_src_sel=SRC_SEL TODO.
      &clk_src_div=2.
      &clk_m_val=0.
      &clk_n_val=0.
      &clk_2d_val=0.
      
      gosub Set_Clock_Freq
      return
    )
    else if ("&clk_desired_freq"=="r")
    (
      return
    )
    else
    (
      print "Invalid selection."
      goto Set_Clock_Freq_Enter
    )
  )

  if ("&clk"=="mmss_camss_gp0_clk")
  (
    gosub PRINT_SET_CLOCK_FREQ_WARNING

    &clk_cmd_rcgr_addr=&HWIO_MMSS_CAMSS_GP0_CMD_RCGR_ADDR
    &clk_cfg_rcgr_addr=&HWIO_MMSS_CAMSS_GP0_CFG_RCGR_ADDR

    print "Choose frequency (MHz) from list below: " 

    print "0.01           0.024          6.0            " 
    print "12.0           13.043478      24.0           " 
    print "50.0           100.0          200.0          " 

    print " "
    print "Enter desired frequency (r to return): "
    enter &clk_desired_freq
    print " "

    if ("&clk_desired_freq"=="0.01")
    (
      &clk_src_name="CXO"
      &clk_src_sel=SRC_SEL TODO.
      &clk_src_div=32.
      &clk_m_val=1.
      &clk_n_val=120.
      &clk_2d_val=120.
      
      gosub Set_Clock_Freq
      return
    )
    else if ("&clk_desired_freq"=="0.024")
    (
      &clk_src_name="CXO"
      &clk_src_sel=SRC_SEL TODO.
      &clk_src_div=32.
      &clk_m_val=1.
      &clk_n_val=50.
      &clk_2d_val=50.
      
      gosub Set_Clock_Freq
      return
    )
    else if ("&clk_desired_freq"=="6.0")
    (
      &clk_src_name="GPLL0_OUT_MAIN_DIV"
      &clk_src_sel=SRC_SEL TODO.
      &clk_src_div=20.
      &clk_m_val=1.
      &clk_n_val=5.
      &clk_2d_val=5.
      
      gosub Set_Clock_Freq
      return
    )
    else if ("&clk_desired_freq"=="12.0")
    (
      &clk_src_name="GPLL0_OUT_MAIN_DIV"
      &clk_src_sel=SRC_SEL TODO.
      &clk_src_div=20.
      &clk_m_val=2.
      &clk_n_val=5.
      &clk_2d_val=5.
      
      gosub Set_Clock_Freq
      return
    )
    else if ("&clk_desired_freq"=="13.043478")
    (
      &clk_src_name="GPLL0_OUT_MAIN_DIV"
      &clk_src_sel=SRC_SEL TODO.
      &clk_src_div=2.
      &clk_m_val=1.
      &clk_n_val=23.
      &clk_2d_val=23.
      
      gosub Set_Clock_Freq
      return
    )
    else if ("&clk_desired_freq"=="24.0")
    (
      &clk_src_name="GPLL0_OUT_MAIN_DIV"
      &clk_src_sel=SRC_SEL TODO.
      &clk_src_div=2.
      &clk_m_val=2.
      &clk_n_val=25.
      &clk_2d_val=25.
      
      gosub Set_Clock_Freq
      return
    )
    else if ("&clk_desired_freq"=="50.0")
    (
      &clk_src_name="GPLL0_OUT_MAIN_DIV"
      &clk_src_sel=SRC_SEL TODO.
      &clk_src_div=12.
      &clk_m_val=0.
      &clk_n_val=0.
      &clk_2d_val=0.
      
      gosub Set_Clock_Freq
      return
    )
    else if ("&clk_desired_freq"=="100.0")
    (
      &clk_src_name="GPLL0_OUT_MAIN_DIV"
      &clk_src_sel=SRC_SEL TODO.
      &clk_src_div=6.
      &clk_m_val=0.
      &clk_n_val=0.
      &clk_2d_val=0.
      
      gosub Set_Clock_Freq
      return
    )
    else if ("&clk_desired_freq"=="200.0")
    (
      &clk_src_name="GPLL0_OUT_MAIN"
      &clk_src_sel=SRC_SEL TODO.
      &clk_src_div=6.
      &clk_m_val=0.
      &clk_n_val=0.
      &clk_2d_val=0.
      
      gosub Set_Clock_Freq
      return
    )
    else if ("&clk_desired_freq"=="r")
    (
      return
    )
    else
    (
      print "Invalid selection."
      goto Set_Clock_Freq_Enter
    )
  )

  if ("&clk"=="mmss_camss_gp1_clk")
  (
    gosub PRINT_SET_CLOCK_FREQ_WARNING

    &clk_cmd_rcgr_addr=&HWIO_MMSS_CAMSS_GP1_CMD_RCGR_ADDR
    &clk_cfg_rcgr_addr=&HWIO_MMSS_CAMSS_GP1_CFG_RCGR_ADDR

    print "Choose frequency (MHz) from list below: " 

    print "0.01           0.024          6.0            " 
    print "12.0           13.043478      24.0           " 
    print "50.0           100.0          200.0          " 

    print " "
    print "Enter desired frequency (r to return): "
    enter &clk_desired_freq
    print " "

    if ("&clk_desired_freq"=="0.01")
    (
      &clk_src_name="CXO"
      &clk_src_sel=SRC_SEL TODO.
      &clk_src_div=32.
      &clk_m_val=1.
      &clk_n_val=120.
      &clk_2d_val=120.
      
      gosub Set_Clock_Freq
      return
    )
    else if ("&clk_desired_freq"=="0.024")
    (
      &clk_src_name="CXO"
      &clk_src_sel=SRC_SEL TODO.
      &clk_src_div=32.
      &clk_m_val=1.
      &clk_n_val=50.
      &clk_2d_val=50.
      
      gosub Set_Clock_Freq
      return
    )
    else if ("&clk_desired_freq"=="6.0")
    (
      &clk_src_name="GPLL0_OUT_MAIN_DIV"
      &clk_src_sel=SRC_SEL TODO.
      &clk_src_div=20.
      &clk_m_val=1.
      &clk_n_val=5.
      &clk_2d_val=5.
      
      gosub Set_Clock_Freq
      return
    )
    else if ("&clk_desired_freq"=="12.0")
    (
      &clk_src_name="GPLL0_OUT_MAIN_DIV"
      &clk_src_sel=SRC_SEL TODO.
      &clk_src_div=20.
      &clk_m_val=2.
      &clk_n_val=5.
      &clk_2d_val=5.
      
      gosub Set_Clock_Freq
      return
    )
    else if ("&clk_desired_freq"=="13.043478")
    (
      &clk_src_name="GPLL0_OUT_MAIN_DIV"
      &clk_src_sel=SRC_SEL TODO.
      &clk_src_div=2.
      &clk_m_val=1.
      &clk_n_val=23.
      &clk_2d_val=23.
      
      gosub Set_Clock_Freq
      return
    )
    else if ("&clk_desired_freq"=="24.0")
    (
      &clk_src_name="GPLL0_OUT_MAIN_DIV"
      &clk_src_sel=SRC_SEL TODO.
      &clk_src_div=2.
      &clk_m_val=2.
      &clk_n_val=25.
      &clk_2d_val=25.
      
      gosub Set_Clock_Freq
      return
    )
    else if ("&clk_desired_freq"=="50.0")
    (
      &clk_src_name="GPLL0_OUT_MAIN_DIV"
      &clk_src_sel=SRC_SEL TODO.
      &clk_src_div=12.
      &clk_m_val=0.
      &clk_n_val=0.
      &clk_2d_val=0.
      
      gosub Set_Clock_Freq
      return
    )
    else if ("&clk_desired_freq"=="100.0")
    (
      &clk_src_name="GPLL0_OUT_MAIN_DIV"
      &clk_src_sel=SRC_SEL TODO.
      &clk_src_div=6.
      &clk_m_val=0.
      &clk_n_val=0.
      &clk_2d_val=0.
      
      gosub Set_Clock_Freq
      return
    )
    else if ("&clk_desired_freq"=="200.0")
    (
      &clk_src_name="GPLL0_OUT_MAIN"
      &clk_src_sel=SRC_SEL TODO.
      &clk_src_div=6.
      &clk_m_val=0.
      &clk_n_val=0.
      &clk_2d_val=0.
      
      gosub Set_Clock_Freq
      return
    )
    else if ("&clk_desired_freq"=="r")
    (
      return
    )
    else
    (
      print "Invalid selection."
      goto Set_Clock_Freq_Enter
    )
  )

  if ("&clk"=="mmss_camss_cci_clk")
  (
    gosub PRINT_SET_CLOCK_FREQ_WARNING

    &clk_cmd_rcgr_addr=&HWIO_MMSS_CCI_CMD_RCGR_ADDR
    &clk_cfg_rcgr_addr=&HWIO_MMSS_CCI_CFG_RCGR_ADDR

    print "Choose frequency (MHz) from list below: " 

    print "37.5           50.0           100.0          " 

    print " "
    print "Enter desired frequency (r to return): "
    enter &clk_desired_freq
    print " "

    if ("&clk_desired_freq"=="37.5")
    (
      &clk_src_name="GPLL0_OUT_MAIN_DIV"
      &clk_src_sel=SRC_SEL TODO.
      &clk_src_div=16.
      &clk_m_val=0.
      &clk_n_val=0.
      &clk_2d_val=0.
      
      gosub Set_Clock_Freq
      return
    )
    else if ("&clk_desired_freq"=="50.0")
    (
      &clk_src_name="GPLL0_OUT_MAIN_DIV"
      &clk_src_sel=SRC_SEL TODO.
      &clk_src_div=12.
      &clk_m_val=0.
      &clk_n_val=0.
      &clk_2d_val=0.
      
      gosub Set_Clock_Freq
      return
    )
    else if ("&clk_desired_freq"=="100.0")
    (
      &clk_src_name="GPLL0_OUT_MAIN"
      &clk_src_sel=SRC_SEL TODO.
      &clk_src_div=12.
      &clk_m_val=0.
      &clk_n_val=0.
      &clk_2d_val=0.
      
      gosub Set_Clock_Freq
      return
    )
    else if ("&clk_desired_freq"=="r")
    (
      return
    )
    else
    (
      print "Invalid selection."
      goto Set_Clock_Freq_Enter
    )
  )

  if ("&clk"=="mmss_camss_cpp_clk")||("&clk"=="mmss_spdm_cpp_clk")
  (
    gosub PRINT_SET_CLOCK_FREQ_WARNING

    &clk_cmd_rcgr_addr=&HWIO_MMSS_CPP_CMD_RCGR_ADDR
    &clk_cfg_rcgr_addr=&HWIO_MMSS_CPP_CFG_RCGR_ADDR

    print "Choose frequency (MHz) from list below: " 

    print "120.0          256.0          384.0          " 
    print "480.0          540.0          576.0          " 

    print " "
    print "Enter desired frequency (r to return): "
    enter &clk_desired_freq
    print " "

    if ("&clk_desired_freq"=="120.0")
    (
      &clk_src_name="GPLL0_OUT_MAIN"
      &clk_src_sel=SRC_SEL TODO.
      &clk_src_div=10.
      &clk_m_val=0.
      &clk_n_val=0.
      &clk_2d_val=0.
      
      gosub Set_Clock_Freq
      return
    )
    else if ("&clk_desired_freq"=="256.0")
    (
      &clk_src_name="MMPLL4_PLL_OUT_MAIN"
      &clk_src_sel=SRC_SEL TODO.
      &clk_src_div=6.
      &clk_m_val=0.
      &clk_n_val=0.
      &clk_2d_val=0.
      
      gosub Set_Clock_Freq
      return
    )
    else if ("&clk_desired_freq"=="384.0")
    (
      &clk_src_name="MMPLL4_PLL_OUT_MAIN"
      &clk_src_sel=SRC_SEL TODO.
      &clk_src_div=4.
      &clk_m_val=0.
      &clk_n_val=0.
      &clk_2d_val=0.
      
      gosub Set_Clock_Freq
      return
    )
    else if ("&clk_desired_freq"=="480.0")
    (
      &clk_src_name="MMPLL7_PLL_OUT_MAIN"
      &clk_src_sel=SRC_SEL TODO.
      &clk_src_div=4.
      &clk_m_val=0.
      &clk_n_val=0.
      &clk_2d_val=0.
      
      gosub Set_Clock_Freq
      return
    )
    else if ("&clk_desired_freq"=="540.0")
    (
      &clk_src_name="MMPLL6_PLL_OUT_MAIN"
      &clk_src_sel=SRC_SEL TODO.
      &clk_src_div=4.
      &clk_m_val=0.
      &clk_n_val=0.
      &clk_2d_val=0.
      
      gosub Set_Clock_Freq
      return
    )
    else if ("&clk_desired_freq"=="576.0")
    (
      &clk_src_name="MMPLL10_PLL_OUT_MAIN"
      &clk_src_sel=SRC_SEL TODO.
      &clk_src_div=2.
      &clk_m_val=0.
      &clk_n_val=0.
      &clk_2d_val=0.
      
      gosub Set_Clock_Freq
      return
    )
    else if ("&clk_desired_freq"=="r")
    (
      return
    )
    else
    (
      print "Invalid selection."
      goto Set_Clock_Freq_Enter
    )
  )

  if ("&clk"=="mmss_camss_csi0_clk")||("&clk"=="mmss_camss_csi0pix_clk")||("&clk"=="mmss_camss_csi0rdi_clk")||("&clk"=="mmss_spdm_csi0_clk")||("&clk"=="mmss_spdm_debug_clk")
  (
    gosub PRINT_SET_CLOCK_FREQ_WARNING

    &clk_cmd_rcgr_addr=&HWIO_MMSS_CSI0_CMD_RCGR_ADDR
    &clk_cfg_rcgr_addr=&HWIO_MMSS_CSI0_CFG_RCGR_ADDR

    print "Choose frequency (MHz) from list below: " 

    print "100.0          200.0          310.0          " 
    print "404.0          465.0          " 

    print " "
    print "Enter desired frequency (r to return): "
    enter &clk_desired_freq
    print " "

    if ("&clk_desired_freq"=="100.0")
    (
      &clk_src_name="GPLL0_OUT_MAIN_DIV"
      &clk_src_sel=SRC_SEL TODO.
      &clk_src_div=6.
      &clk_m_val=0.
      &clk_n_val=0.
      &clk_2d_val=0.
      
      gosub Set_Clock_Freq
      return
    )
    else if ("&clk_desired_freq"=="200.0")
    (
      &clk_src_name="GPLL0_OUT_MAIN"
      &clk_src_sel=SRC_SEL TODO.
      &clk_src_div=6.
      &clk_m_val=0.
      &clk_n_val=0.
      &clk_2d_val=0.
      
      gosub Set_Clock_Freq
      return
    )
    else if ("&clk_desired_freq"=="310.0")
    (
      &clk_src_name="MMPLL8_PLL_OUT_MAIN"
      &clk_src_sel=SRC_SEL TODO.
      &clk_src_div=6.
      &clk_m_val=0.
      &clk_n_val=0.
      &clk_2d_val=0.
      
      gosub Set_Clock_Freq
      return
    )
    else if ("&clk_desired_freq"=="404.0")
    (
      &clk_src_name="MMPLL0_PLL_OUT_MAIN"
      &clk_src_sel=SRC_SEL TODO.
      &clk_src_div=4.
      &clk_m_val=0.
      &clk_n_val=0.
      &clk_2d_val=0.
      
      gosub Set_Clock_Freq
      return
    )
    else if ("&clk_desired_freq"=="465.0")
    (
      &clk_src_name="MMPLL8_PLL_OUT_MAIN"
      &clk_src_sel=SRC_SEL TODO.
      &clk_src_div=4.
      &clk_m_val=0.
      &clk_n_val=0.
      &clk_2d_val=0.
      
      gosub Set_Clock_Freq
      return
    )
    else if ("&clk_desired_freq"=="r")
    (
      return
    )
    else
    (
      print "Invalid selection."
      goto Set_Clock_Freq_Enter
    )
  )

  if ("&clk"=="mmss_camss_csi0phytimer_clk")
  (
    gosub PRINT_SET_CLOCK_FREQ_WARNING

    &clk_cmd_rcgr_addr=&HWIO_MMSS_CSI0PHYTIMER_CMD_RCGR_ADDR
    &clk_cfg_rcgr_addr=&HWIO_MMSS_CSI0PHYTIMER_CFG_RCGR_ADDR

    print "Choose frequency (MHz) from list below: " 

    print "100.0          200.0          269.333333     " 

    print " "
    print "Enter desired frequency (r to return): "
    enter &clk_desired_freq
    print " "

    if ("&clk_desired_freq"=="100.0")
    (
      &clk_src_name="GPLL0_OUT_MAIN_DIV"
      &clk_src_sel=SRC_SEL TODO.
      &clk_src_div=6.
      &clk_m_val=0.
      &clk_n_val=0.
      &clk_2d_val=0.
      
      gosub Set_Clock_Freq
      return
    )
    else if ("&clk_desired_freq"=="200.0")
    (
      &clk_src_name="GPLL0_OUT_MAIN"
      &clk_src_sel=SRC_SEL TODO.
      &clk_src_div=6.
      &clk_m_val=0.
      &clk_n_val=0.
      &clk_2d_val=0.
      
      gosub Set_Clock_Freq
      return
    )
    else if ("&clk_desired_freq"=="269.333333")
    (
      &clk_src_name="MMPLL0_PLL_OUT_MAIN"
      &clk_src_sel=SRC_SEL TODO.
      &clk_src_div=6.
      &clk_m_val=0.
      &clk_n_val=0.
      &clk_2d_val=0.
      
      gosub Set_Clock_Freq
      return
    )
    else if ("&clk_desired_freq"=="r")
    (
      return
    )
    else
    (
      print "Invalid selection."
      goto Set_Clock_Freq_Enter
    )
  )

  if ("&clk"=="mmss_camss_csi1_clk")||("&clk"=="mmss_camss_csi1pix_clk")||("&clk"=="mmss_camss_csi1rdi_clk")
  (
    gosub PRINT_SET_CLOCK_FREQ_WARNING

    &clk_cmd_rcgr_addr=&HWIO_MMSS_CSI1_CMD_RCGR_ADDR
    &clk_cfg_rcgr_addr=&HWIO_MMSS_CSI1_CFG_RCGR_ADDR

    print "Choose frequency (MHz) from list below: " 

    print "100.0          200.0          310.0          " 
    print "404.0          465.0          " 

    print " "
    print "Enter desired frequency (r to return): "
    enter &clk_desired_freq
    print " "

    if ("&clk_desired_freq"=="100.0")
    (
      &clk_src_name="GPLL0_OUT_MAIN_DIV"
      &clk_src_sel=SRC_SEL TODO.
      &clk_src_div=6.
      &clk_m_val=0.
      &clk_n_val=0.
      &clk_2d_val=0.
      
      gosub Set_Clock_Freq
      return
    )
    else if ("&clk_desired_freq"=="200.0")
    (
      &clk_src_name="GPLL0_OUT_MAIN"
      &clk_src_sel=SRC_SEL TODO.
      &clk_src_div=6.
      &clk_m_val=0.
      &clk_n_val=0.
      &clk_2d_val=0.
      
      gosub Set_Clock_Freq
      return
    )
    else if ("&clk_desired_freq"=="310.0")
    (
      &clk_src_name="MMPLL8_PLL_OUT_MAIN"
      &clk_src_sel=SRC_SEL TODO.
      &clk_src_div=6.
      &clk_m_val=0.
      &clk_n_val=0.
      &clk_2d_val=0.
      
      gosub Set_Clock_Freq
      return
    )
    else if ("&clk_desired_freq"=="404.0")
    (
      &clk_src_name="MMPLL0_PLL_OUT_MAIN"
      &clk_src_sel=SRC_SEL TODO.
      &clk_src_div=4.
      &clk_m_val=0.
      &clk_n_val=0.
      &clk_2d_val=0.
      
      gosub Set_Clock_Freq
      return
    )
    else if ("&clk_desired_freq"=="465.0")
    (
      &clk_src_name="MMPLL8_PLL_OUT_MAIN"
      &clk_src_sel=SRC_SEL TODO.
      &clk_src_div=4.
      &clk_m_val=0.
      &clk_n_val=0.
      &clk_2d_val=0.
      
      gosub Set_Clock_Freq
      return
    )
    else if ("&clk_desired_freq"=="r")
    (
      return
    )
    else
    (
      print "Invalid selection."
      goto Set_Clock_Freq_Enter
    )
  )

  if ("&clk"=="mmss_camss_csi1phytimer_clk")
  (
    gosub PRINT_SET_CLOCK_FREQ_WARNING

    &clk_cmd_rcgr_addr=&HWIO_MMSS_CSI1PHYTIMER_CMD_RCGR_ADDR
    &clk_cfg_rcgr_addr=&HWIO_MMSS_CSI1PHYTIMER_CFG_RCGR_ADDR

    print "Choose frequency (MHz) from list below: " 

    print "100.0          200.0          269.333333     " 

    print " "
    print "Enter desired frequency (r to return): "
    enter &clk_desired_freq
    print " "

    if ("&clk_desired_freq"=="100.0")
    (
      &clk_src_name="GPLL0_OUT_MAIN_DIV"
      &clk_src_sel=SRC_SEL TODO.
      &clk_src_div=6.
      &clk_m_val=0.
      &clk_n_val=0.
      &clk_2d_val=0.
      
      gosub Set_Clock_Freq
      return
    )
    else if ("&clk_desired_freq"=="200.0")
    (
      &clk_src_name="GPLL0_OUT_MAIN"
      &clk_src_sel=SRC_SEL TODO.
      &clk_src_div=6.
      &clk_m_val=0.
      &clk_n_val=0.
      &clk_2d_val=0.
      
      gosub Set_Clock_Freq
      return
    )
    else if ("&clk_desired_freq"=="269.333333")
    (
      &clk_src_name="MMPLL0_PLL_OUT_MAIN"
      &clk_src_sel=SRC_SEL TODO.
      &clk_src_div=6.
      &clk_m_val=0.
      &clk_n_val=0.
      &clk_2d_val=0.
      
      gosub Set_Clock_Freq
      return
    )
    else if ("&clk_desired_freq"=="r")
    (
      return
    )
    else
    (
      print "Invalid selection."
      goto Set_Clock_Freq_Enter
    )
  )

  if ("&clk"=="mmss_camss_csi2_clk")||("&clk"=="mmss_camss_csi2pix_clk")||("&clk"=="mmss_camss_csi2rdi_clk")
  (
    gosub PRINT_SET_CLOCK_FREQ_WARNING

    &clk_cmd_rcgr_addr=&HWIO_MMSS_CSI2_CMD_RCGR_ADDR
    &clk_cfg_rcgr_addr=&HWIO_MMSS_CSI2_CFG_RCGR_ADDR

    print "Choose frequency (MHz) from list below: " 

    print "100.0          200.0          310.0          " 
    print "404.0          465.0          " 

    print " "
    print "Enter desired frequency (r to return): "
    enter &clk_desired_freq
    print " "

    if ("&clk_desired_freq"=="100.0")
    (
      &clk_src_name="GPLL0_OUT_MAIN_DIV"
      &clk_src_sel=SRC_SEL TODO.
      &clk_src_div=6.
      &clk_m_val=0.
      &clk_n_val=0.
      &clk_2d_val=0.
      
      gosub Set_Clock_Freq
      return
    )
    else if ("&clk_desired_freq"=="200.0")
    (
      &clk_src_name="GPLL0_OUT_MAIN"
      &clk_src_sel=SRC_SEL TODO.
      &clk_src_div=6.
      &clk_m_val=0.
      &clk_n_val=0.
      &clk_2d_val=0.
      
      gosub Set_Clock_Freq
      return
    )
    else if ("&clk_desired_freq"=="310.0")
    (
      &clk_src_name="MMPLL8_PLL_OUT_MAIN"
      &clk_src_sel=SRC_SEL TODO.
      &clk_src_div=6.
      &clk_m_val=0.
      &clk_n_val=0.
      &clk_2d_val=0.
      
      gosub Set_Clock_Freq
      return
    )
    else if ("&clk_desired_freq"=="404.0")
    (
      &clk_src_name="MMPLL0_PLL_OUT_MAIN"
      &clk_src_sel=SRC_SEL TODO.
      &clk_src_div=4.
      &clk_m_val=0.
      &clk_n_val=0.
      &clk_2d_val=0.
      
      gosub Set_Clock_Freq
      return
    )
    else if ("&clk_desired_freq"=="465.0")
    (
      &clk_src_name="MMPLL8_PLL_OUT_MAIN"
      &clk_src_sel=SRC_SEL TODO.
      &clk_src_div=4.
      &clk_m_val=0.
      &clk_n_val=0.
      &clk_2d_val=0.
      
      gosub Set_Clock_Freq
      return
    )
    else if ("&clk_desired_freq"=="r")
    (
      return
    )
    else
    (
      print "Invalid selection."
      goto Set_Clock_Freq_Enter
    )
  )

  if ("&clk"=="mmss_camss_csi2phytimer_clk")
  (
    gosub PRINT_SET_CLOCK_FREQ_WARNING

    &clk_cmd_rcgr_addr=&HWIO_MMSS_CSI2PHYTIMER_CMD_RCGR_ADDR
    &clk_cfg_rcgr_addr=&HWIO_MMSS_CSI2PHYTIMER_CFG_RCGR_ADDR

    print "Choose frequency (MHz) from list below: " 

    print "100.0          200.0          269.333333     " 

    print " "
    print "Enter desired frequency (r to return): "
    enter &clk_desired_freq
    print " "

    if ("&clk_desired_freq"=="100.0")
    (
      &clk_src_name="GPLL0_OUT_MAIN_DIV"
      &clk_src_sel=SRC_SEL TODO.
      &clk_src_div=6.
      &clk_m_val=0.
      &clk_n_val=0.
      &clk_2d_val=0.
      
      gosub Set_Clock_Freq
      return
    )
    else if ("&clk_desired_freq"=="200.0")
    (
      &clk_src_name="GPLL0_OUT_MAIN"
      &clk_src_sel=SRC_SEL TODO.
      &clk_src_div=6.
      &clk_m_val=0.
      &clk_n_val=0.
      &clk_2d_val=0.
      
      gosub Set_Clock_Freq
      return
    )
    else if ("&clk_desired_freq"=="269.333333")
    (
      &clk_src_name="MMPLL0_PLL_OUT_MAIN"
      &clk_src_sel=SRC_SEL TODO.
      &clk_src_div=6.
      &clk_m_val=0.
      &clk_n_val=0.
      &clk_2d_val=0.
      
      gosub Set_Clock_Freq
      return
    )
    else if ("&clk_desired_freq"=="r")
    (
      return
    )
    else
    (
      print "Invalid selection."
      goto Set_Clock_Freq_Enter
    )
  )

  if ("&clk"=="mmss_camss_csi3_clk")||("&clk"=="mmss_camss_csi3pix_clk")||("&clk"=="mmss_camss_csi3rdi_clk")
  (
    gosub PRINT_SET_CLOCK_FREQ_WARNING

    &clk_cmd_rcgr_addr=&HWIO_MMSS_CSI3_CMD_RCGR_ADDR
    &clk_cfg_rcgr_addr=&HWIO_MMSS_CSI3_CFG_RCGR_ADDR

    print "Choose frequency (MHz) from list below: " 

    print "100.0          200.0          310.0          " 
    print "404.0          465.0          " 

    print " "
    print "Enter desired frequency (r to return): "
    enter &clk_desired_freq
    print " "

    if ("&clk_desired_freq"=="100.0")
    (
      &clk_src_name="GPLL0_OUT_MAIN_DIV"
      &clk_src_sel=SRC_SEL TODO.
      &clk_src_div=6.
      &clk_m_val=0.
      &clk_n_val=0.
      &clk_2d_val=0.
      
      gosub Set_Clock_Freq
      return
    )
    else if ("&clk_desired_freq"=="200.0")
    (
      &clk_src_name="GPLL0_OUT_MAIN"
      &clk_src_sel=SRC_SEL TODO.
      &clk_src_div=6.
      &clk_m_val=0.
      &clk_n_val=0.
      &clk_2d_val=0.
      
      gosub Set_Clock_Freq
      return
    )
    else if ("&clk_desired_freq"=="310.0")
    (
      &clk_src_name="MMPLL8_PLL_OUT_MAIN"
      &clk_src_sel=SRC_SEL TODO.
      &clk_src_div=6.
      &clk_m_val=0.
      &clk_n_val=0.
      &clk_2d_val=0.
      
      gosub Set_Clock_Freq
      return
    )
    else if ("&clk_desired_freq"=="404.0")
    (
      &clk_src_name="MMPLL0_PLL_OUT_MAIN"
      &clk_src_sel=SRC_SEL TODO.
      &clk_src_div=4.
      &clk_m_val=0.
      &clk_n_val=0.
      &clk_2d_val=0.
      
      gosub Set_Clock_Freq
      return
    )
    else if ("&clk_desired_freq"=="465.0")
    (
      &clk_src_name="MMPLL8_PLL_OUT_MAIN"
      &clk_src_sel=SRC_SEL TODO.
      &clk_src_div=4.
      &clk_m_val=0.
      &clk_n_val=0.
      &clk_2d_val=0.
      
      gosub Set_Clock_Freq
      return
    )
    else if ("&clk_desired_freq"=="r")
    (
      return
    )
    else
    (
      print "Invalid selection."
      goto Set_Clock_Freq_Enter
    )
  )

  if ("&clk"=="mmss_camss_cphy_csid0_clk")||("&clk"=="mmss_camss_cphy_csid1_clk")||("&clk"=="mmss_camss_cphy_csid2_clk")||("&clk"=="mmss_camss_cphy_csid3_clk")||("&clk"=="mmss_camss_csiphy0_clk")||("&clk"=="mmss_camss_csiphy1_clk")||("&clk"=="mmss_camss_csiphy2_clk")
  (
    gosub PRINT_SET_CLOCK_FREQ_WARNING

    &clk_cmd_rcgr_addr=&HWIO_MMSS_CSIPHY_CMD_RCGR_ADDR
    &clk_cfg_rcgr_addr=&HWIO_MMSS_CSIPHY_CFG_RCGR_ADDR

    print "Choose frequency (MHz) from list below: " 

    print "100.0          200.0          269.333333     " 
    print "320.0          " 

    print " "
    print "Enter desired frequency (r to return): "
    enter &clk_desired_freq
    print " "

    if ("&clk_desired_freq"=="100.0")
    (
      &clk_src_name="GPLL0_OUT_MAIN_DIV"
      &clk_src_sel=SRC_SEL TODO.
      &clk_src_div=6.
      &clk_m_val=0.
      &clk_n_val=0.
      &clk_2d_val=0.
      
      gosub Set_Clock_Freq
      return
    )
    else if ("&clk_desired_freq"=="200.0")
    (
      &clk_src_name="GPLL0_OUT_MAIN"
      &clk_src_sel=SRC_SEL TODO.
      &clk_src_div=6.
      &clk_m_val=0.
      &clk_n_val=0.
      &clk_2d_val=0.
      
      gosub Set_Clock_Freq
      return
    )
    else if ("&clk_desired_freq"=="269.333333")
    (
      &clk_src_name="MMPLL0_PLL_OUT_MAIN"
      &clk_src_sel=SRC_SEL TODO.
      &clk_src_div=6.
      &clk_m_val=0.
      &clk_n_val=0.
      &clk_2d_val=0.
      
      gosub Set_Clock_Freq
      return
    )
    else if ("&clk_desired_freq"=="320.0")
    (
      &clk_src_name="MMPLL7_PLL_OUT_MAIN"
      &clk_src_sel=SRC_SEL TODO.
      &clk_src_div=6.
      &clk_m_val=0.
      &clk_n_val=0.
      &clk_2d_val=0.
      
      gosub Set_Clock_Freq
      return
    )
    else if ("&clk_desired_freq"=="r")
    (
      return
    )
    else
    (
      print "Invalid selection."
      goto Set_Clock_Freq_Enter
    )
  )

  if ("&clk"=="mmss_mdss_dp_aux_clk")
  (
    gosub PRINT_SET_CLOCK_FREQ_WARNING

    &clk_cmd_rcgr_addr=&HWIO_MMSS_DP_AUX_CMD_RCGR_ADDR
    &clk_cfg_rcgr_addr=&HWIO_MMSS_DP_AUX_CFG_RCGR_ADDR

    print "Choose frequency (MHz) from list below: " 

    print "19.2           " 

    print " "
    print "Enter desired frequency (r to return): "
    enter &clk_desired_freq
    print " "

    if ("&clk_desired_freq"=="19.2")
    (
      &clk_src_name="CXO"
      &clk_src_sel=SRC_SEL TODO.
      &clk_src_div=2.
      &clk_m_val=0.
      &clk_n_val=0.
      &clk_2d_val=0.
      
      gosub Set_Clock_Freq
      return
    )
    else if ("&clk_desired_freq"=="r")
    (
      return
    )
    else
    (
      print "Invalid selection."
      goto Set_Clock_Freq_Enter
    )
  )

  if ("&clk"=="mmss_mdss_dp_crypto_clk")||("&clk"=="mmss_spdm_dp_crypto_clk")
  (
    gosub PRINT_SET_CLOCK_FREQ_WARNING

    &clk_cmd_rcgr_addr=&HWIO_MMSS_DP_CRYPTO_CMD_RCGR_ADDR
    &clk_cfg_rcgr_addr=&HWIO_MMSS_DP_CRYPTO_CFG_RCGR_ADDR

    print "Choose frequency (MHz) from list below: " 

    print "101.25         168.75         337.5          " 

    print " "
    print "Enter desired frequency (r to return): "
    enter &clk_desired_freq
    print " "

    if ("&clk_desired_freq"=="101.25")
    (
      &clk_src_name="EXTERNAL"
      &clk_src_sel=SRC_SEL TODO.
      &clk_src_div=2.
      &clk_m_val=0.
      &clk_n_val=0.
      &clk_2d_val=0.
      
      gosub Set_Clock_Freq
      return
    )
    else if ("&clk_desired_freq"=="168.75")
    (
      &clk_src_name="EXTERNAL"
      &clk_src_sel=SRC_SEL TODO.
      &clk_src_div=2.
      &clk_m_val=0.
      &clk_n_val=0.
      &clk_2d_val=0.
      
      gosub Set_Clock_Freq
      return
    )
    else if ("&clk_desired_freq"=="337.5")
    (
      &clk_src_name="EXTERNAL"
      &clk_src_sel=SRC_SEL TODO.
      &clk_src_div=2.
      &clk_m_val=0.
      &clk_n_val=0.
      &clk_2d_val=0.
      
      gosub Set_Clock_Freq
      return
    )
    else if ("&clk_desired_freq"=="r")
    (
      return
    )
    else
    (
      print "Invalid selection."
      goto Set_Clock_Freq_Enter
    )
  )

  if ("&clk"=="mmss_mdss_dp_gtc_clk")
  (
    gosub PRINT_SET_CLOCK_FREQ_WARNING

    &clk_cmd_rcgr_addr=&HWIO_MMSS_DP_GTC_CMD_RCGR_ADDR
    &clk_cfg_rcgr_addr=&HWIO_MMSS_DP_GTC_CFG_RCGR_ADDR

    print "Choose frequency (MHz) from list below: " 

    print "40.0           60.0           " 

    print " "
    print "Enter desired frequency (r to return): "
    enter &clk_desired_freq
    print " "

    if ("&clk_desired_freq"=="40.0")
    (
      &clk_src_name="GPLL0_OUT_MAIN_DIV"
      &clk_src_sel=SRC_SEL TODO.
      &clk_src_div=15.
      &clk_m_val=0.
      &clk_n_val=0.
      &clk_2d_val=0.
      
      gosub Set_Clock_Freq
      return
    )
    else if ("&clk_desired_freq"=="60.0")
    (
      &clk_src_name="GPLL0_OUT_MAIN"
      &clk_src_sel=SRC_SEL TODO.
      &clk_src_div=20.
      &clk_m_val=0.
      &clk_n_val=0.
      &clk_2d_val=0.
      
      gosub Set_Clock_Freq
      return
    )
    else if ("&clk_desired_freq"=="r")
    (
      return
    )
    else
    (
      print "Invalid selection."
      goto Set_Clock_Freq_Enter
    )
  )

  if ("&clk"=="mmss_mdss_dp_link_clk")||("&clk"=="mmss_mdss_dp_link_intf_clk")
  (
    gosub PRINT_SET_CLOCK_FREQ_WARNING

    &clk_cmd_rcgr_addr=&HWIO_MMSS_DP_LINK_CMD_RCGR_ADDR
    &clk_cfg_rcgr_addr=&HWIO_MMSS_DP_LINK_CFG_RCGR_ADDR

    print "Choose frequency (MHz) from list below: " 

    print "162.0          270.0          540.0          " 

    print " "
    print "Enter desired frequency (r to return): "
    enter &clk_desired_freq
    print " "

    if ("&clk_desired_freq"=="162.0")
    (
      &clk_src_name="EXTERNAL"
      &clk_src_sel=SRC_SEL TODO.
      &clk_src_div=2.
      &clk_m_val=0.
      &clk_n_val=0.
      &clk_2d_val=0.
      
      gosub Set_Clock_Freq
      return
    )
    else if ("&clk_desired_freq"=="270.0")
    (
      &clk_src_name="EXTERNAL"
      &clk_src_sel=SRC_SEL TODO.
      &clk_src_div=2.
      &clk_m_val=0.
      &clk_n_val=0.
      &clk_2d_val=0.
      
      gosub Set_Clock_Freq
      return
    )
    else if ("&clk_desired_freq"=="540.0")
    (
      &clk_src_name="EXTERNAL"
      &clk_src_sel=SRC_SEL TODO.
      &clk_src_div=2.
      &clk_m_val=0.
      &clk_n_val=0.
      &clk_2d_val=0.
      
      gosub Set_Clock_Freq
      return
    )
    else if ("&clk_desired_freq"=="r")
    (
      return
    )
    else
    (
      print "Invalid selection."
      goto Set_Clock_Freq_Enter
    )
  )

  if ("&clk"=="mmss_mdss_dp_pixel_clk")||("&clk"=="mmss_spdm_dp_pixel_clk")
  (
    gosub PRINT_SET_CLOCK_FREQ_WARNING

    &clk_cmd_rcgr_addr=&HWIO_MMSS_DP_PIXEL_CMD_RCGR_ADDR
    &clk_cfg_rcgr_addr=&HWIO_MMSS_DP_PIXEL_CFG_RCGR_ADDR

    print "Choose frequency (MHz) from list below: " 

    print "148.38         296.74         593.47         " 

    print " "
    print "Enter desired frequency (r to return): "
    enter &clk_desired_freq
    print " "

    if ("&clk_desired_freq"=="148.38")
    (
      &clk_src_name="EXTERNAL"
      &clk_src_sel=SRC_SEL TODO.
      &clk_src_div=2.
      &clk_m_val=0.
      &clk_n_val=0.
      &clk_2d_val=0.
      
      gosub Set_Clock_Freq
      return
    )
    else if ("&clk_desired_freq"=="296.74")
    (
      &clk_src_name="EXTERNAL"
      &clk_src_sel=SRC_SEL TODO.
      &clk_src_div=2.
      &clk_m_val=0.
      &clk_n_val=0.
      &clk_2d_val=0.
      
      gosub Set_Clock_Freq
      return
    )
    else if ("&clk_desired_freq"=="593.47")
    (
      &clk_src_name="EXTERNAL"
      &clk_src_sel=SRC_SEL TODO.
      &clk_src_div=2.
      &clk_m_val=0.
      &clk_n_val=0.
      &clk_2d_val=0.
      
      gosub Set_Clock_Freq
      return
    )
    else if ("&clk_desired_freq"=="r")
    (
      return
    )
    else
    (
      print "Invalid selection."
      goto Set_Clock_Freq_Enter
    )
  )

  if ("&clk"=="mmss_mdss_esc0_clk")
  (
    gosub PRINT_SET_CLOCK_FREQ_WARNING

    &clk_cmd_rcgr_addr=&HWIO_MMSS_ESC0_CMD_RCGR_ADDR
    &clk_cfg_rcgr_addr=&HWIO_MMSS_ESC0_CFG_RCGR_ADDR

    print "Choose frequency (MHz) from list below: " 

    print "19.2           19.2           " 

    print " "
    print "Enter desired frequency (r to return): "
    enter &clk_desired_freq
    print " "

    if ("&clk_desired_freq"=="19.2")
    (
      &clk_src_name="CXO"
      &clk_src_sel=SRC_SEL TODO.
      &clk_src_div=2.
      &clk_m_val=0.
      &clk_n_val=0.
      &clk_2d_val=0.
      
      gosub Set_Clock_Freq
      return
    )
    else if ("&clk_desired_freq"=="19.2")
    (
      &clk_src_name="EXTERNAL"
      &clk_src_sel=SRC_SEL TODO.
      &clk_src_div=2.
      &clk_m_val=0.
      &clk_n_val=0.
      &clk_2d_val=0.
      
      gosub Set_Clock_Freq
      return
    )
    else if ("&clk_desired_freq"=="r")
    (
      return
    )
    else
    (
      print "Invalid selection."
      goto Set_Clock_Freq_Enter
    )
  )

  if ("&clk"=="mmss_mdss_esc1_clk")
  (
    gosub PRINT_SET_CLOCK_FREQ_WARNING

    &clk_cmd_rcgr_addr=&HWIO_MMSS_ESC1_CMD_RCGR_ADDR
    &clk_cfg_rcgr_addr=&HWIO_MMSS_ESC1_CFG_RCGR_ADDR

    print "Choose frequency (MHz) from list below: " 

    print "19.2           19.2           " 

    print " "
    print "Enter desired frequency (r to return): "
    enter &clk_desired_freq
    print " "

    if ("&clk_desired_freq"=="19.2")
    (
      &clk_src_name="CXO"
      &clk_src_sel=SRC_SEL TODO.
      &clk_src_div=2.
      &clk_m_val=0.
      &clk_n_val=0.
      &clk_2d_val=0.
      
      gosub Set_Clock_Freq
      return
    )
    else if ("&clk_desired_freq"=="19.2")
    (
      &clk_src_name="EXTERNAL"
      &clk_src_sel=SRC_SEL TODO.
      &clk_src_div=2.
      &clk_m_val=0.
      &clk_n_val=0.
      &clk_2d_val=0.
      
      gosub Set_Clock_Freq
      return
    )
    else if ("&clk_desired_freq"=="r")
    (
      return
    )
    else
    (
      print "Invalid selection."
      goto Set_Clock_Freq_Enter
    )
  )

  if ("&clk"=="mmss_camss_jpeg0_clk")||("&clk"=="mmss_spdm_jpeg0_clk")
  (
    gosub PRINT_SET_CLOCK_FREQ_WARNING

    &clk_cmd_rcgr_addr=&HWIO_MMSS_JPEG0_CMD_RCGR_ADDR
    &clk_cfg_rcgr_addr=&HWIO_MMSS_JPEG0_CFG_RCGR_ADDR

    print "Choose frequency (MHz) from list below: " 

    print "66.666667      133.333333     219.428571     " 
    print "320.0          480.0          " 

    print " "
    print "Enter desired frequency (r to return): "
    enter &clk_desired_freq
    print " "

    if ("&clk_desired_freq"=="66.666667")
    (
      &clk_src_name="GPLL0_OUT_MAIN_DIV"
      &clk_src_sel=SRC_SEL TODO.
      &clk_src_div=9.
      &clk_m_val=0.
      &clk_n_val=0.
      &clk_2d_val=0.
      
      gosub Set_Clock_Freq
      return
    )
    else if ("&clk_desired_freq"=="133.333333")
    (
      &clk_src_name="GPLL0_OUT_MAIN"
      &clk_src_sel=SRC_SEL TODO.
      &clk_src_div=9.
      &clk_m_val=0.
      &clk_n_val=0.
      &clk_2d_val=0.
      
      gosub Set_Clock_Freq
      return
    )
    else if ("&clk_desired_freq"=="219.428571")
    (
      &clk_src_name="MMPLL4_PLL_OUT_MAIN"
      &clk_src_sel=SRC_SEL TODO.
      &clk_src_div=7.
      &clk_m_val=0.
      &clk_n_val=0.
      &clk_2d_val=0.
      
      gosub Set_Clock_Freq
      return
    )
    else if ("&clk_desired_freq"=="320.0")
    (
      &clk_src_name="MMPLL7_PLL_OUT_MAIN"
      &clk_src_sel=SRC_SEL TODO.
      &clk_src_div=6.
      &clk_m_val=0.
      &clk_n_val=0.
      &clk_2d_val=0.
      
      gosub Set_Clock_Freq
      return
    )
    else if ("&clk_desired_freq"=="480.0")
    (
      &clk_src_name="MMPLL7_PLL_OUT_MAIN"
      &clk_src_sel=SRC_SEL TODO.
      &clk_src_div=4.
      &clk_m_val=0.
      &clk_n_val=0.
      &clk_2d_val=0.
      
      gosub Set_Clock_Freq
      return
    )
    else if ("&clk_desired_freq"=="r")
    (
      return
    )
    else
    (
      print "Invalid selection."
      goto Set_Clock_Freq_Enter
    )
  )

  if ("&clk"=="mmss_camss_mclk0_clk")
  (
    gosub PRINT_SET_CLOCK_FREQ_WARNING

    &clk_cmd_rcgr_addr=&HWIO_MMSS_MCLK0_CMD_RCGR_ADDR
    &clk_cfg_rcgr_addr=&HWIO_MMSS_MCLK0_CFG_RCGR_ADDR

    print "Choose frequency (MHz) from list below: " 

    print "4.8            6.0            8.0            " 
    print "9.6            16.666667      19.2           " 
    print "24.0           33.333333      48.0           " 
    print "66.666667      " 

    print " "
    print "Enter desired frequency (r to return): "
    enter &clk_desired_freq
    print " "

    if ("&clk_desired_freq"=="4.8")
    (
      &clk_src_name="CXO"
      &clk_src_sel=SRC_SEL TODO.
      &clk_src_div=8.
      &clk_m_val=0.
      &clk_n_val=0.
      &clk_2d_val=0.
      
      gosub Set_Clock_Freq
      return
    )
    else if ("&clk_desired_freq"=="6.0")
    (
      &clk_src_name="GPLL0_OUT_MAIN_DIV"
      &clk_src_sel=SRC_SEL TODO.
      &clk_src_div=20.
      &clk_m_val=1.
      &clk_n_val=5.
      &clk_2d_val=5.
      
      gosub Set_Clock_Freq
      return
    )
    else if ("&clk_desired_freq"=="8.0")
    (
      &clk_src_name="GPLL0_OUT_MAIN_DIV"
      &clk_src_sel=SRC_SEL TODO.
      &clk_src_div=2.
      &clk_m_val=2.
      &clk_n_val=75.
      &clk_2d_val=75.
      
      gosub Set_Clock_Freq
      return
    )
    else if ("&clk_desired_freq"=="9.6")
    (
      &clk_src_name="CXO"
      &clk_src_sel=SRC_SEL TODO.
      &clk_src_div=4.
      &clk_m_val=0.
      &clk_n_val=0.
      &clk_2d_val=0.
      
      gosub Set_Clock_Freq
      return
    )
    else if ("&clk_desired_freq"=="16.666667")
    (
      &clk_src_name="GPLL0_OUT_MAIN_DIV"
      &clk_src_sel=SRC_SEL TODO.
      &clk_src_div=4.
      &clk_m_val=1.
      &clk_n_val=9.
      &clk_2d_val=9.
      
      gosub Set_Clock_Freq
      return
    )
    else if ("&clk_desired_freq"=="19.2")
    (
      &clk_src_name="CXO"
      &clk_src_sel=SRC_SEL TODO.
      &clk_src_div=2.
      &clk_m_val=0.
      &clk_n_val=0.
      &clk_2d_val=0.
      
      gosub Set_Clock_Freq
      return
    )
    else if ("&clk_desired_freq"=="24.0")
    (
      &clk_src_name="GPLL0_OUT_MAIN_DIV"
      &clk_src_sel=SRC_SEL TODO.
      &clk_src_div=2.
      &clk_m_val=2.
      &clk_n_val=25.
      &clk_2d_val=25.
      
      gosub Set_Clock_Freq
      return
    )
    else if ("&clk_desired_freq"=="33.333333")
    (
      &clk_src_name="GPLL0_OUT_MAIN_DIV"
      &clk_src_sel=SRC_SEL TODO.
      &clk_src_div=2.
      &clk_m_val=1.
      &clk_n_val=9.
      &clk_2d_val=9.
      
      gosub Set_Clock_Freq
      return
    )
    else if ("&clk_desired_freq"=="48.0")
    (
      &clk_src_name="GPLL0_OUT_MAIN"
      &clk_src_sel=SRC_SEL TODO.
      &clk_src_div=2.
      &clk_m_val=2.
      &clk_n_val=25.
      &clk_2d_val=25.
      
      gosub Set_Clock_Freq
      return
    )
    else if ("&clk_desired_freq"=="66.666667")
    (
      &clk_src_name="GPLL0_OUT_MAIN"
      &clk_src_sel=SRC_SEL TODO.
      &clk_src_div=2.
      &clk_m_val=1.
      &clk_n_val=9.
      &clk_2d_val=9.
      
      gosub Set_Clock_Freq
      return
    )
    else if ("&clk_desired_freq"=="r")
    (
      return
    )
    else
    (
      print "Invalid selection."
      goto Set_Clock_Freq_Enter
    )
  )

  if ("&clk"=="mmss_camss_mclk1_clk")
  (
    gosub PRINT_SET_CLOCK_FREQ_WARNING

    &clk_cmd_rcgr_addr=&HWIO_MMSS_MCLK1_CMD_RCGR_ADDR
    &clk_cfg_rcgr_addr=&HWIO_MMSS_MCLK1_CFG_RCGR_ADDR

    print "Choose frequency (MHz) from list below: " 

    print "4.8            6.0            8.0            " 
    print "9.6            16.666667      19.2           " 
    print "24.0           33.333333      48.0           " 
    print "66.666667      " 

    print " "
    print "Enter desired frequency (r to return): "
    enter &clk_desired_freq
    print " "

    if ("&clk_desired_freq"=="4.8")
    (
      &clk_src_name="CXO"
      &clk_src_sel=SRC_SEL TODO.
      &clk_src_div=8.
      &clk_m_val=0.
      &clk_n_val=0.
      &clk_2d_val=0.
      
      gosub Set_Clock_Freq
      return
    )
    else if ("&clk_desired_freq"=="6.0")
    (
      &clk_src_name="GPLL0_OUT_MAIN_DIV"
      &clk_src_sel=SRC_SEL TODO.
      &clk_src_div=20.
      &clk_m_val=1.
      &clk_n_val=5.
      &clk_2d_val=5.
      
      gosub Set_Clock_Freq
      return
    )
    else if ("&clk_desired_freq"=="8.0")
    (
      &clk_src_name="GPLL0_OUT_MAIN_DIV"
      &clk_src_sel=SRC_SEL TODO.
      &clk_src_div=2.
      &clk_m_val=2.
      &clk_n_val=75.
      &clk_2d_val=75.
      
      gosub Set_Clock_Freq
      return
    )
    else if ("&clk_desired_freq"=="9.6")
    (
      &clk_src_name="CXO"
      &clk_src_sel=SRC_SEL TODO.
      &clk_src_div=4.
      &clk_m_val=0.
      &clk_n_val=0.
      &clk_2d_val=0.
      
      gosub Set_Clock_Freq
      return
    )
    else if ("&clk_desired_freq"=="16.666667")
    (
      &clk_src_name="GPLL0_OUT_MAIN_DIV"
      &clk_src_sel=SRC_SEL TODO.
      &clk_src_div=4.
      &clk_m_val=1.
      &clk_n_val=9.
      &clk_2d_val=9.
      
      gosub Set_Clock_Freq
      return
    )
    else if ("&clk_desired_freq"=="19.2")
    (
      &clk_src_name="CXO"
      &clk_src_sel=SRC_SEL TODO.
      &clk_src_div=2.
      &clk_m_val=0.
      &clk_n_val=0.
      &clk_2d_val=0.
      
      gosub Set_Clock_Freq
      return
    )
    else if ("&clk_desired_freq"=="24.0")
    (
      &clk_src_name="GPLL0_OUT_MAIN_DIV"
      &clk_src_sel=SRC_SEL TODO.
      &clk_src_div=2.
      &clk_m_val=2.
      &clk_n_val=25.
      &clk_2d_val=25.
      
      gosub Set_Clock_Freq
      return
    )
    else if ("&clk_desired_freq"=="33.333333")
    (
      &clk_src_name="GPLL0_OUT_MAIN_DIV"
      &clk_src_sel=SRC_SEL TODO.
      &clk_src_div=2.
      &clk_m_val=1.
      &clk_n_val=9.
      &clk_2d_val=9.
      
      gosub Set_Clock_Freq
      return
    )
    else if ("&clk_desired_freq"=="48.0")
    (
      &clk_src_name="GPLL0_OUT_MAIN"
      &clk_src_sel=SRC_SEL TODO.
      &clk_src_div=2.
      &clk_m_val=2.
      &clk_n_val=25.
      &clk_2d_val=25.
      
      gosub Set_Clock_Freq
      return
    )
    else if ("&clk_desired_freq"=="66.666667")
    (
      &clk_src_name="GPLL0_OUT_MAIN"
      &clk_src_sel=SRC_SEL TODO.
      &clk_src_div=2.
      &clk_m_val=1.
      &clk_n_val=9.
      &clk_2d_val=9.
      
      gosub Set_Clock_Freq
      return
    )
    else if ("&clk_desired_freq"=="r")
    (
      return
    )
    else
    (
      print "Invalid selection."
      goto Set_Clock_Freq_Enter
    )
  )

  if ("&clk"=="mmss_camss_mclk2_clk")
  (
    gosub PRINT_SET_CLOCK_FREQ_WARNING

    &clk_cmd_rcgr_addr=&HWIO_MMSS_MCLK2_CMD_RCGR_ADDR
    &clk_cfg_rcgr_addr=&HWIO_MMSS_MCLK2_CFG_RCGR_ADDR

    print "Choose frequency (MHz) from list below: " 

    print "4.8            6.0            8.0            " 
    print "9.6            16.666667      19.2           " 
    print "24.0           33.333333      48.0           " 
    print "66.666667      " 

    print " "
    print "Enter desired frequency (r to return): "
    enter &clk_desired_freq
    print " "

    if ("&clk_desired_freq"=="4.8")
    (
      &clk_src_name="CXO"
      &clk_src_sel=SRC_SEL TODO.
      &clk_src_div=8.
      &clk_m_val=0.
      &clk_n_val=0.
      &clk_2d_val=0.
      
      gosub Set_Clock_Freq
      return
    )
    else if ("&clk_desired_freq"=="6.0")
    (
      &clk_src_name="GPLL0_OUT_MAIN_DIV"
      &clk_src_sel=SRC_SEL TODO.
      &clk_src_div=20.
      &clk_m_val=1.
      &clk_n_val=5.
      &clk_2d_val=5.
      
      gosub Set_Clock_Freq
      return
    )
    else if ("&clk_desired_freq"=="8.0")
    (
      &clk_src_name="GPLL0_OUT_MAIN_DIV"
      &clk_src_sel=SRC_SEL TODO.
      &clk_src_div=2.
      &clk_m_val=2.
      &clk_n_val=75.
      &clk_2d_val=75.
      
      gosub Set_Clock_Freq
      return
    )
    else if ("&clk_desired_freq"=="9.6")
    (
      &clk_src_name="CXO"
      &clk_src_sel=SRC_SEL TODO.
      &clk_src_div=4.
      &clk_m_val=0.
      &clk_n_val=0.
      &clk_2d_val=0.
      
      gosub Set_Clock_Freq
      return
    )
    else if ("&clk_desired_freq"=="16.666667")
    (
      &clk_src_name="GPLL0_OUT_MAIN_DIV"
      &clk_src_sel=SRC_SEL TODO.
      &clk_src_div=4.
      &clk_m_val=1.
      &clk_n_val=9.
      &clk_2d_val=9.
      
      gosub Set_Clock_Freq
      return
    )
    else if ("&clk_desired_freq"=="19.2")
    (
      &clk_src_name="CXO"
      &clk_src_sel=SRC_SEL TODO.
      &clk_src_div=2.
      &clk_m_val=0.
      &clk_n_val=0.
      &clk_2d_val=0.
      
      gosub Set_Clock_Freq
      return
    )
    else if ("&clk_desired_freq"=="24.0")
    (
      &clk_src_name="GPLL0_OUT_MAIN_DIV"
      &clk_src_sel=SRC_SEL TODO.
      &clk_src_div=2.
      &clk_m_val=2.
      &clk_n_val=25.
      &clk_2d_val=25.
      
      gosub Set_Clock_Freq
      return
    )
    else if ("&clk_desired_freq"=="33.333333")
    (
      &clk_src_name="GPLL0_OUT_MAIN_DIV"
      &clk_src_sel=SRC_SEL TODO.
      &clk_src_div=2.
      &clk_m_val=1.
      &clk_n_val=9.
      &clk_2d_val=9.
      
      gosub Set_Clock_Freq
      return
    )
    else if ("&clk_desired_freq"=="48.0")
    (
      &clk_src_name="GPLL0_OUT_MAIN"
      &clk_src_sel=SRC_SEL TODO.
      &clk_src_div=2.
      &clk_m_val=2.
      &clk_n_val=25.
      &clk_2d_val=25.
      
      gosub Set_Clock_Freq
      return
    )
    else if ("&clk_desired_freq"=="66.666667")
    (
      &clk_src_name="GPLL0_OUT_MAIN"
      &clk_src_sel=SRC_SEL TODO.
      &clk_src_div=2.
      &clk_m_val=1.
      &clk_n_val=9.
      &clk_2d_val=9.
      
      gosub Set_Clock_Freq
      return
    )
    else if ("&clk_desired_freq"=="r")
    (
      return
    )
    else
    (
      print "Invalid selection."
      goto Set_Clock_Freq_Enter
    )
  )

  if ("&clk"=="mmss_camss_mclk3_clk")
  (
    gosub PRINT_SET_CLOCK_FREQ_WARNING

    &clk_cmd_rcgr_addr=&HWIO_MMSS_MCLK3_CMD_RCGR_ADDR
    &clk_cfg_rcgr_addr=&HWIO_MMSS_MCLK3_CFG_RCGR_ADDR

    print "Choose frequency (MHz) from list below: " 

    print "4.8            6.0            8.0            " 
    print "9.6            16.666667      19.2           " 
    print "24.0           33.333333      48.0           " 
    print "66.666667      " 

    print " "
    print "Enter desired frequency (r to return): "
    enter &clk_desired_freq
    print " "

    if ("&clk_desired_freq"=="4.8")
    (
      &clk_src_name="CXO"
      &clk_src_sel=SRC_SEL TODO.
      &clk_src_div=8.
      &clk_m_val=0.
      &clk_n_val=0.
      &clk_2d_val=0.
      
      gosub Set_Clock_Freq
      return
    )
    else if ("&clk_desired_freq"=="6.0")
    (
      &clk_src_name="GPLL0_OUT_MAIN_DIV"
      &clk_src_sel=SRC_SEL TODO.
      &clk_src_div=20.
      &clk_m_val=1.
      &clk_n_val=5.
      &clk_2d_val=5.
      
      gosub Set_Clock_Freq
      return
    )
    else if ("&clk_desired_freq"=="8.0")
    (
      &clk_src_name="GPLL0_OUT_MAIN_DIV"
      &clk_src_sel=SRC_SEL TODO.
      &clk_src_div=2.
      &clk_m_val=2.
      &clk_n_val=75.
      &clk_2d_val=75.
      
      gosub Set_Clock_Freq
      return
    )
    else if ("&clk_desired_freq"=="9.6")
    (
      &clk_src_name="CXO"
      &clk_src_sel=SRC_SEL TODO.
      &clk_src_div=4.
      &clk_m_val=0.
      &clk_n_val=0.
      &clk_2d_val=0.
      
      gosub Set_Clock_Freq
      return
    )
    else if ("&clk_desired_freq"=="16.666667")
    (
      &clk_src_name="GPLL0_OUT_MAIN_DIV"
      &clk_src_sel=SRC_SEL TODO.
      &clk_src_div=4.
      &clk_m_val=1.
      &clk_n_val=9.
      &clk_2d_val=9.
      
      gosub Set_Clock_Freq
      return
    )
    else if ("&clk_desired_freq"=="19.2")
    (
      &clk_src_name="CXO"
      &clk_src_sel=SRC_SEL TODO.
      &clk_src_div=2.
      &clk_m_val=0.
      &clk_n_val=0.
      &clk_2d_val=0.
      
      gosub Set_Clock_Freq
      return
    )
    else if ("&clk_desired_freq"=="24.0")
    (
      &clk_src_name="GPLL0_OUT_MAIN_DIV"
      &clk_src_sel=SRC_SEL TODO.
      &clk_src_div=2.
      &clk_m_val=2.
      &clk_n_val=25.
      &clk_2d_val=25.
      
      gosub Set_Clock_Freq
      return
    )
    else if ("&clk_desired_freq"=="33.333333")
    (
      &clk_src_name="GPLL0_OUT_MAIN_DIV"
      &clk_src_sel=SRC_SEL TODO.
      &clk_src_div=2.
      &clk_m_val=1.
      &clk_n_val=9.
      &clk_2d_val=9.
      
      gosub Set_Clock_Freq
      return
    )
    else if ("&clk_desired_freq"=="48.0")
    (
      &clk_src_name="GPLL0_OUT_MAIN"
      &clk_src_sel=SRC_SEL TODO.
      &clk_src_div=2.
      &clk_m_val=2.
      &clk_n_val=25.
      &clk_2d_val=25.
      
      gosub Set_Clock_Freq
      return
    )
    else if ("&clk_desired_freq"=="66.666667")
    (
      &clk_src_name="GPLL0_OUT_MAIN"
      &clk_src_sel=SRC_SEL TODO.
      &clk_src_div=2.
      &clk_m_val=1.
      &clk_n_val=9.
      &clk_2d_val=9.
      
      gosub Set_Clock_Freq
      return
    )
    else if ("&clk_desired_freq"=="r")
    (
      return
    )
    else
    (
      print "Invalid selection."
      goto Set_Clock_Freq_Enter
    )
  )

  if ("&clk"=="mmss_mdss_mdp_clk")||("&clk"=="mmss_spdm_mdp_clk")
  (
    gosub PRINT_SET_CLOCK_FREQ_WARNING

    &clk_cmd_rcgr_addr=&HWIO_MMSS_MDP_CMD_RCGR_ADDR
    &clk_cfg_rcgr_addr=&HWIO_MMSS_MDP_CFG_RCGR_ADDR

    print "Choose frequency (MHz) from list below: " 

    print "100.0          150.0          171.428571     " 
    print "200.0          275.0          300.0          " 
    print "330.0          412.5          " 

    print " "
    print "Enter desired frequency (r to return): "
    enter &clk_desired_freq
    print " "

    if ("&clk_desired_freq"=="100.0")
    (
      &clk_src_name="GPLL0_OUT_MAIN_DIV"
      &clk_src_sel=SRC_SEL TODO.
      &clk_src_div=6.
      &clk_m_val=0.
      &clk_n_val=0.
      &clk_2d_val=0.
      
      gosub Set_Clock_Freq
      return
    )
    else if ("&clk_desired_freq"=="150.0")
    (
      &clk_src_name="GPLL0_OUT_MAIN_DIV"
      &clk_src_sel=SRC_SEL TODO.
      &clk_src_div=4.
      &clk_m_val=0.
      &clk_n_val=0.
      &clk_2d_val=0.
      
      gosub Set_Clock_Freq
      return
    )
    else if ("&clk_desired_freq"=="171.428571")
    (
      &clk_src_name="GPLL0_OUT_MAIN"
      &clk_src_sel=SRC_SEL TODO.
      &clk_src_div=7.
      &clk_m_val=0.
      &clk_n_val=0.
      &clk_2d_val=0.
      
      gosub Set_Clock_Freq
      return
    )
    else if ("&clk_desired_freq"=="200.0")
    (
      &clk_src_name="GPLL0_OUT_MAIN"
      &clk_src_sel=SRC_SEL TODO.
      &clk_src_div=6.
      &clk_m_val=0.
      &clk_n_val=0.
      &clk_2d_val=0.
      
      gosub Set_Clock_Freq
      return
    )
    else if ("&clk_desired_freq"=="275.0")
    (
      &clk_src_name="MMPLL5_PLL_OUT_MAIN"
      &clk_src_sel=SRC_SEL TODO.
      &clk_src_div=6.
      &clk_m_val=0.
      &clk_n_val=0.
      &clk_2d_val=0.
      
      gosub Set_Clock_Freq
      return
    )
    else if ("&clk_desired_freq"=="300.0")
    (
      &clk_src_name="GPLL0_OUT_MAIN"
      &clk_src_sel=SRC_SEL TODO.
      &clk_src_div=4.
      &clk_m_val=0.
      &clk_n_val=0.
      &clk_2d_val=0.
      
      gosub Set_Clock_Freq
      return
    )
    else if ("&clk_desired_freq"=="330.0")
    (
      &clk_src_name="MMPLL5_PLL_OUT_MAIN"
      &clk_src_sel=SRC_SEL TODO.
      &clk_src_div=5.
      &clk_m_val=0.
      &clk_n_val=0.
      &clk_2d_val=0.
      
      gosub Set_Clock_Freq
      return
    )
    else if ("&clk_desired_freq"=="412.5")
    (
      &clk_src_name="MMPLL5_PLL_OUT_MAIN"
      &clk_src_sel=SRC_SEL TODO.
      &clk_src_div=4.
      &clk_m_val=0.
      &clk_n_val=0.
      &clk_2d_val=0.
      
      gosub Set_Clock_Freq
      return
    )
    else if ("&clk_desired_freq"=="r")
    (
      return
    )
    else
    (
      print "Invalid selection."
      goto Set_Clock_Freq_Enter
    )
  )

  if ("&clk"=="mmss_mdss_pclk0_clk")||("&clk"=="mmss_spdm_pclk0_clk")
  (
    gosub PRINT_SET_CLOCK_FREQ_WARNING

    &clk_cmd_rcgr_addr=&HWIO_MMSS_PCLK0_CMD_RCGR_ADDR
    &clk_cfg_rcgr_addr=&HWIO_MMSS_PCLK0_CFG_RCGR_ADDR

    print "Choose frequency (MHz) from list below: " 

    print "175.0          280.0          350.0          " 

    print " "
    print "Enter desired frequency (r to return): "
    enter &clk_desired_freq
    print " "

    if ("&clk_desired_freq"=="175.0")
    (
      &clk_src_name="EXTERNAL"
      &clk_src_sel=SRC_SEL TODO.
      &clk_src_div=2.
      &clk_m_val=0.
      &clk_n_val=0.
      &clk_2d_val=0.
      
      gosub Set_Clock_Freq
      return
    )
    else if ("&clk_desired_freq"=="280.0")
    (
      &clk_src_name="EXTERNAL"
      &clk_src_sel=SRC_SEL TODO.
      &clk_src_div=2.
      &clk_m_val=0.
      &clk_n_val=0.
      &clk_2d_val=0.
      
      gosub Set_Clock_Freq
      return
    )
    else if ("&clk_desired_freq"=="350.0")
    (
      &clk_src_name="EXTERNAL"
      &clk_src_sel=SRC_SEL TODO.
      &clk_src_div=2.
      &clk_m_val=0.
      &clk_n_val=0.
      &clk_2d_val=0.
      
      gosub Set_Clock_Freq
      return
    )
    else if ("&clk_desired_freq"=="r")
    (
      return
    )
    else
    (
      print "Invalid selection."
      goto Set_Clock_Freq_Enter
    )
  )

  if ("&clk"=="mmss_mdss_pclk1_clk")||("&clk"=="mmss_spdm_pclk1_clk")
  (
    gosub PRINT_SET_CLOCK_FREQ_WARNING

    &clk_cmd_rcgr_addr=&HWIO_MMSS_PCLK1_CMD_RCGR_ADDR
    &clk_cfg_rcgr_addr=&HWIO_MMSS_PCLK1_CFG_RCGR_ADDR

    print "Choose frequency (MHz) from list below: " 

    print "175.0          280.0          350.0          " 

    print " "
    print "Enter desired frequency (r to return): "
    enter &clk_desired_freq
    print " "

    if ("&clk_desired_freq"=="175.0")
    (
      &clk_src_name="EXTERNAL"
      &clk_src_sel=SRC_SEL TODO.
      &clk_src_div=2.
      &clk_m_val=0.
      &clk_n_val=0.
      &clk_2d_val=0.
      
      gosub Set_Clock_Freq
      return
    )
    else if ("&clk_desired_freq"=="280.0")
    (
      &clk_src_name="EXTERNAL"
      &clk_src_sel=SRC_SEL TODO.
      &clk_src_div=2.
      &clk_m_val=0.
      &clk_n_val=0.
      &clk_2d_val=0.
      
      gosub Set_Clock_Freq
      return
    )
    else if ("&clk_desired_freq"=="350.0")
    (
      &clk_src_name="EXTERNAL"
      &clk_src_sel=SRC_SEL TODO.
      &clk_src_div=2.
      &clk_m_val=0.
      &clk_n_val=0.
      &clk_2d_val=0.
      
      gosub Set_Clock_Freq
      return
    )
    else if ("&clk_desired_freq"=="r")
    (
      return
    )
    else
    (
      print "Invalid selection."
      goto Set_Clock_Freq_Enter
    )
  )

  if ("&clk"=="mmss_mdss_rot_clk")||("&clk"=="mmss_spdm_rot_clk")
  (
    gosub PRINT_SET_CLOCK_FREQ_WARNING

    &clk_cmd_rcgr_addr=&HWIO_MMSS_ROT_CMD_RCGR_ADDR
    &clk_cfg_rcgr_addr=&HWIO_MMSS_ROT_CFG_RCGR_ADDR

    print "Choose frequency (MHz) from list below: " 

    print "171.428571     275.0          330.0          " 
    print "412.5          " 

    print " "
    print "Enter desired frequency (r to return): "
    enter &clk_desired_freq
    print " "

    if ("&clk_desired_freq"=="171.428571")
    (
      &clk_src_name="GPLL0_OUT_MAIN"
      &clk_src_sel=SRC_SEL TODO.
      &clk_src_div=7.
      &clk_m_val=0.
      &clk_n_val=0.
      &clk_2d_val=0.
      
      gosub Set_Clock_Freq
      return
    )
    else if ("&clk_desired_freq"=="275.0")
    (
      &clk_src_name="MMPLL5_PLL_OUT_MAIN"
      &clk_src_sel=SRC_SEL TODO.
      &clk_src_div=6.
      &clk_m_val=0.
      &clk_n_val=0.
      &clk_2d_val=0.
      
      gosub Set_Clock_Freq
      return
    )
    else if ("&clk_desired_freq"=="330.0")
    (
      &clk_src_name="MMPLL5_PLL_OUT_MAIN"
      &clk_src_sel=SRC_SEL TODO.
      &clk_src_div=5.
      &clk_m_val=0.
      &clk_n_val=0.
      &clk_2d_val=0.
      
      gosub Set_Clock_Freq
      return
    )
    else if ("&clk_desired_freq"=="412.5")
    (
      &clk_src_name="MMPLL5_PLL_OUT_MAIN"
      &clk_src_sel=SRC_SEL TODO.
      &clk_src_div=4.
      &clk_m_val=0.
      &clk_n_val=0.
      &clk_2d_val=0.
      
      gosub Set_Clock_Freq
      return
    )
    else if ("&clk_desired_freq"=="r")
    (
      return
    )
    else
    (
      print "Invalid selection."
      goto Set_Clock_Freq_Enter
    )
  )

  if ("&clk"=="mmss_camss_csi_vfe0_clk")||("&clk"=="mmss_camss_vfe0_clk")||("&clk"=="mmss_camss_vfe0_stream_clk")||("&clk"=="mmss_spdm_vfe0_clk")
  (
    gosub PRINT_SET_CLOCK_FREQ_WARNING

    &clk_cmd_rcgr_addr=&HWIO_MMSS_VFE0_CMD_RCGR_ADDR
    &clk_cfg_rcgr_addr=&HWIO_MMSS_VFE0_CFG_RCGR_ADDR

    print "Choose frequency (MHz) from list below: " 

    print "120.0          200.0          256.0          " 
    print "300.0          404.0          480.0          " 
    print "540.0          576.0          " 

    print " "
    print "Enter desired frequency (r to return): "
    enter &clk_desired_freq
    print " "

    if ("&clk_desired_freq"=="120.0")
    (
      &clk_src_name="GPLL0_OUT_MAIN"
      &clk_src_sel=SRC_SEL TODO.
      &clk_src_div=10.
      &clk_m_val=0.
      &clk_n_val=0.
      &clk_2d_val=0.
      
      gosub Set_Clock_Freq
      return
    )
    else if ("&clk_desired_freq"=="200.0")
    (
      &clk_src_name="GPLL0_OUT_MAIN"
      &clk_src_sel=SRC_SEL TODO.
      &clk_src_div=6.
      &clk_m_val=0.
      &clk_n_val=0.
      &clk_2d_val=0.
      
      gosub Set_Clock_Freq
      return
    )
    else if ("&clk_desired_freq"=="256.0")
    (
      &clk_src_name="MMPLL4_PLL_OUT_MAIN"
      &clk_src_sel=SRC_SEL TODO.
      &clk_src_div=6.
      &clk_m_val=0.
      &clk_n_val=0.
      &clk_2d_val=0.
      
      gosub Set_Clock_Freq
      return
    )
    else if ("&clk_desired_freq"=="300.0")
    (
      &clk_src_name="GPLL0_OUT_MAIN"
      &clk_src_sel=SRC_SEL TODO.
      &clk_src_div=4.
      &clk_m_val=0.
      &clk_n_val=0.
      &clk_2d_val=0.
      
      gosub Set_Clock_Freq
      return
    )
    else if ("&clk_desired_freq"=="404.0")
    (
      &clk_src_name="MMPLL0_PLL_OUT_MAIN"
      &clk_src_sel=SRC_SEL TODO.
      &clk_src_div=4.
      &clk_m_val=0.
      &clk_n_val=0.
      &clk_2d_val=0.
      
      gosub Set_Clock_Freq
      return
    )
    else if ("&clk_desired_freq"=="480.0")
    (
      &clk_src_name="MMPLL7_PLL_OUT_MAIN"
      &clk_src_sel=SRC_SEL TODO.
      &clk_src_div=4.
      &clk_m_val=0.
      &clk_n_val=0.
      &clk_2d_val=0.
      
      gosub Set_Clock_Freq
      return
    )
    else if ("&clk_desired_freq"=="540.0")
    (
      &clk_src_name="MMPLL6_PLL_OUT_MAIN"
      &clk_src_sel=SRC_SEL TODO.
      &clk_src_div=4.
      &clk_m_val=0.
      &clk_n_val=0.
      &clk_2d_val=0.
      
      gosub Set_Clock_Freq
      return
    )
    else if ("&clk_desired_freq"=="576.0")
    (
      &clk_src_name="MMPLL10_PLL_OUT_MAIN"
      &clk_src_sel=SRC_SEL TODO.
      &clk_src_div=2.
      &clk_m_val=0.
      &clk_n_val=0.
      &clk_2d_val=0.
      
      gosub Set_Clock_Freq
      return
    )
    else if ("&clk_desired_freq"=="r")
    (
      return
    )
    else
    (
      print "Invalid selection."
      goto Set_Clock_Freq_Enter
    )
  )

  if ("&clk"=="mmss_camss_csi_vfe1_clk")||("&clk"=="mmss_camss_vfe1_clk")||("&clk"=="mmss_camss_vfe1_stream_clk")||("&clk"=="mmss_spdm_vfe1_clk")
  (
    gosub PRINT_SET_CLOCK_FREQ_WARNING

    &clk_cmd_rcgr_addr=&HWIO_MMSS_VFE1_CMD_RCGR_ADDR
    &clk_cfg_rcgr_addr=&HWIO_MMSS_VFE1_CFG_RCGR_ADDR

    print "Choose frequency (MHz) from list below: " 

    print "120.0          200.0          256.0          " 
    print "300.0          404.0          480.0          " 
    print "540.0          576.0          " 

    print " "
    print "Enter desired frequency (r to return): "
    enter &clk_desired_freq
    print " "

    if ("&clk_desired_freq"=="120.0")
    (
      &clk_src_name="GPLL0_OUT_MAIN"
      &clk_src_sel=SRC_SEL TODO.
      &clk_src_div=10.
      &clk_m_val=0.
      &clk_n_val=0.
      &clk_2d_val=0.
      
      gosub Set_Clock_Freq
      return
    )
    else if ("&clk_desired_freq"=="200.0")
    (
      &clk_src_name="GPLL0_OUT_MAIN"
      &clk_src_sel=SRC_SEL TODO.
      &clk_src_div=6.
      &clk_m_val=0.
      &clk_n_val=0.
      &clk_2d_val=0.
      
      gosub Set_Clock_Freq
      return
    )
    else if ("&clk_desired_freq"=="256.0")
    (
      &clk_src_name="MMPLL4_PLL_OUT_MAIN"
      &clk_src_sel=SRC_SEL TODO.
      &clk_src_div=6.
      &clk_m_val=0.
      &clk_n_val=0.
      &clk_2d_val=0.
      
      gosub Set_Clock_Freq
      return
    )
    else if ("&clk_desired_freq"=="300.0")
    (
      &clk_src_name="GPLL0_OUT_MAIN"
      &clk_src_sel=SRC_SEL TODO.
      &clk_src_div=4.
      &clk_m_val=0.
      &clk_n_val=0.
      &clk_2d_val=0.
      
      gosub Set_Clock_Freq
      return
    )
    else if ("&clk_desired_freq"=="404.0")
    (
      &clk_src_name="MMPLL0_PLL_OUT_MAIN"
      &clk_src_sel=SRC_SEL TODO.
      &clk_src_div=4.
      &clk_m_val=0.
      &clk_n_val=0.
      &clk_2d_val=0.
      
      gosub Set_Clock_Freq
      return
    )
    else if ("&clk_desired_freq"=="480.0")
    (
      &clk_src_name="MMPLL7_PLL_OUT_MAIN"
      &clk_src_sel=SRC_SEL TODO.
      &clk_src_div=4.
      &clk_m_val=0.
      &clk_n_val=0.
      &clk_2d_val=0.
      
      gosub Set_Clock_Freq
      return
    )
    else if ("&clk_desired_freq"=="540.0")
    (
      &clk_src_name="MMPLL6_PLL_OUT_MAIN"
      &clk_src_sel=SRC_SEL TODO.
      &clk_src_div=4.
      &clk_m_val=0.
      &clk_n_val=0.
      &clk_2d_val=0.
      
      gosub Set_Clock_Freq
      return
    )
    else if ("&clk_desired_freq"=="576.0")
    (
      &clk_src_name="MMPLL10_PLL_OUT_MAIN"
      &clk_src_sel=SRC_SEL TODO.
      &clk_src_div=2.
      &clk_m_val=0.
      &clk_n_val=0.
      &clk_2d_val=0.
      
      gosub Set_Clock_Freq
      return
    )
    else if ("&clk_desired_freq"=="r")
    (
      return
    )
    else
    (
      print "Invalid selection."
      goto Set_Clock_Freq_Enter
    )
  )

  if ("&clk"=="mmss_spdm_video_core_clk")||("&clk"=="mmss_video_core_clk")||("&clk"=="mmss_video_subcore0_clk")
  (
    gosub PRINT_SET_CLOCK_FREQ_WARNING

    &clk_cmd_rcgr_addr=&HWIO_MMSS_VIDEO_CORE_CMD_RCGR_ADDR
    &clk_cfg_rcgr_addr=&HWIO_MMSS_VIDEO_CORE_CFG_RCGR_ADDR

    print "Choose frequency (MHz) from list below: " 

    print "133.333333     269.333333     320.0          " 
    print "404.0          441.6          518.4          " 

    print " "
    print "Enter desired frequency (r to return): "
    enter &clk_desired_freq
    print " "

    if ("&clk_desired_freq"=="133.333333")
    (
      &clk_src_name="GPLL0_OUT_MAIN"
      &clk_src_sel=SRC_SEL TODO.
      &clk_src_div=9.
      &clk_m_val=0.
      &clk_n_val=0.
      &clk_2d_val=0.
      
      gosub Set_Clock_Freq
      return
    )
    else if ("&clk_desired_freq"=="269.333333")
    (
      &clk_src_name="MMPLL0_PLL_OUT_MAIN"
      &clk_src_sel=SRC_SEL TODO.
      &clk_src_div=6.
      &clk_m_val=0.
      &clk_n_val=0.
      &clk_2d_val=0.
      
      gosub Set_Clock_Freq
      return
    )
    else if ("&clk_desired_freq"=="320.0")
    (
      &clk_src_name="MMPLL7_PLL_OUT_MAIN"
      &clk_src_sel=SRC_SEL TODO.
      &clk_src_div=6.
      &clk_m_val=0.
      &clk_n_val=0.
      &clk_2d_val=0.
      
      gosub Set_Clock_Freq
      return
    )
    else if ("&clk_desired_freq"=="404.0")
    (
      &clk_src_name="MMPLL0_PLL_OUT_MAIN"
      &clk_src_sel=SRC_SEL TODO.
      &clk_src_div=4.
      &clk_m_val=0.
      &clk_n_val=0.
      &clk_2d_val=0.
      
      gosub Set_Clock_Freq
      return
    )
    else if ("&clk_desired_freq"=="441.6")
    (
      &clk_src_name="MMPLL3_PLL_OUT_MAIN"
      &clk_src_sel=SRC_SEL TODO.
      &clk_src_div=4.
      &clk_m_val=0.
      &clk_n_val=0.
      &clk_2d_val=0.
      
      gosub Set_Clock_Freq
      return
    )
    else if ("&clk_desired_freq"=="518.4")
    (
      &clk_src_name="MMPLL3_PLL_OUT_MAIN"
      &clk_src_sel=SRC_SEL TODO.
      &clk_src_div=4.
      &clk_m_val=0.
      &clk_n_val=0.
      &clk_2d_val=0.
      
      gosub Set_Clock_Freq
      return
    )
    else if ("&clk_desired_freq"=="r")
    (
      return
    )
    else
    (
      print "Invalid selection."
      goto Set_Clock_Freq_Enter
    )
  )

  if ("&clk"=="mmss_mdss_vsync_clk")
  (
    gosub PRINT_SET_CLOCK_FREQ_WARNING

    &clk_cmd_rcgr_addr=&HWIO_MMSS_VSYNC_CMD_RCGR_ADDR
    &clk_cfg_rcgr_addr=&HWIO_MMSS_VSYNC_CFG_RCGR_ADDR

    print "Choose frequency (MHz) from list below: " 

    print "19.2           " 

    print " "
    print "Enter desired frequency (r to return): "
    enter &clk_desired_freq
    print " "

    if ("&clk_desired_freq"=="19.2")
    (
      &clk_src_name="CXO"
      &clk_src_sel=SRC_SEL TODO.
      &clk_src_div=2.
      &clk_m_val=0.
      &clk_n_val=0.
      &clk_2d_val=0.
      
      gosub Set_Clock_Freq
      return
    )
    else if ("&clk_desired_freq"=="r")
    (
      return
    )
    else
    (
      print "Invalid selection."
      goto Set_Clock_Freq_Enter
    )
  )


  return

