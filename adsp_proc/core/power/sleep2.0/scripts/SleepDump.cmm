;---------------------------------------------------------------------------
;  File: SleepDump.cmm
;  
;  Description: Dumps Sleep related data structures, optionally dumps sleep 
;               ulogs and merge them
;  
;               Copyright (c) 2011-2016 Qualcomm Technologies, Inc. (QTI).
;               All Rights Reserved.
;               Qualcomm Technologies Confidential and Proprietary
;---------------------------------------------------------------------------


;Path to the output file.
;The three options are for nolog, nodump, and/or nomerge. any ordering is fine
ENTRY &op_path &opt1 &opt2 &opt3 &opt4

;ULog time stamp
GLOBAL &ULogTimestamp &output &curr_dir &resourceStr 
GLOBAL &str

;Local variables
LOCAL &temp &lprmName &ulogcall &uSleepulogcall &clprListPtr
LOCAL &fTable &fCnt &numElem &eCnt &elem
LOCAL &numMLUT &scriptDir
LOCAL &numFLUT &tmpCnt
LOCAL &logCnt &logName &numLogs

&curr_dir=os.pwd()

if "&op_path"==""
(
  ;Print a help message for srcipt
  AREA.Create SleepDumpHelp
  AREA.Select SleepDumpHelp
  AREA SleepDumpHelp

  ; no path to output provided.
  PRINT "Use: SleepDump.cmm <output_path> [config] [nolog] [nodump] [nomerge] [npa]"
  PRINT "  Optional arguments, 
  PRINT "  config  - default (for default directory structure)"
  PRINT "  nolog   - Sleep Ulogs will not be dumped"
  PRINT "            (Will set nomerge implicitly)"
  PRINT "  nodump  - Sleep Data structures will not be dumped"
  PRINT "  nomerge - Sleep logs will not be merged"
  PRINT "  npa     - Also dump NPA state"

  ENDDO
)

;---------------------------------------------------------------------------
; op_path is the path to output the file, 
; We will see if that directory already exist if not we try to create
; If it fails, we abort the script
;---------------------------------------------------------------------------
if !OS.DIR(&op_path)
(
  PRINT "Output path does not exist. Trying to create..."
  mkdir &op_path

  ; Error while creating output path
  if !OS.DIR(&op_path)
  (
    PRINT "Error: Failed to locate/create &(op_path). Exiting..."
    ENDDO
  )
)

; Opening a file for sleep dump at given output path
cd &op_path
&op_path=os.pwd()
cd &curr_dir

; Locate the core directory (by doing \..\ three times in the current working directory)
&coredir=os.ppd()
&coredir=os.file.path(&coredir)
&coredir=os.file.path(&coredir)
&coredir=os.file.path(&coredir)

;-------------------------------------------------------------------------
; Processing the optional arguments
;
; Currently we are comparing all combination of last 4 arguments in order 
; to provide flexibility to specify option in any order. But try to find
; out if there is a way for command line arguments with varying numbers.
;-------------------------------------------------------------------------
&buildConfig="default"
&merge="true"
&log="true"
&dump="true"
&npastate="false"

;if nomerge is passed as either option param
if "&opt1"=="nomerge"||"&opt2"=="nomerge"||"&opt3"=="nomerge"||"&opt4"=="nomerge"
(
  &merge="false"
)

;if npa is passed as either option param
if "&opt1"=="npa"||"&opt2"=="npa"||"&opt3"=="npa"||"&opt4"=="npa"
(
  &npastate="true"
)

;if nolog is passed as either option param
;merge is implicitly declared as false when log is false, 
;because then theres only 1 or 0 logs, and there's nothing to merge
if "&opt1"=="nolog"||"&opt2"=="nolog"||"&opt3"=="nolog"||"&opt4"=="nolog"
(
  &log="false"
  &merge="false"
)

;if nodump is passed as one of optional param
if "&opt1"=="nodump"||"&opt2"=="nodump"||"&opt3"=="nodump"||"&opt4"=="nodump" 
(
  &dump="false"
)

; finding out the correct build configuration. For each os we might need
; a comparison. Find out the better way if exists
if "&opt1"=="qnx"||"&opt2"=="qnx"||"&opt3"=="qnx"||"&opt4"=="qnx"
(
  &buildConfig="qnx"
)

;-----------------------------------------------------------------------
; Constructing log call string and calling ulog dump on it based on
; build configuration
;-----------------------------------------------------------------------
&resourceStr=""
;switching to appropriate directory to get sleep logs

IF symbol.exist(g_SleepNumOfFreqs)
  &numMLUT=V.VALUE(g_SleepNumOfFreqs)
ELSE
  &numMLUT=1

;Don't run if we passed the nolog param
if "&log"=="true"
(
  ; We may need a function that takes argument as build configuration
  ; (modem, apps) and number of cores sleep is running. Based on those
  ; two args, it calls ulog script for all sleep logs before actual 
  ; dumping starts
  if "&buildConfig"=="default"
  (
    ;String to call ulog dump
    &ulogcall="&(coredir)\services\diag\diagbuffer\scripts\ULogDump.cmm"
    &uSleepulogcall="&(coredir)\services\diag\micro_diagbuffer\scripts\micro_ULogDump.cmm"
    &scriptDir="&(curr_dir)"

    ; Call micro ulog to dump logs from island section
    if V.VALUE(g_sleepEnabledFeatures & 0x0020)!=0
    (
      ; Call micro ulog to dump logs from island section
      &logCnt=0
      &numLogs=VAR.SIZEOF(g_uSleepLogs)/VAR.SIZEOF(g_uSleepLogs[0])
      while &logCnt<&numLogs
      (      
        &logName=DATA.STRING(D:V.VALUE(g_uSleepLogs[&logCnt].name))
        ;print "Dumping Log: &logName"
        DO &uSleepulogcall &op_path "&logName"
        &logCnt=&logCnt+1
      )

      ; Call ulog to dump logs from normal section
      &logCnt=0
      &numLogs=VAR.SIZEOF(g_uSleepDDRLogs)/VAR.SIZEOF(g_uSleepDDRLogs[0])
      while &logCnt<&numLogs
      (      
        &logName=DATA.STRING(D:V.VALUE(g_uSleepDDRLogs[&logCnt].name))
        ;print "Dumping Log: &logName"
        DO &ulogcall &op_path "&logName"
        &logCnt=&logCnt+1
      )
    )

    ;calling ulog script to dump all sleep logs
    &logCnt=0
    while &logCnt<V.VALUE(g_sleepNumberOfLogs)
    (      
      &logName=DATA.STRING(D:V.VALUE(g_sleepLogNameArray[&logCnt]))
      ;print "Dumping Log: &logName"
      DO &ulogcall &op_path "&logName"
      &logCnt=&logCnt+1
    )
  )

  ; different configuration can go here like LPASS, sensors if they
  ; have different ulog call or logs than what we have for default
  
  if "&merge"=="true"
  (
    do &(scriptDir)\mergeLogs.cmm &(scriptDir) &op_path mergedOutput.ulog
  )
)

;----------------------------------------------------------------------------
; Running the actual dump for sleep data structures. If we don't have correct
; time stamp (due to nolog option as input or ulog failed for some reason)
; we simply set it to all Fs so that during merging, dump will be at the end.
;----------------------------------------------------------------------------
if "&ULogTimestamp"==""
(
  &ULogTimestamp=0xFFFFFFFF
)

;Don't run dump if we passed nodump
if "&dump"=="true"
(
  cd &op_path
  OPEN #1 "SleepDump.ulog" /Create
  &output="WRITE #1"
  
  &numFLUT=0
  &str="&(ULogTimestamp): (Frequency List:"      
  &fTable=V.VALUE((sleep_fLUT_node *)g_sleepFLUT)
  while V.VALUE((sleep_fLUT_node *)&fTable)!=0
  (             
    &temp=FORMAT.DECIMAL(0, V.VALUE(((sleep_fLUT_node *)&fTable)->frequency))
    &str="&(str) &(temp)"
    
    if V.VALUE(g_sleepEnabledFeatures & 0x0008)!=0
    (
      &tmpCnt=0
      while &tmpCnt<&numMLUT
      (
        &temp=V.VALUE(((sleep_fLUT_node *)&fTable)->frequency)
        if &temp==V.VALUE(SleepLPR_static_freq_list[&tmpCnt])
        (
          &str="&(str)*"
          &tmpCnt=&numMLUT
        )
        &tmpCnt=&tmpCnt+1
      )
    )
    
    &fTable=V.VALUE(((sleep_fLUT_node *)&fTable)->next)
    &numFLUT=&numFLUT+1
  )
  &output "&(str))"
  
  &clprListPtr=V.VALUE(&g_LPRRegistry)
  GOSUB DumpCLpr &clprListPtr

  &resourceStr=""
  
  CLOSE #1
  
  ;Write statistic dump file
  OPEN #1 "SleepStatDump.ulog" /Create
  &output="WRITE #1"
   
  GOSUB DumpSleepFeatures
  GOSUB DumpSleepStats
  
  &output "&(ULogTimestamp): Lookup table element statistics:"
  &fCnt=0
  while &fCnt<&numMLUT
  ( 
    if V.VALUE(g_sleepEnabledFeatures & 0x0008)!=0
    (
      &elem=FORMAT.DECIMAL(0, V.VALUE(SleepLPR_static_freq_list[&fCnt]))
    )
    else
    (
      &elem=0
    )
      
    &output "&(ULogTimestamp):  Table &fCnt, frequency &(elem)"

    &elem=V.VALUE((sleep_mLUT *)SleepLPR_power_lookup_table[&fCnt])
    &numElem=V.VALUE(((sleep_mLUT *)&elem)->num_elements)
    &eCnt=0
    while &eCnt<&numElem
    (
      &temp=V.VALUE(((sleep_mLUT *)&elem)->element)
      &temp=V.VALUE(&((sleep_mLUT_elem *)&temp)[&eCnt])
      GOSUB DumpLTElemStats &temp
      &output "&(str)"
      &eCnt=&eCnt+1
    )
    &output "&(ULogTimestamp):"
    &fCnt=&fCnt+1
  )
  
  CLOSE #1  
)

;End Dump
PRINT "Sleep dump completed..."

;Dump the NPA state if option was given
if "&npastate"=="true"
(
  PRINT "Dumping NPA state..."
  &ulogcall="&(curr_dir)\..\..\npa\scripts\NPADump.cmm"
  DO &ulogcall &op_path state
)

cd &(curr_dir)

ENDDO



;=================================================================
;                          Functions
;=================================================================

;-----------------------------------------------------------------
; Dumping a synthesized LPR. This function will gets called
; while dumping list of Syn LPRs.
;-----------------------------------------------------------------

DumpCLpr:
  ENTRY &clpr
  LOCAL &ptrClprm &ptrLpr &lprName &temp
  LOCAL &numCLprms &numCacheComp &numUncacheComp
  LOCAL &it &jt

  &numCLprms=V.VALUE(((synthRegistry *)&clpr)->LPR->mode_count)
  &output "&(ULogTimestamp):"
  &output "&(ULogTimestamp):  Registered LPRs"

  ; This is somewhat long procedure. We don't store directly registered
  ; sleep_lpr. We can query the look up table but for that we will have 
  ; to introduce new variable for its size as cmm script does not know 
  ; its size at run time. Things may get tricky if binary compatibilty
  ; is to be introduced.

  &it=0
  while &it<&numCLprms
  (
    &ptrClprm=V.VALUE(((synthRegistry *)&clpr)->LPR->modes + &it)
    
    ; Num of expected modes of ptrClprm CLprm
    &numCacheComp=V.VALUE(((sleep_synth_lprm *)&ptrClprm)->cacheable.num_component_modes)
    &numUncacheComp=V.VALUE(((sleep_synth_lprm *)&ptrClprm)->uncacheable.num_component_modes)
    
    &jt=0
    while &jt<&numCacheComp
    (
      &temp=V.VALUE(((sleep_synth_lprm *)&ptrClprm)->cacheable.component_modes + &jt)
      &temp=V.VALUE((sleep_lprm *)(*(sleep_lprm **)&temp))
      &ptrLpr=V.VALUE(((sleep_lprm *)&temp)->parent_LPR)
      IF &ptrLpr!=0 
      (
        &lprName=DATA.STRING(D:V.VALUE(((sleep_lpr *)&ptrLpr)->resource_name))
  
        if STRING.SCAN("&(resourceStr)", "$&(lprName)$", 0)==-1
        (
          GOSUB DumpSleepLpr &ptrLpr
          &resourceStr="&(resourceStr) $&(lprName)$"
        )
      )

      &jt=&jt+1
    )

    &jt=0
    while &jt<&numUncacheComp
    (
      &temp=V.VALUE(((sleep_synth_lprm *)&ptrClprm)->uncacheable.component_modes + &jt)
      &temp=V.VALUE((sleep_lprm *)(*(sleep_lprm **)&temp))
      &ptrLpr=V.VALUE(((sleep_lprm *)&temp)->parent_LPR)
      IF &ptrLpr!=0 
      (
        &lprName=DATA.STRING(D:V.VALUE(((sleep_lpr *)&ptrLpr)->resource_name))
  
        if STRING.SCAN("&(resourceStr)", "$&(lprName)$", 0)==-1
        (
          GOSUB DumpSleepLpr &ptrLpr
          &resourceStr="&(resourceStr) $&(lprName)$"
        )
      )

      &jt=&jt+1
    )

    &it=&it+1
  )

  &output "&(ULogTimestamp):  Synthesized modes:"

  &it=0
  while &it<&numCLprms
  (
    &ptrClprm=V.VALUE(((synthRegistry *)&clpr)->LPR->modes + &it)
    
    GOSUB DumpCLprm &ptrClprm
    &it=&it+1
  )

  RETURN

;-----------------------------------------------------------------
; Dumping individual CLprm
;-----------------------------------------------------------------
DumpCLprm:
  ENTRY &clprm
  LOCAL &lprmName &componentLprms &status_val &status_string

  &lprmName=DATA.STRING(D:V.VALUE(((sleep_synth_lprm *)&clprm)->name))
  &status_val=V.VALUE(((sleep_synth_lprm *)&clprm)->mode_status)

  IF &status_val==0
    &status_string="Enabled"
  ELSE
    &status_string="Disabled"

  &output "&(ULogTimestamp):    (Mode: &(lprmName))"
  &output "&(ULogTimestamp):       (Status: &(status_string))"

  RETURN


;---------------------------------------------------------------------------
; Dumps the sleep_lpr structure
;---------------------------------------------------------------------------
DumpSleepLpr:
  ENTRY &lprPtr
  LOCAL &aMode &modeAddress &index &tempStr &modeName

  &index=0
 
  &aMode=V.VALUE(((sleep_lpr *)&lprPtr)->modes + 1 )
  &lprName=DATA.STRING(D:V.VALUE(((sleep_lpr *)&lprPtr)->resource_name))
  &modeCount=V.VALUE(((sleep_lpr *)&lprPtr)->mode_count)
  &output "&(ULogTimestamp):   Resource Name: &(lprName)"

  while &index<&modeCount
  (
    &aMode=V.VALUE(((sleep_lpr *)&lprPtr)->modes + &index )
    &modeName=DATA.STRING(D:V.VALUE(((sleep_lpr *)&aMode)->resource_name))
    PRINT "&(aMode) : &(lprName).&(modeName)"
    GOSUB DumpSleepLprm &aMode &index
    &index=&index+1
  )
  PRINT " "
  &output "&(ULogTimestamp):"

  RETURN


;---------------------------------------------------------------------------
; Dumps sleep_lprm structure
;---------------------------------------------------------------------------
DumpSleepLprm:
  ENTRY &lprm &index
  LOCAL &modeName &temp
  LOCAL &modeStatus &intime &attrs &statusStr &registered

  &modeName=DATA.STRING(D:V.VALUE(((sleep_lprm *)&lprm)->mode_name))

  &modeStatus=V.VALUE(((sleep_lprm *)&lprm)->mode_enabled)
  IF &modeStatus==0
    &statusStr="Disabled"
  ELSE
    &statusStr="Enabled "

  &temp=FORMAT.DECIMAL(0, &index)
  &str="&(ULogTimestamp):    Mode #&temp : (Name: "
  &temp=FORMAT.STRING("&(modeName)", 20., ' ')
  &str="&(str)&temp"
  
  &registered=V.VALUE( ((sleep_lpr *)(((sleep_lprm *)&lprm)->parent_LPR))->registered )
  if &registered==0
    &str="&(str) - NOT REGISTERED)"
  else
    &str="&(str))"
  
  &str="&(str) (status: &(statusStr))"

  &attrs=FORMAT.HEX(0, V.VALUE(((sleep_lprm *)&lprm)->attributes))
  &str="&(str) (Attribute: 0x&(attrs))"

  &output "&(str)"

  RETURN

;---------------------------------------------------------------------------
; Dumps lookup table stats
;---------------------------------------------------------------------------
DumpLTElemStats:
  ENTRY &ltelem
  LOCAL &dur &stats &min &max &temp
  
  &stats=V.VALUE( (sleepStats_generic *)&(((sleep_mLUT_elem *)&ltelem)->element_stats) )
  &dur=V.VALUE(((sleep_mLUT_elem *)&ltelem)->duration_thresh)
  &dur=FORMAT.DECIMAL(0, &dur);
  &str="&(ULogTimestamp):   (Element: "
  &temp=FORMAT.STRING("&(dur))", -10., ' ')
  &str="&(str)&temp"
  
  &min=V.VALUE( ((sleepStats_generic *)&stats)->min )
  &min=FORMAT.DECIMAL(0, &min)
  &max=V.VALUE( ((sleepStats_generic *)&stats)->max )
  &max=FORMAT.DECIMAL(0, &max)
  &str="&(str)(Hit Range: "
  &temp=FORMAT.STRING("&(min) <-> &(max))", -25., ' ')
  &str="&(str)&temp"
    
  &tmp=V.VALUE( ((sleepStats_generic *)&stats)->count )
  &tmp=FORMAT.DECIMAL(0, &tmp)
  &str="&(str) (Count: &(tmp))"
  
  RETURN

;---------------------------------------------------------------------------
; Dumps sleep feature status
;---------------------------------------------------------------------------  
DumpSleepFeatures:
   
  &output "&(ULogTimestamp): Sleep Features:"
  
  &str="&(ULogTimestamp):                 QDSS :"
  if V.VALUE(g_sleepEnabledFeatures & 0x0001)!=0
    &str="&(str) Enabled"
  else
    &str="&(str) Disabled"
  &output "&(str)"
  
  &str="&(ULogTimestamp):         RSVD FEATURE :"
  if V.VALUE(g_sleepEnabledFeatures & 0x0002)!=0
    &str="&(str) Enabled"
  else
    &str="&(str) Disabled"
  &output "&(str)"
  
  &str="&(ULogTimestamp): Synth Backoff Adjust :"
  if V.VALUE(g_sleepEnabledFeatures & 0x0004)!=0
    &str="&(str) Enabled"
  else
    &str="&(str) Disabled"
  &output "&(str)"
  
  &str="&(ULogTimestamp):    Frequency Scaling :"
  if V.VALUE(g_sleepEnabledFeatures & 0x0008)!=0
    &str="&(str) Enabled"
  else
    &str="&(str) Disabled"
  &output "&(str)"
  
  ;Flag is actually "disable modes" when set
  &str="&(ULogTimestamp):    Sleep allow modes :"
  if V.VALUE(g_sleepEnabledFeatures & 0x0010)!=0
    &str="&(str) Disable"
  else
    &str="&(str) Enabled"
  &output "&(str)"
  
  &str="&(ULogTimestamp):               uSleep :"
  if V.VALUE(g_sleepEnabledFeatures & 0x0020)!=0
    &str="&(str) Enabled"
  else
    &str="&(str) Disabled"
  &output "&(str)"

  &str="&(ULogTimestamp):                  QRT :"
  if V.VALUE(g_sleepEnabledFeatures & 0x0040)!=0
    &str="&(str) Enabled"
  else
    &str="&(str) Disabled"
  &output "&(str)"

  &output "&(ULogTimestamp):"
  
  RETURN
  
;---------------------------------------------------------------------------
; Dumps LPR stats
;---------------------------------------------------------------------------
DumpSleepStats:
  LOCAL &SLT &num &numLPRM &i &j &lpr 
  LOCAL &fCnt &stats &temp &elem
  LOCAL &count &total &idx &dynData

  &output "&(ULogTimestamp): Sleep Component Mode Statistics:"

  &str="&(ULogTimestamp): "
  &temp=FORMAT.STRING(" MODE", 32., ' ')
  &str="&(str)&temp"
  
  &temp=FORMAT.STRING("TOTAL TIME", -16., ' ')
  &str="&(str)&temp"
  
  &temp=FORMAT.STRING("LAST TIME", -17., ' ')
  &str="&(str)&temp"
  
  &temp=FORMAT.STRING("CYCLE COUNT", -17., ' ')
  &str="&(str)&temp"
  &output "&(str)"
  &output "&(ULogTimestamp):"
  
  &num=Var.SIZEOF(SleepLPR_LookupTable)/Var.SIZEOF(SleepLPR_LookupTable[0])
  &i=0
  while &i<&num
  ( 
    &SLT=V.VALUE((sleep_lpr *)SleepLPR_LookupTable[&i])
    
    &j=0
    &numLPRM=V.VALUE(((sleep_lpr *)&SLT)->mode_count)
    
    while &j<&numLPRM
    (
      ;Sample line:
      ;0xC4EEE10: Mode: (cxo.shutdown) (Total time: 123456789) (Last time: 123456) (Cycles 660)
      
      &modeName=DATA.STRING(D:V.VALUE(((sleep_lpr *)&SLT)->resource_name))
      
      &lpr=V.VALUE((sleep_lpr *)&SLT)
      &elem=V.VALUE((sleep_lprm *)(((sleep_lpr *)&lpr)->modes) + &j)
      &temp=DATA.STRING(D:V.VALUE(((sleep_lprm *)&elem)->mode_name))

      &modeName=FORMAT.STRING(" &(modeName).&(temp)", 32., ' ')
      &str="&(ULogTimestamp): &modeName"
      
      &temp=FORMAT.DECIMALU(16., V.VALUE(((sleep_lprm *)&elem)->mode_statistics.in_mode_time))
      &str="&(str)&temp "
      
      &temp=FORMAT.DECIMALU(16., V.VALUE(((sleep_lprm *)&elem)->mode_statistics.last_mode_time))
      &str="&(str)&temp "
      
      &temp=FORMAT.DECIMALU(16., V.VALUE(((sleep_lprm *)&elem)->mode_statistics.mode_run_cycles))
      &output "&(str)&temp"
      
      &j=&j+1
    )
    &i=&i+1
  )
  &output "&(ULogTimestamp):"

  RETURN  
