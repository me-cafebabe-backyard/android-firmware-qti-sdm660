;=============================================================================
;
; tc.cmm 
;
; Script to execute a single testclock.cmm sequence (and leave its window
; displayed).
;
; Intended to serve as an alternative to using the interactice testclock.cmm
; directly. This method allows users to avoid PRACTICE script interference and
; to leverage the T32 main command line history utility.
;
; ============================================================================
;
; Copyright (c) 2015 Qualcomm Technologies Incorporated.  All Rights Reserved.  
; QUALCOMM Proprietary and Confidential. 
;
; ============================================================================
; $Header: //components/rel/core.qdsp6/1.0.c2/systemdrivers/clock/scripts/sdm660/cdsp/tc.cmm#1 $
; $DateTime: 2020/02/10 01:57:30 $
; $Author: pwbldsvc $
; ============================================================================

local &tc_ret
local &script_dir
local &launch_line

entry %LINE &launch_line

; Get the absolute path to this script's directory.
&script_dir=OS.PPD()

; Run a single testclock sequence and leave its window displayed.
do &script_dir\testclock.cmm __help_same_window__ __tc__ &launch_line x .
entry &tc_ret

enddo &tc_ret
