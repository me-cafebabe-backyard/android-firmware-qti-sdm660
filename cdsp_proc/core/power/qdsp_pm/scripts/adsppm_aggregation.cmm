;====================================================================
; Copyright (c) 2015 Qualcomm Technologies, Inc.
; All Rights Reserved.
; Qualcomm Technologies, Inc. Confidential and Proprietary.
;====================================================================

;===================================================================
; Name:  adsppm_aggregation.cmm
;
; Description:
;   Print out all the aggregated values and the contributions from 
;	client requests
;
;====================================================================

LOCAL &AggrOutput
&AggrOutput="adsppm_aggregated_outputs"

;AREA.RESet

WINPOS 0. 0. 50% 100% , , AggrOutput
AREA.CREATE &AggrOutput 256. 1024.
AREA.CLEAR &AggrOutput
AREA.VIEW &AggrOutput
AREA.SELECT &AggrOutput

LOCAL &clientNode &clientName &clientId &client &clientNodeBckup
LOCAL &index &numClients &numClientsPrint
LOCAL &reqArray &reqNode &resIdToDump
LOCAL &rscIdx &counter &nRscClients &GeneralParam

LOCAL &typeList
LOCAL &nTypes   ; of AdsppmRscIds

;==================================================
; Constants used in this file
;==================================================
LOCAL &RscIdSleepLat &RscIdMips &RscIdBW
LOCAL &BusPortQ6Master

&RscIdSleepLat=3	;Adsppm_Rsc_Id_Sleep_Latency
&RscIdMips=4		;Adsppm_Rsc_Id_Mips
&RscIdBW=5			;Adsppm_Rsc_Id_BW

&BusPortQ6Master=1	;AdsppmBusPort_Q6DSP_Master
;===================================================

&output="PRINT"
&typeList=":power:core_clk:sleep_latency:mips:bw::mempower"

&nTypes=0
WHILE (VAR.STRING((AdsppmRscIdType)&nTypes)!="Adsppm_Rsc_Id_Max")
(
    &nTypes=&nTypes+1
)

PRINT ""
PRINT "----------------------------------------------------------------------------------------------"
PRINT %COLOR.PURPLE "ADSPPM Aggregated Data"
PRINT "----------------------------------------------------------------------------------------------"
PRINT ""

&clientNode=V.VALUE(gAdsppmClientManager.clients.link.pNext)
&clientNodeBckup=&clientNode
&numClients=V.VALUE(gAdsppmClientManager.clients.nCnt)
&numClientsPrint=FORMAT.DECIMAL(0,&numClients)

; In case of BW:
;	When this variable is set only DDR contents are printed
; In case of Mips:
;	When this variable is set only mpps contents are printed
&GeneralParam=0

PRINT %COLOR.GREEN "Total No. of clients  = &numClientsPrint"
PRINT ""
PRINT "----------------------------------------------------------------------------------------------"

GOSUB printLatencyMgr
PRINT "----------------------------------------------------------------------------------------------"
&resIdToDump=&RscIdSleepLat
GOSUB printReq &resIdToDump &clientNodeBckup &GeneralParam
PRINT "----------------------------------------------------------------------------------------------"

GOSUB printMIPSMgr
PRINT "----------------------------------------------------------------------------------------------"
&resIdToDump=&RscIdMips
&GeneralParam="Adsppm_Q6ClockRequestUsageType_Mpps"
GOSUB printReq &resIdToDump &clientNodeBckup &GeneralParam
PRINT "----------------------------------------------------------------------------------------------"
&GeneralParam="Adsppm_Q6ClockRequestUsageType_Mips"
GOSUB printReq &resIdToDump &clientNodeBckup &GeneralParam
PRINT "----------------------------------------------------------------------------------------------"

GOSUB printBusMgr
PRINT "----------------------------------------------------------------------------------------------"
&resIdToDump=&RscIdBW
&GeneralParam=1			;Print only DDR
GOSUB printReq &resIdToDump &clientNodeBckup &GeneralParam
PRINT "----------------------------------------------------------------------------------------------"
&GeneralParam=0			;Print apart from DDR
GOSUB printReq &resIdToDump &clientNodeBckup &GeneralParam
PRINT "----------------------------------------------------------------------------------------------"

GOSUB printSleep
PRINT "----------------------------------------------------------------------------------------------"

GOSUB printDCVSMgr
PRINT "----------------------------------------------------------------------------------------------"
PRINT ""
PRINT %COLOR.PURPLE "Dump Completed"

GOSUB cleanup_exit

; This is the generic code to print the respect data for mips/bus/sleep etc.
printReq:
	ENTRY &resIdToDump &clientNodeBckup &GeneralParam

	&index=0

	&clientNode=&clientNodeBckup

	WHILE &index<&numClients
	(
		&client=&clientNode+8
		PRIVATE &shortTypeName

		&reqArray=VAR.VALUE(gAdsppmCoreCtx.rscReqQ)
		&rscIdx=&resIdToDump

		IF (&rscIdx<&nTypes)
		(
			; Parse for a specific resource type
			&shortTypeName=STRING.LoWeR(STRING.MID(VAR.STRING((AdsppmRscIdType)&rscIdx),14.,100.))  ; e.g. power, mips, bw

			IF (STRing.SCAN("&typeList",":&shortTypeName",0.)>=0)
			(
				&reqNode=VAR.VALUE(gAdsppmCoreCtx.rscReqQ[&rscIdx-1].link.pNext)        ; Head of the list of clients for the current resource type
				&nRscClients=VAR.VALUE(((coreUtils_Q_Type *)&reqArray)[&rscIdx-1].nCnt) ; number of clients for the current resource type
				&counter=0

				WHILE (&counter<&nRscClients)
				(
					IF (&counter==&index)
					(
						IF ("&shortTypeName"=="sleep_latency")
                        (
                            GOSUB printLatency &client &reqNode
                        )
						ELSE IF ("&shortTypeName"=="mips")
						(
							GOSUB printMIPS &client &reqNode &GeneralParam
						)
						ELSE IF ("&shortTypeName"=="bw")
						(
							GOSUB printBW &client &reqNode &GeneralParam
						)
					)    ; if counter == index
				
					&reqNode=VAR.VALUE((*((coreUtils_Q_LinkType *)&reqNode)).pNext)
					&counter=&counter+1
				)   ; counter < nRscClients loop
			)
		) ; rscIdx loop

		&clientNode=V.VALUE((*((coreUtils_Q_LinkType *)&clientNode)).pNext)
		&index=&index+1	
	) ; index loop
RETURN

;
;   ADSPPM Sleep Latency requests
;
printLatency:
    ENTRY   &client &reqNode
    LOCAL   &validFlag &validFlagExt &reqData &latencyVote
	
	&clientId=FORMAT.DECIMAL(3.,V.VALUE((*((AdsppmClientType *)&client)).clientId))
	&clientName=DATA.STRING(D:V.VALUE((*((AdsppmClientType *)&client)).clientName))

    &validFlag=VAR.VALUE((*((RMHandleType *)&reqNode)).validFlag)
    &validFlagExt=VAR.VALUE((*((RMHandleType *)&reqNode)).validFlag_Ext)
    &reqData=VAR.VALUE((*((RMHandleType *)&reqNode)).pRequestData)
    &latencyVote=FORMAT.DECIMAL(0,VAR.VALUE(*((uint32 *)(&reqData))))

    IF &validFlag==1
    (
		&output  FORMAT.STRing("&clientName",15.,' ') "CID: &clientId   latencyVote       : &latencyVote" 
    )

RETURN

printLatencyMgr:
    PRIVATE &qdsp6Clk
    IF (sYmbol.EXIST("gSleepMgrCtx"))
    (
        ; MPPS Aggregate Data
        PRIVATE &totalLatency
		PRIVATE &activeStateIndex &indexToDump
		
		; General Info
        &activeStateIndex=VAR.VALUE(gSleepMgrCtx.activeStateIndex)
        &indexToDump=&activeStateIndex^1

		&totalLatency=FORMAT.DECIMAL(0.,VAR.VALUE(gSleepMgrCtx.latencyUs[&indexToDump]))     
		PRINT ""
		&output  %COLOR.BLUE "Total Latency Aggr    Latency : &totalLatency"
    )
    ELSE
    (
        &err "Ignoring LatencyMgr dump: no such symbol"
    )
RETURN

;
;   ADSPPM Bandwidth requests
;
printBW:
    ENTRY   &client &reqNode &GeneralParam
    LOCAL   &validFlag &validFlagExt &reqData &reqDataExt &numBwReq &bwReq
    LOCAL   &bwIndex &bwIndexPrint &reqArray
    LOCAL   &bytesPerSec &usagePercentage
	LOCAL   &masterPort &slavePort

    &validFlag=VAR.VALUE((*((RMHandleType *)&reqNode)).validFlag)
    &validFlagExt=VAR.VALUE((*((RMHandleType *)&reqNode)).validFlag_Ext)
    &reqData=VAR.VALUE((*((RMHandleType *)&reqNode)).pRequestData)
    &reqDataExt=VAR.VALUE((*((RMHandleType *)&reqNode)).pRequestData_Ext)
    &numBwReq=VAR.VALUE((*((AdsppmBwReqType *)&reqData)).numOfBw)

    &bwReq=FORMAT.DECIMAL(0,VAR.VALUE((*((AdsppmBwReqType *)&reqData)).pBwArray))

    IF &validFlag==1||&validFlagExt==1
    (
		&clientId=FORMAT.DECIMAL(3.,V.VALUE((*((AdsppmClientType *)&client)).clientId))
		&clientName=DATA.STRING(D:V.VALUE((*((AdsppmClientType *)&client)).clientName))
	)
	
    IF &validFlag==1
    (
        &bwIndex=0
        &bwIndexPrint=FORMAT.DECIMAL(1.,&bwIndex)
        &reqArray=VAR.VALUE((*((AdsppmBwReqType *)&reqData)).pBwArray)

        WHILE (&bwIndex<&numBwReq)
        (
            &bwReq=VAR.VALUE((AdsppmBusBWRequestValueType *)&reqArray)+Var.SIZEOF(((AdsppmBusBWRequestValueType *)&reqArray)[0])*&bwIndex

			&masterPort=FORMAT.UDECIMAL(3.,VAR.VALUE((*((AdsppmBusBWRequestValueType *)&bwReq)).busRoute.masterPort))
			&slavePort=FORMAT.UDECIMAL(3.,VAR.VALUE((*((AdsppmBusBWRequestValueType *)&bwReq)).busRoute.slavePort))
			;&masterPort=VAR.STRING((AdsppmBusPortIdType)(*((AdsppmBusBWRequestValueType *)&bwReq)).busRoute.masterPort)
			;&slavePort=VAR.STRING((AdsppmBusPortIdType)(*((AdsppmBusBWRequestValueType *)&bwReq)).busRoute.slavePort)

            &bytesPerSec=FORMAT.UDECIMAL(10.,VAR.VALUE((*((AdsppmBusBWRequestValueType *)&bwReq)).bwValue.busBwValue.bwBytePerSec))
            &usagePercentage=FORMAT.DECIMAL(5.,VAR.VALUE((*((AdsppmBusBWRequestValueType *)&bwReq)).bwValue.busBwValue.usagePercentage))
			
			IF &GeneralParam==1		;Dump DDR BW
			(	
				IF (VAR.VALUE((*((AdsppmBusBWRequestValueType *)&bwReq)).busRoute.masterPort)==&BusPortQ6Master)
				(
					;AdsppmBusPort_Ddr_Slave
					IF (VAR.STRING((AdsppmBusPortIdType)(*((AdsppmBusBWRequestValueType *)&bwReq)).busRoute.slavePort)=="AdsppmBusPort_Ddr_Slave")
					(
						&output  FORMAT.STRing("&clientName",15.,' ') "CID: &clientId" FORMAT.STRing("BW-> ",-10.,' ') "&bwIndexPrint    BytesPerSec &bytesPerSec" " : Usage% &usagePercentage Route: &masterPort -> &slavePort"
					)
				)
			)
			ELSE IF &GeneralParam==0
			(
				; Other than DDR BW
				IF (VAR.STRING((AdsppmBusPortIdType)(*((AdsppmBusBWRequestValueType *)&bwReq)).busRoute.slavePort)!="AdsppmBusPort_Ddr_Slave")
				(
					&output  FORMAT.STRing("&clientName",15.,' ') "CID: &clientId" FORMAT.STRing("BW-> ",-10.,' ') "&bwIndexPrint    BytesPerSec &bytesPerSec" " : Usage% &usagePercentage Route: &masterPort -> &slavePort"
				)
				ELSE IF (VAR.VALUE((*((AdsppmBusBWRequestValueType *)&bwReq)).busRoute.masterPort)!=&BusPortQ6Master)
				(
					&output  FORMAT.STRing("&clientName",15.,' ') "CID: &clientId" FORMAT.STRing("BW-> ",-10.,' ') "&bwIndexPrint    BytesPerSec &bytesPerSec" " : Usage% &usagePercentage Route: &masterPort -> &slavePort"
				)
			)

            &bwIndex=&bwIndex+1
            &bwIndexPrint=FORMAT.DECIMAL(0,&bwIndex)
        )
    )

    IF &validFlagExt==1
    (
		&bwIndex=0
		&bwIndexPrint=FORMAT.DECIMAL(1.,&bwIndex)

		&masterPort=FORMAT.UDECIMAL(3.,VAR.VALUE((*((AdsppmBusBWRequestValueType *)&bwReq)).busRoute.masterPort))
		&slavePort=FORMAT.UDECIMAL(3.,VAR.VALUE((*((AdsppmBusBWRequestValueType *)&bwReq)).busRoute.slavePort))
		;&masterPort=VAR.STRING((AdsppmBusPortIdType)(*((AdsppmBusBWRequestValueType *)&bwReq)).busRoute.masterPort)
		;&slavePort=VAR.STRING((AdsppmBusPortIdType)(*((AdsppmBusBWRequestValueType *)&bwReq)).busRoute.slavePort)
		

        &bytesPerSec=FORMAT.UDECIMAL(10.,VAR.VALUE((*((AdsppmBusBWRequestValueType *)&reqDataExt)).bwValue.busBwValue.bwBytePerSec))
        &usagePercentage=FORMAT.DECIMAL(5.,VAR.VALUE((*((AdsppmBusBWRequestValueType *)&reqDataExt)).bwValue.busBwValue.usagePercentage))

		IF &GeneralParam==1		;Dump DDR BW
		(	
			IF (VAR.VALUE((*((AdsppmBusBWRequestValueType *)&bwReq)).busRoute.masterPort)==&BusPortQ6Master)
			(
				;AdsppmBusPort_Ddr_Slave
				IF (VAR.STRING((AdsppmBusPortIdType)(*((AdsppmBusBWRequestValueType *)&bwReq)).busRoute.slavePort)=="AdsppmBusPort_Ddr_Slave")
				(
					&output  FORMAT.STRing("&clientName",15.,' ') "CID: &clientId" FORMAT.STRing("Reg->",-10.,' ') "&bwIndexPrint    BytesPerSec &bytesPerSec" " : Usage% &usagePercentage Route: &masterPort -> &slavePort"
				)
			)
		)
		ELSE IF &GeneralParam==0
		(
			; Other than DDR BW
			IF (VAR.STRING((AdsppmBusPortIdType)(*((AdsppmBusBWRequestValueType *)&bwReq)).busRoute.slavePort)!="AdsppmBusPort_Ddr_Slave")
			(
				&output  FORMAT.STRing("&clientName",15.,' ') "CID: &clientId" FORMAT.STRing("Reg->",-10.,' ') "&bwIndexPrint    BytesPerSec &bytesPerSec" " : Usage% &usagePercentage Route: &masterPort -> &slavePort"
			)
			ELSE IF (VAR.VALUE((*((AdsppmBusBWRequestValueType *)&bwReq)).busRoute.masterPort)!=&BusPortQ6Master)
			(
				&output  FORMAT.STRing("&clientName",15.,' ') "CID: &clientId" FORMAT.STRing("BW-> ",-10.,' ') "&bwIndexPrint    BytesPerSec &bytesPerSec" " : Usage% &usagePercentage Route: &masterPort -> &slavePort"
			)
		)
    )
	RETURN

printBusMgr:
    PRIVATE &preCurrentIndex &indexToDump
    PRIVATE &masterPort &slavePort
    PRIVATE &abVal &ibVal &latVal

    IF (sYmbol.EXIST("gBusMgrCtx"))
    (
        ; General Info
        &preCurrentIndex=VAR.VALUE(gBusMgrCtx.preCurrentIndex)
        &indexToDump=&preCurrentIndex^1

        &masterPort=VAR.STRING((*(gBusMgrCtx.pExtBwAggregateData[&indexToDump])).busRoute.masterPort)
        &slavePort=VAR.STRING((*(gBusMgrCtx.pExtBwAggregateData[&indexToDump])).busRoute.slavePort)
        &abVal=FORMAT.DECIMAL(0.,VAR.VALUE((*(gBusMgrCtx.pExtBwAggregateData[&indexToDump])).bwValue.busBwAbIb.Ab))
        &ibVal=FORMAT.DECIMAL(0.,VAR.VALUE((*(gBusMgrCtx.pExtBwAggregateData[&indexToDump])).bwValue.busBwAbIb.Ib))
		&latVal=FORMAT.DECIMAL(0.,VAR.VALUE((*(gBusMgrCtx.pExtBwAggregateData[&indexToDump])).bwValue.busBwAbIb.latencyNs))
		PRINT ""
		&output  %COLOR.BLUE "Total DDR BW Aggr    AB : &abVal    IB : &ibVal    lat : &latVal"
    )
    ELSE
    (
        &err "Ignoring BusMgr dump: No such symbol"
    )
RETURN

;
;   ADSPPM MIPS requests
;
printMIPS:
    ENTRY   &client &reqNode &GeneralParam
    LOCAL   &validFlag &validFlagExt &reqData &usageType
    PRIVATE &mipsTotal &mipsPerThread
	

    &validFlag=VAR.VALUE((*((RMHandleType *)&reqNode)).validFlag)
    &validFlagExt=VAR.VALUE((*((RMHandleType *)&reqNode)).validFlag_Ext)
    &reqData=VAR.VALUE((*((RMHandleType *)&reqNode)).pRequestData)
	
    IF &validFlag==1||&validFlagExt==1
    (
	&clientId=FORMAT.DECIMAL(3.,V.VALUE((*((AdsppmClientType *)&client)).clientId))
    &clientName=DATA.STRING(D:V.VALUE((*((AdsppmClientType *)&client)).clientName))
	&usageType=VAR.VALUE((*((AdsppmQ6ClockRequestInfoType *)&reqData)).usageType)
	)

    IF &validFlag==1
    (
		IF (VAR.STRING((AdsppmQ6ClockRequestUsageType)(*((AdsppmQ6ClockRequestInfoType *)&reqData)).usageType)=="&GeneralParam")
		(
			;Adsppm_Q6ClockRequestUsageType_Mpps
			IF (VAR.STRING((AdsppmQ6ClockRequestUsageType)(*((AdsppmQ6ClockRequestInfoType *)&reqData)).usageType)=="Adsppm_Q6ClockRequestUsageType_Mpps")
			(
				&mppsTotal=FORMAT.DECIMAL(5.,VAR.VALUE((*((AdsppmQ6ClockRequestInfoType *)&reqData)).AdsppmQ6ClockRequestType.mppsRequestData.mppsTotal))
				&adspFloorClock=FORMAT.DECIMAL(5.,VAR.VALUE((*((AdsppmQ6ClockRequestInfoType *)&reqData)).AdsppmQ6ClockRequestType.mppsRequestData.adspFloorClock))
				&output  FORMAT.STRing("&clientName",15.,' ') "CID: &clientId    MPPS total &mppsTotal    ADSP floor clock &adspFloorClock"
			)
			ELSE
			(
				&mipsTotal=FORMAT.DECIMAL(5.,VAR.VALUE((*((AdsppmQ6ClockRequestInfoType *)&reqData)).AdsppmQ6ClockRequestType.mipsRequestData.mipsTotal))
				&mipsPerThread=FORMAT.DECIMAL(5.,VAR.VALUE((*((AdsppmQ6ClockRequestInfoType *)&reqData)).AdsppmQ6ClockRequestType.mipsRequestData.mipsPerThread))
				&output  FORMAT.STRing("&clientName",15.,' ') "CID: &clientId    MIPS total &mipsTotal    Mips Per Thread  &mipsPerThread"
			)
		)
    )
RETURN

printMIPSMgr:
    PRIVATE &qdsp6Clk
    IF (sYmbol.EXIST("mipsMgrCtx"))
    (
        ; MPPS Aggregate Data
        PRIVATE &totalMPPS &nDominantThreads

        &totalMPPS=FORMAT.Decimal(0.,VAR.VALUE(mipsMgrCtx.mppsAggregateData.mppsTotal))
        &nDominantThreads=FORMAT.Decimal(0.,VAR.VALUE(mipsMgrCtx.mppsAggregateData.numDominantThreads))
        &qdsp6Clk=FORMAT.DECIMAL(0.,VAR.VALUE(mipsMgrCtx.currentAggregateData.mipsToClockData.qDSP6Clock))
		PRINT ""
		&output  %COLOR.BLUE "Total MPPS Aggr    MPPS : &totalMPPS    Dominant Threads: &nDominantThreads    QDSP6_Clk : &qdsp6Clk"
    )
    ELSE
    (
        &err "Ignoring mipsMgr dump: no such symbol"
    )
RETURN

printSleep:
    IF (sYmbol.EXIST("gUSleepMgrCtx"))
    (
		PRIVATE &activeStateIndex &currActiveStateIndex
		PRIVATE &currentSleepVote &maxVoterId &currVoterIndex
		PRIVATE	&currVote

		&maxVoterId=0
		WHILE (VAR.STRING((USleepMgr_VoterIdType)&maxVoterId)!="USleepMgr_VoterId_Max")
		(
			&maxVoterId=&maxVoterId+1		;this includes USleepMgr_VoterId_None
		)
        &activeStateIndex=VAR.VALUE(gUSleepMgrCtx.activeStateIndex)
        &currActiveStateIndex=&activeStateIndex^1
		
		&currentSleepVote=VAR.VALUE((gUSleepMgrCtx.currentAggrVote[&currActiveStateIndex]))
		PRINT ""
		&output  %COLOR.BLUE "Final Sleep Vote &currentSleepVote ("+VAR.STRING((USleepMgr_VoteType)&currentSleepVote)+")"
		PRINT "----------------------------------------------------------------------------------------------"

		&currVoterIndex=0
		WHILE (&currVoterIndex<(&maxVoterId-1))
        (
			&currVote=VAR.VALUE((gUSleepMgrCtx.votes[&currVoterIndex]))
			&currVoterIndex=&currVoterIndex+1
			&output FORMAT.STRing(VAR.STRING((USleepMgr_VoterIdType)&currVoterIndex),30.,' ') ": "+VAR.STRING((USleepMgr_VoteType)&currVote)
		)
	)
	ELSE
    (
        &err "Ignoring uSleep dump: no such symbol"
    )
RETURN

printDCVSMgr:
    IF (sYmbol.EXIST("gAdsppmDcvsManager"))
    (
		PRIVATE &dcvsAdsp2DdrBwVote
		PRIVATE &abVal &ibVal &latVal

        ;&dcvsAdsp2DdrBwVote=FORMAT.Decimal(0.,VAR.VALUE(gAdsppmDcvsManager.dcvsAdsp2DdrBwVote))
		&abVal=FORMAT.DECIMAL(0.,VAR.VALUE(gAdsppmDcvsManager.dcvsAdsp2DdrBwVote.Ab))
        &ibVal=FORMAT.DECIMAL(0.,VAR.VALUE(gAdsppmDcvsManager.dcvsAdsp2DdrBwVote.Ib))
		&latVal=FORMAT.DECIMAL(0.,VAR.VALUE(gAdsppmDcvsManager.dcvsAdsp2DdrBwVote.latencyNs))
        &dcvsAdspClockVote=FORMAT.Decimal(0.,VAR.VALUE(gAdsppmDcvsManager.dcvsAdspClockVote))

		PRINT ""
		&output  %COLOR.BLUE "DCVS Vote Info    Q6 Clock :: &dcvsAdspClockVote    DDR Bw:: AB : &abVal    IB : &ibVal    lat : &latVal"
	)
	ELSE
    (
        &err "Ignoring DCVSMgr dump: no such symbol"
    )
RETURN

cleanup_exit:
    AREA.CLOSE  ; close everything since we're exiting

    IF ("&output"!="PRINT")
    (
        CLOSE #1
    )

    PRINT %COLOR.PURPLE "Exiting..."
    ENDDO